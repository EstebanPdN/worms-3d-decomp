/* Generated reference-only placements. All bodies are source-built. */
OUTPUT_FORMAT("elf32-powerpc")
OUTPUT_ARCH(powerpc)
ENTRY(w3d_auto_802df9d8)
_SDA_BASE_ = 0x804b2540;
_SDA2_BASE_ = 0x804c2540;
fn_802CDF40__Fif = 0x802cdf40;
fn_802DD10C__Fii = 0x802dd10c;
fn_802E5A4C__Fff = 0x802e5a4c;
SECTIONS {
  .text.w3d_auto_802df9d8 0x802df9d8 : { *(.text.w3d_auto_802df9d8) }
  /DISCARD/ : { *(.text*) *(.rodata*) *(.data*) *(.bss*) *(.sdata*) *(.sbss*) *(.comment) }
}
