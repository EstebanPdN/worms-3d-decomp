/* Generated reference-only placements. All bodies are source-built. */
OUTPUT_FORMAT("elf32-powerpc")
OUTPUT_ARCH(powerpc)
ENTRY(w3d_cx7b_selection_update_802c7894)
_SDA_BASE_ = 0x804b2540;
_SDA2_BASE_ = 0x804c2540;
fn_802c7a98 = 0x802c7a98;
SECTIONS {
  .text.w3d_cx7b_selection_update_802c7894 0x802c7894 : { *(.text.w3d_cx7b_selection_update_802c7894) }
  /DISCARD/ : { *(.text*) *(.rodata*) *(.data*) *(.bss*) *(.sdata*) *(.sbss*) *(.comment) }
}
