/* Generated reference-only placements. All bodies are source-built. */
OUTPUT_FORMAT("elf32-powerpc")
OUTPUT_ARCH(powerpc)
ENTRY(w3d_registry_unlink_80119fb4)
_SDA_BASE_ = 0x804b2540;
_SDA2_BASE_ = 0x804c2540;
w3d_concrete_actor_initialize = 0x80141d68;
w3d_fn_8011a0cc = 0x8011a0cc;
w3d_fn_8011a108 = 0x8011a108;
w3d_fn_8011a918 = 0x8011a918;
w3d_fn_8011aa98 = 0x8011aa98;
w3d_fn_8011bf6c = 0x8011bf6c;
w3d_fn_8011c0ac = 0x8011c0ac;
w3d_fn_8011da38 = 0x8011da38;
w3d_fn_8011dbc0 = 0x8011dbc0;
w3d_fn_8015db40 = 0x8015db40;
w3d_fn_8015dcdc = 0x8015dcdc;
w3d_global_80361320 = 0x80361320;
w3d_global_80361350 = 0x80361350;
w3d_global_80361380 = 0x80361380;
w3d_global_803616b0 = 0x803616b0;
w3d_global_803616e0 = 0x803616e0;
w3d_global_80361710 = 0x80361710;
w3d_global_80361740 = 0x80361740;
w3d_global_8039bdcc = 0x8039bdcc;
w3d_global_803a42c8 = 0x803a42c8;
w3d_global_803a4330 = 0x803a4330;
w3d_global_803a4390 = 0x803a4390;
w3d_global_803a4494 = 0x803a4494;
w3d_heap_allocate_entry_a = 0x801fe1d8;
w3d_owner_list_remove = 0x8020fd2c;
w3d_registry_list_803612f0 = 0x803612f0;
w3d_registry_list_80361320 = 0x80361320;
w3d_registry_list_80361350 = 0x80361350;
w3d_registry_list_80361380 = 0x80361380;
w3d_registry_list_803615f0 = 0x803615f0;
w3d_registry_list_80361740 = 0x80361740;
w3d_state_register = 0x8020fd04;
SECTIONS {
  .text.w3d_registry_unlink_80119fb4 0x80119fb4 : { *(.text.w3d_registry_unlink_80119fb4) }
  .text.w3d_registry_create_80119ff8 0x80119ff8 : { *(.text.w3d_registry_create_80119ff8) }
  .text.w3d_registry_release_8011a058 0x8011a058 : { *(.text.w3d_registry_release_8011a058) }
  .text.w3d_registry_retain_8011a0b4 0x8011a0b4 : { *(.text.w3d_registry_retain_8011a0b4) }
  .text.w3d_constant_8011a1c0 0x8011a1c0 : { *(.text.w3d_constant_8011a1c0) }
  .text.w3d_empty_8011a5c4 0x8011a5c4 : { *(.text.w3d_empty_8011a5c4) }
  .text.w3d_address_8011a7f4 0x8011a7f4 : { *(.text.w3d_address_8011a7f4) }
  .text.w3d_registry_unlink_8011a800 0x8011a800 : { *(.text.w3d_registry_unlink_8011a800) }
  .text.w3d_registry_create_8011a844 0x8011a844 : { *(.text.w3d_registry_create_8011a844) }
  .text.w3d_registry_release_8011a8a4 0x8011a8a4 : { *(.text.w3d_registry_release_8011a8a4) }
  .text.w3d_registry_retain_8011a900 0x8011a900 : { *(.text.w3d_registry_retain_8011a900) }
  .text.w3d_address_8011be48 0x8011be48 : { *(.text.w3d_address_8011be48) }
  .text.w3d_registry_unlink_8011be54 0x8011be54 : { *(.text.w3d_registry_unlink_8011be54) }
  .text.w3d_registry_create_8011be98 0x8011be98 : { *(.text.w3d_registry_create_8011be98) }
  .text.w3d_registry_release_8011bef8 0x8011bef8 : { *(.text.w3d_registry_release_8011bef8) }
  .text.w3d_registry_retain_8011bf54 0x8011bf54 : { *(.text.w3d_registry_retain_8011bf54) }
  .text.w3d_address_8011d914 0x8011d914 : { *(.text.w3d_address_8011d914) }
  .text.w3d_registry_unlink_8011d920 0x8011d920 : { *(.text.w3d_registry_unlink_8011d920) }
  .text.w3d_registry_create_8011d964 0x8011d964 : { *(.text.w3d_registry_create_8011d964) }
  .text.w3d_registry_release_8011d9c4 0x8011d9c4 : { *(.text.w3d_registry_release_8011d9c4) }
  .text.w3d_registry_retain_8011da20 0x8011da20 : { *(.text.w3d_registry_retain_8011da20) }
  .text.w3d_empty_8011f8fc 0x8011f8fc : { *(.text.w3d_empty_8011f8fc) }
  .text.w3d_empty_80127704 0x80127704 : { *(.text.w3d_empty_80127704) }
  .text.w3d_address_80127da4 0x80127da4 : { *(.text.w3d_address_80127da4) }
  .text.w3d_empty_80128080 0x80128080 : { *(.text.w3d_empty_80128080) }
  .text.w3d_empty_80128084 0x80128084 : { *(.text.w3d_empty_80128084) }
  .text.w3d_empty_80128f68 0x80128f68 : { *(.text.w3d_empty_80128f68) }
  .text.w3d_set_80133d64 0x80133d64 : { *(.text.w3d_set_80133d64) }
  .text.w3d_constant_80133d6c 0x80133d6c : { *(.text.w3d_constant_80133d6c) }
  .text.w3d_empty_8013c840 0x8013c840 : { *(.text.w3d_empty_8013c840) }
  .text.w3d_get_8013caf0 0x8013caf0 : { *(.text.w3d_get_8013caf0) }
  .text.w3d_set_80140d78 0x80140d78 : { *(.text.w3d_set_80140d78) }
  .text.w3d_get_80141554 0x80141554 : { *(.text.w3d_get_80141554) }
  .text.w3d_get_8014156c 0x8014156c : { *(.text.w3d_get_8014156c) }
  .text.w3d_get_80141574 0x80141574 : { *(.text.w3d_get_80141574) }
  .text.w3d_registry_create_80141c94 0x80141c94 : { *(.text.w3d_registry_create_80141c94) }
  .text.w3d_empty_8014fd34 0x8014fd34 : { *(.text.w3d_empty_8014fd34) }
  .text.w3d_empty_80152690 0x80152690 : { *(.text.w3d_empty_80152690) }
  .text.w3d_empty_8015884c 0x8015884c : { *(.text.w3d_empty_8015884c) }
  .text.w3d_get_80158dc4 0x80158dc4 : { *(.text.w3d_get_80158dc4) }
  .text.w3d_set_80158dcc 0x80158dcc : { *(.text.w3d_set_80158dcc) }
  .text.w3d_constant_801599e4 0x801599e4 : { *(.text.w3d_constant_801599e4) }
  .text.w3d_empty_80159c24 0x80159c24 : { *(.text.w3d_empty_80159c24) }
  .text.w3d_empty_8015a040 0x8015a040 : { *(.text.w3d_empty_8015a040) }
  .text.w3d_empty_8015a044 0x8015a044 : { *(.text.w3d_empty_8015a044) }
  .text.w3d_empty_8015a6e4 0x8015a6e4 : { *(.text.w3d_empty_8015a6e4) }
  .text.w3d_empty_8015a6e8 0x8015a6e8 : { *(.text.w3d_empty_8015a6e8) }
  .text.w3d_empty_8015a6ec 0x8015a6ec : { *(.text.w3d_empty_8015a6ec) }
  .text.w3d_empty_8015ab18 0x8015ab18 : { *(.text.w3d_empty_8015ab18) }
  .text.w3d_address_8015b43c 0x8015b43c : { *(.text.w3d_address_8015b43c) }
  .text.w3d_address_8015b448 0x8015b448 : { *(.text.w3d_address_8015b448) }
  .text.w3d_constant_8015b454 0x8015b454 : { *(.text.w3d_constant_8015b454) }
  .text.w3d_constant_8015b45c 0x8015b45c : { *(.text.w3d_constant_8015b45c) }
  .text.w3d_empty_8015b788 0x8015b788 : { *(.text.w3d_empty_8015b788) }
  .text.w3d_constant_8015ba60 0x8015ba60 : { *(.text.w3d_constant_8015ba60) }
  .text.w3d_constant_8015ba68 0x8015ba68 : { *(.text.w3d_constant_8015ba68) }
  .text.w3d_empty_8015bca4 0x8015bca4 : { *(.text.w3d_empty_8015bca4) }
  .text.w3d_constant_8015bca8 0x8015bca8 : { *(.text.w3d_constant_8015bca8) }
  .text.w3d_empty_8015bd04 0x8015bd04 : { *(.text.w3d_empty_8015bd04) }
  .text.w3d_address_8015bdcc 0x8015bdcc : { *(.text.w3d_address_8015bdcc) }
  .text.w3d_address_8015bdd8 0x8015bdd8 : { *(.text.w3d_address_8015bdd8) }
  .text.w3d_constant_8015bde4 0x8015bde4 : { *(.text.w3d_constant_8015bde4) }
  .text.w3d_constant_8015bdec 0x8015bdec : { *(.text.w3d_constant_8015bdec) }
  .text.w3d_empty_8015c114 0x8015c114 : { *(.text.w3d_empty_8015c114) }
  .text.w3d_constant_8015c144 0x8015c144 : { *(.text.w3d_constant_8015c144) }
  .text.w3d_constant_8015c14c 0x8015c14c : { *(.text.w3d_constant_8015c14c) }
  .text.w3d_constant_8015c2f8 0x8015c2f8 : { *(.text.w3d_constant_8015c2f8) }
  .text.w3d_address_8015c470 0x8015c470 : { *(.text.w3d_address_8015c470) }
  .text.w3d_address_8015c47c 0x8015c47c : { *(.text.w3d_address_8015c47c) }
  .text.w3d_constant_8015c488 0x8015c488 : { *(.text.w3d_constant_8015c488) }
  .text.w3d_constant_8015c490 0x8015c490 : { *(.text.w3d_constant_8015c490) }
  .text.w3d_empty_8015c990 0x8015c990 : { *(.text.w3d_empty_8015c990) }
  .text.w3d_empty_8015ca44 0x8015ca44 : { *(.text.w3d_empty_8015ca44) }
  .text.w3d_constant_8015ccf4 0x8015ccf4 : { *(.text.w3d_constant_8015ccf4) }
  .text.w3d_constant_8015ccfc 0x8015ccfc : { *(.text.w3d_constant_8015ccfc) }
  .text.w3d_address_8015d9c8 0x8015d9c8 : { *(.text.w3d_address_8015d9c8) }
  .text.w3d_registry_unlink_8015d9d4 0x8015d9d4 : { *(.text.w3d_registry_unlink_8015d9d4) }
  .text.w3d_registry_create_8015da18 0x8015da18 : { *(.text.w3d_registry_create_8015da18) }
  .text.w3d_address_8015da78 0x8015da78 : { *(.text.w3d_address_8015da78) }
  .text.w3d_registry_release_8015da84 0x8015da84 : { *(.text.w3d_registry_release_8015da84) }
  /DISCARD/ : { *(.text*) *(.rodata*) *(.data*) *(.bss*) *(.sdata*) *(.sbss*) *(.comment) }
}
