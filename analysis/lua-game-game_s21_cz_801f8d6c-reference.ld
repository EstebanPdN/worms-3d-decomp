/* Generated reference-only placements. All bodies are source-built. */
OUTPUT_FORMAT("elf32-powerpc")
OUTPUT_ARCH(powerpc)
ENTRY(w3d_s21_find_by_name_801f8d6c)
_SDA_BASE_ = 0x804b2540;
_SDA2_BASE_ = 0x804c2540;
fn_802ef074 = 0x802ef074;
SECTIONS {
  .text.w3d_s21_find_by_name_801f8d6c 0x801f8d6c : { *(.text.w3d_s21_find_by_name_801f8d6c) }
  /DISCARD/ : { *(.text*) *(.rodata*) *(.data*) *(.bss*) *(.sdata*) *(.sbss*) *(.comment) }
}
