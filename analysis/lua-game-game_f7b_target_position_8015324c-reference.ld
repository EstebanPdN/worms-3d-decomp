/* Generated reference-only placements. All bodies are source-built. */
OUTPUT_FORMAT("elf32-powerpc")
OUTPUT_ARCH(powerpc)
ENTRY(f7b_target_position_8015324c)
_SDA_BASE_ = 0x804b2540;
_SDA2_BASE_ = 0x804c2540;
__19F7TargetTranslation = 0x80343740;
axis_803a1b50 = 0x803a1b50;
cast_80342a74 = 0x80342a74;
gate_80153f38 = 0x80153f38;
get_80178df0 = 0x80178df0;
rise_803a1b4c = 0x803a1b4c;
rotate_801f7538 = 0x801f7538;
write_801262c0 = 0x801262c0;
zero_803a1b48 = 0x803a1b48;
SECTIONS {
  .text.f7b_target_position_8015324c 0x8015324c : { *(.text.f7b_target_position_8015324c) }
  /DISCARD/ : { *(.text*) *(.rodata*) *(.data*) *(.bss*) *(.sdata*) *(.sbss*) *(.comment) }
}
