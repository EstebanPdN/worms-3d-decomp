/* Generated reference-only placements. All bodies are source-built. */
OUTPUT_FORMAT("elf32-powerpc")
OUTPUT_ARCH(powerpc)
ENTRY(w3d_initialize_named_panel_802ba5c4)
_SDA_BASE_ = 0x804b2540;
_SDA2_BASE_ = 0x804c2540;
fn_800fc1b0 = 0x800fc1b0;
fn_800fd62c = 0x800fd62c;
fn_80165254 = 0x80165254;
fn_802b0b84 = 0x802b0b84;
fn_802ba710 = 0x802ba710;
fn_802ba818 = 0x802ba818;
fn_802baca0 = 0x802baca0;
SECTIONS {
  .text.w3d_initialize_named_panel_802ba5c4 0x802ba5c4 : { *(.text.w3d_initialize_named_panel_802ba5c4) }
  /DISCARD/ : { *(.text*) *(.rodata*) *(.data*) *(.bss*) *(.sdata*) *(.sbss*) *(.comment) }
}
