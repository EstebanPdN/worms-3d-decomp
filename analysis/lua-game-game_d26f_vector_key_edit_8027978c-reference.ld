/* Generated reference-only placements. All bodies are source-built. */
OUTPUT_FORMAT("elf32-powerpc")
OUTPUT_ARCH(powerpc)
ENTRY(d26f_vector_key_edit_8027978c)
_SDA_BASE_ = 0x804b2540;
_SDA2_BASE_ = 0x804c2540;
__17D26fText_803426b8 = 0x803426b8;
lbl_803cdfec = 0x803cdfec;
lbl_803ce014 = 0x803ce014;
lbl_803ce020 = 0x803ce020;
lbl_803ce594 = 0x803ce594;
lbl_803ce5b4 = 0x803ce5b4;
lbl_803ce5d4 = 0x803ce5d4;
lbl_803ce5f4 = 0x803ce5f4;
lbl_803ce5f8 = 0x803ce5f8;
lbl_803ce5fc = 0x803ce5fc;
lbl_803ce600 = 0x803ce600;
lbl_803ce604 = 0x803ce604;
w3d_auto_8027a98c = 0x8027a98c;
w3d_auto_802cbf2c = 0x802cbf2c;
w3d_cc32b_append_lines_v2_802cc0ac = 0x802cc0ac;
w3d_cx7b_script_flag_set_8027a934 = 0x8027a934;
w3d_k8c_log_float_802cc2d8 = 0x802cc2d8;
w3d_s21_append_position_802cd26c = 0x802cd26c;
w3d_s21_sink_write_indexed_802cbdf8 = 0x802cbdf8;
w3d_s21_state_dispatch_8027ae00 = 0x8027ae00;
w3d_s21_vector_get_801e9db8 = 0x801e9db8;
w3d_string_base_finish = 0x8020c5c4;
w3d_string_release = 0x80341588;
SECTIONS {
  .text.d26f_vector_key_edit_8027978c 0x8027978c : { *(.text.d26f_vector_key_edit_8027978c) }
  /DISCARD/ : { *(.text*) *(.rodata*) *(.data*) *(.bss*) *(.sdata*) *(.sbss*) *(.comment) }
}
