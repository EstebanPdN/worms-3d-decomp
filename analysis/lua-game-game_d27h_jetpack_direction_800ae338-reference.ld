/* Generated reference-only placements. All bodies are source-built. */
OUTPUT_FORMAT("elf32-powerpc")
OUTPUT_ARCH(powerpc)
ENTRY(d27h_jetpack_direction_800ae338)
_SDA_BASE_ = 0x804b2540;
_SDA2_BASE_ = 0x804c2540;
_._19Descriptor_80178474 = 0x80178474;
__3Pos = 0x80343740;
cast_80179598 = 0x80179598;
concat_801f740c = 0x801f740c;
construct_801f7538 = 0x801f7538;
g_8045e788 = 0x8045e788;
identity_80341584 = 0x80341584;
lookup_800fc1b0 = 0x800fc1b0;
part_800ae7d4 = 0x800ae7d4;
SECTIONS {
  .text.d27h_jetpack_direction_800ae338 0x800ae338 : { *(.text.d27h_jetpack_direction_800ae338) }
  .rodata 0x80382190 : { *(.rodata) }
  /DISCARD/ : { *(.text*) *(.rodata*) *(.data*) *(.bss*) *(.sdata*) *(.sbss*) *(.comment) }
}
