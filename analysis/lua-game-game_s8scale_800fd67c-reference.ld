/* Generated reference-only placements. All bodies are source-built. */
OUTPUT_FORMAT("elf32-powerpc")
OUTPUT_ARCH(powerpc)
ENTRY(s8_recovered_800fd67c)
_SDA_BASE_ = 0x804b2540;
_SDA2_BASE_ = 0x804c2540;
lbl_8044A524 = 0x8044a524;
lbl_8044A564 = 0x8044a564;
lbl_8044A574 = 0x8044a574;
lbl_8044A584 = 0x8044a584;
lbl_8044A5C4 = 0x8044a5c4;
lbl_8044A5D4 = 0x8044a5d4;
lbl_8044A5E4 = 0x8044a5e4;
SECTIONS {
  .text.s8_recovered_800fd67c 0x800fd67c : { *(.text.s8_recovered_800fd67c) }
  /DISCARD/ : { *(.text*) *(.rodata*) *(.data*) *(.bss*) *(.sdata*) *(.sbss*) *(.comment) }
}
