/* Generated reference-only placements. All bodies are source-built. */
OUTPUT_FORMAT("elf32-powerpc")
OUTPUT_ARCH(powerpc)
ENTRY(f2c_tag_init_801de524)
_SDA_BASE_ = 0x804b2540;
_SDA2_BASE_ = 0x804c2540;
lbl_803b02fc = 0x803b02fc;
lbl_80416a38 = 0x80416a38;
lbl_80416a90 = 0x80416a90;
SECTIONS {
  .text.f2c_tag_init_801de524 0x801de524 : { *(.text.f2c_tag_init_801de524) }
  /DISCARD/ : { *(.text*) *(.rodata*) *(.data*) *(.bss*) *(.sdata*) *(.sbss*) *(.comment) }
}
