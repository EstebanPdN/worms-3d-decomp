/* Generated reference-only placements. All bodies are source-built. */
OUTPUT_FORMAT("elf32-powerpc")
OUTPUT_ARCH(powerpc)
ENTRY(w3d_d28g_hud_input_state_step_8006551c)
_SDA_BASE_ = 0x804b2540;
_SDA2_BASE_ = 0x804c2540;
s8_index_query_800fc6dc = 0x800fc6dc;
w3d_auto_80065c94 = 0x80065c94;
w3d_auto_80066010 = 0x80066010;
w3d_auto_80178c48 = 0x80178c48;
w3d_auto_80178d1c = 0x80178d1c;
w3d_component_step_80065ff0 = 0x80065ff0;
w3d_cx15a_step_four_800660d4 = 0x800660d4;
w3d_fn_80066068 = 0x80066068;
w3d_timed_state_stamp_800664c4 = 0x800664c4;
SECTIONS {
  .text.w3d_d28g_hud_input_state_step_8006551c 0x8006551c : { *(.text.w3d_d28g_hud_input_state_step_8006551c) }
  /DISCARD/ : { *(.text*) *(.rodata*) *(.data*) *(.bss*) *(.sdata*) *(.sbss*) *(.comment) }
}
