/* Generated reference-only placements. All bodies are source-built. */
OUTPUT_FORMAT("elf32-powerpc")
OUTPUT_ARCH(powerpc)
ENTRY(w3d_hud_backing_refresh_8011bc28)
_SDA_BASE_ = 0x804b2540;
_SDA2_BASE_ = 0x804c2540;
w3d_empty_80343580 = 0x80343580;
w3d_empty_8034380c = 0x8034380c;
w3d_f32_8039af64 = 0x8039af64;
w3d_f32_8039af68 = 0x8039af68;
w3d_f32_8039af6c = 0x8039af6c;
w3d_f32_8039af70 = 0x8039af70;
w3d_f32_8039af74 = 0x8039af74;
w3d_f32_8039af78 = 0x8039af78;
w3d_f32_8039af7c = 0x8039af7c;
w3d_fn_80189518 = 0x80189518;
w3d_fn_8018963c = 0x8018963c;
w3d_fn_8018c8bc = 0x8018c8bc;
w3d_getf_8018ca14 = 0x8018ca14;
SECTIONS {
  .text.w3d_hud_backing_refresh_8011bc28 0x8011bc28 : { *(.text.w3d_hud_backing_refresh_8011bc28) }
  /DISCARD/ : { *(.text*) *(.rodata*) *(.data*) *(.bss*) *(.sdata*) *(.sbss*) *(.comment) }
}
