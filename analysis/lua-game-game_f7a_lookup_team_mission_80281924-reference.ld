/* Generated reference-only placements. All bodies are source-built. */
OUTPUT_FORMAT("elf32-powerpc")
OUTPUT_ARCH(powerpc)
ENTRY(w3d_f7a_lookup_team_mission_80281924)
_SDA_BASE_ = 0x804b2540;
_SDA2_BASE_ = 0x804c2540;
__7F7aTextPCc = 0x8020bb54;
failed_803cea20 = 0x803cea20;
fn_800fc1b0 = 0x800fc1b0;
fn_801797b4 = 0x801797b4;
fn_8020bb2c = 0x8020bb2c;
fn_8020bd38 = 0x8020bd38;
fn_8020c5c0 = 0x8020c5c0;
fn_8020c5c4 = 0x8020c5c4;
fn_8027befc = 0x8027befc;
fn_802ef234 = 0x802ef234;
fn_80341584 = 0x80341584;
fn_80341588 = 0x80341588;
fn_80341884 = 0x80341884;
temp_803cf080 = 0x803cf080;
SECTIONS {
  .text.w3d_f7a_lookup_team_mission_80281924 0x80281924 : { *(.text.w3d_f7a_lookup_team_mission_80281924) }
  /DISCARD/ : { *(.text*) *(.rodata*) *(.data*) *(.bss*) *(.sdata*) *(.sbss*) *(.comment) }
}
