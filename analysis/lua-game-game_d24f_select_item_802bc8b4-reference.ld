/* Generated reference-only placements. All bodies are source-built. */
OUTPUT_FORMAT("elf32-powerpc")
OUTPUT_ARCH(powerpc)
ENTRY(d24f_select_item_802bc8b4)
_SDA_BASE_ = 0x804b2540;
_SDA2_BASE_ = 0x804c2540;
w3d_auto_802bd318 = 0x802bd318;
w3d_get_802bd2bc = 0x802bd2bc;
w3d_s21_nested_value_802bc71c = 0x802bc71c;
SECTIONS {
  .text.d24f_select_item_802bc8b4 0x802bc8b4 : { *(.text.d24f_select_item_802bc8b4) }
  /DISCARD/ : { *(.text*) *(.rodata*) *(.data*) *(.bss*) *(.sdata*) *(.sbss*) *(.comment) }
}
