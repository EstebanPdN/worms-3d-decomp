/* Generated reference-only placements. All bodies are source-built. */
OUTPUT_FORMAT("elf32-powerpc")
OUTPUT_ARCH(powerpc)
ENTRY(insert_unique__Q24_STLt8_Rb_tree5Z14D43kPairRecordZ14D43kPairRecordZQ24_STLt9_Identity1Z14D43kPairRecordZQ24_STLt4less1Z14D43kPairRecordZQ24_STLt9allocator1Z14D43kPairRecordGQ24_STLt17_Rb_tree_iterator2Z14D43kPairRecordZQ24_STLt16_Nonconst_traits1Z14D43kPairRecordRC14D43kPairRecord)
_SDA_BASE_ = 0x804b2540;
_SDA2_BASE_ = 0x804c2540;
_M_insert__Q24_STLt8_Rb_tree5Z14D43kPairRecordZ14D43kPairRecordZQ24_STLt9_Identity1Z14D43kPairRecordZQ24_STLt4less1Z14D43kPairRecordZQ24_STLt9allocator1Z14D43kPairRecordPQ24_STL18_Rb_tree_node_baseT1RC14D43kPairRecordT1 = 0x80355b6c;
insert_unique__Q24_STLt8_Rb_tree5Z14D43kPairRecordZ14D43kPairRecordZQ24_STLt9_Identity1Z14D43kPairRecordZQ24_STLt4less1Z14D43kPairRecordZQ24_STLt9allocator1Z14D43kPairRecordRC14D43kPairRecord = 0x80355e40;
SECTIONS {
  .text.insert_unique__Q24_STLt8_Rb_tree5Z14D43kPairRecordZ14D43kPairRecordZQ24_STLt9_Identity1Z14D43kPairRecordZQ24_STLt4less1Z14D43kPairRecordZQ24_STLt9allocator1Z14D43kPairRecordGQ24_STLt17_Rb_tree_iterator2Z14D43kPairRecordZQ24_STLt16_Nonconst_traits1Z14D43kPairRecordRC14D43kPairRecord 0x80355fa0 : { *(.text.insert_unique__Q24_STLt8_Rb_tree5Z14D43kPairRecordZ14D43kPairRecordZQ24_STLt9_Identity1Z14D43kPairRecordZQ24_STLt4less1Z14D43kPairRecordZQ24_STLt9allocator1Z14D43kPairRecordGQ24_STLt17_Rb_tree_iterator2Z14D43kPairRecordZQ24_STLt16_Nonconst_traits1Z14D43kPairRecordRC14D43kPairRecord) }
  /DISCARD/ : { *(.text*) *(.rodata*) *(.data*) *(.bss*) *(.sdata*) *(.sbss*) *(.comment) }
}
