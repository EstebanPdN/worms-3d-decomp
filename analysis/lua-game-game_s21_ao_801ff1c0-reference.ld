/* Generated reference-only placements. All bodies are source-built. */
OUTPUT_FORMAT("elf32-powerpc")
OUTPUT_ARCH(powerpc)
ENTRY(w3d_s21_double_to_text_801ff1c0)
_SDA_BASE_ = 0x804b2540;
_SDA2_BASE_ = 0x804c2540;
fn_8020dd44 = 0x8020dd44;
SECTIONS {
  .text.w3d_s21_double_to_text_801ff1c0 0x801ff1c0 : { *(.text.w3d_s21_double_to_text_801ff1c0) }
  /DISCARD/ : { *(.text*) *(.rodata*) *(.data*) *(.bss*) *(.sdata*) *(.sbss*) *(.comment) }
}
