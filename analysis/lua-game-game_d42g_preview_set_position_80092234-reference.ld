/* Generated reference-only placements. All bodies are source-built. */
OUTPUT_FORMAT("elf32-powerpc")
OUTPUT_ARCH(powerpc)
ENTRY(d42g_preview_set_position_80092234)
_SDA_BASE_ = 0x804b2540;
_SDA2_BASE_ = 0x804c2540;
w3d_cx9c_chunk_cursor_80343bc0 = 0x80343bc0;
SECTIONS {
  .text.d42g_preview_set_position_80092234 0x80092234 : { *(.text.d42g_preview_set_position_80092234) }
  /DISCARD/ : { *(.text*) *(.rodata*) *(.data*) *(.bss*) *(.sdata*) *(.sbss*) *(.comment) }
}
