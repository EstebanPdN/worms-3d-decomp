/* Generated reference-only placements. All bodies are source-built. */
OUTPUT_FORMAT("elf32-powerpc")
OUTPUT_ARCH(powerpc)
ENTRY(s8_destroy_800deb44)
_SDA_BASE_ = 0x804b2540;
_SDA2_BASE_ = 0x804c2540;
fn_800de958 = 0x800de958;
fn_800e0400 = 0x800e0400;
fn_8020c5c4 = 0x8020c5c4;
fn_80341588 = 0x80341588;
w3d_vtable_8040ff68 = 0x8040ff68;
SECTIONS {
  .text.s8_destroy_800deb44 0x800deb44 : { *(.text.s8_destroy_800deb44) }
  /DISCARD/ : { *(.text*) *(.rodata*) *(.data*) *(.bss*) *(.sdata*) *(.sbss*) *(.comment) }
}
