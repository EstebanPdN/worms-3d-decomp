/* Generated reference-only placements. All bodies are source-built. */
OUTPUT_FORMAT("elf32-powerpc")
OUTPUT_ARCH(powerpc)
ENTRY(f2b_lerp_position_800ff97c)
_SDA_BASE_ = 0x804b2540;
_SDA2_BASE_ = 0x804c2540;
factor_80178df0 = 0x80178df0;
target_80178ec4 = 0x80178ec4;
SECTIONS {
  .text.f2b_lerp_position_800ff97c 0x800ff97c : { *(.text.f2b_lerp_position_800ff97c) }
  /DISCARD/ : { *(.text*) *(.rodata*) *(.data*) *(.bss*) *(.sdata*) *(.sbss*) *(.comment) }
}
