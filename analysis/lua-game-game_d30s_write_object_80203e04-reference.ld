/* Generated reference-only placements. All bodies are source-built. */
OUTPUT_FORMAT("elf32-powerpc")
OUTPUT_ARCH(powerpc)
ENTRY(d30s_write_object_80203e04)
_SDA_BASE_ = 0x804b2540;
_SDA2_BASE_ = 0x804c2540;
d30s_record_map_get_80205654 = 0x80205654;
insert_unique__Q24_STLt8_Rb_tree5ZP12D30sWritableZQ24_STLt4pair2ZCP12D30sWritableZiZQ24_STLt10_Select1st1ZQ24_STLt4pair2ZCP12D30sWritableZiZQ24_STLt4less1ZP12D30sWritableZQ24_STLt9allocator1ZQ24_STLt4pair2ZCP12D30sWritableZiRCQ24_STLt4pair2ZCP12D30sWritableZi = 0x8035bad8;
w3d_d28e_write_file_80204950 = 0x80204950;
w3d_s21_write_varint_80204760 = 0x80204760;
SECTIONS {
  .text.d30s_write_object_80203e04 0x80203e04 : { *(.text.d30s_write_object_80203e04) }
  /DISCARD/ : { *(.text*) *(.rodata*) *(.data*) *(.bss*) *(.sdata*) *(.sbss*) *(.comment) }
}
