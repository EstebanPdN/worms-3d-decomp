/* Generated reference-only placements. All bodies are source-built. */
OUTPUT_FORMAT("elf32-powerpc")
OUTPUT_ARCH(powerpc)
ENTRY(w3d_s20_call_handle_object_800e95e0)
_SDA_BASE_ = 0x804b2540;
_SDA2_BASE_ = 0x804c2540;
fn_80164fc8 = 0x80164fc8;
SECTIONS {
  .text.w3d_s20_call_handle_object_800e95e0 0x800e95e0 : { *(.text.w3d_s20_call_handle_object_800e95e0) }
  .text.w3d_s20_call_handle_object_800e962c 0x800e962c : { *(.text.w3d_s20_call_handle_object_800e962c) }
  /DISCARD/ : { *(.text*) *(.rodata*) *(.data*) *(.bss*) *(.sdata*) *(.sbss*) *(.comment) }
}
