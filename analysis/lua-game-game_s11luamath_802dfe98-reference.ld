/* Generated reference-only placements. All bodies are source-built. */
OUTPUT_FORMAT("elf32-powerpc")
OUTPUT_ARCH(powerpc)
ENTRY(s11_lua_extreme_802dfe98)
_SDA_BASE_ = 0x804b2540;
_SDA2_BASE_ = 0x804c2540;
fn_802CD7F4 = 0x802cd7f4;
fn_802CDF40 = 0x802cdf40;
fn_802DD10C = 0x802dd10c;
SECTIONS {
  .text.s11_lua_extreme_802dfe98 0x802dfe98 : { *(.text.s11_lua_extreme_802dfe98) }
  /DISCARD/ : { *(.text*) *(.rodata*) *(.data*) *(.bss*) *(.sdata*) *(.sbss*) *(.comment) }
}
