/* Generated reference-only placements. All bodies are source-built. */
OUTPUT_FORMAT("elf32-powerpc")
OUTPUT_ARCH(powerpc)
ENTRY(w3d_address_8019ff00)
_SDA_BASE_ = 0x804b2540;
_SDA2_BASE_ = 0x804c2540;
w3d_fn_801a0078 = 0x801a0078;
w3d_fn_801a00c4 = 0x801a00c4;
w3d_fn_801a06fc = 0x801a06fc;
w3d_fn_801a07f0 = 0x801a07f0;
w3d_fn_801a25c8 = 0x801a25c8;
w3d_fn_801a2668 = 0x801a2668;
w3d_fn_801a5334 = 0x801a5334;
w3d_fn_801a538c = 0x801a538c;
w3d_fn_801a61c0 = 0x801a61c0;
w3d_fn_801a6280 = 0x801a6280;
w3d_fn_801a7274 = 0x801a7274;
w3d_fn_801a734c = 0x801a734c;
w3d_fn_801a81c4 = 0x801a81c4;
w3d_fn_801a8adc = 0x801a8adc;
w3d_fn_801ab268 = 0x801ab268;
w3d_fn_801ab364 = 0x801ab364;
w3d_global_803622d0 = 0x803622d0;
w3d_global_80362300 = 0x80362300;
w3d_global_80362330 = 0x80362330;
w3d_global_80362360 = 0x80362360;
w3d_global_803623ac = 0x803623ac;
w3d_global_803623f8 = 0x803623f8;
w3d_global_80362444 = 0x80362444;
w3d_global_80362490 = 0x80362490;
w3d_global_803a9ac0 = 0x803a9ac0;
w3d_global_803a9aec = 0x803a9aec;
w3d_global_803a9b94 = 0x803a9b94;
w3d_global_803a9bd8 = 0x803a9bd8;
w3d_global_803a9e30 = 0x803a9e30;
w3d_global_803a9f58 = 0x803a9f58;
w3d_global_803a9fdc = 0x803a9fdc;
w3d_global_803aa0bc = 0x803aa0bc;
w3d_global_803aa270 = 0x803aa270;
w3d_heap_allocate_entry_a = 0x801fe1d8;
w3d_owner_list_remove = 0x8020fd2c;
w3d_registry_list_803622d0 = 0x803622d0;
w3d_registry_list_80362300 = 0x80362300;
w3d_registry_list_80362330 = 0x80362330;
w3d_registry_list_80362360 = 0x80362360;
w3d_registry_list_803623ac = 0x803623ac;
w3d_registry_list_803623f8 = 0x803623f8;
w3d_registry_list_80362444 = 0x80362444;
w3d_registry_list_80362490 = 0x80362490;
w3d_state_register = 0x8020fd04;
SECTIONS {
  .text.w3d_address_8019ff00 0x8019ff00 : { *(.text.w3d_address_8019ff00) }
  .text.w3d_registry_unlink_8019ff0c 0x8019ff0c : { *(.text.w3d_registry_unlink_8019ff0c) }
  .text.w3d_registry_create_8019ff50 0x8019ff50 : { *(.text.w3d_registry_create_8019ff50) }
  .text.w3d_address_8019ffb0 0x8019ffb0 : { *(.text.w3d_address_8019ffb0) }
  .text.w3d_registry_release_8019ffbc 0x8019ffbc : { *(.text.w3d_registry_release_8019ffbc) }
  .text.w3d_registry_retain_801a0018 0x801a0018 : { *(.text.w3d_registry_retain_801a0018) }
  .text.w3d_address_801a0584 0x801a0584 : { *(.text.w3d_address_801a0584) }
  .text.w3d_registry_unlink_801a0590 0x801a0590 : { *(.text.w3d_registry_unlink_801a0590) }
  .text.w3d_registry_create_801a05d4 0x801a05d4 : { *(.text.w3d_registry_create_801a05d4) }
  .text.w3d_address_801a0634 0x801a0634 : { *(.text.w3d_address_801a0634) }
  .text.w3d_registry_release_801a0640 0x801a0640 : { *(.text.w3d_registry_release_801a0640) }
  .text.w3d_registry_retain_801a069c 0x801a069c : { *(.text.w3d_registry_retain_801a069c) }
  .text.w3d_constant_801a0844 0x801a0844 : { *(.text.w3d_constant_801a0844) }
  .text.w3d_address_801a19c0 0x801a19c0 : { *(.text.w3d_address_801a19c0) }
  .text.w3d_registry_retain_801a19e0 0x801a19e0 : { *(.text.w3d_registry_retain_801a19e0) }
  .text.w3d_get_801a2420 0x801a2420 : { *(.text.w3d_get_801a2420) }
  .text.w3d_address_801a2428 0x801a2428 : { *(.text.w3d_address_801a2428) }
  .text.w3d_registry_unlink_801a2434 0x801a2434 : { *(.text.w3d_registry_unlink_801a2434) }
  .text.w3d_registry_create_801a2478 0x801a2478 : { *(.text.w3d_registry_create_801a2478) }
  .text.w3d_address_801a24d8 0x801a24d8 : { *(.text.w3d_address_801a24d8) }
  .text.w3d_registry_release_801a24e4 0x801a24e4 : { *(.text.w3d_registry_release_801a24e4) }
  .text.w3d_registry_retain_801a2540 0x801a2540 : { *(.text.w3d_registry_retain_801a2540) }
  .text.w3d_address_801a515c 0x801a515c : { *(.text.w3d_address_801a515c) }
  .text.w3d_registry_unlink_801a5168 0x801a5168 : { *(.text.w3d_registry_unlink_801a5168) }
  .text.w3d_registry_create_801a51ac 0x801a51ac : { *(.text.w3d_registry_create_801a51ac) }
  .text.w3d_get_801a5264 0x801a5264 : { *(.text.w3d_get_801a5264) }
  .text.w3d_address_801a526c 0x801a526c : { *(.text.w3d_address_801a526c) }
  .text.w3d_registry_release_801a5278 0x801a5278 : { *(.text.w3d_registry_release_801a5278) }
  .text.w3d_registry_retain_801a52d4 0x801a52d4 : { *(.text.w3d_registry_retain_801a52d4) }
  .text.w3d_constant_801a555c 0x801a555c : { *(.text.w3d_constant_801a555c) }
  .text.w3d_get_801a55cc 0x801a55cc : { *(.text.w3d_get_801a55cc) }
  .text.w3d_get_801a55e0 0x801a55e0 : { *(.text.w3d_get_801a55e0) }
  .text.w3d_address_801a5fe8 0x801a5fe8 : { *(.text.w3d_address_801a5fe8) }
  .text.w3d_registry_unlink_801a5ff4 0x801a5ff4 : { *(.text.w3d_registry_unlink_801a5ff4) }
  .text.w3d_registry_create_801a6038 0x801a6038 : { *(.text.w3d_registry_create_801a6038) }
  .text.w3d_get_801a60f0 0x801a60f0 : { *(.text.w3d_get_801a60f0) }
  .text.w3d_address_801a60f8 0x801a60f8 : { *(.text.w3d_address_801a60f8) }
  .text.w3d_registry_release_801a6104 0x801a6104 : { *(.text.w3d_registry_release_801a6104) }
  .text.w3d_registry_retain_801a6160 0x801a6160 : { *(.text.w3d_registry_retain_801a6160) }
  .text.w3d_get_801a6528 0x801a6528 : { *(.text.w3d_get_801a6528) }
  .text.w3d_get_801a653c 0x801a653c : { *(.text.w3d_get_801a653c) }
  .text.w3d_get_801a6544 0x801a6544 : { *(.text.w3d_get_801a6544) }
  .text.w3d_address_801a709c 0x801a709c : { *(.text.w3d_address_801a709c) }
  .text.w3d_registry_unlink_801a70a8 0x801a70a8 : { *(.text.w3d_registry_unlink_801a70a8) }
  .text.w3d_registry_create_801a70ec 0x801a70ec : { *(.text.w3d_registry_create_801a70ec) }
  .text.w3d_get_801a71a4 0x801a71a4 : { *(.text.w3d_get_801a71a4) }
  .text.w3d_address_801a71ac 0x801a71ac : { *(.text.w3d_address_801a71ac) }
  .text.w3d_registry_release_801a71b8 0x801a71b8 : { *(.text.w3d_registry_release_801a71b8) }
  .text.w3d_registry_retain_801a7214 0x801a7214 : { *(.text.w3d_registry_retain_801a7214) }
  .text.w3d_constant_801a75fc 0x801a75fc : { *(.text.w3d_constant_801a75fc) }
  .text.w3d_get_801a7678 0x801a7678 : { *(.text.w3d_get_801a7678) }
  .text.w3d_address_801a7fc0 0x801a7fc0 : { *(.text.w3d_address_801a7fc0) }
  .text.w3d_registry_unlink_801a7fcc 0x801a7fcc : { *(.text.w3d_registry_unlink_801a7fcc) }
  .text.w3d_registry_create_801a8010 0x801a8010 : { *(.text.w3d_registry_create_801a8010) }
  .text.w3d_get_801a80c8 0x801a80c8 : { *(.text.w3d_get_801a80c8) }
  .text.w3d_address_801a80d0 0x801a80d0 : { *(.text.w3d_address_801a80d0) }
  .text.w3d_registry_release_801a80dc 0x801a80dc : { *(.text.w3d_registry_release_801a80dc) }
  .text.w3d_registry_retain_801a8138 0x801a8138 : { *(.text.w3d_registry_retain_801a8138) }
  .text.w3d_get_801a92c0 0x801a92c0 : { *(.text.w3d_get_801a92c0) }
  .text.w3d_constant_801a9364 0x801a9364 : { *(.text.w3d_constant_801a9364) }
  .text.w3d_address_801ab090 0x801ab090 : { *(.text.w3d_address_801ab090) }
  .text.w3d_registry_unlink_801ab09c 0x801ab09c : { *(.text.w3d_registry_unlink_801ab09c) }
  .text.w3d_registry_create_801ab0e0 0x801ab0e0 : { *(.text.w3d_registry_create_801ab0e0) }
  .text.w3d_get_801ab198 0x801ab198 : { *(.text.w3d_get_801ab198) }
  .text.w3d_address_801ab1a0 0x801ab1a0 : { *(.text.w3d_address_801ab1a0) }
  .text.w3d_registry_release_801ab1ac 0x801ab1ac : { *(.text.w3d_registry_release_801ab1ac) }
  .text.w3d_registry_retain_801ab208 0x801ab208 : { *(.text.w3d_registry_retain_801ab208) }
  .text.w3d_constant_801ab550 0x801ab550 : { *(.text.w3d_constant_801ab550) }
  .text.w3d_get_801ab5c0 0x801ab5c0 : { *(.text.w3d_get_801ab5c0) }
  .text.w3d_get_801ab5d4 0x801ab5d4 : { *(.text.w3d_get_801ab5d4) }
  .text.w3d_get_801ab5e8 0x801ab5e8 : { *(.text.w3d_get_801ab5e8) }
  .text.w3d_get_801ab788 0x801ab788 : { *(.text.w3d_get_801ab788) }
  .text.w3d_get_801ab79c 0x801ab79c : { *(.text.w3d_get_801ab79c) }
  .text.w3d_get_801ab7b0 0x801ab7b0 : { *(.text.w3d_get_801ab7b0) }
  .text.w3d_get_801ab7c4 0x801ab7c4 : { *(.text.w3d_get_801ab7c4) }
  .text.w3d_get_801ab7d8 0x801ab7d8 : { *(.text.w3d_get_801ab7d8) }
  .text.w3d_get_801ab7ec 0x801ab7ec : { *(.text.w3d_get_801ab7ec) }
  .text.w3d_get_801ab800 0x801ab800 : { *(.text.w3d_get_801ab800) }
  .text.w3d_get_801ab814 0x801ab814 : { *(.text.w3d_get_801ab814) }
  .text.w3d_get_801ab828 0x801ab828 : { *(.text.w3d_get_801ab828) }
  /DISCARD/ : { *(.text*) *(.rodata*) *(.data*) *(.bss*) *(.sdata*) *(.sbss*) *(.comment) }
}
