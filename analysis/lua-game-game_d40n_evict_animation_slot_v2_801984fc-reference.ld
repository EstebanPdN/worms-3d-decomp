/* Generated reference-only placements. All bodies are source-built. */
OUTPUT_FORMAT("elf32-powerpc")
OUTPUT_ARCH(powerpc)
ENTRY(w3d_d40n_evict_animation_slot_v2_801984fc)
_SDA_BASE_ = 0x804b2540;
_SDA2_BASE_ = 0x804c2540;
fn_80197f98 = 0x80197f98;
fn_801981f8 = 0x801981f8;
fn_802fb7ac = 0x802fb7ac;
fn_80343810 = 0x80343810;
msg_803a85a0 = 0x803a85a0;
msg_803a85d8 = 0x803a85d8;
msg_803a8610 = 0x803a8610;
msg_803a8630 = 0x803a8630;
msg_803a8650 = 0x803a8650;
SECTIONS {
  .text.w3d_d40n_evict_animation_slot_v2_801984fc 0x801984fc : { *(.text.w3d_d40n_evict_animation_slot_v2_801984fc) }
  /DISCARD/ : { *(.text*) *(.rodata*) *(.data*) *(.bss*) *(.sdata*) *(.sbss*) *(.comment) }
}
