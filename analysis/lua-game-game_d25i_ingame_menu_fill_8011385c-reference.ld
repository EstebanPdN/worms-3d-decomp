/* Generated reference-only placements. All bodies are source-built. */
OUTPUT_FORMAT("elf32-powerpc")
OUTPUT_ARCH(powerpc)
ENTRY(d25i_ingame_menu_fill_8011385c)
_SDA_BASE_ = 0x804b2540;
_SDA2_BASE_ = 0x804c2540;
_._19Descriptor_80178474 = 0x80178474;
__6StringPCc = 0x8020bb54;
array_lock_801ef048 = 0x801ef048;
as_table_80341584 = 0x80341584;
class_80419e68 = 0x80419e68;
create_8020b680 = 0x8020b680;
list_append_801ef174 = 0x801ef174;
list_begin_801ef380 = 0x801ef380;
n_8039a630 = 0x8039a630;
n_8039a644 = 0x8039a644;
n_8039a650 = 0x8039a650;
n_8039a658 = 0x8039a658;
n_8039a668 = 0x8039a668;
n_8039a680 = 0x8039a680;
n_8039a68c = 0x8039a68c;
n_8039a6c0 = 0x8039a6c0;
n_8039a6d0 = 0x8039a6d0;
read_key_800fc2b0 = 0x800fc2b0;
strcmp_802ef234 = 0x802ef234;
string_assign_8020bd38 = 0x8020bd38;
string_finish_8020c5c4 = 0x8020c5c4;
string_release_80341588 = 0x80341588;
table_get_80179598 = 0x80179598;
SECTIONS {
  .text.d25i_ingame_menu_fill_8011385c 0x8011385c : { *(.text.d25i_ingame_menu_fill_8011385c) }
  /DISCARD/ : { *(.text*) *(.rodata*) *(.data*) *(.bss*) *(.sdata*) *(.sbss*) *(.comment) }
}
