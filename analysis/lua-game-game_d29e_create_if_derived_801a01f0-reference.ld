/* Generated reference-only placements. All bodies are source-built. */
OUTPUT_FORMAT("elf32-powerpc")
OUTPUT_ARCH(powerpc)
ENTRY(w3d_d29e_create_if_derived_801a01f0)
_SDA_BASE_ = 0x804b2540;
_SDA2_BASE_ = 0x804c2540;
lbl_804138b0 = 0x804138b0;
w3d_auto_8020b648 = 0x8020b648;
SECTIONS {
  .text.w3d_d29e_create_if_derived_801a01f0 0x801a01f0 : { *(.text.w3d_d29e_create_if_derived_801a01f0) }
  /DISCARD/ : { *(.text*) *(.rodata*) *(.data*) *(.bss*) *(.sdata*) *(.sbss*) *(.comment) }
}
