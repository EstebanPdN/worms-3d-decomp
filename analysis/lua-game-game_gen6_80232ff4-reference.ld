/* Generated reference-only placements. All bodies are source-built. */
OUTPUT_FORMAT("elf32-powerpc")
OUTPUT_ARCH(powerpc)
ENTRY(w3d_member_80232ff4)
_SDA_BASE_ = 0x804b2540;
_SDA2_BASE_ = 0x804c2540;
SECTIONS {
  .text.w3d_member_80232ff4 0x80232ff4 : { *(.text.w3d_member_80232ff4) }
  .text.w3d_member_80233064 0x80233064 : { *(.text.w3d_member_80233064) }
  .text.w3d_member_80233104 0x80233104 : { *(.text.w3d_member_80233104) }
  .text.w3d_member_80233174 0x80233174 : { *(.text.w3d_member_80233174) }
  .text.w3d_member_802331f4 0x802331f4 : { *(.text.w3d_member_802331f4) }
  .text.w3d_member_80233264 0x80233264 : { *(.text.w3d_member_80233264) }
  .text.w3d_member_802332d4 0x802332d4 : { *(.text.w3d_member_802332d4) }
  .text.w3d_member_80233344 0x80233344 : { *(.text.w3d_member_80233344) }
  .text.w3d_member_802333b4 0x802333b4 : { *(.text.w3d_member_802333b4) }
  .text.w3d_member_80233424 0x80233424 : { *(.text.w3d_member_80233424) }
  .text.w3d_member_802334c4 0x802334c4 : { *(.text.w3d_member_802334c4) }
  .text.w3d_member_80233534 0x80233534 : { *(.text.w3d_member_80233534) }
  .text.w3d_member_802335d4 0x802335d4 : { *(.text.w3d_member_802335d4) }
  .text.w3d_member_80233654 0x80233654 : { *(.text.w3d_member_80233654) }
  .text.w3d_member_802336d4 0x802336d4 : { *(.text.w3d_member_802336d4) }
  .text.w3d_member_80233794 0x80233794 : { *(.text.w3d_member_80233794) }
  .text.w3d_member_80233814 0x80233814 : { *(.text.w3d_member_80233814) }
  .text.w3d_member_802350ac 0x802350ac : { *(.text.w3d_member_802350ac) }
  .text.w3d_member_8023511c 0x8023511c : { *(.text.w3d_member_8023511c) }
  .text.w3d_member_8023518c 0x8023518c : { *(.text.w3d_member_8023518c) }
  .text.w3d_member_802351fc 0x802351fc : { *(.text.w3d_member_802351fc) }
  .text.w3d_member_8023526c 0x8023526c : { *(.text.w3d_member_8023526c) }
  .text.w3d_member_802352ec 0x802352ec : { *(.text.w3d_member_802352ec) }
  .text.w3d_member_8023535c 0x8023535c : { *(.text.w3d_member_8023535c) }
  .text.w3d_member_802353cc 0x802353cc : { *(.text.w3d_member_802353cc) }
  .text.w3d_member_8023544c 0x8023544c : { *(.text.w3d_member_8023544c) }
  .text.w3d_member_802354bc 0x802354bc : { *(.text.w3d_member_802354bc) }
  .text.w3d_member_8023552c 0x8023552c : { *(.text.w3d_member_8023552c) }
  .text.w3d_member_8023559c 0x8023559c : { *(.text.w3d_member_8023559c) }
  .text.w3d_member_8023560c 0x8023560c : { *(.text.w3d_member_8023560c) }
  .text.w3d_member_8023567c 0x8023567c : { *(.text.w3d_member_8023567c) }
  .text.w3d_member_802356ec 0x802356ec : { *(.text.w3d_member_802356ec) }
  .text.w3d_member_8023576c 0x8023576c : { *(.text.w3d_member_8023576c) }
  .text.w3d_member_802357dc 0x802357dc : { *(.text.w3d_member_802357dc) }
  .text.w3d_member_8023585c 0x8023585c : { *(.text.w3d_member_8023585c) }
  .text.w3d_setf_80235874 0x80235874 : { *(.text.w3d_setf_80235874) }
  .text.w3d_getf_8023587c 0x8023587c : { *(.text.w3d_getf_8023587c) }
  .text.w3d_setf_80235884 0x80235884 : { *(.text.w3d_setf_80235884) }
  .text.w3d_getf_8023588c 0x8023588c : { *(.text.w3d_getf_8023588c) }
  .text.w3d_member_80238660 0x80238660 : { *(.text.w3d_member_80238660) }
  .text.w3d_member_802386d0 0x802386d0 : { *(.text.w3d_member_802386d0) }
  .text.w3d_member_802387bc 0x802387bc : { *(.text.w3d_member_802387bc) }
  .text.w3d_member_8023882c 0x8023882c : { *(.text.w3d_member_8023882c) }
  .text.w3d_member_8023889c 0x8023889c : { *(.text.w3d_member_8023889c) }
  .text.w3d_member_8023896c 0x8023896c : { *(.text.w3d_member_8023896c) }
  .text.w3d_member_80238a1c 0x80238a1c : { *(.text.w3d_member_80238a1c) }
  .text.w3d_member_80238a8c 0x80238a8c : { *(.text.w3d_member_80238a8c) }
  .text.w3d_member_80238b4c 0x80238b4c : { *(.text.w3d_member_80238b4c) }
  .text.w3d_member_80238bbc 0x80238bbc : { *(.text.w3d_member_80238bbc) }
  .text.w3d_member_80238c2c 0x80238c2c : { *(.text.w3d_member_80238c2c) }
  .text.w3d_member_80238c9c 0x80238c9c : { *(.text.w3d_member_80238c9c) }
  .text.w3d_member_80249a44 0x80249a44 : { *(.text.w3d_member_80249a44) }
  .text.w3d_member_80249b74 0x80249b74 : { *(.text.w3d_member_80249b74) }
  .text.w3d_member_80249c14 0x80249c14 : { *(.text.w3d_member_80249c14) }
  .text.w3d_member_80249c94 0x80249c94 : { *(.text.w3d_member_80249c94) }
  .text.w3d_member_80249d04 0x80249d04 : { *(.text.w3d_member_80249d04) }
  .text.w3d_copy12_80249d0c 0x80249d0c : { *(.text.w3d_copy12_80249d0c) }
  .text.w3d_member_80249d2c 0x80249d2c : { *(.text.w3d_member_80249d2c) }
  .text.w3d_copy12_80249d34 0x80249d34 : { *(.text.w3d_copy12_80249d34) }
  .text.w3d_member_80249d54 0x80249d54 : { *(.text.w3d_member_80249d54) }
  .text.w3d_copy12_80249dec 0x80249dec : { *(.text.w3d_copy12_80249dec) }
  .text.w3d_member_80249e0c 0x80249e0c : { *(.text.w3d_member_80249e0c) }
  .text.w3d_copy12_80249e14 0x80249e14 : { *(.text.w3d_copy12_80249e14) }
  .text.w3d_member_80249e34 0x80249e34 : { *(.text.w3d_member_80249e34) }
  .text.w3d_member_80249ea4 0x80249ea4 : { *(.text.w3d_member_80249ea4) }
  .text.w3d_member_80249f14 0x80249f14 : { *(.text.w3d_member_80249f14) }
  .text.w3d_member_80249f94 0x80249f94 : { *(.text.w3d_member_80249f94) }
  .text.w3d_member_80249fd0 0x80249fd0 : { *(.text.w3d_member_80249fd0) }
  .text.w3d_copy12_80249fe8 0x80249fe8 : { *(.text.w3d_copy12_80249fe8) }
  .text.w3d_member_8024a008 0x8024a008 : { *(.text.w3d_member_8024a008) }
  .text.w3d_copy12_8024a010 0x8024a010 : { *(.text.w3d_copy12_8024a010) }
  .text.w3d_member_8024a030 0x8024a030 : { *(.text.w3d_member_8024a030) }
  .text.w3d_copy12_8024a038 0x8024a038 : { *(.text.w3d_copy12_8024a038) }
  .text.w3d_member_8024a058 0x8024a058 : { *(.text.w3d_member_8024a058) }
  .text.w3d_copy12_8024a060 0x8024a060 : { *(.text.w3d_copy12_8024a060) }
  .text.w3d_member_8024a080 0x8024a080 : { *(.text.w3d_member_8024a080) }
  .text.w3d_setf_8024a088 0x8024a088 : { *(.text.w3d_setf_8024a088) }
  .text.w3d_getf_8024a090 0x8024a090 : { *(.text.w3d_getf_8024a090) }
  .text.w3d_setf_8024a0a8 0x8024a0a8 : { *(.text.w3d_setf_8024a0a8) }
  .text.w3d_getf_8024a0b0 0x8024a0b0 : { *(.text.w3d_getf_8024a0b0) }
  /DISCARD/ : { *(.text*) *(.rodata*) *(.data*) *(.bss*) *(.sdata*) *(.sbss*) *(.comment) }
}
