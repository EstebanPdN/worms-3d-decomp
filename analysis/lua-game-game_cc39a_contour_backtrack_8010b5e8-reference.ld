/* Generated reference-only placements. All bodies are source-built. */
OUTPUT_FORMAT("elf32-powerpc")
OUTPUT_ARCH(powerpc)
ENTRY(cc39a_contour_backtrack_8010b5e8)
_SDA_BASE_ = 0x804b2540;
_SDA2_BASE_ = 0x804c2540;
cc39a_cell_8010b560 = 0x8010b560;
cc39a_dx_80399ec8 = 0x80399ec8;
cc39a_dy_80399ed8 = 0x80399ed8;
cc39a_inside_8010b594 = 0x8010b594;
cc39a_marks_8044c9ec = 0x8044c9ec;
cc39a_start_80399ee8 = 0x80399ee8;
cc39a_turn_80399e88 = 0x80399e88;
SECTIONS {
  .text.cc39a_contour_backtrack_8010b5e8 0x8010b5e8 : { *(.text.cc39a_contour_backtrack_8010b5e8) }
  /DISCARD/ : { *(.text*) *(.rodata*) *(.data*) *(.bss*) *(.sdata*) *(.sbss*) *(.comment) }
}
