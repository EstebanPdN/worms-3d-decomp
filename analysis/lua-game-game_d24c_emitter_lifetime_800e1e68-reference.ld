/* Generated reference-only placements. All bodies are source-built. */
OUTPUT_FORMAT("elf32-powerpc")
OUTPUT_ARCH(powerpc)
ENTRY(d24c_emitter_lifetime_800e1e68)
_SDA_BASE_ = 0x804b2540;
_SDA2_BASE_ = 0x804c2540;
identity_80341584 = 0x80341584;
remove_8015fd1c = 0x8015fd1c;
settings_801797b4 = 0x801797b4;
SECTIONS {
  .text.d24c_emitter_lifetime_800e1e68 0x800e1e68 : { *(.text.d24c_emitter_lifetime_800e1e68) }
  /DISCARD/ : { *(.text*) *(.rodata*) *(.data*) *(.bss*) *(.sdata*) *(.sbss*) *(.comment) }
}
