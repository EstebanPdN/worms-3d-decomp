/* Generated reference-only placements. All bodies are source-built. */
OUTPUT_FORMAT("elf32-powerpc")
OUTPUT_ARCH(powerpc)
ENTRY(d30s_guid_map_release_last_802124b4)
_SDA_BASE_ = 0x804b2540;
_SDA2_BASE_ = 0x804c2540;
erase__Q24_STLt9hashtable6ZQ24_STLt4pair2ZC11D30sGuidKeyZP9D30sIfaceZ11D30sGuidKeyZ12D30sGuidHashZQ24_STLt10_Select1st1ZQ24_STLt4pair2ZC11D30sGuidKeyZP9D30sIfaceZ10D30sGuidEqZQ24_STLt9allocator1ZQ24_STLt4pair2ZC11D30sGuidKeyZP9D30sIfaceRCQ24_STLt12_Ht_iterator7ZQ24_STLt4pair2ZC11D30sGuidKeyZP9D30sIfaceZQ24_STLt13_Const_traits1ZQ24_STLt4pair2ZC11D30sGuidKeyZP9D30sIfaceZ11D30sGuidKeyZ12D30sGuidHashZQ24_STLt10_Select1st1ZQ24_STLt4pair2ZC11D30sGuidKeyZP9D30sIfaceZ10D30sGuidEqZQ24_STLt9allocator1ZQ24_STLt4pair2ZC11D30sGuidKeyZP9D30sIface = 0x8035c8c8;
memcmp = 0x802eedc0;
SECTIONS {
  .text.d30s_guid_map_release_last_802124b4 0x802124b4 : { *(.text.d30s_guid_map_release_last_802124b4) }
  /DISCARD/ : { *(.text*) *(.rodata*) *(.data*) *(.bss*) *(.sdata*) *(.sbss*) *(.comment) }
}
