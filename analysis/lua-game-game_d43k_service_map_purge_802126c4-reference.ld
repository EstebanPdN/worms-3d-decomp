/* Generated reference-only placements. All bodies are source-built. */
OUTPUT_FORMAT("elf32-powerpc")
OUTPUT_ARCH(powerpc)
ENTRY(w3d_d43k_service_map_purge_802126c4)
_SDA_BASE_ = 0x804b2540;
_SDA2_BASE_ = 0x804c2540;
_M_copy_from__Q24_STLt9hashtable6ZQ24_STLt4pair2ZC11D30sGuidKeyZP9D30sIfaceZ11D30sGuidKeyZ12D30sGuidHashZQ24_STLt10_Select1st1ZQ24_STLt4pair2ZC11D30sGuidKeyZP9D30sIfaceZ10D30sGuidEqZQ24_STLt9allocator1ZQ24_STLt4pair2ZC11D30sGuidKeyZP9D30sIfaceRCQ24_STLt9hashtable6ZQ24_STLt4pair2ZC11D30sGuidKeyZP9D30sIfaceZ11D30sGuidKeyZ12D30sGuidHashZQ24_STLt10_Select1st1ZQ24_STLt4pair2ZC11D30sGuidKeyZP9D30sIfaceZ10D30sGuidEqZQ24_STLt9allocator1ZQ24_STLt4pair2ZC11D30sGuidKeyZP9D30sIface = 0x8035ded0;
_M_insert__Q24_STLt9hashtable6ZQ24_STLt4pair2ZC11D30sGuidKeyZP9D30sIfaceZ11D30sGuidKeyZ12D30sGuidHashZQ24_STLt10_Select1st1ZQ24_STLt4pair2ZC11D30sGuidKeyZP9D30sIfaceZ10D30sGuidEqZQ24_STLt9allocator1ZQ24_STLt4pair2ZC11D30sGuidKeyZP9D30sIfaceRCQ24_STLt4pair2ZC11D30sGuidKeyZP9D30sIface = 0x8035c75c;
__Q24_STLt8hash_map5Z11D30sGuidKeyZP9D30sIfaceZ12D30sGuidHashZ10D30sGuidEqZQ24_STLt9allocator1ZQ24_STLt4pair2ZC11D30sGuidKeyZP9D30sIface = 0x8035e070;
clear__Q24_STLt9hashtable6ZQ24_STLt4pair2ZC11D30sGuidKeyZP9D30sIfaceZ11D30sGuidKeyZ12D30sGuidHashZQ24_STLt10_Select1st1ZQ24_STLt4pair2ZC11D30sGuidKeyZP9D30sIfaceZ10D30sGuidEqZQ24_STLt9allocator1ZQ24_STLt4pair2ZC11D30sGuidKeyZP9D30sIface = 0x8035c81c;
free = 0x802134fc;
memcmp = 0x802eedc0;
SECTIONS {
  .text.w3d_d43k_service_map_purge_802126c4 0x802126c4 : { *(.text.w3d_d43k_service_map_purge_802126c4) }
  /DISCARD/ : { *(.text*) *(.rodata*) *(.data*) *(.bss*) *(.sdata*) *(.sbss*) *(.comment) }
}
