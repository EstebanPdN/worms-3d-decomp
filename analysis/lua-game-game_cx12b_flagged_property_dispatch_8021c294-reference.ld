/* Generated reference-only placements. All bodies are source-built. */
OUTPUT_FORMAT("elf32-powerpc")
OUTPUT_ARCH(powerpc)
ENTRY(w3d_cx12b_flagged_property_dispatch_8021c294)
_SDA_BASE_ = 0x804b2540;
_SDA2_BASE_ = 0x804c2540;
descriptor_8041aac8 = 0x8041aac8;
dispatch_8021e930 = 0x8021e930;
flags_80240b84 = 0x80240b84;
lookup_8020b680 = 0x8020b680;
SECTIONS {
  .text.w3d_cx12b_flagged_property_dispatch_8021c294 0x8021c294 : { *(.text.w3d_cx12b_flagged_property_dispatch_8021c294) }
  /DISCARD/ : { *(.text*) *(.rodata*) *(.data*) *(.bss*) *(.sdata*) *(.sbss*) *(.comment) }
}
