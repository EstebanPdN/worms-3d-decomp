/* Generated reference-only placements. All bodies are source-built. */
OUTPUT_FORMAT("elf32-powerpc")
OUTPUT_ARCH(powerpc)
ENTRY(w3d_cx16c_probe_stream_open_8021d8b4)
_SDA_BASE_ = 0x804b2540;
_SDA2_BASE_ = 0x804c2540;
cx16c_construct_80207fec = 0x80207fec;
cx16c_destroy_8020803c = 0x8020803c;
cx16c_open_802080a0 = 0x802080a0;
cx16c_release_8020810c = 0x8020810c;
SECTIONS {
  .text.w3d_cx16c_probe_stream_open_8021d8b4 0x8021d8b4 : { *(.text.w3d_cx16c_probe_stream_open_8021d8b4) }
  /DISCARD/ : { *(.text*) *(.rodata*) *(.data*) *(.bss*) *(.sdata*) *(.sbss*) *(.comment) }
}
