/* Generated reference-only placements. All bodies are source-built. */
OUTPUT_FORMAT("elf32-powerpc")
OUTPUT_ARCH(powerpc)
ENTRY(f3c_tag_init_801e81c8)
_SDA_BASE_ = 0x804b2540;
_SDA2_BASE_ = 0x804c2540;
fn_8020fcb4 = 0x8020fcb4;
lbl_803657d8 = 0x803657d8;
SECTIONS {
  .text.f3c_tag_init_801e81c8 0x801e81c8 : { *(.text.f3c_tag_init_801e81c8) }
  /DISCARD/ : { *(.text*) *(.rodata*) *(.data*) *(.bss*) *(.sdata*) *(.sbss*) *(.comment) }
}
