/* Generated reference-only placements. All bodies are source-built. */
OUTPUT_FORMAT("elf32-powerpc")
OUTPUT_ARCH(powerpc)
ENTRY(w3d_d24e_build_view_matrix_801a1008)
_SDA_BASE_ = 0x804b2540;
_SDA2_BASE_ = 0x804c2540;
fn_801a0cf4 = 0x801a0cf4;
SECTIONS {
  .text.w3d_d24e_build_view_matrix_801a1008 0x801a1008 : { *(.text.w3d_d24e_build_view_matrix_801a1008) }
  /DISCARD/ : { *(.text*) *(.rodata*) *(.data*) *(.bss*) *(.sdata*) *(.sbss*) *(.comment) }
}
