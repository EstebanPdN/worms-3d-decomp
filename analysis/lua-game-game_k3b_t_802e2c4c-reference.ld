/* Generated reference-only placements. All bodies are source-built. */
OUTPUT_FORMAT("elf32-powerpc")
OUTPUT_ARCH(powerpc)
ENTRY(w3d_k3b_tagged_construct_802e2c4c)
_SDA_BASE_ = 0x804b2540;
_SDA2_BASE_ = 0x804c2540;
w3d_vtable_8041ca60 = 0x8041ca60;
w3d_vtable_8041cab8 = 0x8041cab8;
SECTIONS {
  .text.w3d_k3b_tagged_construct_802e2c4c 0x802e2c4c : { *(.text.w3d_k3b_tagged_construct_802e2c4c) }
  /DISCARD/ : { *(.text*) *(.rodata*) *(.data*) *(.bss*) *(.sdata*) *(.sbss*) *(.comment) }
}
