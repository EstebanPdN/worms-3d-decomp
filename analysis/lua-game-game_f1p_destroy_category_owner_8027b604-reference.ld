/* Generated reference-only placements. All bodies are source-built. */
OUTPUT_FORMAT("elf32-powerpc")
OUTPUT_ARCH(powerpc)
ENTRY(_._16F1pCategoryOwner)
_SDA_BASE_ = 0x804b2540;
_SDA2_BASE_ = 0x804c2540;
_._24F1pCategoryBase_801628ec = 0x801628ec;
fn_8020c5c4 = 0x8020c5c4;
fn_802134fc = 0x802134fc;
fn_80341588 = 0x80341588;
vt_8041bec0 = 0x8041bec0;
SECTIONS {
  .text._._16F1pCategoryOwner 0x8027b604 : { *(.text._._16F1pCategoryOwner) }
  /DISCARD/ : { *(.text*) *(.rodata*) *(.data*) *(.bss*) *(.sdata*) *(.sbss*) *(.comment) }
}
