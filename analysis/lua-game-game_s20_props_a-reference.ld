/* Generated reference-only placements. All bodies are source-built. */
OUTPUT_FORMAT("elf32-powerpc")
OUTPUT_ARCH(powerpc)
ENTRY(w3d_s20_register_vector_property_8018ec60)
_SDA_BASE_ = 0x804b2540;
_SDA2_BASE_ = 0x804c2540;
fn_801e8d9c = 0x801e8d9c;
fn_801f0210 = 0x801f0210;
fn_801f15e0 = 0x801f15e0;
lbl_803a8078 = 0x803a8078;
lbl_803a809c = 0x803a809c;
lbl_803a80c4 = 0x803a80c4;
SECTIONS {
  .text.w3d_s20_register_vector_property_8018ec60 0x8018ec60 : { *(.text.w3d_s20_register_vector_property_8018ec60) }
  .text.w3d_s20_register_color_property_8018efe0 0x8018efe0 : { *(.text.w3d_s20_register_color_property_8018efe0) }
  /DISCARD/ : { *(.text*) *(.rodata*) *(.data*) *(.bss*) *(.sdata*) *(.sbss*) *(.comment) }
}
