/* Generated reference-only placements. All bodies are source-built. */
OUTPUT_FORMAT("elf32-powerpc")
OUTPUT_ARCH(powerpc)
ENTRY(cc24a_planner_bomber_probe_8000a9ac)
_SDA_BASE_ = 0x804b2540;
_SDA2_BASE_ = 0x804c2540;
cc24a_apply_8001a7f8 = 0x8001a7f8;
cc24a_lookup_80341694 = 0x80341694;
cc24a_prepare_8002f098 = 0x8002f098;
cc24a_probe_8001b8f0 = 0x8001b8f0;
cc24a_target_8041e85c = 0x8041e85c;
cc24a_threshold_80369be4 = 0x80369be4;
cc24a_velocity_8002f2d8 = 0x8002f2d8;
SECTIONS {
  .text.cc24a_planner_bomber_probe_8000a9ac 0x8000a9ac : { *(.text.cc24a_planner_bomber_probe_8000a9ac) }
  /DISCARD/ : { *(.text*) *(.rodata*) *(.data*) *(.bss*) *(.sdata*) *(.sbss*) *(.comment) }
}
