/* Generated reference-only placements. All bodies are source-built. */
OUTPUT_FORMAT("elf32-powerpc")
OUTPUT_ARCH(powerpc)
ENTRY(w3d_get_802338ec)
_SDA_BASE_ = 0x804b2540;
_SDA2_BASE_ = 0x804c2540;
SECTIONS {
  .text.w3d_get_802338ec 0x802338ec : { *(.text.w3d_get_802338ec) }
  .text.w3d_get_80233958 0x80233958 : { *(.text.w3d_get_80233958) }
  .text.w3d_get_802339c4 0x802339c4 : { *(.text.w3d_get_802339c4) }
  .text.w3d_get_80233a30 0x80233a30 : { *(.text.w3d_get_80233a30) }
  .text.w3d_get_80233a9c 0x80233a9c : { *(.text.w3d_get_80233a9c) }
  .text.w3d_get_80233b08 0x80233b08 : { *(.text.w3d_get_80233b08) }
  .text.w3d_get_80233b74 0x80233b74 : { *(.text.w3d_get_80233b74) }
  .text.w3d_get_80233be0 0x80233be0 : { *(.text.w3d_get_80233be0) }
  .text.w3d_get_80233c4c 0x80233c4c : { *(.text.w3d_get_80233c4c) }
  .text.w3d_get_80233cb8 0x80233cb8 : { *(.text.w3d_get_80233cb8) }
  .text.w3d_get_80233d24 0x80233d24 : { *(.text.w3d_get_80233d24) }
  .text.w3d_get_80233d90 0x80233d90 : { *(.text.w3d_get_80233d90) }
  .text.w3d_get_80233dfc 0x80233dfc : { *(.text.w3d_get_80233dfc) }
  .text.w3d_get_80233e68 0x80233e68 : { *(.text.w3d_get_80233e68) }
  .text.w3d_get_80233ed4 0x80233ed4 : { *(.text.w3d_get_80233ed4) }
  .text.w3d_get_80233f40 0x80233f40 : { *(.text.w3d_get_80233f40) }
  .text.w3d_get_80233fac 0x80233fac : { *(.text.w3d_get_80233fac) }
  .text.w3d_get_80234018 0x80234018 : { *(.text.w3d_get_80234018) }
  .text.w3d_get_80234084 0x80234084 : { *(.text.w3d_get_80234084) }
  .text.w3d_get_802340f0 0x802340f0 : { *(.text.w3d_get_802340f0) }
  .text.w3d_get_8023415c 0x8023415c : { *(.text.w3d_get_8023415c) }
  .text.w3d_get_802341c8 0x802341c8 : { *(.text.w3d_get_802341c8) }
  .text.w3d_get_80234234 0x80234234 : { *(.text.w3d_get_80234234) }
  .text.w3d_get_802342a0 0x802342a0 : { *(.text.w3d_get_802342a0) }
  .text.w3d_get_8023430c 0x8023430c : { *(.text.w3d_get_8023430c) }
  .text.w3d_get_80234378 0x80234378 : { *(.text.w3d_get_80234378) }
  .text.w3d_get_802343e4 0x802343e4 : { *(.text.w3d_get_802343e4) }
  .text.w3d_get_80234450 0x80234450 : { *(.text.w3d_get_80234450) }
  .text.w3d_get_802344bc 0x802344bc : { *(.text.w3d_get_802344bc) }
  .text.w3d_get_80234528 0x80234528 : { *(.text.w3d_get_80234528) }
  .text.w3d_get_80234594 0x80234594 : { *(.text.w3d_get_80234594) }
  .text.w3d_get_80234600 0x80234600 : { *(.text.w3d_get_80234600) }
  .text.w3d_get_8023466c 0x8023466c : { *(.text.w3d_get_8023466c) }
  .text.w3d_get_802346d8 0x802346d8 : { *(.text.w3d_get_802346d8) }
  .text.w3d_get_80234744 0x80234744 : { *(.text.w3d_get_80234744) }
  .text.w3d_get_802347b0 0x802347b0 : { *(.text.w3d_get_802347b0) }
  .text.w3d_get_8023481c 0x8023481c : { *(.text.w3d_get_8023481c) }
  .text.w3d_get_80234888 0x80234888 : { *(.text.w3d_get_80234888) }
  .text.w3d_get_802348f4 0x802348f4 : { *(.text.w3d_get_802348f4) }
  .text.w3d_get_80234960 0x80234960 : { *(.text.w3d_get_80234960) }
  .text.w3d_get_802349cc 0x802349cc : { *(.text.w3d_get_802349cc) }
  .text.w3d_get_80234a38 0x80234a38 : { *(.text.w3d_get_80234a38) }
  .text.w3d_get_80234aa4 0x80234aa4 : { *(.text.w3d_get_80234aa4) }
  .text.w3d_get_80234b10 0x80234b10 : { *(.text.w3d_get_80234b10) }
  .text.w3d_get_80234b7c 0x80234b7c : { *(.text.w3d_get_80234b7c) }
  .text.w3d_get_80234be8 0x80234be8 : { *(.text.w3d_get_80234be8) }
  .text.w3d_get_80234c54 0x80234c54 : { *(.text.w3d_get_80234c54) }
  .text.w3d_get_80234cc0 0x80234cc0 : { *(.text.w3d_get_80234cc0) }
  .text.w3d_get_80234d2c 0x80234d2c : { *(.text.w3d_get_80234d2c) }
  .text.w3d_get_80234d98 0x80234d98 : { *(.text.w3d_get_80234d98) }
  .text.w3d_get_80234e04 0x80234e04 : { *(.text.w3d_get_80234e04) }
  .text.w3d_get_80234e70 0x80234e70 : { *(.text.w3d_get_80234e70) }
  .text.w3d_get_80234edc 0x80234edc : { *(.text.w3d_get_80234edc) }
  .text.w3d_set_80234ee4 0x80234ee4 : { *(.text.w3d_set_80234ee4) }
  .text.w3d_get_80234eec 0x80234eec : { *(.text.w3d_get_80234eec) }
  .text.w3d_set_80234ef4 0x80234ef4 : { *(.text.w3d_set_80234ef4) }
  .text.w3d_get_80234efc 0x80234efc : { *(.text.w3d_get_80234efc) }
  .text.w3d_set_80234f04 0x80234f04 : { *(.text.w3d_set_80234f04) }
  .text.w3d_get_80234f0c 0x80234f0c : { *(.text.w3d_get_80234f0c) }
  .text.w3d_set_80234f14 0x80234f14 : { *(.text.w3d_set_80234f14) }
  .text.w3d_get_80234f1c 0x80234f1c : { *(.text.w3d_get_80234f1c) }
  .text.w3d_set_80234f24 0x80234f24 : { *(.text.w3d_set_80234f24) }
  .text.w3d_get_80234f2c 0x80234f2c : { *(.text.w3d_get_80234f2c) }
  .text.w3d_set_80234f34 0x80234f34 : { *(.text.w3d_set_80234f34) }
  .text.w3d_get_80234f3c 0x80234f3c : { *(.text.w3d_get_80234f3c) }
  .text.w3d_set_80234f44 0x80234f44 : { *(.text.w3d_set_80234f44) }
  .text.w3d_get_80234f4c 0x80234f4c : { *(.text.w3d_get_80234f4c) }
  .text.w3d_set_80234f54 0x80234f54 : { *(.text.w3d_set_80234f54) }
  .text.w3d_get_80234f5c 0x80234f5c : { *(.text.w3d_get_80234f5c) }
  .text.w3d_set_80234f64 0x80234f64 : { *(.text.w3d_set_80234f64) }
  .text.w3d_get_80234f6c 0x80234f6c : { *(.text.w3d_get_80234f6c) }
  .text.w3d_set_80234f74 0x80234f74 : { *(.text.w3d_set_80234f74) }
  .text.w3d_get_80234f7c 0x80234f7c : { *(.text.w3d_get_80234f7c) }
  .text.w3d_set_80234f84 0x80234f84 : { *(.text.w3d_set_80234f84) }
  .text.w3d_get_80234f8c 0x80234f8c : { *(.text.w3d_get_80234f8c) }
  .text.w3d_set_80234f94 0x80234f94 : { *(.text.w3d_set_80234f94) }
  .text.w3d_get_80234f9c 0x80234f9c : { *(.text.w3d_get_80234f9c) }
  .text.w3d_set_80234fa4 0x80234fa4 : { *(.text.w3d_set_80234fa4) }
  .text.w3d_get_80234fac 0x80234fac : { *(.text.w3d_get_80234fac) }
  .text.w3d_set_80234fb4 0x80234fb4 : { *(.text.w3d_set_80234fb4) }
  /DISCARD/ : { *(.text*) *(.rodata*) *(.data*) *(.bss*) *(.sdata*) *(.sbss*) *(.comment) }
}
