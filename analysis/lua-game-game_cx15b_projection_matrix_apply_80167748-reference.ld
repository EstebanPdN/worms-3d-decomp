/* Generated reference-only placements. All bodies are source-built. */
OUTPUT_FORMAT("elf32-powerpc")
OUTPUT_ARCH(powerpc)
ENTRY(w3d_cx15b_projection_matrix_apply_80167748)
_SDA_BASE_ = 0x804b2540;
_SDA2_BASE_ = 0x804c2540;
projection_8030bec4 = 0x8030bec4;
value_803a4e18 = 0x803a4e18;
value_803a4e1c = 0x803a4e1c;
SECTIONS {
  .text.w3d_cx15b_projection_matrix_apply_80167748 0x80167748 : { *(.text.w3d_cx15b_projection_matrix_apply_80167748) }
  /DISCARD/ : { *(.text*) *(.rodata*) *(.data*) *(.bss*) *(.sdata*) *(.sbss*) *(.comment) }
}
