/* Generated reference-only placements. All bodies are source-built. */
OUTPUT_FORMAT("elf32-powerpc")
OUTPUT_ARCH(powerpc)
ENTRY(w3d_cc17d_widget_construct_80285610)
_SDA_BASE_ = 0x804b2540;
_SDA2_BASE_ = 0x804c2540;
base_8015fef0 = 0x8015fef0;
member_802afb20 = 0x802afb20;
table_8041bf40 = 0x8041bf40;
table_8041bf90 = 0x8041bf90;
SECTIONS {
  .text.w3d_cc17d_widget_construct_80285610 0x80285610 : { *(.text.w3d_cc17d_widget_construct_80285610) }
  /DISCARD/ : { *(.text*) *(.rodata*) *(.data*) *(.bss*) *(.sdata*) *(.sbss*) *(.comment) }
}
