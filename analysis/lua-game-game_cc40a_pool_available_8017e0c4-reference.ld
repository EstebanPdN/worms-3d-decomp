/* Generated reference-only placements. All bodies are source-built. */
OUTPUT_FORMAT("elf32-powerpc")
OUTPUT_ARCH(powerpc)
ENTRY(cc40a_pool_available_8017e0c4)
_SDA_BASE_ = 0x804b2540;
_SDA2_BASE_ = 0x804c2540;
cc40a_capacity_80170b10 = 0x80170b10;
cc40a_capacity_80174520 = 0x80174520;
cc40a_capacity_8017f524 = 0x8017f524;
cc40a_capacity_801829bc = 0x801829bc;
cc40a_capacity_80183eb4 = 0x80183eb4;
cc40a_capacity_8018774c = 0x8018774c;
cc40a_capacity_8018a7e4 = 0x8018a7e4;
cc40a_used_80170b18 = 0x80170b18;
cc40a_used_80174528 = 0x80174528;
cc40a_used_8017f52c = 0x8017f52c;
cc40a_used_801829c4 = 0x801829c4;
cc40a_used_80183ebc = 0x80183ebc;
cc40a_used_80187754 = 0x80187754;
cc40a_used_8018a7ec = 0x8018a7ec;
SECTIONS {
  .text.cc40a_pool_available_8017e0c4 0x8017e0c4 : { *(.text.cc40a_pool_available_8017e0c4) }
  /DISCARD/ : { *(.text*) *(.rodata*) *(.data*) *(.bss*) *(.sdata*) *(.sbss*) *(.comment) }
}
