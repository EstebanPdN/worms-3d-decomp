/* Generated reference-only placements. All bodies are source-built. */
OUTPUT_FORMAT("elf32-powerpc")
OUTPUT_ARCH(powerpc)
ENTRY(d31f_mission_images_8028d3b8)
_SDA_BASE_ = 0x804b2540;
_SDA2_BASE_ = 0x804c2540;
__6String = 0x803426b8;
__6StringPCc = 0x8020bb54;
fn_801712c4 = 0x801712c4;
lbl_803cff40 = 0x803cff40;
lbl_803cff88 = 0x803cff88;
lbl_803cffac = 0x803cffac;
w3d_empty_8034357c = 0x8034357c;
w3d_empty_80343808 = 0x80343808;
w3d_f3a_suffix_8028dcd8 = 0x8028dcd8;
w3d_f9a_image_resolve_8028d8ec = 0x8028d8ec;
w3d_handle_set_name = 0x8015adf4;
w3d_named_suffix_802b1510 = 0x802b1510;
w3d_s20_store_byte_value_80173f88 = 0x80173f88;
w3d_string_base_finish = 0x8020c5c4;
w3d_string_base_init = 0x8020c5c0;
w3d_string_format = 0x8020c510;
w3d_string_header = 0x80341884;
w3d_string_release = 0x80341588;
SECTIONS {
  .text.d31f_mission_images_8028d3b8 0x8028d3b8 : { *(.text.d31f_mission_images_8028d3b8) }
  /DISCARD/ : { *(.text*) *(.rodata*) *(.data*) *(.bss*) *(.sdata*) *(.sbss*) *(.comment) }
}
