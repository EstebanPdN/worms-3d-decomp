/* Generated reference-only placements. All bodies are source-built. */
OUTPUT_FORMAT("elf32-powerpc")
OUTPUT_ARCH(powerpc)
ENTRY(w3d_s10_create_named_entry_80207298)
_SDA_BASE_ = 0x804b2540;
_SDA2_BASE_ = 0x804c2540;
fn_801fe1d8 = 0x801fe1d8;
fn_80200074 = 0x80200074;
fn_802076ac = 0x802076ac;
fn_802076c8 = 0x802076c8;
fn_8020bd38 = 0x8020bd38;
fn_80219f44 = 0x80219f44;
lbl_8045ed58 = 0x8045ed58;
SECTIONS {
  .text.w3d_s10_create_named_entry_80207298 0x80207298 : { *(.text.w3d_s10_create_named_entry_80207298) }
  /DISCARD/ : { *(.text*) *(.rodata*) *(.data*) *(.bss*) *(.sdata*) *(.sbss*) *(.comment) }
}
