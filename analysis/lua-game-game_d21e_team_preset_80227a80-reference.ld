/* Generated reference-only placements. All bodies are source-built. */
OUTPUT_FORMAT("elf32-powerpc")
OUTPUT_ARCH(powerpc)
ENTRY(__14D21eTeamPresetUs)
_SDA_BASE_ = 0x804b2540;
_SDA2_BASE_ = 0x804c2540;
__10D21eString = 0x803426b8;
__8D21eTeamUs = 0x80227398;
__vt_14D21eTeamPreset = 0x8041a140;
w3d_auto_80231fd0 = 0x80231fd0;
w3d_cc18b_array_write_80231f14 = 0x80231f14;
w3d_s10_service_forward_8020b680 = 0x8020b680;
w3d_service_key_80419ea8 = 0x80419ea8;
w3d_string_base_finish = 0x8020c5c4;
w3d_string_format = 0x8020c510;
w3d_string_release = 0x80341588;
w3d_string_release_header = 0x8020bb2c;
w3d_text_worm_number_803b506c = 0x803b506c;
SECTIONS {
  .text.__14D21eTeamPresetUs 0x80227a80 : { *(.text.__14D21eTeamPresetUs) }
  /DISCARD/ : { *(.text*) *(.rodata*) *(.data*) *(.bss*) *(.sdata*) *(.sbss*) *(.comment) }
}
