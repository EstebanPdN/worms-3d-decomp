/* Generated reference-only placements. All bodies are source-built. */
OUTPUT_FORMAT("elf32-powerpc")
OUTPUT_ARCH(powerpc)
ENTRY(sol35d12_assign_byte_suffix_8020c0fc_v2)
_SDA_BASE_ = 0x804b2540;
_SDA2_BASE_ = 0x804c2540;
__Q224Sol35d12SuffixV28020c0fc6String = 0x803426b8;
sol35d12_allocate_8020bc88 = 0x8020bc88;
sol35d12_finish_8020c5c4 = 0x8020c5c4;
sol35d12_free_8020bb2c = 0x8020bb2c;
sol35d12_release_80341588 = 0x80341588;
sol35d12_transfer_802eee50 = 0x802eee50;
SECTIONS {
  .text.sol35d12_assign_byte_suffix_8020c0fc_v2 0x8020c0fc : { *(.text.sol35d12_assign_byte_suffix_8020c0fc_v2) }
  /DISCARD/ : { *(.text*) *(.rodata*) *(.data*) *(.bss*) *(.sdata*) *(.sbss*) *(.comment) }
}
