/* Generated reference-only placements. All bodies are source-built. */
OUTPUT_FORMAT("elf32-powerpc")
OUTPUT_ARCH(powerpc)
ENTRY(w3d_k3b_tagged_construct_801ee1e4)
_SDA_BASE_ = 0x804b2540;
_SDA2_BASE_ = 0x804c2540;
w3d_vtable_80411ac0 = 0x80411ac0;
w3d_vtable_80417700 = 0x80417700;
SECTIONS {
  .text.w3d_k3b_tagged_construct_801ee1e4 0x801ee1e4 : { *(.text.w3d_k3b_tagged_construct_801ee1e4) }
  /DISCARD/ : { *(.text*) *(.rodata*) *(.data*) *(.bss*) *(.sdata*) *(.sbss*) *(.comment) }
}
