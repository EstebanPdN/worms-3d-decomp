/* Generated reference-only placements. All bodies are source-built. */
OUTPUT_FORMAT("elf32-powerpc")
OUTPUT_ARCH(powerpc)
ENTRY(w3d_cx14b_affine_near_801f7620)
_SDA_BASE_ = 0x804b2540;
_SDA2_BASE_ = 0x804c2540;
near_801f659c = 0x801f659c;
SECTIONS {
  .text.w3d_cx14b_affine_near_801f7620 0x801f7620 : { *(.text.w3d_cx14b_affine_near_801f7620) }
  /DISCARD/ : { *(.text*) *(.rodata*) *(.data*) *(.bss*) *(.sdata*) *(.sbss*) *(.comment) }
}
