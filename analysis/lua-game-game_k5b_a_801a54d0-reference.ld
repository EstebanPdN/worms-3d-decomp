/* Generated reference-only placements. All bodies are source-built. */
OUTPUT_FORMAT("elf32-powerpc")
OUTPUT_ARCH(powerpc)
ENTRY(w3d_k5b_panel_style_reset_801a54d0)
_SDA_BASE_ = 0x804b2540;
_SDA2_BASE_ = 0x804c2540;
lbl_8045e63c = 0x8045e63c;
lbl_8045e690 = 0x8045e690;
SECTIONS {
  .text.w3d_k5b_panel_style_reset_801a54d0 0x801a54d0 : { *(.text.w3d_k5b_panel_style_reset_801a54d0) }
  /DISCARD/ : { *(.text*) *(.rodata*) *(.data*) *(.bss*) *(.sdata*) *(.sbss*) *(.comment) }
}
