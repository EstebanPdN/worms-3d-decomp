/* Generated reference-only placements. All bodies are source-built. */
OUTPUT_FORMAT("elf32-powerpc")
OUTPUT_ARCH(powerpc)
ENTRY(d27f_wrap_text_lines_80289a34)
_SDA_BASE_ = 0x804b2540;
_SDA2_BASE_ = 0x804c2540;
__6StringPCc = 0x8020bb54;
fn_8018c5b0 = 0x8018c5b0;
fn_8018c938 = 0x8018c938;
fn_80343580 = 0x80343580;
lbl_803cf9f4 = 0x803cf9f4;
lbl_803cfa24 = 0x803cfa24;
w3d_handle_load_8015adf4 = 0x8015adf4;
w3d_s4_card_add_record_80289d2c = 0x80289d2c;
w3d_string_finish_8020c5c4 = 0x8020c5c4;
w3d_string_release_80341588 = 0x80341588;
SECTIONS {
  .text.d27f_wrap_text_lines_80289a34 0x80289a34 : { *(.text.d27f_wrap_text_lines_80289a34) }
  .rodata 0x803cfa28 : { *(.rodata) }
  /DISCARD/ : { *(.text*) *(.rodata*) *(.data*) *(.bss*) *(.sdata*) *(.sbss*) *(.comment) }
}
