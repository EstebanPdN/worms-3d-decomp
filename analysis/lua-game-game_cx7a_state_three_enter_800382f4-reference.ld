/* Generated reference-only placements. All bodies are source-built. */
OUTPUT_FORMAT("elf32-powerpc")
OUTPUT_ARCH(powerpc)
ENTRY(w3d_cx7a_state_three_enter_800382f4)
_SDA_BASE_ = 0x804b2540;
_SDA2_BASE_ = 0x804c2540;
byte_store_80173f88 = 0x80173f88;
refresh_80038684 = 0x80038684;
SECTIONS {
  .text.w3d_cx7a_state_three_enter_800382f4 0x800382f4 : { *(.text.w3d_cx7a_state_three_enter_800382f4) }
  /DISCARD/ : { *(.text*) *(.rodata*) *(.data*) *(.bss*) *(.sdata*) *(.sbss*) *(.comment) }
}
