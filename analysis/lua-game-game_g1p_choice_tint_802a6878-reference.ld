/* Generated reference-only placements. All bodies are source-built. */
OUTPUT_FORMAT("elf32-powerpc")
OUTPUT_ARCH(powerpc)
ENTRY(g1p_choice_tint_802a6878)
_SDA_BASE_ = 0x804b2540;
_SDA2_BASE_ = 0x804c2540;
fn_80173df0 = 0x80173df0;
fn_802a7980 = 0x802a7980;
fn_802a7998 = 0x802a7998;
fn_8034357c = 0x8034357c;
SECTIONS {
  .text.g1p_choice_tint_802a6878 0x802a6878 : { *(.text.g1p_choice_tint_802a6878) }
  /DISCARD/ : { *(.text*) *(.rodata*) *(.data*) *(.bss*) *(.sdata*) *(.sbss*) *(.comment) }
}
