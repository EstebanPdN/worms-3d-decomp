/* Generated reference-only placements. All bodies are source-built. */
OUTPUT_FORMAT("elf32-powerpc")
OUTPUT_ARCH(powerpc)
ENTRY(w3d_k6b_register_bounds_bindings_801b5c24)
_SDA_BASE_ = 0x804b2540;
_SDA2_BASE_ = 0x804c2540;
fn_801e8d9c = 0x801e8d9c;
lbl_803ab078 = 0x803ab078;
lbl_803ab0a8 = 0x803ab0a8;
lbl_8045e690 = 0x8045e690;
w3d_binding_create_801f1094 = 0x801f1094;
w3d_s12_create_member_binding_801ece2c = 0x801ece2c;
SECTIONS {
  .text.w3d_k6b_register_bounds_bindings_801b5c24 0x801b5c24 : { *(.text.w3d_k6b_register_bounds_bindings_801b5c24) }
  /DISCARD/ : { *(.text*) *(.rodata*) *(.data*) *(.bss*) *(.sdata*) *(.sbss*) *(.comment) }
}
