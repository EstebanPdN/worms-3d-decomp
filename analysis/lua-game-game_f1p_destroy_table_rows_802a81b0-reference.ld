/* Generated reference-only placements. All bodies are source-built. */
OUTPUT_FORMAT("elf32-powerpc")
OUTPUT_ARCH(powerpc)
ENTRY(_._18F1p_802a81b0_Owner)
_SDA_BASE_ = 0x804b2540;
_SDA2_BASE_ = 0x804c2540;
_._26F1p_802a81b0_Base_8015ff2c = 0x8015ff2c;
_._28F1p_802a81b0_Member_802afc40 = 0x802afc40;
fn_8020c5c4 = 0x8020c5c4;
fn_80341588 = 0x80341588;
vt_8041c500 = 0x8041c500;
vt_8041c550 = 0x8041c550;
SECTIONS {
  .text._._18F1p_802a81b0_Owner 0x802a81b0 : { *(.text._._18F1p_802a81b0_Owner) }
  /DISCARD/ : { *(.text*) *(.rodata*) *(.data*) *(.bss*) *(.sdata*) *(.sbss*) *(.comment) }
}
