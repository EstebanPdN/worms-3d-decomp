/* Generated reference-only placements. All bodies are source-built. */
OUTPUT_FORMAT("elf32-powerpc")
OUTPUT_ARCH(powerpc)
ENTRY(w3d_d24b_inventory_defaults_reset_8008c954)
_SDA_BASE_ = 0x804b2540;
_SDA2_BASE_ = 0x804c2540;
_._19Descriptor_80178474 = 0x80178474;
w3d_alliance_inventory_800fcdb8 = 0x800fcdb8;
w3d_as_inventory_80179598 = 0x80179598;
w3d_clear_flags_8025c2d8 = 0x8025c2d8;
w3d_clear_flags_8025ca78 = 0x8025ca78;
w3d_identity_80341584 = 0x80341584;
w3d_propagate_tag_801ea4c8 = 0x801ea4c8;
w3d_resource_property_800fc1b0 = 0x800fc1b0;
w3d_string_8037dbd4 = 0x8037dbd4;
w3d_string_8037e0cc = 0x8037e0cc;
w3d_string_8037e0e4 = 0x8037e0e4;
w3d_string_8037e0fc = 0x8037e0fc;
w3d_string_8037e118 = 0x8037e118;
w3d_team_inventory_800fcc9c = 0x800fcc9c;
w3d_unsigned_read_800fc330 = 0x800fc330;
w3d_worm_inventory_800fca64 = 0x800fca64;
SECTIONS {
  .text.w3d_d24b_inventory_defaults_reset_8008c954 0x8008c954 : { *(.text.w3d_d24b_inventory_defaults_reset_8008c954) }
  /DISCARD/ : { *(.text*) *(.rodata*) *(.data*) *(.bss*) *(.sdata*) *(.sbss*) *(.comment) }
}
