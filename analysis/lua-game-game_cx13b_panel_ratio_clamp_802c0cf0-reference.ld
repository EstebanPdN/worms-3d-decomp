/* Generated reference-only placements. All bodies are source-built. */
OUTPUT_FORMAT("elf32-powerpc")
OUTPUT_ARCH(powerpc)
ENTRY(w3d_cx13b_panel_ratio_clamp_802c0cf0)
_SDA_BASE_ = 0x804b2540;
_SDA2_BASE_ = 0x804c2540;
factor_803d847c = 0x803d847c;
lookup_8015ae3c = 0x8015ae3c;
measure_8018b4cc = 0x8018b4cc;
minimum_803d8480 = 0x803d8480;
view_8034435c = 0x8034435c;
SECTIONS {
  .text.w3d_cx13b_panel_ratio_clamp_802c0cf0 0x802c0cf0 : { *(.text.w3d_cx13b_panel_ratio_clamp_802c0cf0) }
  /DISCARD/ : { *(.text*) *(.rodata*) *(.data*) *(.bss*) *(.sdata*) *(.sbss*) *(.comment) }
}
