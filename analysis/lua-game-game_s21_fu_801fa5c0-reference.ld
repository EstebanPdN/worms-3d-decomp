/* Generated reference-only placements. All bodies are source-built. */
OUTPUT_FORMAT("elf32-powerpc")
OUTPUT_ARCH(powerpc)
ENTRY(w3d_s21_submit_b_801fa5c0)
_SDA_BASE_ = 0x804b2540;
_SDA2_BASE_ = 0x804c2540;
fn_801f9c60 = 0x801f9c60;
fn_801fac44 = 0x801fac44;
SECTIONS {
  .text.w3d_s21_submit_b_801fa5c0 0x801fa5c0 : { *(.text.w3d_s21_submit_b_801fa5c0) }
  /DISCARD/ : { *(.text*) *(.rodata*) *(.data*) *(.bss*) *(.sdata*) *(.sbss*) *(.comment) }
}
