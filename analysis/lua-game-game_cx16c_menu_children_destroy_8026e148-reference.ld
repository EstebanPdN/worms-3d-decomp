/* Generated reference-only placements. All bodies are source-built. */
OUTPUT_FORMAT("elf32-powerpc")
OUTPUT_ARCH(powerpc)
ENTRY(w3d_cx16c_menu_children_destroy_8026e148)
_SDA_BASE_ = 0x804b2540;
_SDA2_BASE_ = 0x804c2540;
cx16c_base_destroy_8015ff2c = 0x8015ff2c;
cx16c_context_destroy_802afc40 = 0x802afc40;
cx16c_table_8041bd60 = 0x8041bd60;
cx16c_table_8041bdb0 = 0x8041bdb0;
SECTIONS {
  .text.w3d_cx16c_menu_children_destroy_8026e148 0x8026e148 : { *(.text.w3d_cx16c_menu_children_destroy_8026e148) }
  /DISCARD/ : { *(.text*) *(.rodata*) *(.data*) *(.bss*) *(.sdata*) *(.sbss*) *(.comment) }
}
