/* Generated reference-only placements. All bodies are source-built. */
OUTPUT_FORMAT("elf32-powerpc")
OUTPUT_ARCH(powerpc)
ENTRY(k4a_toggler_update_8012bd08)
_SDA_BASE_ = 0x804b2540;
_SDA2_BASE_ = 0x804c2540;
w3d_auto_80178d1c = 0x80178d1c;
w3d_constant_8015fb2c = 0x8015fb2c;
w3d_constructor_native_cast = 0x80342a78;
SECTIONS {
  .text.k4a_toggler_update_8012bd08 0x8012bd08 : { *(.text.k4a_toggler_update_8012bd08) }
  /DISCARD/ : { *(.text*) *(.rodata*) *(.data*) *(.bss*) *(.sdata*) *(.sbss*) *(.comment) }
}
