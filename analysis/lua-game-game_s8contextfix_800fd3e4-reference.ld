/* Generated reference-only placements. All bodies are source-built. */
OUTPUT_FORMAT("elf32-powerpc")
OUTPUT_ARCH(powerpc)
ENTRY(s8_indexed_property_800fd3e4)
_SDA_BASE_ = 0x804b2540;
_SDA2_BASE_ = 0x804c2540;
fn_801797B4 = 0x801797b4;
fn_80341584 = 0x80341584;
lbl_8044A564 = 0x8044a564;
lbl_8044D254 = 0x8044d254;
SECTIONS {
  .text.s8_indexed_property_800fd3e4 0x800fd3e4 : { *(.text.s8_indexed_property_800fd3e4) }
  /DISCARD/ : { *(.text*) *(.rodata*) *(.data*) *(.bss*) *(.sdata*) *(.sbss*) *(.comment) }
}
