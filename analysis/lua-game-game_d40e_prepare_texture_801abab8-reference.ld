/* Generated reference-only placements. All bodies are source-built. */
OUTPUT_FORMAT("elf32-powerpc")
OUTPUT_ARCH(powerpc)
ENTRY(w3d_d40e_prepare_texture_801abab8)
_SDA_BASE_ = 0x804b2540;
_SDA2_BASE_ = 0x804c2540;
fn_801afd5c = 0x801afd5c;
fn_801afe54 = 0x801afe54;
w3d_auto_801aba98 = 0x801aba98;
w3d_d31e_convert_image_801d95c4 = 0x801d95c4;
w3d_k5b_array_ref_lock_801ef048 = 0x801ef048;
SECTIONS {
  .text.w3d_d40e_prepare_texture_801abab8 0x801abab8 : { *(.text.w3d_d40e_prepare_texture_801abab8) }
  /DISCARD/ : { *(.text*) *(.rodata*) *(.data*) *(.bss*) *(.sdata*) *(.sbss*) *(.comment) }
}
