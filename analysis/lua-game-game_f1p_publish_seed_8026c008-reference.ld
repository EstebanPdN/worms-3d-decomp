/* Generated reference-only placements. All bodies are source-built. */
OUTPUT_FORMAT("elf32-powerpc")
OUTPUT_ARCH(powerpc)
ENTRY(w3d_publish_seed_8026c008)
_SDA_BASE_ = 0x804b2540;
_SDA2_BASE_ = 0x804c2540;
__15String_803426b8 = 0x803426b8;
fn_800fc43c = 0x800fc43c;
fn_800fc550 = 0x800fc550;
fn_8020c510 = 0x8020c510;
fn_8020c5c4 = 0x8020c5c4;
fn_8026ce4c = 0x8026ce4c;
fn_80341588 = 0x80341588;
format_803cb8d0 = 0x803cb8d0;
name_803cb8bc = 0x803cb8bc;
name_803cb950 = 0x803cb950;
SECTIONS {
  .text.w3d_publish_seed_8026c008 0x8026c008 : { *(.text.w3d_publish_seed_8026c008) }
  /DISCARD/ : { *(.text*) *(.rodata*) *(.data*) *(.bss*) *(.sdata*) *(.sbss*) *(.comment) }
}
