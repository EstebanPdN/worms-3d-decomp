/* Generated reference-only placements. All bodies are source-built. */
OUTPUT_FORMAT("elf32-powerpc")
OUTPUT_ARCH(powerpc)
ENTRY(w3d_cx12b_wormpot_hit_dispatch_802aa2a4)
_SDA_BASE_ = 0x804b2540;
_SDA2_BASE_ = 0x804c2540;
dispatch_802aa8a4 = 0x802aa8a4;
maxx_803d69c0 = 0x803d69c0;
maxy_803d69b8 = 0x803d69b8;
minx_803d69bc = 0x803d69bc;
miny_803d69b4 = 0x803d69b4;
selected_802ab5c0 = 0x802ab5c0;
SECTIONS {
  .text.w3d_cx12b_wormpot_hit_dispatch_802aa2a4 0x802aa2a4 : { *(.text.w3d_cx12b_wormpot_hit_dispatch_802aa2a4) }
  /DISCARD/ : { *(.text*) *(.rodata*) *(.data*) *(.bss*) *(.sdata*) *(.sbss*) *(.comment) }
}
