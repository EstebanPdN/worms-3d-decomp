/* Generated reference-only placements. All bodies are source-built. */
OUTPUT_FORMAT("elf32-powerpc")
OUTPUT_ARCH(powerpc)
ENTRY(w3d_f7a_propagate_named_tag_8028f93c)
_SDA_BASE_ = 0x804b2540;
_SDA2_BASE_ = 0x804c2540;
_._15F7aTag_80178474 = 0x80178474;
fn_800fc1b0 = 0x800fc1b0;
fn_80179598 = 0x80179598;
fn_801ea4c8 = 0x801ea4c8;
fn_80341584 = 0x80341584;
SECTIONS {
  .text.w3d_f7a_propagate_named_tag_8028f93c 0x8028f93c : { *(.text.w3d_f7a_propagate_named_tag_8028f93c) }
  /DISCARD/ : { *(.text*) *(.rodata*) *(.data*) *(.bss*) *(.sdata*) *(.sbss*) *(.comment) }
}
