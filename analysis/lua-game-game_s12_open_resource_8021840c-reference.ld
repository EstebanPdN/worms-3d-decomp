/* Generated reference-only placements. All bodies are source-built. */
OUTPUT_FORMAT("elf32-powerpc")
OUTPUT_ARCH(powerpc)
ENTRY(w3d_s12_open_resource_8021840c)
_SDA_BASE_ = 0x804b2540;
_SDA2_BASE_ = 0x804c2540;
fn_801fe1d8__Fi = 0x801fe1d8;
fn_8020bd38__FP7S12PathPCc = 0x8020bd38;
fn_8020bf2c__FP7S12PathPCc = 0x8020bf2c;
fn_8020c5c0__FP7S12Path = 0x8020c5c0;
fn_8020c5c4__FP7S12Path = 0x8020c5c4;
fn_80218194__FP7S12Path = 0x80218194;
fn_802187dc__FPv = 0x802187dc;
fn_80218c50__FP9S12StreamPCci = 0x80218c50;
fn_80218d78__FP9S12StreamP20S12ResourceDirectory = 0x80218d78;
fn_80218ec4__FPv = 0x80218ec4;
fn_80219184__FP9S12StreamPCci = 0x80219184;
fn_802192b8__FP9S12StreamP20S12ResourceDirectory = 0x802192b8;
fn_802eedc0__FPCcT0i = 0x802eedc0;
fn_80341588__FP7S12Path = 0x80341588;
fn_80341884__FP7S12Path = 0x80341884;
lbl_803b387c = 0x803b387c;
lbl_803b3880 = 0x803b3880;
SECTIONS {
  .text.w3d_s12_open_resource_8021840c 0x8021840c : { *(.text.w3d_s12_open_resource_8021840c) }
  /DISCARD/ : { *(.text*) *(.rodata*) *(.data*) *(.bss*) *(.sdata*) *(.sbss*) *(.comment) }
}
