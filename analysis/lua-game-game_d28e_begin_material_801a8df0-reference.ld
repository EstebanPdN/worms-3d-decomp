/* Generated reference-only placements. All bodies are source-built. */
OUTPUT_FORMAT("elf32-powerpc")
OUTPUT_ARCH(powerpc)
ENTRY(w3d_d28e_begin_material_801a8df0)
_SDA_BASE_ = 0x804b2540;
_SDA2_BASE_ = 0x804c2540;
alloc_80212fd4 = 0x80212fd4;
f8c_frustum_801a9f78 = 0x801a9f78;
free_802134fc = 0x802134fc;
lbl_80363c44 = 0x80363c44;
memcmp_802eedc0 = 0x802eedc0;
memcpy_802eee50 = 0x802eee50;
memmove_802eeef4 = 0x802eeef4;
w3d_ctor_801bdfe4 = 0x801bdfe4;
w3d_handle_storage_fallback_803413d8 = 0x803413d8;
w3d_heap_allocate_801fe1d8 = 0x801fe1d8;
w3d_k5b_pairs_cancel_801f5da0 = 0x801f5da0;
SECTIONS {
  .text.w3d_d28e_begin_material_801a8df0 0x801a8df0 : { *(.text.w3d_d28e_begin_material_801a8df0) }
  /DISCARD/ : { *(.text*) *(.rodata*) *(.data*) *(.bss*) *(.sdata*) *(.sbss*) *(.comment) }
}
