/* Generated reference-only placements. All bodies are source-built. */
OUTPUT_FORMAT("elf32-powerpc")
OUTPUT_ARCH(powerpc)
ENTRY(cc39a_script_source_line_80102890)
_SDA_BASE_ = 0x804b2540;
_SDA2_BASE_ = 0x804c2540;
cc39a_copy_802eee50 = 0x802eee50;
cc39a_data_800ffb68 = 0x800ffb68;
cc39a_find_80102a34 = 0x80102a34;
cc39a_length_800ffb70 = 0x800ffb70;
cc39a_line_800ffca4 = 0x800ffca4;
cc39a_unavailable_80398f30 = 0x80398f30;
SECTIONS {
  .text.cc39a_script_source_line_80102890 0x80102890 : { *(.text.cc39a_script_source_line_80102890) }
  /DISCARD/ : { *(.text*) *(.rodata*) *(.data*) *(.bss*) *(.sdata*) *(.sbss*) *(.comment) }
}
