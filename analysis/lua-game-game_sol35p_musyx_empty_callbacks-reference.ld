/* Generated reference-only placements. All bodies are source-built. */
OUTPUT_FORMAT("elf32-powerpc")
OUTPUT_ARCH(powerpc)
ENTRY(sol35p_musyx_empty_80334f84)
_SDA_BASE_ = 0x804b2540;
_SDA2_BASE_ = 0x804c2540;
SECTIONS {
  .text.sol35p_musyx_empty_80334f84 0x80334f84 : { *(.text.sol35p_musyx_empty_80334f84) }
  .text.sol35p_musyx_empty_80335abc 0x80335abc : { *(.text.sol35p_musyx_empty_80335abc) }
  /DISCARD/ : { *(.text*) *(.rodata*) *(.data*) *(.bss*) *(.sdata*) *(.sbss*) *(.comment) }
}
