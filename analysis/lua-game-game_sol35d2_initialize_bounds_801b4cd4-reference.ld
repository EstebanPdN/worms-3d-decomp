/* Generated reference-only placements. All bodies are source-built. */
OUTPUT_FORMAT("elf32-powerpc")
OUTPUT_ARCH(powerpc)
ENTRY(w3d_sol35d2_initialize_bounds_801b4cd4)
_SDA_BASE_ = 0x804b2540;
_SDA2_BASE_ = 0x804c2540;
fn_801e8d9c = 0x801e8d9c;
fn_801ece2c = 0x801ece2c;
fn_801ed24c = 0x801ed24c;
fn_801f0f74 = 0x801f0f74;
fn_8020bb2c = 0x8020bb2c;
fn_8020c5c0 = 0x8020c5c0;
fn_8020c5c4 = 0x8020c5c4;
fn_80341588 = 0x80341588;
fn_80341884 = 0x80341884;
lbl_803aac54 = 0x803aac54;
lbl_803aac84 = 0x803aac84;
lbl_803aacb4 = 0x803aacb4;
lbl_8045e63c = 0x8045e63c;
lbl_804b06a0 = 0x804b06a0;
SECTIONS {
  .text.w3d_sol35d2_initialize_bounds_801b4cd4 0x801b4cd4 : { *(.text.w3d_sol35d2_initialize_bounds_801b4cd4) }
  /DISCARD/ : { *(.text*) *(.rodata*) *(.data*) *(.bss*) *(.sdata*) *(.sbss*) *(.comment) }
}
