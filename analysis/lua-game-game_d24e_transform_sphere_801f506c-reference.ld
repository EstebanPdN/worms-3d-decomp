/* Generated reference-only placements. All bodies are source-built. */
OUTPUT_FORMAT("elf32-powerpc")
OUTPUT_ARCH(powerpc)
ENTRY(w3d_d24e_transform_sphere_801f506c)
_SDA_BASE_ = 0x804b2540;
_SDA2_BASE_ = 0x804c2540;
constant_803b1598 = 0x803b1598;
fn_802e82c0 = 0x802e82c0;
SECTIONS {
  .text.w3d_d24e_transform_sphere_801f506c 0x801f506c : { *(.text.w3d_d24e_transform_sphere_801f506c) }
  /DISCARD/ : { *(.text*) *(.rodata*) *(.data*) *(.bss*) *(.sdata*) *(.sbss*) *(.comment) }
}
