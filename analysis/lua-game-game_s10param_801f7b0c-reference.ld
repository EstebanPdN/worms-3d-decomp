/* Generated reference-only placements. All bodies are source-built. */
OUTPUT_FORMAT("elf32-powerpc")
OUTPUT_ARCH(powerpc)
ENTRY(w3d_s10_registry_remove_801f7b0c)
_SDA_BASE_ = 0x804b2540;
_SDA2_BASE_ = 0x804c2540;
fn_801f7c18 = 0x801f7c18;
fn_8020fd2c = 0x8020fd2c;
lbl_8045e7b8 = 0x8045e7b8;
SECTIONS {
  .text.w3d_s10_registry_remove_801f7b0c 0x801f7b0c : { *(.text.w3d_s10_registry_remove_801f7b0c) }
  /DISCARD/ : { *(.text*) *(.rodata*) *(.data*) *(.bss*) *(.sdata*) *(.sbss*) *(.comment) }
}
