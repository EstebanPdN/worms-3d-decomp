/* Generated reference-only placements. All bodies are source-built. */
OUTPUT_FORMAT("elf32-powerpc")
OUTPUT_ARCH(powerpc)
ENTRY(w3d_s21_opt_number_802dd180)
_SDA_BASE_ = 0x804b2540;
_SDA2_BASE_ = 0x804c2540;
fn_802cd9e8 = 0x802cd9e8;
fn_802dd10c = 0x802dd10c;
SECTIONS {
  .text.w3d_s21_opt_number_802dd180 0x802dd180 : { *(.text.w3d_s21_opt_number_802dd180) }
  /DISCARD/ : { *(.text*) *(.rodata*) *(.data*) *(.bss*) *(.sdata*) *(.sbss*) *(.comment) }
}
