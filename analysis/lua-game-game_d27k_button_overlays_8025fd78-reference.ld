/* Generated reference-only placements. All bodies are source-built. */
OUTPUT_FORMAT("elf32-powerpc")
OUTPUT_ARCH(powerpc)
ENTRY(w3d_d27k_button_overlays_8025fd78)
_SDA_BASE_ = 0x804b2540;
_SDA2_BASE_ = 0x804c2540;
__15String_803426b8 = 0x803426b8;
assign_8020bd38 = 0x8020bd38;
finish_8026026c = 0x8026026c;
format_8020c510 = 0x8020c510;
load_802b1510__6LoaderPcPP6ObjectUc = 0x802b1510;
one_803cab94 = 0x803cab94;
string_finish_8020c5c4 = 0x8020c5c4;
string_release_80341588 = 0x80341588;
text_803cab08 = 0x803cab08;
text_803cab14 = 0x803cab14;
text_803cab38 = 0x803cab38;
text_803cab40 = 0x803cab40;
text_803cab48 = 0x803cab48;
text_803cab50 = 0x803cab50;
text_803cab58 = 0x803cab58;
text_803cab5c = 0x803cab5c;
zero_803cab90 = 0x803cab90;
SECTIONS {
  .text.w3d_d27k_button_overlays_8025fd78 0x8025fd78 : { *(.text.w3d_d27k_button_overlays_8025fd78) }
  /DISCARD/ : { *(.text*) *(.rodata*) *(.data*) *(.bss*) *(.sdata*) *(.sbss*) *(.comment) }
}
