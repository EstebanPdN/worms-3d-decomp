/* Generated reference-only placements. All bodies are source-built. */
OUTPUT_FORMAT("elf32-powerpc")
OUTPUT_ARCH(powerpc)
ENTRY(k2a_scale_clamp_80097e7c)
_SDA_BASE_ = 0x804b2540;
_SDA2_BASE_ = 0x804c2540;
w3d_f32_8037f710 = 0x8037f710;
w3d_f32_8037f714 = 0x8037f714;
w3d_f32_8037f718 = 0x8037f718;
w3d_f32_8037f71c = 0x8037f71c;
w3d_f32_8037f720 = 0x8037f720;
SECTIONS {
  .text.k2a_scale_clamp_80097e7c 0x80097e7c : { *(.text.k2a_scale_clamp_80097e7c) }
  /DISCARD/ : { *(.text*) *(.rodata*) *(.data*) *(.bss*) *(.sdata*) *(.sbss*) *(.comment) }
}
