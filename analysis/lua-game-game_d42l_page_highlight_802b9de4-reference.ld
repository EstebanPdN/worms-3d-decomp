/* Generated reference-only placements. All bodies are source-built. */
OUTPUT_FORMAT("elf32-powerpc")
OUTPUT_ARCH(powerpc)
ENTRY(d42l_page_highlight_802b9de4)
_SDA_BASE_ = 0x804b2540;
_SDA2_BASE_ = 0x804c2540;
d26j_set_colour_80173df0 = 0x80173df0;
memset = 0x802eefe0;
w3d_auto_8025f064 = 0x8025f064;
w3d_auto_8029677c = 0x8029677c;
w3d_d30k_mesh_fill_colour_8025eed0 = 0x8025eed0;
SECTIONS {
  .text.d42l_page_highlight_802b9de4 0x802b9de4 : { *(.text.d42l_page_highlight_802b9de4) }
  /DISCARD/ : { *(.text*) *(.rodata*) *(.data*) *(.bss*) *(.sdata*) *(.sbss*) *(.comment) }
}
