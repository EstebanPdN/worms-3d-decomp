/* Generated reference-only placements. All bodies are source-built. */
OUTPUT_FORMAT("elf32-powerpc")
OUTPUT_ARCH(powerpc)
ENTRY(w3d_cx11b_compact_vector_grow_80210d54)
_SDA_BASE_ = 0x804b2540;
_SDA2_BASE_ = 0x804c2540;
resize_80210b90 = 0x80210b90;
SECTIONS {
  .text.w3d_cx11b_compact_vector_grow_80210d54 0x80210d54 : { *(.text.w3d_cx11b_compact_vector_grow_80210d54) }
  /DISCARD/ : { *(.text*) *(.rodata*) *(.data*) *(.bss*) *(.sdata*) *(.sbss*) *(.comment) }
}
