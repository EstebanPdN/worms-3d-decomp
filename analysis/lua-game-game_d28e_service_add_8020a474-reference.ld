/* Generated reference-only placements. All bodies are source-built. */
OUTPUT_FORMAT("elf32-powerpc")
OUTPUT_ARCH(powerpc)
ENTRY(w3d_d28e_service_add_8020a474)
_SDA_BASE_ = 0x804b2540;
_SDA2_BASE_ = 0x804c2540;
alloc_80212fd4 = 0x80212fd4;
free_802134fc = 0x802134fc;
memcpy_802eee50 = 0x802eee50;
w3d_find_8035c414 = 0x8035c414;
SECTIONS {
  .text.w3d_d28e_service_add_8020a474 0x8020a474 : { *(.text.w3d_d28e_service_add_8020a474) }
  /DISCARD/ : { *(.text*) *(.rodata*) *(.data*) *(.bss*) *(.sdata*) *(.sbss*) *(.comment) }
}
