/* Generated reference-only placements. All bodies are source-built. */
OUTPUT_FORMAT("elf32-powerpc")
OUTPUT_ARCH(powerpc)
ENTRY(w3d_sol35d4_initialize_strings_80224eb8)
_SDA_BASE_ = 0x804b2540;
_SDA2_BASE_ = 0x804c2540;
fn_801e8d9c = 0x801e8d9c;
fn_801eb674 = 0x801eb674;
fn_801ebf38 = 0x801ebf38;
fn_801ed24c = 0x801ed24c;
fn_8020bb2c = 0x8020bb2c;
fn_8020c5c0 = 0x8020c5c0;
fn_8020c5c4 = 0x8020c5c4;
fn_80341588 = 0x80341588;
fn_80341884 = 0x80341884;
lbl_803b7aa4 = 0x803b7aa4;
lbl_803b7ac8 = 0x803b7ac8;
lbl_803b7afc = 0x803b7afc;
lbl_803b7b30 = 0x803b7b30;
lbl_803b7b68 = 0x803b7b68;
lbl_803b7ba4 = 0x803b7ba4;
lbl_803b7bd8 = 0x803b7bd8;
lbl_803b7c10 = 0x803b7c10;
lbl_804b06a0 = 0x804b06a0;
SECTIONS {
  .text.w3d_sol35d4_initialize_strings_80224eb8 0x80224eb8 : { *(.text.w3d_sol35d4_initialize_strings_80224eb8) }
  /DISCARD/ : { *(.text*) *(.rodata*) *(.data*) *(.bss*) *(.sdata*) *(.sbss*) *(.comment) }
}
