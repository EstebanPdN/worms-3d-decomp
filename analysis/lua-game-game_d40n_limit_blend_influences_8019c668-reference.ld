/* Generated reference-only placements. All bodies are source-built. */
OUTPUT_FORMAT("elf32-powerpc")
OUTPUT_ARCH(powerpc)
ENTRY(w3d_d40n_limit_blend_influences_8019c668)
_SDA_BASE_ = 0x804b2540;
_SDA2_BASE_ = 0x804c2540;
fn_801ef048 = 0x801ef048;
fn_8020b680 = 0x8020b680;
fn_80351d58 = 0x80351d58;
registry_804148b0 = 0x804148b0;
type_80363604 = 0x80363604;
SECTIONS {
  .text.w3d_d40n_limit_blend_influences_8019c668 0x8019c668 : { *(.text.w3d_d40n_limit_blend_influences_8019c668) }
  .rodata 0x803a97ec : { *(.rodata) }
  /DISCARD/ : { *(.text*) *(.rodata*) *(.data*) *(.bss*) *(.sdata*) *(.sbss*) *(.comment) }
}
