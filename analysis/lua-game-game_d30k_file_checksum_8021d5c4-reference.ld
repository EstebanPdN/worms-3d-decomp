/* Generated reference-only placements. All bodies are source-built. */
OUTPUT_FORMAT("elf32-powerpc")
OUTPUT_ARCH(powerpc)
ENTRY(w3d_d30k_file_checksum_8021d5c4)
_SDA_BASE_ = 0x804b2540;
_SDA2_BASE_ = 0x804c2540;
Close__4File = 0x8020810c;
Open__4FilePCci = 0x802080a0;
Read__4FilePvUiPUi = 0x80208298;
_._4File = 0x8020803c;
__4File = 0x80207fec;
fn_801fe0b8 = 0x801fe0b8;
fn_801fe160 = 0x801fe160;
fn_8021d7ec = 0x8021d7ec;
SECTIONS {
  .text.w3d_d30k_file_checksum_8021d5c4 0x8021d5c4 : { *(.text.w3d_d30k_file_checksum_8021d5c4) }
  /DISCARD/ : { *(.text*) *(.rodata*) *(.data*) *(.bss*) *(.sdata*) *(.sbss*) *(.comment) }
}
