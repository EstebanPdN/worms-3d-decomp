/* Generated reference-only placements. All bodies are source-built. */
OUTPUT_FORMAT("elf32-powerpc")
OUTPUT_ARCH(powerpc)
ENTRY(w3d_s21_forward_negative_80212cf4)
_SDA_BASE_ = 0x804b2540;
_SDA2_BASE_ = 0x804c2540;
fn_80212c74 = 0x80212c74;
SECTIONS {
  .text.w3d_s21_forward_negative_80212cf4 0x80212cf4 : { *(.text.w3d_s21_forward_negative_80212cf4) }
  /DISCARD/ : { *(.text*) *(.rodata*) *(.data*) *(.bss*) *(.sdata*) *(.sbss*) *(.comment) }
}
