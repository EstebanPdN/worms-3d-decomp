/* Generated reference-only placements. All bodies are source-built. */
OUTPUT_FORMAT("elf32-powerpc")
OUTPUT_ARCH(powerpc)
ENTRY(w3d_d24z_strcasecmp_802ef074)
_SDA_BASE_ = 0x804b2540;
_SDA2_BASE_ = 0x804c2540;
d24z_ctype_803db448 = 0x803db448;
SECTIONS {
  .text.w3d_d24z_strcasecmp_802ef074 0x802ef074 : { *(.text.w3d_d24z_strcasecmp_802ef074) }
  /DISCARD/ : { *(.text*) *(.rodata*) *(.data*) *(.bss*) *(.sdata*) *(.sbss*) *(.comment) }
}
