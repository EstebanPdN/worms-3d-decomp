/* Generated reference-only placements. All bodies are source-built. */
OUTPUT_FORMAT("elf32-powerpc")
OUTPUT_ARCH(powerpc)
ENTRY(w3d_cx15b_component_vectors_destroy_801fa11c)
_SDA_BASE_ = 0x804b2540;
_SDA2_BASE_ = 0x804c2540;
base_80418328 = 0x80418328;
delete_801fe1f8 = 0x801fe1f8;
derived_80418268 = 0x80418268;
node_80210990 = 0x80210990;
release_802134fc = 0x802134fc;
table_80418470 = 0x80418470;
tables_8035a244 = 0x8035a244;
SECTIONS {
  .text.w3d_cx15b_component_vectors_destroy_801fa11c 0x801fa11c : { *(.text.w3d_cx15b_component_vectors_destroy_801fa11c) }
  /DISCARD/ : { *(.text*) *(.rodata*) *(.data*) *(.bss*) *(.sdata*) *(.sbss*) *(.comment) }
}
