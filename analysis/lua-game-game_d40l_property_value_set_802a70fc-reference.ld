/* Generated reference-only placements. All bodies are source-built. */
OUTPUT_FORMAT("elf32-powerpc")
OUTPUT_ARCH(powerpc)
ENTRY(d40l_property_value_set_802a70fc)
_SDA_BASE_ = 0x804b2540;
_SDA2_BASE_ = 0x804c2540;
_._19Descriptor_80178474 = 0x80178474;
fn_800fc1b0 = 0x800fc1b0;
fn_80179598 = 0x80179598;
fn_801797b4 = 0x801797b4;
fn_8020c510 = 0x8020c510;
fn_8020c5c0 = 0x8020c5c0;
fn_8020c5c4 = 0x8020c5c4;
fn_802a6ce8 = 0x802a6ce8;
fn_80341584 = 0x80341584;
fn_80341588 = 0x80341588;
fn_80341884 = 0x80341884;
s_803d6164 = 0x803d6164;
type_80366578 = 0x80366578;
SECTIONS {
  .text.d40l_property_value_set_802a70fc 0x802a70fc : { *(.text.d40l_property_value_set_802a70fc) }
  /DISCARD/ : { *(.text*) *(.rodata*) *(.data*) *(.bss*) *(.sdata*) *(.sbss*) *(.comment) }
}
