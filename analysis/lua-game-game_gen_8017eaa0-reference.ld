/* Generated reference-only placements. All bodies are source-built. */
OUTPUT_FORMAT("elf32-powerpc")
OUTPUT_ARCH(powerpc)
ENTRY(w3d_registry_unlink_8017eaa0)
_SDA_BASE_ = 0x804b2540;
_SDA2_BASE_ = 0x804c2540;
w3d_base_destroy = 0x80190384;
w3d_fn_80189afc = 0x80189afc;
w3d_fn_8018a3a4 = 0x8018a3a4;
w3d_fn_8018e2e0 = 0x8018e2e0;
w3d_fn_8018e510 = 0x8018e510;
w3d_fn_8018e69c = 0x8018e69c;
w3d_fn_8018e850 = 0x8018e850;
w3d_fn_8018ea74 = 0x8018ea74;
w3d_fn_8018ec10 = 0x8018ec10;
w3d_fn_8018edd4 = 0x8018edd4;
w3d_fn_8018ef90 = 0x8018ef90;
w3d_fn_8018f23c = 0x8018f23c;
w3d_fn_801902e8 = 0x801902e8;
w3d_fn_80190800 = 0x80190800;
w3d_fn_801908bc = 0x801908bc;
w3d_fn_80194234 = 0x80194234;
w3d_fn_80194318 = 0x80194318;
w3d_global_80361c58 = 0x80361c58;
w3d_global_80361c88 = 0x80361c88;
w3d_global_80361cd8 = 0x80361cd8;
w3d_global_80361d28 = 0x80361d28;
w3d_global_80361d78 = 0x80361d78;
w3d_global_80361dc8 = 0x80361dc8;
w3d_global_80361e18 = 0x80361e18;
w3d_global_80361e68 = 0x80361e68;
w3d_global_80361eb8 = 0x80361eb8;
w3d_global_80361f08 = 0x80361f08;
w3d_global_80361f58 = 0x80361f58;
w3d_global_80361f88 = 0x80361f88;
w3d_global_80361fb8 = 0x80361fb8;
w3d_global_803a7714 = 0x803a7714;
w3d_global_803a7ab4 = 0x803a7ab4;
w3d_global_803a7bcc = 0x803a7bcc;
w3d_global_803a7bf8 = 0x803a7bf8;
w3d_global_803a7c1c = 0x803a7c1c;
w3d_global_803a7e10 = 0x803a7e10;
w3d_global_803a81d0 = 0x803a81d0;
w3d_global_803a81f4 = 0x803a81f4;
w3d_global_803a8238 = 0x803a8238;
w3d_global_803a8290 = 0x803a8290;
w3d_heap_allocate_entry_a = 0x801fe1d8;
w3d_owner_list_remove = 0x8020fd2c;
w3d_registry_list_80361b98 = 0x80361b98;
w3d_registry_list_80361c58 = 0x80361c58;
w3d_registry_list_80361c88 = 0x80361c88;
w3d_registry_list_80361cd8 = 0x80361cd8;
w3d_registry_list_80361d28 = 0x80361d28;
w3d_registry_list_80361d78 = 0x80361d78;
w3d_registry_list_80361dc8 = 0x80361dc8;
w3d_registry_list_80361e18 = 0x80361e18;
w3d_registry_list_80361e68 = 0x80361e68;
w3d_registry_list_80361eb8 = 0x80361eb8;
w3d_registry_list_80361f08 = 0x80361f08;
w3d_registry_list_80361f58 = 0x80361f58;
w3d_registry_list_80361f88 = 0x80361f88;
w3d_registry_list_80361fb8 = 0x80361fb8;
w3d_state_register = 0x8020fd04;
SECTIONS {
  .text.w3d_registry_unlink_8017eaa0 0x8017eaa0 : { *(.text.w3d_registry_unlink_8017eaa0) }
  .text.w3d_address_8017eb44 0x8017eb44 : { *(.text.w3d_address_8017eb44) }
  .text.w3d_registry_retain_8017ebac 0x8017ebac : { *(.text.w3d_registry_retain_8017ebac) }
  .text.w3d_constant_8017f5c0 0x8017f5c0 : { *(.text.w3d_constant_8017f5c0) }
  .text.w3d_constant_80188a04 0x80188a04 : { *(.text.w3d_constant_80188a04) }
  .text.w3d_address_80188a0c 0x80188a0c : { *(.text.w3d_address_80188a0c) }
  .text.w3d_constant_80188b24 0x80188b24 : { *(.text.w3d_constant_80188b24) }
  .text.w3d_address_80188b2c 0x80188b2c : { *(.text.w3d_address_80188b2c) }
  .text.w3d_constant_80189154 0x80189154 : { *(.text.w3d_constant_80189154) }
  .text.w3d_address_80189984 0x80189984 : { *(.text.w3d_address_80189984) }
  .text.w3d_registry_unlink_80189990 0x80189990 : { *(.text.w3d_registry_unlink_80189990) }
  .text.w3d_registry_create_801899d4 0x801899d4 : { *(.text.w3d_registry_create_801899d4) }
  .text.w3d_address_80189a34 0x80189a34 : { *(.text.w3d_address_80189a34) }
  .text.w3d_registry_release_80189a40 0x80189a40 : { *(.text.w3d_registry_release_80189a40) }
  .text.w3d_registry_retain_80189a9c 0x80189a9c : { *(.text.w3d_registry_retain_80189a9c) }
  .text.w3d_constant_8018bcf0 0x8018bcf0 : { *(.text.w3d_constant_8018bcf0) }
  .text.w3d_address_8018bcf8 0x8018bcf8 : { *(.text.w3d_address_8018bcf8) }
  .text.w3d_constant_8018bf04 0x8018bf04 : { *(.text.w3d_constant_8018bf04) }
  .text.w3d_address_8018bf0c 0x8018bf0c : { *(.text.w3d_address_8018bf0c) }
  .text.w3d_get_8018e0c8 0x8018e0c8 : { *(.text.w3d_get_8018e0c8) }
  .text.w3d_get_8018e0d0 0x8018e0d0 : { *(.text.w3d_get_8018e0d0) }
  .text.w3d_address_8018e1b4 0x8018e1b4 : { *(.text.w3d_address_8018e1b4) }
  .text.w3d_registry_unlink_8018e228 0x8018e228 : { *(.text.w3d_registry_unlink_8018e228) }
  .text.w3d_address_8018e414 0x8018e414 : { *(.text.w3d_address_8018e414) }
  .text.w3d_registry_unlink_8018e488 0x8018e488 : { *(.text.w3d_registry_unlink_8018e488) }
  .text.w3d_address_8018e5a0 0x8018e5a0 : { *(.text.w3d_address_8018e5a0) }
  .text.w3d_registry_unlink_8018e614 0x8018e614 : { *(.text.w3d_registry_unlink_8018e614) }
  .text.w3d_address_8018e72c 0x8018e72c : { *(.text.w3d_address_8018e72c) }
  .text.w3d_registry_unlink_8018e7a0 0x8018e7a0 : { *(.text.w3d_registry_unlink_8018e7a0) }
  .text.w3d_address_8018e974 0x8018e974 : { *(.text.w3d_address_8018e974) }
  .text.w3d_registry_unlink_8018e9e8 0x8018e9e8 : { *(.text.w3d_registry_unlink_8018e9e8) }
  .text.w3d_address_8018eb04 0x8018eb04 : { *(.text.w3d_address_8018eb04) }
  .text.w3d_registry_unlink_8018eb78 0x8018eb78 : { *(.text.w3d_registry_unlink_8018eb78) }
  .text.w3d_address_8018ecd8 0x8018ecd8 : { *(.text.w3d_address_8018ecd8) }
  .text.w3d_registry_unlink_8018ed4c 0x8018ed4c : { *(.text.w3d_registry_unlink_8018ed4c) }
  .text.w3d_address_8018ee84 0x8018ee84 : { *(.text.w3d_address_8018ee84) }
  .text.w3d_registry_unlink_8018eef8 0x8018eef8 : { *(.text.w3d_registry_unlink_8018eef8) }
  .text.w3d_address_8018f040 0x8018f040 : { *(.text.w3d_address_8018f040) }
  .text.w3d_registry_unlink_8018f0b4 0x8018f0b4 : { *(.text.w3d_registry_unlink_8018f0b4) }
  .text.w3d_registry_release_8018fa9c 0x8018fa9c : { *(.text.w3d_registry_release_8018fa9c) }
  .text.w3d_registry_release_8018faf8 0x8018faf8 : { *(.text.w3d_registry_release_8018faf8) }
  .text.w3d_registry_release_8018fb54 0x8018fb54 : { *(.text.w3d_registry_release_8018fb54) }
  .text.w3d_registry_release_8018fbb0 0x8018fbb0 : { *(.text.w3d_registry_release_8018fbb0) }
  .text.w3d_registry_release_8018fc0c 0x8018fc0c : { *(.text.w3d_registry_release_8018fc0c) }
  .text.w3d_registry_release_8018fc68 0x8018fc68 : { *(.text.w3d_registry_release_8018fc68) }
  .text.w3d_registry_release_8018fcc4 0x8018fcc4 : { *(.text.w3d_registry_release_8018fcc4) }
  .text.w3d_registry_release_8018fd20 0x8018fd20 : { *(.text.w3d_registry_release_8018fd20) }
  .text.w3d_registry_release_8018fd7c 0x8018fd7c : { *(.text.w3d_registry_release_8018fd7c) }
  .text.w3d_set_8018fe48 0x8018fe48 : { *(.text.w3d_set_8018fe48) }
  .text.w3d_get_8018fe50 0x8018fe50 : { *(.text.w3d_get_8018fe50) }
  .text.w3d_set_8018fe58 0x8018fe58 : { *(.text.w3d_set_8018fe58) }
  .text.w3d_get_8018fe60 0x8018fe60 : { *(.text.w3d_get_8018fe60) }
  .text.w3d_set_8018fe68 0x8018fe68 : { *(.text.w3d_set_8018fe68) }
  .text.w3d_get_8018fe70 0x8018fe70 : { *(.text.w3d_get_8018fe70) }
  .text.w3d_get_8018ff84 0x8018ff84 : { *(.text.w3d_get_8018ff84) }
  .text.w3d_set_8018ffa0 0x8018ffa0 : { *(.text.w3d_set_8018ffa0) }
  .text.w3d_get_8018ffa8 0x8018ffa8 : { *(.text.w3d_get_8018ffa8) }
  .text.w3d_address_80190170 0x80190170 : { *(.text.w3d_address_80190170) }
  .text.w3d_registry_unlink_8019017c 0x8019017c : { *(.text.w3d_registry_unlink_8019017c) }
  .text.w3d_registry_create_801901c0 0x801901c0 : { *(.text.w3d_registry_create_801901c0) }
  .text.w3d_address_80190220 0x80190220 : { *(.text.w3d_address_80190220) }
  .text.w3d_registry_release_8019022c 0x8019022c : { *(.text.w3d_registry_release_8019022c) }
  .text.w3d_registry_retain_80190288 0x80190288 : { *(.text.w3d_registry_retain_80190288) }
  .text.w3d_constant_80190404 0x80190404 : { *(.text.w3d_constant_80190404) }
  .text.w3d_address_8019040c 0x8019040c : { *(.text.w3d_address_8019040c) }
  .text.w3d_constant_80190424 0x80190424 : { *(.text.w3d_constant_80190424) }
  .text.w3d_get_80190494 0x80190494 : { *(.text.w3d_get_80190494) }
  .text.w3d_constant_801904a8 0x801904a8 : { *(.text.w3d_constant_801904a8) }
  .text.w3d_address_80190630 0x80190630 : { *(.text.w3d_address_80190630) }
  .text.w3d_registry_unlink_8019063c 0x8019063c : { *(.text.w3d_registry_unlink_8019063c) }
  .text.w3d_registry_create_80190680 0x80190680 : { *(.text.w3d_registry_create_80190680) }
  .text.w3d_address_801906e0 0x801906e0 : { *(.text.w3d_address_801906e0) }
  .text.w3d_registry_release_801906ec 0x801906ec : { *(.text.w3d_registry_release_801906ec) }
  .text.w3d_registry_retain_80190748 0x80190748 : { *(.text.w3d_registry_retain_80190748) }
  .text.w3d_address_801940bc 0x801940bc : { *(.text.w3d_address_801940bc) }
  .text.w3d_registry_unlink_801940c8 0x801940c8 : { *(.text.w3d_registry_unlink_801940c8) }
  .text.w3d_registry_create_8019410c 0x8019410c : { *(.text.w3d_registry_create_8019410c) }
  .text.w3d_address_8019416c 0x8019416c : { *(.text.w3d_address_8019416c) }
  .text.w3d_registry_release_80194178 0x80194178 : { *(.text.w3d_registry_release_80194178) }
  .text.w3d_registry_retain_801941d4 0x801941d4 : { *(.text.w3d_registry_retain_801941d4) }
  /DISCARD/ : { *(.text*) *(.rodata*) *(.data*) *(.bss*) *(.sdata*) *(.sbss*) *(.comment) }
}
