/* Generated reference-only placements. All bodies are source-built. */
OUTPUT_FORMAT("elf32-powerpc")
OUTPUT_ARCH(powerpc)
ENTRY(w3d_s20_normalize_after_call_800ed38c)
_SDA_BASE_ = 0x804b2540;
_SDA2_BASE_ = 0x804c2540;
fn_801797b4 = 0x801797b4;
fn_802e82c0 = 0x802e82c0;
fn_80341584 = 0x80341584;
lbl_8038b600 = 0x8038b600;
lbl_8038b604 = 0x8038b604;
SECTIONS {
  .text.w3d_s20_normalize_after_call_800ed38c 0x800ed38c : { *(.text.w3d_s20_normalize_after_call_800ed38c) }
  /DISCARD/ : { *(.text*) *(.rodata*) *(.data*) *(.bss*) *(.sdata*) *(.sbss*) *(.comment) }
}
