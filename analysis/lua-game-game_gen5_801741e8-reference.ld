/* Generated reference-only placements. All bodies are source-built. */
OUTPUT_FORMAT("elf32-powerpc")
OUTPUT_ARCH(powerpc)
ENTRY(w3d_forward_801741e8)
_SDA_BASE_ = 0x804b2540;
_SDA2_BASE_ = 0x804c2540;
w3d_address_8017eb44 = 0x8017eb44;
w3d_address_80189a34 = 0x80189a34;
w3d_address_80190220 = 0x80190220;
w3d_address_801906e0 = 0x801906e0;
w3d_address_8019416c = 0x8019416c;
w3d_address_80198894 = 0x80198894;
w3d_address_8019c29c = 0x8019c29c;
w3d_address_8019cb34 = 0x8019cb34;
w3d_address_8019d6c4 = 0x8019d6c4;
w3d_address_8019d9b4 = 0x8019d9b4;
w3d_address_8019e4e8 = 0x8019e4e8;
w3d_address_8019ffb0 = 0x8019ffb0;
w3d_address_801a0634 = 0x801a0634;
w3d_address_801a19c0 = 0x801a19c0;
w3d_address_801a24d8 = 0x801a24d8;
w3d_address_801a526c = 0x801a526c;
w3d_address_801a60f8 = 0x801a60f8;
w3d_address_801a71ac = 0x801a71ac;
w3d_address_801a80d0 = 0x801a80d0;
w3d_address_801ab1a0 = 0x801ab1a0;
w3d_address_801ac0d4 = 0x801ac0d4;
w3d_address_801ac6d4 = 0x801ac6d4;
w3d_address_801ae310 = 0x801ae310;
w3d_address_801ae9f8 = 0x801ae9f8;
w3d_address_801b0c70 = 0x801b0c70;
w3d_address_801b16f4 = 0x801b16f4;
w3d_address_801b21d4 = 0x801b21d4;
w3d_address_801b2b84 = 0x801b2b84;
w3d_address_801b4344 = 0x801b4344;
w3d_fn_80174168 = 0x80174168;
w3d_fn_80174a98 = 0x80174a98;
w3d_fn_801752d4 = 0x801752d4;
w3d_fn_801757a4 = 0x801757a4;
w3d_fn_80178814 = 0x80178814;
w3d_fn_801797c0 = 0x801797c0;
w3d_fn_8017b78c = 0x8017b78c;
w3d_fn_8017b7e8 = 0x8017b7e8;
w3d_fn_8017bf40 = 0x8017bf40;
w3d_fn_801b4c6c = 0x801b4c6c;
w3d_fn_801b6804 = 0x801b6804;
w3d_fn_801b687c = 0x801b687c;
w3d_fn_801ea0ec = 0x801ea0ec;
w3d_fn_801ea138 = 0x801ea138;
w3d_fn_801ea740 = 0x801ea740;
w3d_fn_8020b460 = 0x8020b460;
w3d_global_80361b68 = 0x80361b68;
w3d_global_803a6724 = 0x803a6724;
w3d_global_803a67d4 = 0x803a67d4;
w3d_global_803a67f4 = 0x803a67f4;
w3d_global_803a7150 = 0x803a7150;
w3d_global_80457014 = 0x80457014;
w3d_heap_allocate_entry_a = 0x801fe1d8;
w3d_owner_list_remove = 0x8020fd2c;
w3d_registry_list_80361b68 = 0x80361b68;
w3d_state_register = 0x8020fd04;
w3d_vtable_80413508 = 0x80413508;
w3d_vtable_80413558 = 0x80413558;
w3d_vtable_80414550 = 0x80414550;
w3d_vtable_80414578 = 0x80414578;
w3d_vtable_804145a0 = 0x804145a0;
w3d_vtable_80415910 = 0x80415910;
w3d_vtable_80415938 = 0x80415938;
w3d_vtable_80415960 = 0x80415960;
w3d_vtable_80415988 = 0x80415988;
w3d_vtable_804159b0 = 0x804159b0;
w3d_vtable_804159d8 = 0x804159d8;
w3d_vtable_80415a00 = 0x80415a00;
w3d_vtable_80415a28 = 0x80415a28;
w3d_vtable_80415ac8 = 0x80415ac8;
SECTIONS {
  .text.w3d_forward_801741e8 0x801741e8 : { *(.text.w3d_forward_801741e8) }
  .text.w3d_constant_80174af8 0x80174af8 : { *(.text.w3d_constant_80174af8) }
  .text.w3d_address_80174b00 0x80174b00 : { *(.text.w3d_address_80174b00) }
  .text.w3d_static_init_80174b0c 0x80174b0c : { *(.text.w3d_static_init_80174b0c) }
  .text.w3d_constant_80174bb8 0x80174bb8 : { *(.text.w3d_constant_80174bb8) }
  .text.w3d_address_80174bc0 0x80174bc0 : { *(.text.w3d_address_80174bc0) }
  .text.w3d_constant_8017503c 0x8017503c : { *(.text.w3d_constant_8017503c) }
  .text.w3d_address_8017515c 0x8017515c : { *(.text.w3d_address_8017515c) }
  .text.w3d_registry_release_80175168 0x80175168 : { *(.text.w3d_registry_release_80175168) }
  .text.w3d_registry_retain_801751c4 0x801751c4 : { *(.text.w3d_registry_retain_801751c4) }
  .text.w3d_forward_801751dc 0x801751dc : { *(.text.w3d_forward_801751dc) }
  .text.w3d_address_80175224 0x80175224 : { *(.text.w3d_address_80175224) }
  .text.w3d_registry_unlink_80175230 0x80175230 : { *(.text.w3d_registry_unlink_80175230) }
  .text.w3d_registry_create_80175274 0x80175274 : { *(.text.w3d_registry_create_80175274) }
  .text.w3d_constant_8017665c 0x8017665c : { *(.text.w3d_constant_8017665c) }
  .text.w3d_static_init_80178900 0x80178900 : { *(.text.w3d_static_init_80178900) }
  .text.w3d_get_801789d8 0x801789d8 : { *(.text.w3d_get_801789d8) }
  .text.w3d_get_80178a90 0x80178a90 : { *(.text.w3d_get_80178a90) }
  .text.w3d_constant_801798d0 0x801798d0 : { *(.text.w3d_constant_801798d0) }
  .text.w3d_constant_801798d8 0x801798d8 : { *(.text.w3d_constant_801798d8) }
  .text.w3d_static_init_801798e0 0x801798e0 : { *(.text.w3d_static_init_801798e0) }
  .text.w3d_static_init_8017b7b0 0x8017b7b0 : { *(.text.w3d_static_init_8017b7b0) }
  .text.w3d_address_8017b7dc 0x8017b7dc : { *(.text.w3d_address_8017b7dc) }
  .text.w3d_address_8017b900 0x8017b900 : { *(.text.w3d_address_8017b900) }
  .text.w3d_registry_release_8017b90c 0x8017b90c : { *(.text.w3d_registry_release_8017b90c) }
  .text.w3d_registry_retain_8017b968 0x8017b968 : { *(.text.w3d_registry_retain_8017b968) }
  .text.w3d_forward_8017b980 0x8017b980 : { *(.text.w3d_forward_8017b980) }
  .text.w3d_get_8017d6ec 0x8017d6ec : { *(.text.w3d_get_8017d6ec) }
  .text.w3d_forward_8017ebc4 0x8017ebc4 : { *(.text.w3d_forward_8017ebc4) }
  .text.w3d_forward_80189ab4 0x80189ab4 : { *(.text.w3d_forward_80189ab4) }
  .text.w3d_forward_801902a0 0x801902a0 : { *(.text.w3d_forward_801902a0) }
  .text.w3d_forward_80190760 0x80190760 : { *(.text.w3d_forward_80190760) }
  .text.w3d_forward_801941ec 0x801941ec : { *(.text.w3d_forward_801941ec) }
  .text.w3d_forward_80198914 0x80198914 : { *(.text.w3d_forward_80198914) }
  .text.w3d_dtor_held_8019b4a0 0x8019b4a0 : { *(.text.w3d_dtor_held_8019b4a0) }
  .text.w3d_dtor_8019bbfc 0x8019bbfc : { *(.text.w3d_dtor_8019bbfc) }
  .text.w3d_ifaceset_8019bff4 0x8019bff4 : { *(.text.w3d_ifaceset_8019bff4) }
  .text.w3d_forward_8019c31c 0x8019c31c : { *(.text.w3d_forward_8019c31c) }
  .text.w3d_forward_8019cbb4 0x8019cbb4 : { *(.text.w3d_forward_8019cbb4) }
  .text.w3d_forward_8019d744 0x8019d744 : { *(.text.w3d_forward_8019d744) }
  .text.w3d_forward_8019da34 0x8019da34 : { *(.text.w3d_forward_8019da34) }
  .text.w3d_forward_8019e568 0x8019e568 : { *(.text.w3d_forward_8019e568) }
  .text.w3d_forward_801a0030 0x801a0030 : { *(.text.w3d_forward_801a0030) }
  .text.w3d_forward_801a06b4 0x801a06b4 : { *(.text.w3d_forward_801a06b4) }
  .text.w3d_forward_801a19f8 0x801a19f8 : { *(.text.w3d_forward_801a19f8) }
  .text.w3d_forward_801a2558 0x801a2558 : { *(.text.w3d_forward_801a2558) }
  .text.w3d_forward_801a52ec 0x801a52ec : { *(.text.w3d_forward_801a52ec) }
  .text.w3d_forward_801a6178 0x801a6178 : { *(.text.w3d_forward_801a6178) }
  .text.w3d_forward_801a722c 0x801a722c : { *(.text.w3d_forward_801a722c) }
  .text.w3d_forward_801a8150 0x801a8150 : { *(.text.w3d_forward_801a8150) }
  .text.w3d_forward_801ab220 0x801ab220 : { *(.text.w3d_forward_801ab220) }
  .text.w3d_forward_801ac154 0x801ac154 : { *(.text.w3d_forward_801ac154) }
  .text.w3d_forward_801ac754 0x801ac754 : { *(.text.w3d_forward_801ac754) }
  .text.w3d_forward_801ae390 0x801ae390 : { *(.text.w3d_forward_801ae390) }
  .text.w3d_forward_801aea78 0x801aea78 : { *(.text.w3d_forward_801aea78) }
  .text.w3d_forward_801b0cf0 0x801b0cf0 : { *(.text.w3d_forward_801b0cf0) }
  .text.w3d_forward_801b1774 0x801b1774 : { *(.text.w3d_forward_801b1774) }
  .text.w3d_forward_801b2254 0x801b2254 : { *(.text.w3d_forward_801b2254) }
  .text.w3d_forward_801b2c04 0x801b2c04 : { *(.text.w3d_forward_801b2c04) }
  .text.w3d_forward_801b43c4 0x801b43c4 : { *(.text.w3d_forward_801b43c4) }
  .text.w3d_dtor_held_801b4ef0 0x801b4ef0 : { *(.text.w3d_dtor_held_801b4ef0) }
  .text.w3d_dtor_held_801b5134 0x801b5134 : { *(.text.w3d_dtor_held_801b5134) }
  .text.w3d_ctor_801b529c 0x801b529c : { *(.text.w3d_ctor_801b529c) }
  .text.w3d_dtor_801b52d8 0x801b52d8 : { *(.text.w3d_dtor_801b52d8) }
  .text.w3d_ifaceset_801b58e8 0x801b58e8 : { *(.text.w3d_ifaceset_801b58e8) }
  .text.w3d_ifaceset_801b5964 0x801b5964 : { *(.text.w3d_ifaceset_801b5964) }
  .text.w3d_ifaceset_801b59d0 0x801b59d0 : { *(.text.w3d_ifaceset_801b59d0) }
  .text.w3d_dtor_801b5bd4 0x801b5bd4 : { *(.text.w3d_dtor_801b5bd4) }
  .text.w3d_ctor_801b6ab4 0x801b6ab4 : { *(.text.w3d_ctor_801b6ab4) }
  .text.w3d_dtor_801b6af0 0x801b6af0 : { *(.text.w3d_dtor_801b6af0) }
  .text.w3d_dtor_held_801b6c78 0x801b6c78 : { *(.text.w3d_dtor_held_801b6c78) }
  .text.w3d_ctor_801b6e68 0x801b6e68 : { *(.text.w3d_ctor_801b6e68) }
  .text.w3d_dtor_801b6ea4 0x801b6ea4 : { *(.text.w3d_dtor_801b6ea4) }
  .text.w3d_ctor_801b6fd0 0x801b6fd0 : { *(.text.w3d_ctor_801b6fd0) }
  .text.w3d_dtor_801b700c 0x801b700c : { *(.text.w3d_dtor_801b700c) }
  .text.w3d_ctor_801b7138 0x801b7138 : { *(.text.w3d_ctor_801b7138) }
  .text.w3d_dtor_801b7174 0x801b7174 : { *(.text.w3d_dtor_801b7174) }
  .text.w3d_dtor_held_801b72fc 0x801b72fc : { *(.text.w3d_dtor_held_801b72fc) }
  .text.w3d_dtor_held_801b7548 0x801b7548 : { *(.text.w3d_dtor_held_801b7548) }
  .text.w3d_dtor_held_801b7794 0x801b7794 : { *(.text.w3d_dtor_held_801b7794) }
  /DISCARD/ : { *(.text*) *(.rodata*) *(.data*) *(.bss*) *(.sdata*) *(.sbss*) *(.comment) }
}
