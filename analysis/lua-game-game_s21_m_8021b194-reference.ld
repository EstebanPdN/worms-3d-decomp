/* Generated reference-only placements. All bodies are source-built. */
OUTPUT_FORMAT("elf32-powerpc")
OUTPUT_ARCH(powerpc)
ENTRY(w3d_s21_dispatch_8021b194)
_SDA_BASE_ = 0x804b2540;
_SDA2_BASE_ = 0x804c2540;
fn_8021b1f8 = 0x8021b1f8;
fn_8021b388 = 0x8021b388;
fn_8021ec2c = 0x8021ec2c;
fn_8021ed14 = 0x8021ed14;
fn_80240994 = 0x80240994;
SECTIONS {
  .text.w3d_s21_dispatch_8021b194 0x8021b194 : { *(.text.w3d_s21_dispatch_8021b194) }
  /DISCARD/ : { *(.text*) *(.rodata*) *(.data*) *(.bss*) *(.sdata*) *(.sbss*) *(.comment) }
}
