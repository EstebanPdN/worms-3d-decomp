/* Generated reference-only placements. All bodies are source-built. */
OUTPUT_FORMAT("elf32-powerpc")
OUTPUT_ARCH(powerpc)
ENTRY(w3d_s21_set_value_all_802bcb6c)
_SDA_BASE_ = 0x804b2540;
_SDA2_BASE_ = 0x804c2540;
fn_802bfb2c = 0x802bfb2c;
SECTIONS {
  .text.w3d_s21_set_value_all_802bcb6c 0x802bcb6c : { *(.text.w3d_s21_set_value_all_802bcb6c) }
  /DISCARD/ : { *(.text*) *(.rodata*) *(.data*) *(.bss*) *(.sdata*) *(.sbss*) *(.comment) }
}
