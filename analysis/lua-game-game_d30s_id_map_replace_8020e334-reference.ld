/* Generated reference-only placements. All bodies are source-built. */
OUTPUT_FORMAT("elf32-powerpc")
OUTPUT_ARCH(powerpc)
ENTRY(d30s_id_map_replace_8020e334)
_SDA_BASE_ = 0x804b2540;
_SDA2_BASE_ = 0x804c2540;
insert_unique__Q24_STLt8_Rb_tree5ZUiZQ24_STLt4pair2ZCUiZPvZQ24_STLt10_Select1st1ZQ24_STLt4pair2ZCUiZPvZQ24_STLt4less1ZUiZQ24_STLt9allocator1ZQ24_STLt4pair2ZCUiZPvGQ24_STLt17_Rb_tree_iterator2ZQ24_STLt4pair2ZCUiZPvZQ24_STLt16_Nonconst_traits1ZQ24_STLt4pair2ZCUiZPvRCQ24_STLt4pair2ZCUiZPv = 0x8035ced0;
SECTIONS {
  .text.d30s_id_map_replace_8020e334 0x8020e334 : { *(.text.d30s_id_map_replace_8020e334) }
  /DISCARD/ : { *(.text*) *(.rodata*) *(.data*) *(.bss*) *(.sdata*) *(.sbss*) *(.comment) }
}
