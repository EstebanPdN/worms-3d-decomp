/* Generated reference-only placements. All bodies are source-built. */
OUTPUT_FORMAT("elf32-powerpc")
OUTPUT_ARCH(powerpc)
ENTRY(__15Screen_8040faa8)
_SDA_BASE_ = 0x804b2540;
_SDA2_BASE_ = 0x804c2540;
__13Base_801628b0 = 0x801628b0;
_vt.4Root = 0x8040faa8;
SECTIONS {
  .text.__15Screen_8040faa8 0x800c6e44 : { *(.text.__15Screen_8040faa8) }
  /DISCARD/ : { *(.text*) *(.rodata*) *(.data*) *(.bss*) *(.sdata*) *(.sbss*) *(.comment) }
}
