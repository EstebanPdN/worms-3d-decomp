/* Generated reference-only placements. All bodies are source-built. */
OUTPUT_FORMAT("elf32-powerpc")
OUTPUT_ARCH(powerpc)
ENTRY(w3d_f12c_construct_editor_80268808)
_SDA_BASE_ = 0x804b2540;
_SDA2_BASE_ = 0x804c2540;
fn_8015fef0 = 0x8015fef0;
fn_8020bd38 = 0x8020bd38;
fn_8026c0d0 = 0x8026c0d0;
fn_8026c714 = 0x8026c714;
fn_802afb20 = 0x802afb20;
fn_803426b8 = 0x803426b8;
name_803cb80c = 0x803cb80c;
vt_8041bc90 = 0x8041bc90;
vt_8041bce0 = 0x8041bce0;
SECTIONS {
  .text.w3d_f12c_construct_editor_80268808 0x80268808 : { *(.text.w3d_f12c_construct_editor_80268808) }
  /DISCARD/ : { *(.text*) *(.rodata*) *(.data*) *(.bss*) *(.sdata*) *(.sbss*) *(.comment) }
}
