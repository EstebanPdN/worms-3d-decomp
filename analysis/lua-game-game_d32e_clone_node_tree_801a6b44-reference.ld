/* Generated reference-only placements. All bodies are source-built. */
OUTPUT_FORMAT("elf32-powerpc")
OUTPUT_ARCH(powerpc)
ENTRY(w3d_d32e_clone_node_tree_801a6b44)
_SDA_BASE_ = 0x804b2540;
_SDA2_BASE_ = 0x804c2540;
f11c_hierarchy_801a69a8 = 0x801a69a8;
lbl_80365788 = 0x80365788;
lbl_8040c960 = 0x8040c960;
w3d_auto_801fffc8 = 0x801fffc8;
w3d_k5b_iface_array_field_set_801ef2ec = 0x801ef2ec;
w3d_s10_assign_interface_801a66c0 = 0x801a66c0;
w3d_s20_find_or_create_801a692c = 0x801a692c;
w3d_s20_find_value_801a688c = 0x801a688c;
w3d_s21_vector_get_801e9db8 = 0x801e9db8;
SECTIONS {
  .text.w3d_d32e_clone_node_tree_801a6b44 0x801a6b44 : { *(.text.w3d_d32e_clone_node_tree_801a6b44) }
  /DISCARD/ : { *(.text*) *(.rodata*) *(.data*) *(.bss*) *(.sdata*) *(.sbss*) *(.comment) }
}
