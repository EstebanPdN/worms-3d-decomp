/* Generated reference-only placements. All bodies are source-built. */
OUTPUT_FORMAT("elf32-powerpc")
OUTPUT_ARCH(powerpc)
ENTRY(f1c_lookup_byte_80202494)
_SDA_BASE_ = 0x804b2540;
_SDA2_BASE_ = 0x804c2540;
fn_801fff18 = 0x801fff18;
fn_8035a990 = 0x8035a990;
SECTIONS {
  .text.f1c_lookup_byte_80202494 0x80202494 : { *(.text.f1c_lookup_byte_80202494) }
  /DISCARD/ : { *(.text*) *(.rodata*) *(.data*) *(.bss*) *(.sdata*) *(.sbss*) *(.comment) }
}
