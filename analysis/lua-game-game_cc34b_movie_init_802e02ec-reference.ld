/* Generated reference-only placements. All bodies are source-built. */
OUTPUT_FORMAT("elf32-powerpc")
OUTPUT_ARCH(powerpc)
ENTRY(w3d_cc34b_movie_init_802e02ec)
_SDA_BASE_ = 0x804b2540;
_SDA2_BASE_ = 0x804c2540;
fn_801fe1d8 = 0x801fe1d8;
fn_802e20e4 = 0x802e20e4;
fn_802ebfbc = 0x802ebfbc;
fn_802eefe0 = 0x802eefe0;
fn_802fab90 = 0x802fab90;
fn_80322268 = 0x80322268;
lbl_803db030 = 0x803db030;
lbl_803db050 = 0x803db050;
lbl_803db054 = 0x803db054;
SECTIONS {
  .text.w3d_cc34b_movie_init_802e02ec 0x802e02ec : { *(.text.w3d_cc34b_movie_init_802e02ec) }
  /DISCARD/ : { *(.text*) *(.rodata*) *(.data*) *(.bss*) *(.sdata*) *(.sbss*) *(.comment) }
}
