/* Generated reference-only placements. All bodies are source-built. */
OUTPUT_FORMAT("elf32-powerpc")
OUTPUT_ARCH(powerpc)
ENTRY(w3d_empty_802092c0)
_SDA_BASE_ = 0x804b2540;
_SDA2_BASE_ = 0x804c2540;
w3d_address_80209f74 = 0x80209f74;
w3d_address_8020aa08 = 0x8020aa08;
w3d_address_8020af90 = 0x8020af90;
w3d_address_8020b168 = 0x8020b168;
w3d_address_8020d25c = 0x8020d25c;
w3d_address_8020df14 = 0x8020df14;
w3d_address_80218004 = 0x80218004;
w3d_address_802180cc = 0x802180cc;
w3d_address_80218dfc = 0x80218dfc;
w3d_address_80219444 = 0x80219444;
w3d_address_80219aac = 0x80219aac;
w3d_address_80219b68 = 0x80219b68;
w3d_address_80219c24 = 0x80219c24;
w3d_address_80219ce0 = 0x80219ce0;
w3d_address_80219d9c = 0x80219d9c;
w3d_fn_801ea138 = 0x801ea138;
w3d_fn_801ea740 = 0x801ea740;
w3d_fn_8020b460 = 0x8020b460;
w3d_fn_8020fac8 = 0x8020fac8;
w3d_fn_80210f5c = 0x80210f5c;
w3d_fn_8021f234 = 0x8021f234;
w3d_fn_80226150 = 0x80226150;
w3d_fn_80226224 = 0x80226224;
w3d_fn_80227560 = 0x80227560;
w3d_vtable_80419fb0 = 0x80419fb0;
w3d_vtable_8041a028 = 0x8041a028;
w3d_vtable_8041a050 = 0x8041a050;
w3d_vtable_8041a0a0 = 0x8041a0a0;
w3d_vtable_8041a140 = 0x8041a140;
w3d_vtable_8041a190 = 0x8041a190;
w3d_vtable_8041a1e0 = 0x8041a1e0;
w3d_vtable_8041a208 = 0x8041a208;
w3d_vtable_8041a230 = 0x8041a230;
w3d_vtable_8041a2a8 = 0x8041a2a8;
w3d_vtable_8041a320 = 0x8041a320;
SECTIONS {
  .text.w3d_empty_802092c0 0x802092c0 : { *(.text.w3d_empty_802092c0) }
  .text.w3d_empty_802092c4 0x802092c4 : { *(.text.w3d_empty_802092c4) }
  .text.w3d_empty_802095d4 0x802095d4 : { *(.text.w3d_empty_802095d4) }
  .text.w3d_empty_802095d8 0x802095d8 : { *(.text.w3d_empty_802095d8) }
  .text.w3d_set_802097e4 0x802097e4 : { *(.text.w3d_set_802097e4) }
  .text.w3d_forward_80209ff4 0x80209ff4 : { *(.text.w3d_forward_80209ff4) }
  .text.w3d_forward_8020aa88 0x8020aa88 : { *(.text.w3d_forward_8020aa88) }
  .text.w3d_forward_8020b010 0x8020b010 : { *(.text.w3d_forward_8020b010) }
  .text.w3d_forward_8020b184 0x8020b184 : { *(.text.w3d_forward_8020b184) }
  .text.w3d_forward_8020d2d0 0x8020d2d0 : { *(.text.w3d_forward_8020d2d0) }
  .text.w3d_forward_8020df94 0x8020df94 : { *(.text.w3d_forward_8020df94) }
  .text.w3d_forward_8020fb88 0x8020fb88 : { *(.text.w3d_forward_8020fb88) }
  .text.w3d_forward_8021107c 0x8021107c : { *(.text.w3d_forward_8021107c) }
  .text.w3d_forward_80218084 0x80218084 : { *(.text.w3d_forward_80218084) }
  .text.w3d_forward_8021814c 0x8021814c : { *(.text.w3d_forward_8021814c) }
  .text.w3d_forward_80218e7c 0x80218e7c : { *(.text.w3d_forward_80218e7c) }
  .text.w3d_forward_802194c4 0x802194c4 : { *(.text.w3d_forward_802194c4) }
  .text.w3d_forward_80219b20 0x80219b20 : { *(.text.w3d_forward_80219b20) }
  .text.w3d_forward_80219bdc 0x80219bdc : { *(.text.w3d_forward_80219bdc) }
  .text.w3d_forward_80219c98 0x80219c98 : { *(.text.w3d_forward_80219c98) }
  .text.w3d_forward_80219d54 0x80219d54 : { *(.text.w3d_forward_80219d54) }
  .text.w3d_forward_80219e10 0x80219e10 : { *(.text.w3d_forward_80219e10) }
  .text.w3d_dtor_80225510 0x80225510 : { *(.text.w3d_dtor_80225510) }
  .text.w3d_dtor_held_80225f54 0x80225f54 : { *(.text.w3d_dtor_held_80225f54) }
  .text.w3d_dtor_held_80226874 0x80226874 : { *(.text.w3d_dtor_held_80226874) }
  .text.w3d_dtor_held_80226ac4 0x80226ac4 : { *(.text.w3d_dtor_held_80226ac4) }
  .text.w3d_ctor_80226cb8 0x80226cb8 : { *(.text.w3d_ctor_80226cb8) }
  .text.w3d_dtor_80226cf4 0x80226cf4 : { *(.text.w3d_dtor_80226cf4) }
  .text.w3d_dtor_80227240 0x80227240 : { *(.text.w3d_dtor_80227240) }
  .text.w3d_dtor_80227bb8 0x80227bb8 : { *(.text.w3d_dtor_80227bb8) }
  .text.w3d_dtor_8022a008 0x8022a008 : { *(.text.w3d_dtor_8022a008) }
  .text.w3d_dtor_held_8022bea4 0x8022bea4 : { *(.text.w3d_dtor_held_8022bea4) }
  .text.w3d_dtor_held_8022c0f8 0x8022c0f8 : { *(.text.w3d_dtor_held_8022c0f8) }
  .text.w3d_dtor_held_8022cca4 0x8022cca4 : { *(.text.w3d_dtor_held_8022cca4) }
  .text.w3d_ifaceset_8023381c 0x8023381c : { *(.text.w3d_ifaceset_8023381c) }
  .text.w3d_ifaceset_80233888 0x80233888 : { *(.text.w3d_ifaceset_80233888) }
  .text.w3d_ifaceset_802338f4 0x802338f4 : { *(.text.w3d_ifaceset_802338f4) }
  .text.w3d_ifaceset_80233960 0x80233960 : { *(.text.w3d_ifaceset_80233960) }
  .text.w3d_ifaceset_802339cc 0x802339cc : { *(.text.w3d_ifaceset_802339cc) }
  .text.w3d_ifaceset_80233a38 0x80233a38 : { *(.text.w3d_ifaceset_80233a38) }
  .text.w3d_ifaceset_80233aa4 0x80233aa4 : { *(.text.w3d_ifaceset_80233aa4) }
  .text.w3d_ifaceset_80233b10 0x80233b10 : { *(.text.w3d_ifaceset_80233b10) }
  .text.w3d_ifaceset_80233b7c 0x80233b7c : { *(.text.w3d_ifaceset_80233b7c) }
  .text.w3d_ifaceset_80233be8 0x80233be8 : { *(.text.w3d_ifaceset_80233be8) }
  .text.w3d_ifaceset_80233c54 0x80233c54 : { *(.text.w3d_ifaceset_80233c54) }
  .text.w3d_ifaceset_80233cc0 0x80233cc0 : { *(.text.w3d_ifaceset_80233cc0) }
  .text.w3d_ifaceset_80233d2c 0x80233d2c : { *(.text.w3d_ifaceset_80233d2c) }
  .text.w3d_ifaceset_80233d98 0x80233d98 : { *(.text.w3d_ifaceset_80233d98) }
  .text.w3d_ifaceset_80233e04 0x80233e04 : { *(.text.w3d_ifaceset_80233e04) }
  .text.w3d_ifaceset_80233e70 0x80233e70 : { *(.text.w3d_ifaceset_80233e70) }
  .text.w3d_ifaceset_80233edc 0x80233edc : { *(.text.w3d_ifaceset_80233edc) }
  .text.w3d_ifaceset_80233f48 0x80233f48 : { *(.text.w3d_ifaceset_80233f48) }
  .text.w3d_ifaceset_80233fb4 0x80233fb4 : { *(.text.w3d_ifaceset_80233fb4) }
  .text.w3d_ifaceset_80234020 0x80234020 : { *(.text.w3d_ifaceset_80234020) }
  .text.w3d_ifaceset_8023408c 0x8023408c : { *(.text.w3d_ifaceset_8023408c) }
  .text.w3d_ifaceset_802340f8 0x802340f8 : { *(.text.w3d_ifaceset_802340f8) }
  .text.w3d_ifaceset_80234164 0x80234164 : { *(.text.w3d_ifaceset_80234164) }
  .text.w3d_ifaceset_802341d0 0x802341d0 : { *(.text.w3d_ifaceset_802341d0) }
  .text.w3d_ifaceset_8023423c 0x8023423c : { *(.text.w3d_ifaceset_8023423c) }
  .text.w3d_ifaceset_802342a8 0x802342a8 : { *(.text.w3d_ifaceset_802342a8) }
  .text.w3d_ifaceset_80234314 0x80234314 : { *(.text.w3d_ifaceset_80234314) }
  .text.w3d_ifaceset_80234380 0x80234380 : { *(.text.w3d_ifaceset_80234380) }
  .text.w3d_ifaceset_802343ec 0x802343ec : { *(.text.w3d_ifaceset_802343ec) }
  .text.w3d_ifaceset_80234458 0x80234458 : { *(.text.w3d_ifaceset_80234458) }
  .text.w3d_ifaceset_802344c4 0x802344c4 : { *(.text.w3d_ifaceset_802344c4) }
  .text.w3d_ifaceset_80234530 0x80234530 : { *(.text.w3d_ifaceset_80234530) }
  .text.w3d_ifaceset_8023459c 0x8023459c : { *(.text.w3d_ifaceset_8023459c) }
  .text.w3d_ifaceset_80234608 0x80234608 : { *(.text.w3d_ifaceset_80234608) }
  .text.w3d_ifaceset_80234674 0x80234674 : { *(.text.w3d_ifaceset_80234674) }
  .text.w3d_ifaceset_802346e0 0x802346e0 : { *(.text.w3d_ifaceset_802346e0) }
  .text.w3d_ifaceset_8023474c 0x8023474c : { *(.text.w3d_ifaceset_8023474c) }
  .text.w3d_ifaceset_802347b8 0x802347b8 : { *(.text.w3d_ifaceset_802347b8) }
  .text.w3d_ifaceset_80234824 0x80234824 : { *(.text.w3d_ifaceset_80234824) }
  .text.w3d_ifaceset_80234890 0x80234890 : { *(.text.w3d_ifaceset_80234890) }
  .text.w3d_ifaceset_802348fc 0x802348fc : { *(.text.w3d_ifaceset_802348fc) }
  .text.w3d_ifaceset_80234968 0x80234968 : { *(.text.w3d_ifaceset_80234968) }
  .text.w3d_ifaceset_802349d4 0x802349d4 : { *(.text.w3d_ifaceset_802349d4) }
  .text.w3d_ifaceset_80234a40 0x80234a40 : { *(.text.w3d_ifaceset_80234a40) }
  .text.w3d_ifaceset_80234aac 0x80234aac : { *(.text.w3d_ifaceset_80234aac) }
  .text.w3d_ifaceset_80234b18 0x80234b18 : { *(.text.w3d_ifaceset_80234b18) }
  /DISCARD/ : { *(.text*) *(.rodata*) *(.data*) *(.bss*) *(.sdata*) *(.sbss*) *(.comment) }
}
