/* Generated reference-only placements. All bodies are source-built. */
OUTPUT_FORMAT("elf32-powerpc")
OUTPUT_ARCH(powerpc)
ENTRY(w3d_d31g_free_camera_update_80072534)
_SDA_BASE_ = 0x804b2540;
_SDA2_BASE_ = 0x804c2540;
cos_802e86d4 = 0x802e86d4;
flag_80178d1c = 0x80178d1c;
k_8037ccc8 = 0x8037ccc8;
sin_802e88ac = 0x802e88ac;
SECTIONS {
  .text.w3d_d31g_free_camera_update_80072534 0x80072534 : { *(.text.w3d_d31g_free_camera_update_80072534) }
  /DISCARD/ : { *(.text*) *(.rodata*) *(.data*) *(.bss*) *(.sdata*) *(.sbss*) *(.comment) }
}
