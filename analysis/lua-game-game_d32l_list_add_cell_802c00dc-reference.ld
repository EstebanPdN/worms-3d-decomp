/* Generated reference-only placements. All bodies are source-built. */
OUTPUT_FORMAT("elf32-powerpc")
OUTPUT_ARCH(powerpc)
ENTRY(d32l_list_add_cell_802c00dc)
_SDA_BASE_ = 0x804b2540;
_SDA2_BASE_ = 0x804c2540;
_S_oom_malloc__Q24_STLt14__malloc_alloc1i0Ui = 0x803413d8;
__3Str = 0x803426b8;
__apl__3StrPCc = 0x8020bf2c;
__as__3StrPCc = 0x8020bd38;
fn_800fc1b0 = 0x800fc1b0;
fn_800fc370 = 0x800fc370;
fn_8015adf4 = 0x8015adf4;
fn_8015ae3c = 0x8015ae3c;
fn_8015aee8 = 0x8015aee8;
fn_80179170 = 0x80179170;
fn_8018b4cc = 0x8018b4cc;
fn_8018b524 = 0x8018b524;
fn_8018c5b0 = 0x8018c5b0;
fn_8018d35c = 0x8018d35c;
fn_8018d434 = 0x8018d434;
fn_8020bb2c = 0x8020bb2c;
fn_8020c43c = 0x8020c43c;
fn_8020c510 = 0x8020c510;
fn_8020c5c4 = 0x8020c5c4;
fn_802bf798 = 0x802bf798;
fn_80341588 = 0x80341588;
fn_80343580 = 0x80343580;
fn_80343744 = 0x80343744;
fn_8034435c = 0x8034435c;
free = 0x802134fc;
lbl_803d83ac = 0x803d83ac;
lbl_803d83c0 = 0x803d83c0;
lbl_803d83c4 = 0x803d83c4;
lbl_803d8438 = 0x803d8438;
lbl_803d843c = 0x803d843c;
malloc = 0x80212fd4;
strlen = 0x802ef9c0;
SECTIONS {
  .text.d32l_list_add_cell_802c00dc 0x802c00dc : { *(.text.d32l_list_add_cell_802c00dc) }
  .rodata 0x803d8460 : { *(.rodata) }
  /DISCARD/ : { *(.text*) *(.rodata*) *(.data*) *(.bss*) *(.sdata*) *(.sbss*) *(.comment) }
}
