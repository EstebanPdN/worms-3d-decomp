/* Generated reference-only placements. All bodies are source-built. */
OUTPUT_FORMAT("elf32-powerpc")
OUTPUT_ARCH(powerpc)
ENTRY(d27c_particle_update_800dc740)
_SDA_BASE_ = 0x804b2540;
_SDA2_BASE_ = 0x804c2540;
anim_800de4c4 = 0x800de4c4;
cast_80342a78 = 0x80342a78;
empty_80342a74 = 0x80342a74;
empty_80342fa4 = 0x80342fa4;
fraction_800de5b4 = 0x800de5b4;
fvalue_80178df0 = 0x80178df0;
jitter_800dff7c = 0x800dff7c;
orient_800de40c = 0x800de40c;
pull_800dfe84 = 0x800dfe84;
timed_800ddcbc = 0x800ddcbc;
value_80178d1c = 0x80178d1c;
vec_80178ec4 = 0x80178ec4;
SECTIONS {
  .text.d27c_particle_update_800dc740 0x800dc740 : { *(.text.d27c_particle_update_800dc740) }
  /DISCARD/ : { *(.text*) *(.rodata*) *(.data*) *(.bss*) *(.sdata*) *(.sbss*) *(.comment) }
}
