/* Generated reference-only placements. All bodies are source-built. */
OUTPUT_FORMAT("elf32-powerpc")
OUTPUT_ARCH(powerpc)
ENTRY(w3d_d29e_build_mip_chain_801d9ca4)
_SDA_BASE_ = 0x804b2540;
_SDA2_BASE_ = 0x804c2540;
fn_801afac0 = 0x801afac0;
fn_801b0a14 = 0x801b0a14;
w3d_k5b_array_ref_lock_801ef048 = 0x801ef048;
SECTIONS {
  .text.w3d_d29e_build_mip_chain_801d9ca4 0x801d9ca4 : { *(.text.w3d_d29e_build_mip_chain_801d9ca4) }
  /DISCARD/ : { *(.text*) *(.rodata*) *(.data*) *(.bss*) *(.sdata*) *(.sbss*) *(.comment) }
}
