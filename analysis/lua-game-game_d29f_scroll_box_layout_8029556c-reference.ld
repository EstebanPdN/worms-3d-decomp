/* Generated reference-only placements. All bodies are source-built. */
OUTPUT_FORMAT("elf32-powerpc")
OUTPUT_ARCH(powerpc)
ENTRY(d29f_scroll_box_layout_8029556c)
_SDA_BASE_ = 0x804b2540;
_SDA2_BASE_ = 0x804c2540;
fn_802958d8 = 0x802958d8;
lbl_803d07c0 = 0x803d07c0;
lbl_803d07c4 = 0x803d07c4;
lbl_803d07c8 = 0x803d07c8;
lbl_803d07cc = 0x803d07cc;
lbl_803d07d0 = 0x803d07d0;
lbl_803d07d4 = 0x803d07d4;
lbl_803d07d8 = 0x803d07d8;
lbl_803d07dc = 0x803d07dc;
w3d_d20e_dynamic_slot_80263cfc = 0x80263cfc;
w3d_s20_store_byte_value_80173f88 = 0x80173f88;
w3d_s4_box_stop_sound = 0x802962f8;
w3d_string_base_init = 0x8020c5c0;
w3d_string_header = 0x80341884;
SECTIONS {
  .text.d29f_scroll_box_layout_8029556c 0x8029556c : { *(.text.d29f_scroll_box_layout_8029556c) }
  /DISCARD/ : { *(.text*) *(.rodata*) *(.data*) *(.bss*) *(.sdata*) *(.sbss*) *(.comment) }
}
