/* Generated reference-only placements. All bodies are source-built. */
OUTPUT_FORMAT("elf32-powerpc")
OUTPUT_ARCH(powerpc)
ENTRY(w3d_sol35d_initialize_bindings_80239e44)
_SDA_BASE_ = 0x804b2540;
_SDA2_BASE_ = 0x804c2540;
fn_801e8d9c = 0x801e8d9c;
fn_801ebf38 = 0x801ebf38;
fn_801ed24c = 0x801ed24c;
fn_8020bb2c = 0x8020bb2c;
fn_8020c5c0 = 0x8020c5c0;
fn_8020c5c4 = 0x8020c5c4;
fn_80341588 = 0x80341588;
fn_80341884 = 0x80341884;
lbl_803bb3e0 = 0x803bb3e0;
lbl_803bb414 = 0x803bb414;
lbl_803bb440 = 0x803bb440;
lbl_803bb470 = 0x803bb470;
lbl_804b06a0 = 0x804b06a0;
SECTIONS {
  .text.w3d_sol35d_initialize_bindings_80239e44 0x80239e44 : { *(.text.w3d_sol35d_initialize_bindings_80239e44) }
  /DISCARD/ : { *(.text*) *(.rodata*) *(.data*) *(.bss*) *(.sdata*) *(.sbss*) *(.comment) }
}
