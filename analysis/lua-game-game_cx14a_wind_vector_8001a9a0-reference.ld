/* Generated reference-only placements. All bodies are source-built. */
OUTPUT_FORMAT("elf32-powerpc")
OUTPUT_ARCH(powerpc)
ENTRY(w3d_cx14a_wind_vector_8001a9a0)
_SDA_BASE_ = 0x804b2540;
_SDA2_BASE_ = 0x804c2540;
cos_802e86d4 = 0x802e86d4;
direction_8036af98 = 0x8036af98;
property_800fc270 = 0x800fc270;
sin_802e88ac = 0x802e88ac;
speed_8036afa8 = 0x8036afa8;
zero_8036afb4 = 0x8036afb4;
SECTIONS {
  .text.w3d_cx14a_wind_vector_8001a9a0 0x8001a9a0 : { *(.text.w3d_cx14a_wind_vector_8001a9a0) }
  /DISCARD/ : { *(.text*) *(.rodata*) *(.data*) *(.bss*) *(.sdata*) *(.sbss*) *(.comment) }
}
