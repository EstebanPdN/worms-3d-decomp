/* Generated reference-only placements. All bodies are source-built. */
OUTPUT_FORMAT("elf32-powerpc")
OUTPUT_ARCH(powerpc)
ENTRY(tsonnet_b31_double_damage_8013e4b0)
_SDA_BASE_ = 0x804b2540;
_SDA2_BASE_ = 0x804c2540;
fn_800e5ca4 = 0x800e5ca4;
fn_80181e3c = 0x80181e3c;
fn_80343740 = 0x80343740;
lbl_8039f2f0 = 0x8039f2f0;
lbl_8039fc3c = 0x8039fc3c;
lbl_8039fc50 = 0x8039fc50;
SECTIONS {
  .text.tsonnet_b31_double_damage_8013e4b0 0x8013e4b0 : { *(.text.tsonnet_b31_double_damage_8013e4b0) }
  /DISCARD/ : { *(.text*) *(.rodata*) *(.data*) *(.bss*) *(.sdata*) *(.sbss*) *(.comment) }
}
