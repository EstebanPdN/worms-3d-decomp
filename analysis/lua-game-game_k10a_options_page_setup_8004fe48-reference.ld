/* Generated reference-only placements. All bodies are source-built. */
OUTPUT_FORMAT("elf32-powerpc")
OUTPUT_ARCH(powerpc)
ENTRY(w3d_k10a_options_page_setup_8004fe48)
_SDA_BASE_ = 0x804b2540;
_SDA2_BASE_ = 0x804c2540;
fn_8004ff24 = 0x8004ff24;
fn_80050534 = 0x80050534;
w3d_auto_802cbf2c = 0x802cbf2c;
w3d_auto_802cd07c = 0x802cd07c;
w3d_auto_802cd14c = 0x802cd14c;
w3d_pieces_803f3fc4 = 0x803f3fc4;
w3d_s21_sink_write_indexed_802cbdf8 = 0x802cbdf8;
w3d_show_options_line_80050620 = 0x80050620;
w3d_string_base_finish = 0x8020c5c4;
w3d_string_default = 0x803426b8;
w3d_string_release = 0x80341588;
SECTIONS {
  .text.w3d_k10a_options_page_setup_8004fe48 0x8004fe48 : { *(.text.w3d_k10a_options_page_setup_8004fe48) }
  /DISCARD/ : { *(.text*) *(.rodata*) *(.data*) *(.bss*) *(.sdata*) *(.sbss*) *(.comment) }
}
