/* Generated reference-only placements. All bodies are source-built. */
OUTPUT_FORMAT("elf32-powerpc")
OUTPUT_ARCH(powerpc)
ENTRY(w3d_s21_parse_flag_name_801fe688)
_SDA_BASE_ = 0x804b2540;
_SDA2_BASE_ = 0x804c2540;
fn_802ef074 = 0x802ef074;
lbl_803b298c = 0x803b298c;
lbl_803b2994 = 0x803b2994;
SECTIONS {
  .text.w3d_s21_parse_flag_name_801fe688 0x801fe688 : { *(.text.w3d_s21_parse_flag_name_801fe688) }
  /DISCARD/ : { *(.text*) *(.rodata*) *(.data*) *(.bss*) *(.sdata*) *(.sbss*) *(.comment) }
}
