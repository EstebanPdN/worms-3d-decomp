/* Generated reference-only placements. All bodies are source-built. */
OUTPUT_FORMAT("elf32-powerpc")
OUTPUT_ARCH(powerpc)
ENTRY(w3d_k3b_tagged_construct_8020d318)
_SDA_BASE_ = 0x804b2540;
_SDA2_BASE_ = 0x804c2540;
w3d_vtable_804181c0 = 0x804181c0;
w3d_vtable_804194d0 = 0x804194d0;
SECTIONS {
  .text.w3d_k3b_tagged_construct_8020d318 0x8020d318 : { *(.text.w3d_k3b_tagged_construct_8020d318) }
  /DISCARD/ : { *(.text*) *(.rodata*) *(.data*) *(.bss*) *(.sdata*) *(.sbss*) *(.comment) }
}
