/* Generated reference-only placements. All bodies are source-built. */
OUTPUT_FORMAT("elf32-powerpc")
OUTPUT_ARCH(powerpc)
ENTRY(w3d_d32d_debug_text_setup_8015d2f4)
_SDA_BASE_ = 0x804b2540;
_SDA2_BASE_ = 0x804c2540;
__6StringPCc = 0x8020bb54;
add_801d086c = 0x801d086c;
add_801d0898 = 0x801d0898;
append_801ef174 = 0x801ef174;
count_801d0858 = 0x801d0858;
d_80414260 = 0x80414260;
d_804143e0 = 0x804143e0;
d_80414518 = 0x80414518;
d_80414610 = 0x80414610;
d_80415b50 = 0x80415b50;
d_80415bb0 = 0x80415bb0;
d_80415c10 = 0x80415c10;
d_80415c30 = 0x80415c30;
d_80415c80 = 0x80415c80;
d_80415cb0 = 0x80415cb0;
d_80415d60 = 0x80415d60;
d_804166b0 = 0x804166b0;
forward_8020b680 = 0x8020b680;
lock_801ef048 = 0x801ef048;
service_8020b648 = 0x8020b648;
string_finish_8020c5c4 = 0x8020c5c4;
string_release_80341588 = 0x80341588;
string_release_header_8020bb2c = 0x8020bb2c;
SECTIONS {
  .text.w3d_d32d_debug_text_setup_8015d2f4 0x8015d2f4 : { *(.text.w3d_d32d_debug_text_setup_8015d2f4) }
  .rodata 0x803a4448 : { *(.rodata) }
  /DISCARD/ : { *(.text*) *(.rodata*) *(.data*) *(.bss*) *(.sdata*) *(.sbss*) *(.comment) }
}
