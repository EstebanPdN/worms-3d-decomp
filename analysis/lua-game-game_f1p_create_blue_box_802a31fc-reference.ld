/* Generated reference-only placements. All bodies are source-built. */
OUTPUT_FORMAT("elf32-powerpc")
OUTPUT_ARCH(powerpc)
ENTRY(w3d_create_blue_box_802a31fc)
_SDA_BASE_ = 0x804b2540;
_SDA2_BASE_ = 0x804c2540;
__20F1pBlueText_8020bb54PCc = 0x8020bb54;
fn_801fe1d8 = 0x801fe1d8;
fn_8020c5c4 = 0x8020c5c4;
fn_8025dffc = 0x8025dffc;
fn_8025e128 = 0x8025e128;
fn_8025ee60 = 0x8025ee60;
fn_8025ee94 = 0x8025ee94;
fn_80341588 = 0x80341588;
scalar_803d2e24 = 0x803d2e24;
text_803d2e08 = 0x803d2e08;
text_803d2e14 = 0x803d2e14;
vector_8045e788 = 0x8045e788;
SECTIONS {
  .text.w3d_create_blue_box_802a31fc 0x802a31fc : { *(.text.w3d_create_blue_box_802a31fc) }
  /DISCARD/ : { *(.text*) *(.rodata*) *(.data*) *(.bss*) *(.sdata*) *(.sbss*) *(.comment) }
}
