/* Generated reference-only placements. All bodies are source-built. */
OUTPUT_FORMAT("elf32-powerpc")
OUTPUT_ARCH(powerpc)
ENTRY(w3d_f2a_cell_corner_masks_800b3e20)
_SDA_BASE_ = 0x804b2540;
_SDA2_BASE_ = 0x804c2540;
fn_8002c73c = 0x8002c73c;
SECTIONS {
  .text.w3d_f2a_cell_corner_masks_800b3e20 0x800b3e20 : { *(.text.w3d_f2a_cell_corner_masks_800b3e20) }
  /DISCARD/ : { *(.text*) *(.rodata*) *(.data*) *(.bss*) *(.sdata*) *(.sbss*) *(.comment) }
}
