/* Generated reference-only placements. All bodies are source-built. */
OUTPUT_FORMAT("elf32-powerpc")
OUTPUT_ARCH(powerpc)
ENTRY(w3d_d43e_children_update_unbind_801dc6d8)
_SDA_BASE_ = 0x804b2540;
_SDA2_BASE_ = 0x804c2540;
w3d_d30k_compact_vector_resize_80210b90 = 0x80210b90;
SECTIONS {
  .text.w3d_d43e_children_update_unbind_801dc6d8 0x801dc6d8 : { *(.text.w3d_d43e_children_update_unbind_801dc6d8) }
  /DISCARD/ : { *(.text*) *(.rodata*) *(.data*) *(.bss*) *(.sdata*) *(.sbss*) *(.comment) }
}
