/* Generated reference-only placements. All bodies are source-built. */
OUTPUT_FORMAT("elf32-powerpc")
OUTPUT_ARCH(powerpc)
ENTRY(d20d_weighted_sum_8018b404)
_SDA_BASE_ = 0x804b2540;
_SDA2_BASE_ = 0x804c2540;
lbl_803a7da0 = 0x803a7da0;
w3d_k1d_lookup_entry_8018b260 = 0x8018b260;
SECTIONS {
  .text.d20d_weighted_sum_8018b404 0x8018b404 : { *(.text.d20d_weighted_sum_8018b404) }
  /DISCARD/ : { *(.text*) *(.rodata*) *(.data*) *(.bss*) *(.sdata*) *(.sbss*) *(.comment) }
}
