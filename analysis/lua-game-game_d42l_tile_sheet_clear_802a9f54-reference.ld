/* Generated reference-only placements. All bodies are source-built. */
OUTPUT_FORMAT("elf32-powerpc")
OUTPUT_ARCH(powerpc)
ENTRY(d42l_tile_sheet_clear_802a9f54)
_SDA_BASE_ = 0x804b2540;
_SDA2_BASE_ = 0x804c2540;
w3d_auto_802b0fec = 0x802b0fec;
SECTIONS {
  .text.d42l_tile_sheet_clear_802a9f54 0x802a9f54 : { *(.text.d42l_tile_sheet_clear_802a9f54) }
  /DISCARD/ : { *(.text*) *(.rodata*) *(.data*) *(.bss*) *(.sdata*) *(.sbss*) *(.comment) }
}
