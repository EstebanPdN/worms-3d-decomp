/* Generated reference-only placements. All bodies are source-built. */
OUTPUT_FORMAT("elf32-powerpc")
OUTPUT_ARCH(powerpc)
ENTRY(f4c_inverse_transpose_801acd6c)
_SDA_BASE_ = 0x804b2540;
_SDA2_BASE_ = 0x804c2540;
fn_801f65f0 = 0x801f65f0;
SECTIONS {
  .text.f4c_inverse_transpose_801acd6c 0x801acd6c : { *(.text.f4c_inverse_transpose_801acd6c) }
  /DISCARD/ : { *(.text*) *(.rodata*) *(.data*) *(.bss*) *(.sdata*) *(.sbss*) *(.comment) }
}
