/* Generated reference-only placements. All bodies are source-built. */
OUTPUT_FORMAT("elf32-powerpc")
OUTPUT_ARCH(powerpc)
ENTRY(w3d_cx12a_quadratic_roots_8009ee18)
_SDA_BASE_ = 0x804b2540;
_SDA2_BASE_ = 0x804c2540;
four_803806b0 = 0x803806b0;
invalid_803806ac = 0x803806ac;
sqrt_802e82c0 = 0x802e82c0;
tolerance_803806a4 = 0x803806a4;
zero_803806a8 = 0x803806a8;
SECTIONS {
  .text.w3d_cx12a_quadratic_roots_8009ee18 0x8009ee18 : { *(.text.w3d_cx12a_quadratic_roots_8009ee18) }
  /DISCARD/ : { *(.text*) *(.rodata*) *(.data*) *(.bss*) *(.sdata*) *(.sbss*) *(.comment) }
}
