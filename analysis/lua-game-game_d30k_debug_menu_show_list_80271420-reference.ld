/* Generated reference-only placements. All bodies are source-built. */
OUTPUT_FORMAT("elf32-powerpc")
OUTPUT_ARCH(powerpc)
ENTRY(w3d_d30k_debug_menu_show_list_80271420)
_SDA_BASE_ = 0x804b2540;
_SDA2_BASE_ = 0x804c2540;
__4Text = 0x803426b8;
fn_8020c5c4 = 0x8020c5c4;
fn_8027a934 = 0x8027a934;
fn_802cbdf8 = 0x802cbdf8;
fn_802cbf2c = 0x802cbf2c;
fn_802cd128 = 0x802cd128;
fn_802cd220 = 0x802cd220;
fn_802cd2e0 = 0x802cd2e0;
fn_80341588 = 0x80341588;
lbl_804012fc = 0x804012fc;
SECTIONS {
  .text.w3d_d30k_debug_menu_show_list_80271420 0x80271420 : { *(.text.w3d_d30k_debug_menu_show_list_80271420) }
  /DISCARD/ : { *(.text*) *(.rodata*) *(.data*) *(.bss*) *(.sdata*) *(.sbss*) *(.comment) }
}
