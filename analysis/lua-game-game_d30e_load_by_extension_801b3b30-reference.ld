/* Generated reference-only placements. All bodies are source-built. */
OUTPUT_FORMAT("elf32-powerpc")
OUTPUT_ARCH(powerpc)
ENTRY(w3d_d30e_load_by_extension_801b3b30)
_SDA_BASE_ = 0x804b2540;
_SDA2_BASE_ = 0x804c2540;
_._6Tagged = 0x8020803c;
__6Tagged = 0x80207fec;
lbl_80362704 = 0x80362704;
lbl_80364fa4 = 0x80364fa4;
lbl_803aaab8 = 0x803aaab8;
lbl_803aaabc = 0x803aaabc;
lbl_803aaac0 = 0x803aaac0;
lbl_803aaac8 = 0x803aaac8;
lbl_803aaacc = 0x803aaacc;
refill__6TaggedPCci = 0x802080a0;
strrchr = 0x802efcc8;
w3d_auto_801ffea8 = 0x801ffea8;
w3d_auto_8020b6c0 = 0x8020b6c0;
w3d_d24z_strcasecmp_802ef074 = 0x802ef074;
w3d_s10_find_string_801b4060 = 0x801b4060;
w3d_s10_find_string_801b40d0 = 0x801b40d0;
SECTIONS {
  .text.w3d_d30e_load_by_extension_801b3b30 0x801b3b30 : { *(.text.w3d_d30e_load_by_extension_801b3b30) }
  /DISCARD/ : { *(.text*) *(.rodata*) *(.data*) *(.bss*) *(.sdata*) *(.sbss*) *(.comment) }
}
