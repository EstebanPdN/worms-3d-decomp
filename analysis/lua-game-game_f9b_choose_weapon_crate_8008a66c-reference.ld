/* Generated reference-only placements. All bodies are source-built. */
OUTPUT_FORMAT("elf32-powerpc")
OUTPUT_ARCH(powerpc)
ENTRY(f9b_choose_weapon_crate_8008a66c)
_SDA_BASE_ = 0x804b2540;
_SDA2_BASE_ = 0x804c2540;
contents_8037da74 = 0x8037da74;
count_800fc3b0 = 0x800fc3b0;
count_8037d930 = 0x8037d930;
random_80162ba8 = 0x80162ba8;
set_800fc550 = 0x800fc550;
total_8008da24 = 0x8008da24;
weapons_803eb63c = 0x803eb63c;
weights_80431c80 = 0x80431c80;
SECTIONS {
  .text.f9b_choose_weapon_crate_8008a66c 0x8008a66c : { *(.text.f9b_choose_weapon_crate_8008a66c) }
  /DISCARD/ : { *(.text*) *(.rodata*) *(.data*) *(.bss*) *(.sdata*) *(.sbss*) *(.comment) }
}
