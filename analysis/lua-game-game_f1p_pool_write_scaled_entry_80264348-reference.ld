/* Generated reference-only placements. All bodies are source-built. */
OUTPUT_FORMAT("elf32-powerpc")
OUTPUT_ARCH(powerpc)
ENTRY(w3d_pool_write_scaled_entry_80264348)
_SDA_BASE_ = 0x804b2540;
_SDA2_BASE_ = 0x804c2540;
fn_8015ae3c = 0x8015ae3c;
fn_80171ee0 = 0x80171ee0;
fn_80171fa0 = 0x80171fa0;
fn_8020c5c4 = 0x8020c5c4;
fn_80341588 = 0x80341588;
fn_80343808 = 0x80343808;
value_803cb280 = 0x803cb280;
value_803cb284 = 0x803cb284;
SECTIONS {
  .text.w3d_pool_write_scaled_entry_80264348 0x80264348 : { *(.text.w3d_pool_write_scaled_entry_80264348) }
  /DISCARD/ : { *(.text*) *(.rodata*) *(.data*) *(.bss*) *(.sdata*) *(.sbss*) *(.comment) }
}
