/* Generated reference-only placements. All bodies are source-built. */
OUTPUT_FORMAT("elf32-powerpc")
OUTPUT_ARCH(powerpc)
ENTRY(remove__12D31sMapOwnerP12D31sMapIfaceUiRQ24_STLt3map4Z10D31sMapKeyZ12D31sMapValueZ14D31sMapKeyLessZQ24_STLt9allocator1ZQ24_STLt4pair2ZC10D31sMapKeyZ12D31sMapValue)
_SDA_BASE_ = 0x804b2540;
_SDA2_BASE_ = 0x804c2540;
_._12D31sMapValue = 0x801f2758;
_M_increment__Q24_STLt10_Rb_global1ZbPQ24_STL18_Rb_tree_node_base = 0x80351ef8;
_Rebalance_for_erase__Q24_STLt10_Rb_global1ZbPQ24_STL18_Rb_tree_node_baseRPQ24_STL18_Rb_tree_node_baseN22 = 0x80352010;
_S_oom_malloc__Q24_STLt14__malloc_alloc1i0Ui = 0x803413d8;
find__12D31sMapOwnerP12D31sMapIfaceUiRQ24_STLt3map4Z10D31sMapKeyZ12D31sMapValueZ14D31sMapKeyLessZQ24_STLt9allocator1ZQ24_STLt4pair2ZC10D31sMapKeyZ12D31sMapValue = 0x801d295c;
free = 0x802134fc;
malloc = 0x80212fd4;
SECTIONS {
  .text.remove__12D31sMapOwnerP12D31sMapIfaceUiRQ24_STLt3map4Z10D31sMapKeyZ12D31sMapValueZ14D31sMapKeyLessZQ24_STLt9allocator1ZQ24_STLt4pair2ZC10D31sMapKeyZ12D31sMapValue 0x801d2aac : { *(.text.remove__12D31sMapOwnerP12D31sMapIfaceUiRQ24_STLt3map4Z10D31sMapKeyZ12D31sMapValueZ14D31sMapKeyLessZQ24_STLt9allocator1ZQ24_STLt4pair2ZC10D31sMapKeyZ12D31sMapValue) }
  /DISCARD/ : { *(.text*) *(.rodata*) *(.data*) *(.bss*) *(.sdata*) *(.sbss*) *(.comment) }
}
