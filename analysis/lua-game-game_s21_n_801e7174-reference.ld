/* Generated reference-only placements. All bodies are source-built. */
OUTPUT_FORMAT("elf32-powerpc")
OUTPUT_ARCH(powerpc)
ENTRY(w3d_s21_construct_801e7174)
_SDA_BASE_ = 0x804b2540;
_SDA2_BASE_ = 0x804c2540;
fn_8020fbd0 = 0x8020fbd0;
lbl_80417048 = 0x80417048;
lbl_80417070 = 0x80417070;
SECTIONS {
  .text.w3d_s21_construct_801e7174 0x801e7174 : { *(.text.w3d_s21_construct_801e7174) }
  /DISCARD/ : { *(.text*) *(.rodata*) *(.data*) *(.bss*) *(.sdata*) *(.sbss*) *(.comment) }
}
