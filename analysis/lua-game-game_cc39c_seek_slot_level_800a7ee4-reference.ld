/* Generated reference-only placements. All bodies are source-built. */
OUTPUT_FORMAT("elf32-powerpc")
OUTPUT_ARCH(powerpc)
ENTRY(cc39c_seek_slot_level_800a7ee4)
_SDA_BASE_ = 0x804b2540;
_SDA2_BASE_ = 0x804c2540;
cc39c_apply_element_800a7488 = 0x800a7488;
SECTIONS {
  .text.cc39c_seek_slot_level_800a7ee4 0x800a7ee4 : { *(.text.cc39c_seek_slot_level_800a7ee4) }
  /DISCARD/ : { *(.text*) *(.rodata*) *(.data*) *(.bss*) *(.sdata*) *(.sbss*) *(.comment) }
}
