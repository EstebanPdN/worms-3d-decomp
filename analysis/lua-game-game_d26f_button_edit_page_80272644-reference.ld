/* Generated reference-only placements. All bodies are source-built. */
OUTPUT_FORMAT("elf32-powerpc")
OUTPUT_ARCH(powerpc)
ENTRY(d26f_button_edit_page_80272644)
_SDA_BASE_ = 0x804b2540;
_SDA2_BASE_ = 0x804c2540;
__17D26fText_803426b8 = 0x803426b8;
lbl_803cc0d8 = 0x803cc0d8;
lbl_803cc78c = 0x803cc78c;
lbl_803cc798 = 0x803cc798;
lbl_803cc7a4 = 0x803cc7a4;
lbl_803cc7c4 = 0x803cc7c4;
lbl_803cc7e4 = 0x803cc7e4;
lbl_803cc804 = 0x803cc804;
lbl_803cc824 = 0x803cc824;
lbl_803cc844 = 0x803cc844;
lbl_803cc864 = 0x803cc864;
lbl_803cc86c = 0x803cc86c;
lbl_803cc874 = 0x803cc874;
lbl_803cc894 = 0x803cc894;
lbl_803cc8b4 = 0x803cc8b4;
w3d_auto_802cbf2c = 0x802cbf2c;
w3d_auto_802cd128 = 0x802cd128;
w3d_cc32b_append_lines_v2_802cc0ac = 0x802cc0ac;
w3d_cx7b_script_flag_set_8027a934 = 0x8027a934;
w3d_dtor_node_8020d36c = 0x8020d36c;
w3d_registry_retain_8020d2b8 = 0x8020d2b8;
w3d_s21_append_position_802cd26c = 0x802cd26c;
w3d_s21_repeat_request_802cd220 = 0x802cd220;
w3d_s21_sink_write_indexed_802cbdf8 = 0x802cbdf8;
w3d_s21_vector_get_801e9db8 = 0x801e9db8;
w3d_string_base_finish = 0x8020c5c4;
w3d_string_release = 0x80341588;
w3d_tagged_construct_8020d318 = 0x8020d318;
SECTIONS {
  .text.d26f_button_edit_page_80272644 0x80272644 : { *(.text.d26f_button_edit_page_80272644) }
  /DISCARD/ : { *(.text*) *(.rodata*) *(.data*) *(.bss*) *(.sdata*) *(.sbss*) *(.comment) }
}
