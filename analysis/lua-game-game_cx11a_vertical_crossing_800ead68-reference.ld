/* Generated reference-only placements. All bodies are source-built. */
OUTPUT_FORMAT("elf32-powerpc")
OUTPUT_ARCH(powerpc)
ENTRY(w3d_cx11a_vertical_crossing_800ead68)
_SDA_BASE_ = 0x804b2540;
_SDA2_BASE_ = 0x804c2540;
step_8038b3fc = 0x8038b3fc;
SECTIONS {
  .text.w3d_cx11a_vertical_crossing_800ead68 0x800ead68 : { *(.text.w3d_cx11a_vertical_crossing_800ead68) }
  /DISCARD/ : { *(.text*) *(.rodata*) *(.data*) *(.bss*) *(.sdata*) *(.sbss*) *(.comment) }
}
