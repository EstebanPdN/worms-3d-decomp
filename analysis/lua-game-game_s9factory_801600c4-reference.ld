/* Generated reference-only placements. All bodies are source-built. */
OUTPUT_FORMAT("elf32-powerpc")
OUTPUT_ARCH(powerpc)
ENTRY(s9_initialize_factory_type_801600c4)
_SDA_BASE_ = 0x804b2540;
_SDA2_BASE_ = 0x804c2540;
fn_80160028 = 0x80160028;
fn_80160030 = 0x80160030;
fn_8016114c = 0x8016114c;
fn_80161154 = 0x80161154;
fn_801629e8 = 0x801629e8;
fn_801629f0 = 0x801629f0;
fn_80200af8 = 0x80200af8;
fn_8020fbd0 = 0x8020fbd0;
lbl_80361800 = 0x80361800;
lbl_80361890 = 0x80361890;
lbl_80361920 = 0x80361920;
lbl_803a4630 = 0x803a4630;
lbl_803a46f0 = 0x803a46f0;
lbl_803a4a04 = 0x803a4a04;
lbl_803e8808 = 0x803e8808;
lbl_803e885c = 0x803e885c;
lbl_803e88b0 = 0x803e88b0;
lbl_80455214 = 0x80455214;
lbl_8045522c = 0x8045522c;
lbl_8045525c = 0x8045525c;
lbl_80455288 = 0x80455288;
SECTIONS {
  .text.s9_initialize_factory_type_801600c4 0x801600c4 : { *(.text.s9_initialize_factory_type_801600c4) }
  .text.s9_initialize_factory_type_801611e8 0x801611e8 : { *(.text.s9_initialize_factory_type_801611e8) }
  .text.s9_initialize_factory_type_80162a84 0x80162a84 : { *(.text.s9_initialize_factory_type_80162a84) }
  /DISCARD/ : { *(.text*) *(.rodata*) *(.data*) *(.bss*) *(.sdata*) *(.sbss*) *(.comment) }
}
