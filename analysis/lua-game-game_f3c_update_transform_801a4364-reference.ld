/* Generated reference-only placements. All bodies are source-built. */
OUTPUT_FORMAT("elf32-powerpc")
OUTPUT_ARCH(powerpc)
ENTRY(f3c_update_transform_801a4364)
_SDA_BASE_ = 0x804b2540;
_SDA2_BASE_ = 0x804c2540;
fn_801a3eb0 = 0x801a3eb0;
fn_801f6298 = 0x801f6298;
fn_801f77f4 = 0x801f77f4;
fn_801f7854 = 0x801f7854;
lbl_80363938 = 0x80363938;
lbl_803a9c1c = 0x803a9c1c;
SECTIONS {
  .text.f3c_update_transform_801a4364 0x801a4364 : { *(.text.f3c_update_transform_801a4364) }
  /DISCARD/ : { *(.text*) *(.rodata*) *(.data*) *(.bss*) *(.sdata*) *(.sbss*) *(.comment) }
}
