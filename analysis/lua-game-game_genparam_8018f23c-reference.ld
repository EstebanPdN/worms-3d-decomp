/* Generated reference-only placements. All bodies are source-built. */
OUTPUT_FORMAT("elf32-powerpc")
OUTPUT_ARCH(powerpc)
ENTRY(w3d_dtor_interfaces8_8018f23c)
_SDA_BASE_ = 0x804b2540;
_SDA2_BASE_ = 0x804c2540;
fn_801b52d8 = 0x801b52d8;
fn_801ea138 = 0x801ea138;
fn_801ea740 = 0x801ea740;
fn_8024cd58 = 0x8024cd58;
w3d_vtable_80413098 = 0x80413098;
w3d_vtable_80414d30 = 0x80414d30;
w3d_vtable_8041b870 = 0x8041b870;
SECTIONS {
  .text.w3d_dtor_interfaces8_8018f23c 0x8018f23c : { *(.text.w3d_dtor_interfaces8_8018f23c) }
  .text.w3d_dtor_interfaces8_801c2520 0x801c2520 : { *(.text.w3d_dtor_interfaces8_801c2520) }
  .text.w3d_dtor_interfaces8_8024cfb0 0x8024cfb0 : { *(.text.w3d_dtor_interfaces8_8024cfb0) }
  /DISCARD/ : { *(.text*) *(.rodata*) *(.data*) *(.bss*) *(.sdata*) *(.sbss*) *(.comment) }
}
