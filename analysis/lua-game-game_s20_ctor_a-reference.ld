/* Generated reference-only placements. All bodies are source-built. */
OUTPUT_FORMAT("elf32-powerpc")
OUTPUT_ARCH(powerpc)
ENTRY(w3d_s20_construct_header_8016f7cc)
_SDA_BASE_ = 0x804b2540;
_SDA2_BASE_ = 0x804c2540;
lbl_80411f90 = 0x80411f90;
lbl_80411fc0 = 0x80411fc0;
lbl_80413710 = 0x80413710;
lbl_80413730 = 0x80413730;
lbl_80413890 = 0x80413890;
lbl_804165f0 = 0x804165f0;
lbl_80416610 = 0x80416610;
SECTIONS {
  .text.w3d_s20_construct_header_8016f7cc 0x8016f7cc : { *(.text.w3d_s20_construct_header_8016f7cc) }
  .text.w3d_s20_construct_header_8019d78c 0x8019d78c : { *(.text.w3d_s20_construct_header_8019d78c) }
  .text.w3d_s20_construct_header_801a0078 0x801a0078 : { *(.text.w3d_s20_construct_header_801a0078) }
  .text.w3d_s20_construct_header_801d47b8 0x801d47b8 : { *(.text.w3d_s20_construct_header_801d47b8) }
  /DISCARD/ : { *(.text*) *(.rodata*) *(.data*) *(.bss*) *(.sdata*) *(.sbss*) *(.comment) }
}
