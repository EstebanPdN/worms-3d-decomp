/* Generated reference-only placements. All bodies are source-built. */
OUTPUT_FORMAT("elf32-powerpc")
OUTPUT_ARCH(powerpc)
ENTRY(f5c_box_sphere_801f55ec)
_SDA_BASE_ = 0x804b2540;
_SDA2_BASE_ = 0x804c2540;
fn_802e82c0 = 0x802e82c0;
lbl_803b15ac = 0x803b15ac;
lbl_803b15b0 = 0x803b15b0;
SECTIONS {
  .text.f5c_box_sphere_801f55ec 0x801f55ec : { *(.text.f5c_box_sphere_801f55ec) }
  /DISCARD/ : { *(.text*) *(.rodata*) *(.data*) *(.bss*) *(.sdata*) *(.sbss*) *(.comment) }
}
