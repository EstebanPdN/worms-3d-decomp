/* Generated reference-only placements. All bodies are source-built. */
OUTPUT_FORMAT("elf32-powerpc")
OUTPUT_ARCH(powerpc)
ENTRY(w3d_cx11b_name_registry_index_80207c0c)
_SDA_BASE_ = 0x804b2540;
_SDA2_BASE_ = 0x804c2540;
compare_802ef234 = 0x802ef234;
count_8045ee68 = 0x8045ee68;
names_8045ee78 = 0x8045ee78;
registry_8045ee54 = 0x8045ee54;
SECTIONS {
  .text.w3d_cx11b_name_registry_index_80207c0c 0x80207c0c : { *(.text.w3d_cx11b_name_registry_index_80207c0c) }
  /DISCARD/ : { *(.text*) *(.rodata*) *(.data*) *(.bss*) *(.sdata*) *(.sbss*) *(.comment) }
}
