/* Generated reference-only placements. All bodies are source-built. */
OUTPUT_FORMAT("elf32-powerpc")
OUTPUT_ARCH(powerpc)
ENTRY(w3d_cx16b_cached_interface_find_801b36f8)
_SDA_BASE_ = 0x804b2540;
_SDA2_BASE_ = 0x804c2540;
fn_801b40d0 = 0x801b40d0;
SECTIONS {
  .text.w3d_cx16b_cached_interface_find_801b36f8 0x801b36f8 : { *(.text.w3d_cx16b_cached_interface_find_801b36f8) }
  /DISCARD/ : { *(.text*) *(.rodata*) *(.data*) *(.bss*) *(.sdata*) *(.sbss*) *(.comment) }
}
