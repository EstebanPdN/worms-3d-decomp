/* Generated reference-only placements. All bodies are source-built. */
OUTPUT_FORMAT("elf32-powerpc")
OUTPUT_ARCH(powerpc)
ENTRY(w3d_get_802704e8)
_SDA_BASE_ = 0x804b2540;
_SDA2_BASE_ = 0x804c2540;
w3d_fn_80270640 = 0x80270640;
w3d_fn_80270698 = 0x80270698;
w3d_fn_80270df0 = 0x80270df0;
w3d_fn_80270e58 = 0x80270e58;
w3d_fn_8027b528 = 0x8027b528;
w3d_fn_8027b604 = 0x8027b604;
w3d_fn_80284d74 = 0x80284d74;
w3d_fn_80284de8 = 0x80284de8;
w3d_fn_80285610 = 0x80285610;
w3d_fn_802856b4 = 0x802856b4;
w3d_fn_802873ac = 0x802873ac;
w3d_fn_8028740c = 0x8028740c;
w3d_fn_80287a84 = 0x80287a84;
w3d_fn_80287b30 = 0x80287b30;
w3d_fn_80287f64 = 0x80287f64;
w3d_fn_80288110 = 0x80288110;
w3d_fn_8028ad4c = 0x8028ad4c;
w3d_fn_8028ae20 = 0x8028ae20;
w3d_fn_8028cde0 = 0x8028cde0;
w3d_fn_8028cea4 = 0x8028cea4;
w3d_fn_8028df60 = 0x8028df60;
w3d_fn_8028e02c = 0x8028e02c;
w3d_fn_8028ef10 = 0x8028ef10;
w3d_fn_8028ef7c = 0x8028ef7c;
w3d_fn_802946f0 = 0x802946f0;
w3d_fn_80294810 = 0x80294810;
w3d_global_803686f8 = 0x803686f8;
w3d_global_80368728 = 0x80368728;
w3d_global_80368758 = 0x80368758;
w3d_global_80368788 = 0x80368788;
w3d_global_803687b8 = 0x803687b8;
w3d_global_803687e8 = 0x803687e8;
w3d_global_80368818 = 0x80368818;
w3d_global_80368848 = 0x80368848;
w3d_global_80368878 = 0x80368878;
w3d_global_803688a8 = 0x803688a8;
w3d_global_803688d8 = 0x803688d8;
w3d_global_80368908 = 0x80368908;
w3d_global_80368938 = 0x80368938;
w3d_global_80470900 = 0x80470900;
w3d_heap_allocate_entry_a = 0x801fe1d8;
w3d_owner_list_remove = 0x8020fd2c;
w3d_registry_list_803686f8 = 0x803686f8;
w3d_registry_list_80368728 = 0x80368728;
w3d_registry_list_80368758 = 0x80368758;
w3d_registry_list_80368788 = 0x80368788;
w3d_registry_list_803687b8 = 0x803687b8;
w3d_registry_list_803687e8 = 0x803687e8;
w3d_registry_list_80368818 = 0x80368818;
w3d_registry_list_80368848 = 0x80368848;
w3d_registry_list_80368878 = 0x80368878;
w3d_registry_list_803688a8 = 0x803688a8;
w3d_registry_list_803688d8 = 0x803688d8;
w3d_registry_list_80368908 = 0x80368908;
w3d_registry_list_80368938 = 0x80368938;
w3d_state_register = 0x8020fd04;
SECTIONS {
  .text.w3d_get_802704e8 0x802704e8 : { *(.text.w3d_get_802704e8) }
  .text.w3d_address_8027051c 0x8027051c : { *(.text.w3d_address_8027051c) }
  .text.w3d_registry_unlink_80270528 0x80270528 : { *(.text.w3d_registry_unlink_80270528) }
  .text.w3d_registry_create_8027056c 0x8027056c : { *(.text.w3d_registry_create_8027056c) }
  .text.w3d_registry_release_802705cc 0x802705cc : { *(.text.w3d_registry_release_802705cc) }
  .text.w3d_registry_retain_80270628 0x80270628 : { *(.text.w3d_registry_retain_80270628) }
  .text.w3d_get_80270c98 0x80270c98 : { *(.text.w3d_get_80270c98) }
  .text.w3d_address_80270ccc 0x80270ccc : { *(.text.w3d_address_80270ccc) }
  .text.w3d_registry_unlink_80270cd8 0x80270cd8 : { *(.text.w3d_registry_unlink_80270cd8) }
  .text.w3d_registry_create_80270d1c 0x80270d1c : { *(.text.w3d_registry_create_80270d1c) }
  .text.w3d_registry_release_80270d7c 0x80270d7c : { *(.text.w3d_registry_release_80270d7c) }
  .text.w3d_registry_retain_80270dd8 0x80270dd8 : { *(.text.w3d_registry_retain_80270dd8) }
  .text.w3d_address_8027b404 0x8027b404 : { *(.text.w3d_address_8027b404) }
  .text.w3d_registry_unlink_8027b410 0x8027b410 : { *(.text.w3d_registry_unlink_8027b410) }
  .text.w3d_registry_create_8027b454 0x8027b454 : { *(.text.w3d_registry_create_8027b454) }
  .text.w3d_registry_release_8027b4b4 0x8027b4b4 : { *(.text.w3d_registry_release_8027b4b4) }
  .text.w3d_registry_retain_8027b510 0x8027b510 : { *(.text.w3d_registry_retain_8027b510) }
  .text.w3d_constant_8027bcfc 0x8027bcfc : { *(.text.w3d_constant_8027bcfc) }
  .text.w3d_empty_8027ffdc 0x8027ffdc : { *(.text.w3d_empty_8027ffdc) }
  .text.w3d_address_80284c50 0x80284c50 : { *(.text.w3d_address_80284c50) }
  .text.w3d_registry_unlink_80284c5c 0x80284c5c : { *(.text.w3d_registry_unlink_80284c5c) }
  .text.w3d_registry_create_80284ca0 0x80284ca0 : { *(.text.w3d_registry_create_80284ca0) }
  .text.w3d_registry_release_80284d00 0x80284d00 : { *(.text.w3d_registry_release_80284d00) }
  .text.w3d_registry_retain_80284d5c 0x80284d5c : { *(.text.w3d_registry_retain_80284d5c) }
  .text.w3d_empty_802852c0 0x802852c0 : { *(.text.w3d_empty_802852c0) }
  .text.w3d_address_802854ec 0x802854ec : { *(.text.w3d_address_802854ec) }
  .text.w3d_registry_unlink_802854f8 0x802854f8 : { *(.text.w3d_registry_unlink_802854f8) }
  .text.w3d_registry_create_8028553c 0x8028553c : { *(.text.w3d_registry_create_8028553c) }
  .text.w3d_registry_release_8028559c 0x8028559c : { *(.text.w3d_registry_release_8028559c) }
  .text.w3d_registry_retain_802855f8 0x802855f8 : { *(.text.w3d_registry_retain_802855f8) }
  .text.w3d_get_80287254 0x80287254 : { *(.text.w3d_get_80287254) }
  .text.w3d_address_80287288 0x80287288 : { *(.text.w3d_address_80287288) }
  .text.w3d_registry_unlink_80287294 0x80287294 : { *(.text.w3d_registry_unlink_80287294) }
  .text.w3d_registry_create_802872d8 0x802872d8 : { *(.text.w3d_registry_create_802872d8) }
  .text.w3d_registry_release_80287338 0x80287338 : { *(.text.w3d_registry_release_80287338) }
  .text.w3d_registry_retain_80287394 0x80287394 : { *(.text.w3d_registry_retain_80287394) }
  .text.w3d_empty_80287830 0x80287830 : { *(.text.w3d_empty_80287830) }
  .text.w3d_address_80287960 0x80287960 : { *(.text.w3d_address_80287960) }
  .text.w3d_registry_unlink_8028796c 0x8028796c : { *(.text.w3d_registry_unlink_8028796c) }
  .text.w3d_registry_create_802879b0 0x802879b0 : { *(.text.w3d_registry_create_802879b0) }
  .text.w3d_registry_release_80287a10 0x80287a10 : { *(.text.w3d_registry_release_80287a10) }
  .text.w3d_registry_retain_80287a6c 0x80287a6c : { *(.text.w3d_registry_retain_80287a6c) }
  .text.w3d_empty_80287dac 0x80287dac : { *(.text.w3d_empty_80287dac) }
  .text.w3d_empty_80287db0 0x80287db0 : { *(.text.w3d_empty_80287db0) }
  .text.w3d_address_80287e40 0x80287e40 : { *(.text.w3d_address_80287e40) }
  .text.w3d_registry_unlink_80287e4c 0x80287e4c : { *(.text.w3d_registry_unlink_80287e4c) }
  .text.w3d_registry_create_80287e90 0x80287e90 : { *(.text.w3d_registry_create_80287e90) }
  .text.w3d_registry_release_80287ef0 0x80287ef0 : { *(.text.w3d_registry_release_80287ef0) }
  .text.w3d_registry_retain_80287f4c 0x80287f4c : { *(.text.w3d_registry_retain_80287f4c) }
  .text.w3d_address_8028ac28 0x8028ac28 : { *(.text.w3d_address_8028ac28) }
  .text.w3d_registry_unlink_8028ac34 0x8028ac34 : { *(.text.w3d_registry_unlink_8028ac34) }
  .text.w3d_registry_create_8028ac78 0x8028ac78 : { *(.text.w3d_registry_create_8028ac78) }
  .text.w3d_registry_release_8028acd8 0x8028acd8 : { *(.text.w3d_registry_release_8028acd8) }
  .text.w3d_registry_retain_8028ad34 0x8028ad34 : { *(.text.w3d_registry_retain_8028ad34) }
  .text.w3d_get_8028cc88 0x8028cc88 : { *(.text.w3d_get_8028cc88) }
  .text.w3d_address_8028ccbc 0x8028ccbc : { *(.text.w3d_address_8028ccbc) }
  .text.w3d_registry_unlink_8028ccc8 0x8028ccc8 : { *(.text.w3d_registry_unlink_8028ccc8) }
  .text.w3d_registry_create_8028cd0c 0x8028cd0c : { *(.text.w3d_registry_create_8028cd0c) }
  .text.w3d_registry_release_8028cd6c 0x8028cd6c : { *(.text.w3d_registry_release_8028cd6c) }
  .text.w3d_registry_retain_8028cdc8 0x8028cdc8 : { *(.text.w3d_registry_retain_8028cdc8) }
  .text.w3d_get_8028de08 0x8028de08 : { *(.text.w3d_get_8028de08) }
  .text.w3d_address_8028de3c 0x8028de3c : { *(.text.w3d_address_8028de3c) }
  .text.w3d_registry_unlink_8028de48 0x8028de48 : { *(.text.w3d_registry_unlink_8028de48) }
  .text.w3d_registry_create_8028de8c 0x8028de8c : { *(.text.w3d_registry_create_8028de8c) }
  .text.w3d_registry_release_8028deec 0x8028deec : { *(.text.w3d_registry_release_8028deec) }
  .text.w3d_registry_retain_8028df48 0x8028df48 : { *(.text.w3d_registry_retain_8028df48) }
  .text.w3d_address_8028edec 0x8028edec : { *(.text.w3d_address_8028edec) }
  .text.w3d_registry_unlink_8028edf8 0x8028edf8 : { *(.text.w3d_registry_unlink_8028edf8) }
  .text.w3d_registry_create_8028ee3c 0x8028ee3c : { *(.text.w3d_registry_create_8028ee3c) }
  .text.w3d_registry_release_8028ee9c 0x8028ee9c : { *(.text.w3d_registry_release_8028ee9c) }
  .text.w3d_registry_retain_8028eef8 0x8028eef8 : { *(.text.w3d_registry_retain_8028eef8) }
  .text.w3d_constant_8028f330 0x8028f330 : { *(.text.w3d_constant_8028f330) }
  .text.w3d_empty_8029301c 0x8029301c : { *(.text.w3d_empty_8029301c) }
  .text.w3d_address_802945cc 0x802945cc : { *(.text.w3d_address_802945cc) }
  .text.w3d_registry_unlink_802945d8 0x802945d8 : { *(.text.w3d_registry_unlink_802945d8) }
  .text.w3d_registry_create_8029461c 0x8029461c : { *(.text.w3d_registry_create_8029461c) }
  .text.w3d_registry_release_8029467c 0x8029467c : { *(.text.w3d_registry_release_8029467c) }
  .text.w3d_registry_retain_802946d8 0x802946d8 : { *(.text.w3d_registry_retain_802946d8) }
  .text.w3d_set_80296774 0x80296774 : { *(.text.w3d_set_80296774) }
  .text.w3d_address_80296908 0x80296908 : { *(.text.w3d_address_80296908) }
  /DISCARD/ : { *(.text*) *(.rodata*) *(.data*) *(.bss*) *(.sdata*) *(.sbss*) *(.comment) }
}
