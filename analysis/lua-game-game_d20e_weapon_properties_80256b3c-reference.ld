/* Generated reference-only placements. All bodies are source-built. */
OUTPUT_FORMAT("elf32-powerpc")
OUTPUT_ARCH(powerpc)
ENTRY(w3d_d20e_register_weapon_properties_80256b3c)
_SDA_BASE_ = 0x804b2540;
_SDA2_BASE_ = 0x804c2540;
constant_803c90b4 = 0x803c90b4;
d20e_empty_804b06a0 = 0x804b06a0;
d20e_release_header_8020bb2c = 0x8020bb2c;
d20e_string_finish_8020c5c4 = 0x8020c5c4;
d20e_string_header_80341884 = 0x80341884;
d20e_string_init_8020c5c0 = 0x8020c5c0;
d20e_string_release_80341588 = 0x80341588;
desc_803c8d9c = 0x803c8d9c;
desc_803c8dc4 = 0x803c8dc4;
desc_803c8dfc = 0x803c8dfc;
desc_803c8e24 = 0x803c8e24;
desc_803c8e4c = 0x803c8e4c;
desc_803c8e74 = 0x803c8e74;
desc_803c8e9c = 0x803c8e9c;
desc_803c8ec4 = 0x803c8ec4;
desc_803c8ee8 = 0x803c8ee8;
desc_803c8f0c = 0x803c8f0c;
desc_803c8f30 = 0x803c8f30;
desc_803c8f54 = 0x803c8f54;
desc_803c8f78 = 0x803c8f78;
desc_803c8f9c = 0x803c8f9c;
desc_803c8fc4 = 0x803c8fc4;
desc_803c8fec = 0x803c8fec;
desc_803c9014 = 0x803c9014;
desc_803c903c = 0x803c903c;
desc_803c9064 = 0x803c9064;
desc_803c908c = 0x803c908c;
fn_801e8d9c = 0x801e8d9c;
fn_801eb674 = 0x801eb674;
fn_801ebf38 = 0x801ebf38;
fn_801ec52c = 0x801ec52c;
fn_801ed24c = 0x801ed24c;
fn_801f0210 = 0x801f0210;
SECTIONS {
  .text.w3d_d20e_register_weapon_properties_80256b3c 0x80256b3c : { *(.text.w3d_d20e_register_weapon_properties_80256b3c) }
  /DISCARD/ : { *(.text*) *(.rodata*) *(.data*) *(.bss*) *(.sdata*) *(.sbss*) *(.comment) }
}
