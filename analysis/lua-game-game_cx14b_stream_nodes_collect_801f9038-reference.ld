/* Generated reference-only placements. All bodies are source-built. */
OUTPUT_FORMAT("elf32-powerpc")
OUTPUT_ARCH(powerpc)
ENTRY(w3d_cx14b_stream_nodes_collect_801f9038)
_SDA_BASE_ = 0x804b2540;
_SDA2_BASE_ = 0x804c2540;
first_801f8de0 = 0x801f8de0;
next_801f8df8 = 0x801f8df8;
SECTIONS {
  .text.w3d_cx14b_stream_nodes_collect_801f9038 0x801f9038 : { *(.text.w3d_cx14b_stream_nodes_collect_801f9038) }
  /DISCARD/ : { *(.text*) *(.rodata*) *(.data*) *(.bss*) *(.sdata*) *(.sbss*) *(.comment) }
}
