/* Generated reference-only placements. All bodies are source-built. */
OUTPUT_FORMAT("elf32-powerpc")
OUTPUT_ARCH(powerpc)
ENTRY(tsonnet_b27_utf_8018a864)
_SDA_BASE_ = 0x804b2540;
_SDA2_BASE_ = 0x804c2540;
fn_8018b360 = 0x8018b360;
fn_801fe0b8 = 0x801fe0b8;
fn_801fe160 = 0x801fe160;
strlen = 0x802ef9c0;
SECTIONS {
  .text.tsonnet_b27_utf_8018a864 0x8018a864 : { *(.text.tsonnet_b27_utf_8018a864) }
  /DISCARD/ : { *(.text*) *(.rodata*) *(.data*) *(.bss*) *(.sdata*) *(.sbss*) *(.comment) }
}
