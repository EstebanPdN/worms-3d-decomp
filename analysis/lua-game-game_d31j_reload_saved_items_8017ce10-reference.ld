/* Generated reference-only placements. All bodies are source-built. */
OUTPUT_FORMAT("elf32-powerpc")
OUTPUT_ARCH(powerpc)
ENTRY(d31j_reload_saved_items_8017ce10)
_SDA_BASE_ = 0x804b2540;
_SDA2_BASE_ = 0x804c2540;
d24j_find_named_item_8017e22c = 0x8017e22c;
lbl_8040ca90 = 0x8040ca90;
lbl_8040e058 = 0x8040e058;
lbl_804a8dd8 = 0x804a8dd8;
w3d_constant_8020b5c8 = 0x8020b5c8;
w3d_d29e_run_file_8020b6e8 = 0x8020b6e8;
w3d_empty_8020b5d0 = 0x8020b5d0;
w3d_string_base_finish = 0x8020c5c4;
w3d_string_base_init = 0x8020c5c0;
w3d_string_default = 0x803426b8;
w3d_string_format = 0x8020c510;
w3d_string_header = 0x80341884;
w3d_string_release = 0x80341588;
SECTIONS {
  .text.d31j_reload_saved_items_8017ce10 0x8017ce10 : { *(.text.d31j_reload_saved_items_8017ce10) }
  /DISCARD/ : { *(.text*) *(.rodata*) *(.data*) *(.bss*) *(.sdata*) *(.sbss*) *(.comment) }
}
