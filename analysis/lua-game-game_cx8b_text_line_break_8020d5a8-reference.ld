/* Generated reference-only placements. All bodies are source-built. */
OUTPUT_FORMAT("elf32-powerpc")
OUTPUT_ARCH(powerpc)
ENTRY(w3d_cx8b_text_line_break_8020d5a8)
_SDA_BASE_ = 0x804b2540;
_SDA2_BASE_ = 0x804c2540;
fn_8020dbf8 = 0x8020dbf8;
text_803b3224 = 0x803b3224;
text_803b322c = 0x803b322c;
SECTIONS {
  .text.w3d_cx8b_text_line_break_8020d5a8 0x8020d5a8 : { *(.text.w3d_cx8b_text_line_break_8020d5a8) }
  /DISCARD/ : { *(.text*) *(.rodata*) *(.data*) *(.bss*) *(.sdata*) *(.sbss*) *(.comment) }
}
