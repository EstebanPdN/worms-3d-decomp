/* Generated reference-only placements. All bodies are source-built. */
OUTPUT_FORMAT("elf32-powerpc")
OUTPUT_ARCH(powerpc)
ENTRY(w3d_constant_801ff658)
_SDA_BASE_ = 0x804b2540;
_SDA2_BASE_ = 0x804c2540;
w3d_fn_801ffc2c = 0x801ffc2c;
w3d_fn_801ffe44 = 0x801ffe44;
w3d_fn_802009c4 = 0x802009c4;
w3d_fn_80200db4 = 0x80200db4;
w3d_fn_80200e5c = 0x80200e5c;
w3d_fn_8020317c = 0x8020317c;
w3d_fn_80203970 = 0x80203970;
w3d_fn_80203b08 = 0x80203b08;
w3d_fn_802057cc = 0x802057cc;
w3d_fn_80205860 = 0x80205860;
w3d_fn_80205ae0 = 0x80205ae0;
w3d_fn_80206850 = 0x80206850;
w3d_fn_80206d08 = 0x80206d08;
w3d_fn_8020703c = 0x8020703c;
w3d_fn_8020797c = 0x8020797c;
w3d_fn_802084f8 = 0x802084f8;
w3d_fn_80208c64 = 0x80208c64;
w3d_fn_80208ce0 = 0x80208ce0;
w3d_fn_802090b8 = 0x802090b8;
w3d_fn_8020b460 = 0x8020b460;
w3d_global_803658f8 = 0x803658f8;
w3d_global_80365928 = 0x80365928;
w3d_global_803b2b7c = 0x803b2b7c;
w3d_global_803b2b94 = 0x803b2b94;
w3d_global_803b2bfc = 0x803b2bfc;
w3d_global_803b2c44 = 0x803b2c44;
w3d_global_803b2c78 = 0x803b2c78;
w3d_global_803b2d80 = 0x803b2d80;
w3d_global_803b2da4 = 0x803b2da4;
w3d_global_803b2dbc = 0x803b2dbc;
w3d_global_803b2dd4 = 0x803b2dd4;
w3d_global_803b2dec = 0x803b2dec;
w3d_global_803b2e0c = 0x803b2e0c;
w3d_global_8040060c = 0x8040060c;
w3d_global_80400628 = 0x80400628;
w3d_global_80400644 = 0x80400644;
w3d_global_8045edf4 = 0x8045edf4;
w3d_global_8045ee24 = 0x8045ee24;
w3d_heap_allocate_entry_a = 0x801fe1d8;
w3d_owner_list_remove = 0x8020fd2c;
w3d_registry_list_803658f8 = 0x803658f8;
w3d_registry_list_80365928 = 0x80365928;
w3d_state_register = 0x8020fd04;
w3d_vtable_80418d48 = 0x80418d48;
w3d_vtable_80419298 = 0x80419298;
w3d_vtable_804192b8 = 0x804192b8;
SECTIONS {
  .text.w3d_constant_801ff658 0x801ff658 : { *(.text.w3d_constant_801ff658) }
  .text.w3d_address_801ff660 0x801ff660 : { *(.text.w3d_address_801ff660) }
  .text.w3d_constant_801ff830 0x801ff830 : { *(.text.w3d_constant_801ff830) }
  .text.w3d_address_801ff838 0x801ff838 : { *(.text.w3d_address_801ff838) }
  .text.w3d_constant_801ff95c 0x801ff95c : { *(.text.w3d_constant_801ff95c) }
  .text.w3d_address_801ff964 0x801ff964 : { *(.text.w3d_address_801ff964) }
  .text.w3d_static_init_801ffe18 0x801ffe18 : { *(.text.w3d_static_init_801ffe18) }
  .text.w3d_constant_801ffe8c 0x801ffe8c : { *(.text.w3d_constant_801ffe8c) }
  .text.w3d_constant_801ffe94 0x801ffe94 : { *(.text.w3d_constant_801ffe94) }
  .text.w3d_ctor_802000f8 0x802000f8 : { *(.text.w3d_ctor_802000f8) }
  .text.w3d_constant_80200390 0x80200390 : { *(.text.w3d_constant_80200390) }
  .text.w3d_get_8020048c 0x8020048c : { *(.text.w3d_get_8020048c) }
  .text.w3d_constant_802009b4 0x802009b4 : { *(.text.w3d_constant_802009b4) }
  .text.w3d_get_802009bc 0x802009bc : { *(.text.w3d_get_802009bc) }
  .text.w3d_static_init_80200a44 0x80200a44 : { *(.text.w3d_static_init_80200a44) }
  .text.w3d_address_80200d04 0x80200d04 : { *(.text.w3d_address_80200d04) }
  .text.w3d_registry_unlink_80200d10 0x80200d10 : { *(.text.w3d_registry_unlink_80200d10) }
  .text.w3d_registry_create_80200d54 0x80200d54 : { *(.text.w3d_registry_create_80200d54) }
  .text.w3d_constant_8020101c 0x8020101c : { *(.text.w3d_constant_8020101c) }
  .text.w3d_constant_80201024 0x80201024 : { *(.text.w3d_constant_80201024) }
  .text.w3d_constant_8020248c 0x8020248c : { *(.text.w3d_constant_8020248c) }
  .text.w3d_static_init_802031d8 0x802031d8 : { *(.text.w3d_static_init_802031d8) }
  .text.w3d_address_80203730 0x80203730 : { *(.text.w3d_address_80203730) }
  .text.w3d_registry_release_8020373c 0x8020373c : { *(.text.w3d_registry_release_8020373c) }
  .text.w3d_registry_retain_80203798 0x80203798 : { *(.text.w3d_registry_retain_80203798) }
  .text.w3d_forward_802037b0 0x802037b0 : { *(.text.w3d_forward_802037b0) }
  .text.w3d_address_802037f8 0x802037f8 : { *(.text.w3d_address_802037f8) }
  .text.w3d_registry_release_80203804 0x80203804 : { *(.text.w3d_registry_release_80203804) }
  .text.w3d_registry_retain_80203860 0x80203860 : { *(.text.w3d_registry_retain_80203860) }
  .text.w3d_forward_80203878 0x80203878 : { *(.text.w3d_forward_80203878) }
  .text.w3d_address_802038c0 0x802038c0 : { *(.text.w3d_address_802038c0) }
  .text.w3d_registry_unlink_802038cc 0x802038cc : { *(.text.w3d_registry_unlink_802038cc) }
  .text.w3d_registry_create_80203910 0x80203910 : { *(.text.w3d_registry_create_80203910) }
  .text.w3d_constant_80203df4 0x80203df4 : { *(.text.w3d_constant_80203df4) }
  .text.w3d_constant_80203dfc 0x80203dfc : { *(.text.w3d_constant_80203dfc) }
  .text.w3d_static_init_80205828 0x80205828 : { *(.text.w3d_static_init_80205828) }
  .text.w3d_address_80205854 0x80205854 : { *(.text.w3d_address_80205854) }
  .text.w3d_address_80205978 0x80205978 : { *(.text.w3d_address_80205978) }
  .text.w3d_registry_release_80205984 0x80205984 : { *(.text.w3d_registry_release_80205984) }
  .text.w3d_registry_retain_802059e0 0x802059e0 : { *(.text.w3d_registry_retain_802059e0) }
  .text.w3d_forward_802059f8 0x802059f8 : { *(.text.w3d_forward_802059f8) }
  .text.w3d_get_802067b4 0x802067b4 : { *(.text.w3d_get_802067b4) }
  .text.w3d_static_init_802068d0 0x802068d0 : { *(.text.w3d_static_init_802068d0) }
  .text.w3d_empty_80206a08 0x80206a08 : { *(.text.w3d_empty_80206a08) }
  .text.w3d_address_80206a38 0x80206a38 : { *(.text.w3d_address_80206a38) }
  .text.w3d_registry_retain_80206a94 0x80206a94 : { *(.text.w3d_registry_retain_80206a94) }
  .text.w3d_forward_80206aac 0x80206aac : { *(.text.w3d_forward_80206aac) }
  .text.w3d_address_80206cfc 0x80206cfc : { *(.text.w3d_address_80206cfc) }
  .text.w3d_address_80206e20 0x80206e20 : { *(.text.w3d_address_80206e20) }
  .text.w3d_registry_release_80206e2c 0x80206e2c : { *(.text.w3d_registry_release_80206e2c) }
  .text.w3d_registry_retain_80206e88 0x80206e88 : { *(.text.w3d_registry_retain_80206e88) }
  .text.w3d_forward_80206ea0 0x80206ea0 : { *(.text.w3d_forward_80206ea0) }
  .text.w3d_get_802071d8 0x802071d8 : { *(.text.w3d_get_802071d8) }
  .text.w3d_static_init_80207a2c 0x80207a2c : { *(.text.w3d_static_init_80207a2c) }
  .text.w3d_address_80207f30 0x80207f30 : { *(.text.w3d_address_80207f30) }
  .text.w3d_registry_retain_80207f8c 0x80207f8c : { *(.text.w3d_registry_retain_80207f8c) }
  .text.w3d_forward_80207fa4 0x80207fa4 : { *(.text.w3d_forward_80207fa4) }
  .text.w3d_address_802082f8 0x802082f8 : { *(.text.w3d_address_802082f8) }
  .text.w3d_registry_retain_80208318 0x80208318 : { *(.text.w3d_registry_retain_80208318) }
  .text.w3d_forward_80208330 0x80208330 : { *(.text.w3d_forward_80208330) }
  .text.w3d_address_80208378 0x80208378 : { *(.text.w3d_address_80208378) }
  .text.w3d_registry_retain_80208398 0x80208398 : { *(.text.w3d_registry_retain_80208398) }
  .text.w3d_forward_802083b0 0x802083b0 : { *(.text.w3d_forward_802083b0) }
  .text.w3d_address_802083f8 0x802083f8 : { *(.text.w3d_address_802083f8) }
  .text.w3d_registry_retain_80208418 0x80208418 : { *(.text.w3d_registry_retain_80208418) }
  .text.w3d_forward_80208430 0x80208430 : { *(.text.w3d_forward_80208430) }
  .text.w3d_address_80208478 0x80208478 : { *(.text.w3d_address_80208478) }
  .text.w3d_registry_retain_80208498 0x80208498 : { *(.text.w3d_registry_retain_80208498) }
  .text.w3d_forward_802084b0 0x802084b0 : { *(.text.w3d_forward_802084b0) }
  .text.w3d_ctor_802087e0 0x802087e0 : { *(.text.w3d_ctor_802087e0) }
  .text.w3d_ctor_80208a4c 0x80208a4c : { *(.text.w3d_ctor_80208a4c) }
  .text.w3d_address_80208b44 0x80208b44 : { *(.text.w3d_address_80208b44) }
  .text.w3d_registry_release_80208b50 0x80208b50 : { *(.text.w3d_registry_release_80208b50) }
  .text.w3d_registry_retain_80208bac 0x80208bac : { *(.text.w3d_registry_retain_80208bac) }
  .text.w3d_forward_80208bc4 0x80208bc4 : { *(.text.w3d_forward_80208bc4) }
  .text.w3d_constant_80209050 0x80209050 : { *(.text.w3d_constant_80209050) }
  .text.w3d_constant_80209058 0x80209058 : { *(.text.w3d_constant_80209058) }
  .text.w3d_static_init_80209134 0x80209134 : { *(.text.w3d_static_init_80209134) }
  .text.w3d_get_802092b8 0x802092b8 : { *(.text.w3d_get_802092b8) }
  /DISCARD/ : { *(.text*) *(.rodata*) *(.data*) *(.bss*) *(.sdata*) *(.sbss*) *(.comment) }
}
