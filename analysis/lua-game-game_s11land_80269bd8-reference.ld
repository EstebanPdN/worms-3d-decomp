/* Generated reference-only placements. All bodies are source-built. */
OUTPUT_FORMAT("elf32-powerpc")
OUTPUT_ARCH(powerpc)
ENTRY(s11_select_land_80269bd8)
_SDA_BASE_ = 0x804b2540;
_SDA2_BASE_ = 0x804c2540;
fn_800FC230__FPPCcPi = 0x800fc230;
fn_8026B3F0__FP12S11LandOwner = 0x8026b3f0;
fn_8026C54C__FP12S11LandOwner = 0x8026c54c;
fn_8026CBC8__FPvi = 0x8026cbc8;
lbl_803CB940 = 0x803cb940;
set_active__12S11LandOwneri = 0x8026c008;
SECTIONS {
  .text.s11_select_land_80269bd8 0x80269bd8 : { *(.text.s11_select_land_80269bd8) }
  /DISCARD/ : { *(.text*) *(.rodata*) *(.data*) *(.bss*) *(.sdata*) *(.sbss*) *(.comment) }
}
