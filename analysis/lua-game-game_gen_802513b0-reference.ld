/* Generated reference-only placements. All bodies are source-built. */
OUTPUT_FORMAT("elf32-powerpc")
OUTPUT_ARCH(powerpc)
ENTRY(w3d_get_802513b0)
_SDA_BASE_ = 0x804b2540;
_SDA2_BASE_ = 0x804c2540;
w3d_fn_802523b4 = 0x802523b4;
w3d_fn_802539c4 = 0x802539c4;
w3d_fn_8025518c = 0x8025518c;
w3d_fn_802553c8 = 0x802553c8;
w3d_fn_80255770 = 0x80255770;
w3d_fn_80256050 = 0x80256050;
w3d_fn_80256a98 = 0x80256a98;
w3d_fn_802570c0 = 0x802570c0;
w3d_fn_8025763c = 0x8025763c;
w3d_global_803682d8 = 0x803682d8;
w3d_global_80368328 = 0x80368328;
w3d_global_80368378 = 0x80368378;
w3d_global_803683c8 = 0x803683c8;
w3d_global_80368418 = 0x80368418;
w3d_global_80368468 = 0x80368468;
w3d_global_803684b8 = 0x803684b8;
w3d_global_80368508 = 0x80368508;
w3d_global_80368558 = 0x80368558;
w3d_owner_list_remove = 0x8020fd2c;
w3d_registry_list_803682d8 = 0x803682d8;
w3d_registry_list_80368328 = 0x80368328;
w3d_registry_list_80368378 = 0x80368378;
w3d_registry_list_803683c8 = 0x803683c8;
w3d_registry_list_80368418 = 0x80368418;
w3d_registry_list_80368468 = 0x80368468;
w3d_registry_list_803684b8 = 0x803684b8;
w3d_registry_list_80368508 = 0x80368508;
w3d_registry_list_80368558 = 0x80368558;
SECTIONS {
  .text.w3d_get_802513b0 0x802513b0 : { *(.text.w3d_get_802513b0) }
  .text.w3d_set_802513b8 0x802513b8 : { *(.text.w3d_set_802513b8) }
  .text.w3d_get_802513c0 0x802513c0 : { *(.text.w3d_get_802513c0) }
  .text.w3d_set_802513c8 0x802513c8 : { *(.text.w3d_set_802513c8) }
  .text.w3d_get_802513d0 0x802513d0 : { *(.text.w3d_get_802513d0) }
  .text.w3d_set_802513d8 0x802513d8 : { *(.text.w3d_set_802513d8) }
  .text.w3d_get_802513e0 0x802513e0 : { *(.text.w3d_get_802513e0) }
  .text.w3d_get_8025144c 0x8025144c : { *(.text.w3d_get_8025144c) }
  .text.w3d_get_802514b8 0x802514b8 : { *(.text.w3d_get_802514b8) }
  .text.w3d_get_802516d4 0x802516d4 : { *(.text.w3d_get_802516d4) }
  .text.w3d_set_802516dc 0x802516dc : { *(.text.w3d_set_802516dc) }
  .text.w3d_get_802516e4 0x802516e4 : { *(.text.w3d_get_802516e4) }
  .text.w3d_set_802516ec 0x802516ec : { *(.text.w3d_set_802516ec) }
  .text.w3d_get_802516f4 0x802516f4 : { *(.text.w3d_get_802516f4) }
  .text.w3d_set_802516fc 0x802516fc : { *(.text.w3d_set_802516fc) }
  .text.w3d_get_80251704 0x80251704 : { *(.text.w3d_get_80251704) }
  .text.w3d_set_80251a74 0x80251a74 : { *(.text.w3d_set_80251a74) }
  .text.w3d_get_80251a7c 0x80251a7c : { *(.text.w3d_get_80251a7c) }
  .text.w3d_set_80251a84 0x80251a84 : { *(.text.w3d_set_80251a84) }
  .text.w3d_get_80251a8c 0x80251a8c : { *(.text.w3d_get_80251a8c) }
  .text.w3d_set_80251a94 0x80251a94 : { *(.text.w3d_set_80251a94) }
  .text.w3d_get_80251a9c 0x80251a9c : { *(.text.w3d_get_80251a9c) }
  .text.w3d_set_80251aa4 0x80251aa4 : { *(.text.w3d_set_80251aa4) }
  .text.w3d_get_80251aac 0x80251aac : { *(.text.w3d_get_80251aac) }
  .text.w3d_set_80251ab4 0x80251ab4 : { *(.text.w3d_set_80251ab4) }
  .text.w3d_get_80251abc 0x80251abc : { *(.text.w3d_get_80251abc) }
  .text.w3d_set_80251ad4 0x80251ad4 : { *(.text.w3d_set_80251ad4) }
  .text.w3d_get_80251adc 0x80251adc : { *(.text.w3d_get_80251adc) }
  .text.w3d_set_80251ae4 0x80251ae4 : { *(.text.w3d_set_80251ae4) }
  .text.w3d_get_80251aec 0x80251aec : { *(.text.w3d_get_80251aec) }
  .text.w3d_set_80251be8 0x80251be8 : { *(.text.w3d_set_80251be8) }
  .text.w3d_get_80251bf0 0x80251bf0 : { *(.text.w3d_get_80251bf0) }
  .text.w3d_set_80251bf8 0x80251bf8 : { *(.text.w3d_set_80251bf8) }
  .text.w3d_get_80251c00 0x80251c00 : { *(.text.w3d_get_80251c00) }
  .text.w3d_set_80251cf8 0x80251cf8 : { *(.text.w3d_set_80251cf8) }
  .text.w3d_get_80251d00 0x80251d00 : { *(.text.w3d_get_80251d00) }
  .text.w3d_get_80251d6c 0x80251d6c : { *(.text.w3d_get_80251d6c) }
  .text.w3d_set_80251dec 0x80251dec : { *(.text.w3d_set_80251dec) }
  .text.w3d_get_80251df4 0x80251df4 : { *(.text.w3d_get_80251df4) }
  .text.w3d_set_80251dfc 0x80251dfc : { *(.text.w3d_set_80251dfc) }
  .text.w3d_get_80251e04 0x80251e04 : { *(.text.w3d_get_80251e04) }
  .text.w3d_set_80251e0c 0x80251e0c : { *(.text.w3d_set_80251e0c) }
  .text.w3d_get_80251e14 0x80251e14 : { *(.text.w3d_get_80251e14) }
  .text.w3d_set_80251e1c 0x80251e1c : { *(.text.w3d_set_80251e1c) }
  .text.w3d_get_80251e24 0x80251e24 : { *(.text.w3d_get_80251e24) }
  .text.w3d_set_80251e2c 0x80251e2c : { *(.text.w3d_set_80251e2c) }
  .text.w3d_get_80251e34 0x80251e34 : { *(.text.w3d_get_80251e34) }
  .text.w3d_set_80251e3c 0x80251e3c : { *(.text.w3d_set_80251e3c) }
  .text.w3d_get_80251e44 0x80251e44 : { *(.text.w3d_get_80251e44) }
  .text.w3d_address_80251e88 0x80251e88 : { *(.text.w3d_address_80251e88) }
  .text.w3d_registry_unlink_80251efc 0x80251efc : { *(.text.w3d_registry_unlink_80251efc) }
  .text.w3d_address_80253278 0x80253278 : { *(.text.w3d_address_80253278) }
  .text.w3d_registry_unlink_802532ec 0x802532ec : { *(.text.w3d_registry_unlink_802532ec) }
  .text.w3d_address_80255068 0x80255068 : { *(.text.w3d_address_80255068) }
  .text.w3d_registry_unlink_802550dc 0x802550dc : { *(.text.w3d_registry_unlink_802550dc) }
  .text.w3d_address_8025529c 0x8025529c : { *(.text.w3d_address_8025529c) }
  .text.w3d_registry_unlink_80255310 0x80255310 : { *(.text.w3d_registry_unlink_80255310) }
  .text.w3d_address_802554f8 0x802554f8 : { *(.text.w3d_address_802554f8) }
  .text.w3d_registry_unlink_8025556c 0x8025556c : { *(.text.w3d_registry_unlink_8025556c) }
  .text.w3d_address_80255d24 0x80255d24 : { *(.text.w3d_address_80255d24) }
  .text.w3d_registry_unlink_80255d98 0x80255d98 : { *(.text.w3d_registry_unlink_80255d98) }
  .text.w3d_address_80256884 0x80256884 : { *(.text.w3d_address_80256884) }
  .text.w3d_registry_unlink_802568f8 0x802568f8 : { *(.text.w3d_registry_unlink_802568f8) }
  .text.w3d_address_80256ef4 0x80256ef4 : { *(.text.w3d_address_80256ef4) }
  .text.w3d_registry_unlink_80256f68 0x80256f68 : { *(.text.w3d_registry_unlink_80256f68) }
  .text.w3d_address_80257470 0x80257470 : { *(.text.w3d_address_80257470) }
  .text.w3d_registry_unlink_802574e4 0x802574e4 : { *(.text.w3d_registry_unlink_802574e4) }
  .text.w3d_registry_release_80257bb8 0x80257bb8 : { *(.text.w3d_registry_release_80257bb8) }
  .text.w3d_registry_release_80257c14 0x80257c14 : { *(.text.w3d_registry_release_80257c14) }
  .text.w3d_registry_release_80257c70 0x80257c70 : { *(.text.w3d_registry_release_80257c70) }
  .text.w3d_registry_release_80257ccc 0x80257ccc : { *(.text.w3d_registry_release_80257ccc) }
  .text.w3d_registry_release_80257d28 0x80257d28 : { *(.text.w3d_registry_release_80257d28) }
  .text.w3d_registry_release_80257d84 0x80257d84 : { *(.text.w3d_registry_release_80257d84) }
  .text.w3d_registry_release_80257de0 0x80257de0 : { *(.text.w3d_registry_release_80257de0) }
  .text.w3d_registry_release_80257e3c 0x80257e3c : { *(.text.w3d_registry_release_80257e3c) }
  .text.w3d_registry_release_80257e98 0x80257e98 : { *(.text.w3d_registry_release_80257e98) }
  .text.w3d_set_80258204 0x80258204 : { *(.text.w3d_set_80258204) }
  .text.w3d_get_8025820c 0x8025820c : { *(.text.w3d_get_8025820c) }
  .text.w3d_set_80258234 0x80258234 : { *(.text.w3d_set_80258234) }
  .text.w3d_get_8025823c 0x8025823c : { *(.text.w3d_get_8025823c) }
  /DISCARD/ : { *(.text*) *(.rodata*) *(.data*) *(.bss*) *(.sdata*) *(.sbss*) *(.comment) }
}
