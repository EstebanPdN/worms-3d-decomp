/* Generated reference-only placements. All bodies are source-built. */
OUTPUT_FORMAT("elf32-powerpc")
OUTPUT_ARCH(powerpc)
ENTRY(w3d_d24a_commentary_draw_80044410)
_SDA_BASE_ = 0x804b2540;
_SDA2_BASE_ = 0x804c2540;
__6StringPCc = 0x8020bb54;
w3d_commentary_play_80043134 = 0x80043134;
w3d_random_8015ff5c = 0x8015ff5c;
w3d_string_80374eac = 0x80374eac;
w3d_string_80374ebc = 0x80374ebc;
w3d_string_80374ecc = 0x80374ecc;
w3d_string_80374edc = 0x80374edc;
w3d_string_80374eec = 0x80374eec;
w3d_string_80374efc = 0x80374efc;
w3d_string_80374f0c = 0x80374f0c;
w3d_string_80374f1c = 0x80374f1c;
w3d_string_finish_8020c5c4 = 0x8020c5c4;
w3d_string_header_80341884 = 0x80341884;
w3d_string_init_8020c5c0 = 0x8020c5c0;
w3d_string_property_800fc2b0 = 0x800fc2b0;
w3d_string_release_80341588 = 0x80341588;
SECTIONS {
  .text.w3d_d24a_commentary_draw_80044410 0x80044410 : { *(.text.w3d_d24a_commentary_draw_80044410) }
  /DISCARD/ : { *(.text*) *(.rodata*) *(.data*) *(.bss*) *(.sdata*) *(.sbss*) *(.comment) }
}
