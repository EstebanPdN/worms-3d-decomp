/* Generated reference-only placements. All bodies are source-built. */
OUTPUT_FORMAT("elf32-powerpc")
OUTPUT_ARCH(powerpc)
ENTRY(w3d_d40f_panel_build_8028ba38)
_SDA_BASE_ = 0x804b2540;
_SDA2_BASE_ = 0x804c2540;
__6String = 0x803426b8;
__6StringPCc = 0x8020bb54;
d20d_text_width_8018c8bc = 0x8018c8bc;
d25f_panel_visibility_8028c160 = 0x8028c160;
d26j_set_colour_80173df0 = 0x80173df0;
fn_8025e128 = 0x8025e128;
lbl_803cfcfc = 0x803cfcfc;
lbl_803cfd20 = 0x803cfd20;
lbl_803cfd2c = 0x803cfd2c;
lbl_803cfd38 = 0x803cfd38;
lbl_803cfd40 = 0x803cfd40;
lbl_803cfd48 = 0x803cfd48;
lbl_803cfd50 = 0x803cfd50;
lbl_803cfd58 = 0x803cfd58;
lbl_803cfd5c = 0x803cfd5c;
lbl_803cfd8c = 0x803cfd8c;
lbl_803cfd9c = 0x803cfd9c;
lbl_803cfdb0 = 0x803cfdb0;
lbl_803cfdc0 = 0x803cfdc0;
lbl_8045e788 = 0x8045e788;
s11_named_handle_8025dffc = 0x8025dffc;
s9_permute_8018d324 = 0x8018d324;
tsonnet_c31_text_size_802b1880 = 0x802b1880;
w3d_auto_800fc270 = 0x800fc270;
w3d_auto_80178f54 = 0x80178f54;
w3d_auto_80263c24 = 0x80263c24;
w3d_call_with_owner_8025ee94 = 0x8025ee94;
w3d_empty_8034357c = 0x8034357c;
w3d_empty_80343580 = 0x80343580;
w3d_forward_to_held_8025ee60 = 0x8025ee60;
w3d_getf_8018ca14 = 0x8018ca14;
w3d_handle_set_name = 0x8015adf4;
w3d_heap_allocate_entry_a = 0x801fe1d8;
w3d_named_suffix_802b1510 = 0x802b1510;
w3d_string_assign = 0x8020bd38;
w3d_string_base_finish = 0x8020c5c4;
w3d_string_format = 0x8020c510;
w3d_string_release = 0x80341588;
SECTIONS {
  .text.w3d_d40f_panel_build_8028ba38 0x8028ba38 : { *(.text.w3d_d40f_panel_build_8028ba38) }
  .rodata 0x803cfdd4 : { *(.rodata) }
  /DISCARD/ : { *(.text*) *(.rodata*) *(.data*) *(.bss*) *(.sdata*) *(.sbss*) *(.comment) }
}
