/* Generated reference-only placements. All bodies are source-built. */
OUTPUT_FORMAT("elf32-powerpc")
OUTPUT_ARCH(powerpc)
ENTRY(d24i_tooltip_tick_8012cf48)
_SDA_BASE_ = 0x804b2540;
_SDA2_BASE_ = 0x804c2540;
__11d24i_StringPCc = 0x8020bb54;
d24i_hack_8039d9ec = 0x8039d9ec;
d24i_pending_a_8012d8c0 = 0x8012d8c0;
d24i_pending_b_8012f77c = 0x8012f77c;
d24i_setting_read_800fc2b0 = 0x800fc2b0;
d24i_setting_write_800fc550 = 0x800fc550;
d24i_string_append_8020bf2c = 0x8020bf2c;
d24i_string_finish_8020c5c4 = 0x8020c5c4;
d24i_string_header_80341884 = 0x80341884;
d24i_string_init_8020c5c0 = 0x8020c5c0;
d24i_string_release_80341588 = 0x80341588;
d24i_tooltip_8039d9e0 = 0x8039d9e0;
SECTIONS {
  .text.d24i_tooltip_tick_8012cf48 0x8012cf48 : { *(.text.d24i_tooltip_tick_8012cf48) }
  /DISCARD/ : { *(.text*) *(.rodata*) *(.data*) *(.bss*) *(.sdata*) *(.sbss*) *(.comment) }
}
