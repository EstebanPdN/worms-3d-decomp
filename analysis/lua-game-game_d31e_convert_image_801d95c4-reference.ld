/* Generated reference-only placements. All bodies are source-built. */
OUTPUT_FORMAT("elf32-powerpc")
OUTPUT_ARCH(powerpc)
ENTRY(w3d_d31e_convert_image_801d95c4)
_SDA_BASE_ = 0x804b2540;
_SDA2_BASE_ = 0x804c2540;
f3c_propagate_tag_801ea4c8 = 0x801ea4c8;
fn_801afac0 = 0x801afac0;
g_conv = 0x803af714;
w3d_k5b_array_ref_lock_801ef048 = 0x801ef048;
w3d_s21_fetch_801ea470 = 0x801ea470;
SECTIONS {
  .text.w3d_d31e_convert_image_801d95c4 0x801d95c4 : { *(.text.w3d_d31e_convert_image_801d95c4) }
  /DISCARD/ : { *(.text*) *(.rodata*) *(.data*) *(.bss*) *(.sdata*) *(.sbss*) *(.comment) }
}
