/* Generated reference-only placements. All bodies are source-built. */
OUTPUT_FORMAT("elf32-powerpc")
OUTPUT_ARCH(powerpc)
ENTRY(_._13F16aCardOwner)
_SDA_BASE_ = 0x804b2540;
_SDA2_BASE_ = 0x804c2540;
_._21F16aCardBase_801628ec = 0x801628ec;
fn_8028aab0 = 0x8028aab0;
table_8041c050 = 0x8041c050;
SECTIONS {
  .text._._13F16aCardOwner 0x80288110 : { *(.text._._13F16aCardOwner) }
  /DISCARD/ : { *(.text*) *(.rodata*) *(.data*) *(.bss*) *(.sdata*) *(.sbss*) *(.comment) }
}
