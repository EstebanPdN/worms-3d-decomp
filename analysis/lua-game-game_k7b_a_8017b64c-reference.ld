/* Generated reference-only placements. All bodies are source-built. */
OUTPUT_FORMAT("elf32-powerpc")
OUTPUT_ARCH(powerpc)
ENTRY(w3d_k7b_refresher_update_8017b64c)
_SDA_BASE_ = 0x804b2540;
_SDA2_BASE_ = 0x804c2540;
fn_8017a07c = 0x8017a07c;
SECTIONS {
  .text.w3d_k7b_refresher_update_8017b64c 0x8017b64c : { *(.text.w3d_k7b_refresher_update_8017b64c) }
  /DISCARD/ : { *(.text*) *(.rodata*) *(.data*) *(.bss*) *(.sdata*) *(.sbss*) *(.comment) }
}
