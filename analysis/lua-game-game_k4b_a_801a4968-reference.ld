/* Generated reference-only placements. All bodies are source-built. */
OUTPUT_FORMAT("elf32-powerpc")
OUTPUT_ARCH(powerpc)
ENTRY(w3d_k4b_visit_head_then_targets_801a4968)
_SDA_BASE_ = 0x804b2540;
_SDA2_BASE_ = 0x804c2540;
w3d_s20_dispatch_five_targets_801a4874 = 0x801a4874;
SECTIONS {
  .text.w3d_k4b_visit_head_then_targets_801a4968 0x801a4968 : { *(.text.w3d_k4b_visit_head_then_targets_801a4968) }
  /DISCARD/ : { *(.text*) *(.rodata*) *(.data*) *(.bss*) *(.sdata*) *(.sbss*) *(.comment) }
}
