/* Generated reference-only placements. All bodies are source-built. */
OUTPUT_FORMAT("elf32-powerpc")
OUTPUT_ARCH(powerpc)
ENTRY(w3d_registry_create_80024c34)
_SDA_BASE_ = 0x804b2540;
_SDA2_BASE_ = 0x804c2540;
w3d_fn_80024bf0 = 0x80024bf0;
w3d_fn_80024d08 = 0x80024d08;
w3d_fn_80024d50 = 0x80024d50;
w3d_fn_80025164 = 0x80025164;
w3d_fn_800251c0 = 0x800251c0;
w3d_fn_80025830 = 0x80025830;
w3d_fn_80025878 = 0x80025878;
w3d_fn_80025d08 = 0x80025d08;
w3d_fn_80025d74 = 0x80025d74;
w3d_fn_800269fc = 0x800269fc;
w3d_fn_80026a90 = 0x80026a90;
w3d_fn_8002765c = 0x8002765c;
w3d_fn_800276d0 = 0x800276d0;
w3d_fn_8002824c = 0x8002824c;
w3d_fn_800282e4 = 0x800282e4;
w3d_fn_80029258 = 0x80029258;
w3d_fn_80029298 = 0x80029298;
w3d_fn_80029514 = 0x80029514;
w3d_fn_80029578 = 0x80029578;
w3d_fn_8002a3e8 = 0x8002a3e8;
w3d_fn_8002a434 = 0x8002a434;
w3d_fn_8002a914 = 0x8002a914;
w3d_fn_8002a978 = 0x8002a978;
w3d_fn_8002b354 = 0x8002b354;
w3d_fn_8002b3a0 = 0x8002b3a0;
w3d_fn_8002b828 = 0x8002b828;
w3d_fn_8002b890 = 0x8002b890;
w3d_fn_8002dd68 = 0x8002dd68;
w3d_global_8035fb80 = 0x8035fb80;
w3d_global_8035fbb0 = 0x8035fbb0;
w3d_global_8035fbe0 = 0x8035fbe0;
w3d_global_8035fc10 = 0x8035fc10;
w3d_global_8035fc40 = 0x8035fc40;
w3d_global_8035fc70 = 0x8035fc70;
w3d_global_8035fca0 = 0x8035fca0;
w3d_global_8035fcd0 = 0x8035fcd0;
w3d_global_8035fd00 = 0x8035fd00;
w3d_global_8035fd30 = 0x8035fd30;
w3d_global_8035fd60 = 0x8035fd60;
w3d_global_8035fd90 = 0x8035fd90;
w3d_global_8035fdc0 = 0x8035fdc0;
w3d_global_8035fdf0 = 0x8035fdf0;
w3d_heap_allocate_entry_a = 0x801fe1d8;
w3d_owner_list_remove = 0x8020fd2c;
w3d_registry_list_8035fb50 = 0x8035fb50;
w3d_registry_list_8035fb80 = 0x8035fb80;
w3d_registry_list_8035fbb0 = 0x8035fbb0;
w3d_registry_list_8035fbe0 = 0x8035fbe0;
w3d_registry_list_8035fc10 = 0x8035fc10;
w3d_registry_list_8035fc40 = 0x8035fc40;
w3d_registry_list_8035fc70 = 0x8035fc70;
w3d_registry_list_8035fca0 = 0x8035fca0;
w3d_registry_list_8035fcd0 = 0x8035fcd0;
w3d_registry_list_8035fd00 = 0x8035fd00;
w3d_registry_list_8035fd30 = 0x8035fd30;
w3d_registry_list_8035fd60 = 0x8035fd60;
w3d_registry_list_8035fd90 = 0x8035fd90;
w3d_registry_list_8035fdc0 = 0x8035fdc0;
w3d_registry_list_8035fdf0 = 0x8035fdf0;
w3d_state_register = 0x8020fd04;
SECTIONS {
  .text.w3d_registry_create_80024c34 0x80024c34 : { *(.text.w3d_registry_create_80024c34) }
  .text.w3d_registry_release_80024c94 0x80024c94 : { *(.text.w3d_registry_release_80024c94) }
  .text.w3d_registry_retain_80024cf0 0x80024cf0 : { *(.text.w3d_registry_retain_80024cf0) }
  .text.w3d_constant_80024e98 0x80024e98 : { *(.text.w3d_constant_80024e98) }
  .text.w3d_address_80025040 0x80025040 : { *(.text.w3d_address_80025040) }
  .text.w3d_registry_unlink_8002504c 0x8002504c : { *(.text.w3d_registry_unlink_8002504c) }
  .text.w3d_registry_create_80025090 0x80025090 : { *(.text.w3d_registry_create_80025090) }
  .text.w3d_registry_release_800250f0 0x800250f0 : { *(.text.w3d_registry_release_800250f0) }
  .text.w3d_registry_retain_8002514c 0x8002514c : { *(.text.w3d_registry_retain_8002514c) }
  .text.w3d_constant_80025474 0x80025474 : { *(.text.w3d_constant_80025474) }
  .text.w3d_address_8002570c 0x8002570c : { *(.text.w3d_address_8002570c) }
  .text.w3d_registry_unlink_80025718 0x80025718 : { *(.text.w3d_registry_unlink_80025718) }
  .text.w3d_registry_create_8002575c 0x8002575c : { *(.text.w3d_registry_create_8002575c) }
  .text.w3d_registry_release_800257bc 0x800257bc : { *(.text.w3d_registry_release_800257bc) }
  .text.w3d_registry_retain_80025818 0x80025818 : { *(.text.w3d_registry_retain_80025818) }
  .text.w3d_constant_80025a14 0x80025a14 : { *(.text.w3d_constant_80025a14) }
  .text.w3d_empty_80025b34 0x80025b34 : { *(.text.w3d_empty_80025b34) }
  .text.w3d_address_80025be4 0x80025be4 : { *(.text.w3d_address_80025be4) }
  .text.w3d_registry_unlink_80025bf0 0x80025bf0 : { *(.text.w3d_registry_unlink_80025bf0) }
  .text.w3d_registry_create_80025c34 0x80025c34 : { *(.text.w3d_registry_create_80025c34) }
  .text.w3d_registry_release_80025c94 0x80025c94 : { *(.text.w3d_registry_release_80025c94) }
  .text.w3d_registry_retain_80025cf0 0x80025cf0 : { *(.text.w3d_registry_retain_80025cf0) }
  .text.w3d_address_800268d8 0x800268d8 : { *(.text.w3d_address_800268d8) }
  .text.w3d_registry_unlink_800268e4 0x800268e4 : { *(.text.w3d_registry_unlink_800268e4) }
  .text.w3d_registry_create_80026928 0x80026928 : { *(.text.w3d_registry_create_80026928) }
  .text.w3d_registry_release_80026988 0x80026988 : { *(.text.w3d_registry_release_80026988) }
  .text.w3d_registry_retain_800269e4 0x800269e4 : { *(.text.w3d_registry_retain_800269e4) }
  .text.w3d_empty_80027328 0x80027328 : { *(.text.w3d_empty_80027328) }
  .text.w3d_address_80027538 0x80027538 : { *(.text.w3d_address_80027538) }
  .text.w3d_registry_unlink_80027544 0x80027544 : { *(.text.w3d_registry_unlink_80027544) }
  .text.w3d_registry_create_80027588 0x80027588 : { *(.text.w3d_registry_create_80027588) }
  .text.w3d_registry_release_800275e8 0x800275e8 : { *(.text.w3d_registry_release_800275e8) }
  .text.w3d_registry_retain_80027644 0x80027644 : { *(.text.w3d_registry_retain_80027644) }
  .text.w3d_address_80028128 0x80028128 : { *(.text.w3d_address_80028128) }
  .text.w3d_registry_unlink_80028134 0x80028134 : { *(.text.w3d_registry_unlink_80028134) }
  .text.w3d_registry_create_80028178 0x80028178 : { *(.text.w3d_registry_create_80028178) }
  .text.w3d_registry_release_800281d8 0x800281d8 : { *(.text.w3d_registry_release_800281d8) }
  .text.w3d_registry_retain_80028234 0x80028234 : { *(.text.w3d_registry_retain_80028234) }
  .text.w3d_address_80029134 0x80029134 : { *(.text.w3d_address_80029134) }
  .text.w3d_registry_unlink_80029140 0x80029140 : { *(.text.w3d_registry_unlink_80029140) }
  .text.w3d_registry_create_80029184 0x80029184 : { *(.text.w3d_registry_create_80029184) }
  .text.w3d_registry_release_800291e4 0x800291e4 : { *(.text.w3d_registry_release_800291e4) }
  .text.w3d_registry_retain_80029240 0x80029240 : { *(.text.w3d_registry_retain_80029240) }
  .text.w3d_constant_80029354 0x80029354 : { *(.text.w3d_constant_80029354) }
  .text.w3d_empty_8002935c 0x8002935c : { *(.text.w3d_empty_8002935c) }
  .text.w3d_empty_80029360 0x80029360 : { *(.text.w3d_empty_80029360) }
  .text.w3d_address_800293f0 0x800293f0 : { *(.text.w3d_address_800293f0) }
  .text.w3d_registry_unlink_800293fc 0x800293fc : { *(.text.w3d_registry_unlink_800293fc) }
  .text.w3d_registry_create_80029440 0x80029440 : { *(.text.w3d_registry_create_80029440) }
  .text.w3d_registry_release_800294a0 0x800294a0 : { *(.text.w3d_registry_release_800294a0) }
  .text.w3d_registry_retain_800294fc 0x800294fc : { *(.text.w3d_registry_retain_800294fc) }
  .text.w3d_address_8002a2c4 0x8002a2c4 : { *(.text.w3d_address_8002a2c4) }
  .text.w3d_registry_unlink_8002a2d0 0x8002a2d0 : { *(.text.w3d_registry_unlink_8002a2d0) }
  .text.w3d_registry_create_8002a314 0x8002a314 : { *(.text.w3d_registry_create_8002a314) }
  .text.w3d_registry_release_8002a374 0x8002a374 : { *(.text.w3d_registry_release_8002a374) }
  .text.w3d_registry_retain_8002a3d0 0x8002a3d0 : { *(.text.w3d_registry_retain_8002a3d0) }
  .text.w3d_constant_8002a5ac 0x8002a5ac : { *(.text.w3d_constant_8002a5ac) }
  .text.w3d_empty_8002a688 0x8002a688 : { *(.text.w3d_empty_8002a688) }
  .text.w3d_address_8002a7f0 0x8002a7f0 : { *(.text.w3d_address_8002a7f0) }
  .text.w3d_registry_unlink_8002a7fc 0x8002a7fc : { *(.text.w3d_registry_unlink_8002a7fc) }
  .text.w3d_registry_create_8002a840 0x8002a840 : { *(.text.w3d_registry_create_8002a840) }
  .text.w3d_registry_release_8002a8a0 0x8002a8a0 : { *(.text.w3d_registry_release_8002a8a0) }
  .text.w3d_registry_retain_8002a8fc 0x8002a8fc : { *(.text.w3d_registry_retain_8002a8fc) }
  .text.w3d_constant_8002ab9c 0x8002ab9c : { *(.text.w3d_constant_8002ab9c) }
  .text.w3d_address_8002b230 0x8002b230 : { *(.text.w3d_address_8002b230) }
  .text.w3d_registry_unlink_8002b23c 0x8002b23c : { *(.text.w3d_registry_unlink_8002b23c) }
  .text.w3d_registry_create_8002b280 0x8002b280 : { *(.text.w3d_registry_create_8002b280) }
  .text.w3d_registry_release_8002b2e0 0x8002b2e0 : { *(.text.w3d_registry_release_8002b2e0) }
  .text.w3d_registry_retain_8002b33c 0x8002b33c : { *(.text.w3d_registry_retain_8002b33c) }
  .text.w3d_address_8002b704 0x8002b704 : { *(.text.w3d_address_8002b704) }
  .text.w3d_registry_unlink_8002b710 0x8002b710 : { *(.text.w3d_registry_unlink_8002b710) }
  .text.w3d_registry_create_8002b754 0x8002b754 : { *(.text.w3d_registry_create_8002b754) }
  .text.w3d_registry_release_8002b7b4 0x8002b7b4 : { *(.text.w3d_registry_release_8002b7b4) }
  .text.w3d_registry_retain_8002b810 0x8002b810 : { *(.text.w3d_registry_retain_8002b810) }
  .text.w3d_address_8002d728 0x8002d728 : { *(.text.w3d_address_8002d728) }
  .text.w3d_registry_unlink_8002d734 0x8002d734 : { *(.text.w3d_registry_unlink_8002d734) }
  .text.w3d_registry_retain_8002d8a4 0x8002d8a4 : { *(.text.w3d_registry_retain_8002d8a4) }
  .text.w3d_address_8002dc44 0x8002dc44 : { *(.text.w3d_address_8002dc44) }
  .text.w3d_registry_unlink_8002dc50 0x8002dc50 : { *(.text.w3d_registry_unlink_8002dc50) }
  .text.w3d_registry_create_8002dc94 0x8002dc94 : { *(.text.w3d_registry_create_8002dc94) }
  /DISCARD/ : { *(.text*) *(.rodata*) *(.data*) *(.bss*) *(.sdata*) *(.sbss*) *(.comment) }
}
