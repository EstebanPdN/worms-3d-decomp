/* Generated reference-only placements. All bodies are source-built. */
OUTPUT_FORMAT("elf32-powerpc")
OUTPUT_ARCH(powerpc)
ENTRY(w3d_k8b_tree_vector_dtor_801ac860)
_SDA_BASE_ = 0x804b2540;
_SDA2_BASE_ = 0x804c2540;
lbl_80414040 = 0x80414040;
lbl_80414088 = 0x80414088;
w3d_actor_member_delete_backend = 0x801fe1f8;
w3d_auto_801f2758 = 0x801f2758;
w3d_auto_80355800 = 0x80355800;
w3d_destroy_801e828c = 0x801e828c;
w3d_handle_storage_release = 0x802134fc;
SECTIONS {
  .text.w3d_k8b_tree_vector_dtor_801ac860 0x801ac860 : { *(.text.w3d_k8b_tree_vector_dtor_801ac860) }
  /DISCARD/ : { *(.text*) *(.rodata*) *(.data*) *(.bss*) *(.sdata*) *(.sbss*) *(.comment) }
}
