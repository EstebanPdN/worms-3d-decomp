/* Generated reference-only placements. All bodies are source-built. */
OUTPUT_FORMAT("elf32-powerpc")
OUTPUT_ARCH(powerpc)
ENTRY(w3d_registry_release_801cfb44)
_SDA_BASE_ = 0x804b2540;
_SDA2_BASE_ = 0x804c2540;
w3d_fn_801ca210 = 0x801ca210;
w3d_fn_801ca2d0 = 0x801ca2d0;
w3d_fn_801ca534 = 0x801ca534;
w3d_fn_801ca65c = 0x801ca65c;
w3d_fn_801cab04 = 0x801cab04;
w3d_fn_801cac04 = 0x801cac04;
w3d_fn_801cafe8 = 0x801cafe8;
w3d_fn_801cb0c8 = 0x801cb0c8;
w3d_fn_801cb3d8 = 0x801cb3d8;
w3d_fn_801cb464 = 0x801cb464;
w3d_fn_801cb54c = 0x801cb54c;
w3d_fn_801cb654 = 0x801cb654;
w3d_fn_801cb8f0 = 0x801cb8f0;
w3d_fn_801cb98c = 0x801cb98c;
w3d_fn_801cbab0 = 0x801cbab0;
w3d_fn_801cbb38 = 0x801cbb38;
w3d_fn_801cbc3c = 0x801cbc3c;
w3d_fn_801cbcc4 = 0x801cbcc4;
w3d_fn_801cbdc8 = 0x801cbdc8;
w3d_fn_801cbe50 = 0x801cbe50;
w3d_fn_801cbf54 = 0x801cbf54;
w3d_fn_801cbffc = 0x801cbffc;
w3d_fn_801cc160 = 0x801cc160;
w3d_fn_801cc1e8 = 0x801cc1e8;
w3d_fn_801cc2ec = 0x801cc2ec;
w3d_fn_801cc394 = 0x801cc394;
w3d_fn_801cc4c8 = 0x801cc4c8;
w3d_fn_801cc550 = 0x801cc550;
w3d_fn_801cc654 = 0x801cc654;
w3d_fn_801cc6dc = 0x801cc6dc;
w3d_fn_801cc7e0 = 0x801cc7e0;
w3d_fn_801cc868 = 0x801cc868;
w3d_fn_801cc96c = 0x801cc96c;
w3d_fn_801cc9f8 = 0x801cc9f8;
w3d_fn_801ccafc = 0x801ccafc;
w3d_fn_801ccb88 = 0x801ccb88;
w3d_fn_801ccc8c = 0x801ccc8c;
w3d_fn_801ccd1c = 0x801ccd1c;
w3d_fn_801cce30 = 0x801cce30;
w3d_fn_801ccee8 = 0x801ccee8;
w3d_fn_801cd078 = 0x801cd078;
w3d_fn_801cd138 = 0x801cd138;
w3d_fn_801cd2d0 = 0x801cd2d0;
w3d_fn_801cd360 = 0x801cd360;
w3d_fn_801cd474 = 0x801cd474;
w3d_fn_801cd504 = 0x801cd504;
w3d_fn_801cd618 = 0x801cd618;
w3d_fn_801cd750 = 0x801cd750;
w3d_fn_801cdb78 = 0x801cdb78;
w3d_fn_801cdc00 = 0x801cdc00;
w3d_fn_801cdd04 = 0x801cdd04;
w3d_fn_801cddbc = 0x801cddbc;
w3d_fn_801cdfa8 = 0x801cdfa8;
w3d_fn_801ce064 = 0x801ce064;
w3d_fn_801ce248 = 0x801ce248;
w3d_fn_801ce2c8 = 0x801ce2c8;
w3d_fn_801ce3b0 = 0x801ce3b0;
w3d_fn_801ce4a0 = 0x801ce4a0;
w3d_fn_801ce614 = 0x801ce614;
w3d_fn_801ce6b8 = 0x801ce6b8;
w3d_fn_801ce81c = 0x801ce81c;
w3d_fn_801ce89c = 0x801ce89c;
w3d_fn_801ce984 = 0x801ce984;
w3d_fn_801cea24 = 0x801cea24;
w3d_fn_801cebd8 = 0x801cebd8;
w3d_fn_801cec60 = 0x801cec60;
w3d_fn_801ced84 = 0x801ced84;
w3d_fn_801cee30 = 0x801cee30;
w3d_fn_801cef90 = 0x801cef90;
w3d_fn_801cf034 = 0x801cf034;
SECTIONS {
  .text.w3d_registry_release_801cfb44 0x801cfb44 : { *(.text.w3d_registry_release_801cfb44) }
  .text.w3d_registry_release_801cfba0 0x801cfba0 : { *(.text.w3d_registry_release_801cfba0) }
  .text.w3d_registry_release_801cfbfc 0x801cfbfc : { *(.text.w3d_registry_release_801cfbfc) }
  .text.w3d_registry_release_801cfc58 0x801cfc58 : { *(.text.w3d_registry_release_801cfc58) }
  .text.w3d_registry_release_801cfcb4 0x801cfcb4 : { *(.text.w3d_registry_release_801cfcb4) }
  .text.w3d_registry_release_801cfd10 0x801cfd10 : { *(.text.w3d_registry_release_801cfd10) }
  .text.w3d_registry_release_801cfd6c 0x801cfd6c : { *(.text.w3d_registry_release_801cfd6c) }
  .text.w3d_registry_release_801cfdc8 0x801cfdc8 : { *(.text.w3d_registry_release_801cfdc8) }
  .text.w3d_registry_release_801cfe24 0x801cfe24 : { *(.text.w3d_registry_release_801cfe24) }
  .text.w3d_registry_release_801cfe80 0x801cfe80 : { *(.text.w3d_registry_release_801cfe80) }
  .text.w3d_registry_release_801cfedc 0x801cfedc : { *(.text.w3d_registry_release_801cfedc) }
  .text.w3d_registry_release_801cff38 0x801cff38 : { *(.text.w3d_registry_release_801cff38) }
  .text.w3d_registry_release_801cff94 0x801cff94 : { *(.text.w3d_registry_release_801cff94) }
  .text.w3d_registry_release_801cfff0 0x801cfff0 : { *(.text.w3d_registry_release_801cfff0) }
  .text.w3d_registry_release_801d004c 0x801d004c : { *(.text.w3d_registry_release_801d004c) }
  .text.w3d_registry_release_801d00a8 0x801d00a8 : { *(.text.w3d_registry_release_801d00a8) }
  .text.w3d_registry_release_801d0104 0x801d0104 : { *(.text.w3d_registry_release_801d0104) }
  .text.w3d_registry_release_801d0160 0x801d0160 : { *(.text.w3d_registry_release_801d0160) }
  .text.w3d_registry_release_801d01bc 0x801d01bc : { *(.text.w3d_registry_release_801d01bc) }
  .text.w3d_registry_release_801d0218 0x801d0218 : { *(.text.w3d_registry_release_801d0218) }
  .text.w3d_registry_release_801d0274 0x801d0274 : { *(.text.w3d_registry_release_801d0274) }
  .text.w3d_registry_release_801d02d0 0x801d02d0 : { *(.text.w3d_registry_release_801d02d0) }
  .text.w3d_registry_release_801d032c 0x801d032c : { *(.text.w3d_registry_release_801d032c) }
  .text.w3d_registry_release_801d0388 0x801d0388 : { *(.text.w3d_registry_release_801d0388) }
  .text.w3d_registry_release_801d03e4 0x801d03e4 : { *(.text.w3d_registry_release_801d03e4) }
  .text.w3d_registry_release_801d0440 0x801d0440 : { *(.text.w3d_registry_release_801d0440) }
  .text.w3d_registry_release_801d049c 0x801d049c : { *(.text.w3d_registry_release_801d049c) }
  .text.w3d_registry_release_801d04f8 0x801d04f8 : { *(.text.w3d_registry_release_801d04f8) }
  .text.w3d_registry_release_801d0554 0x801d0554 : { *(.text.w3d_registry_release_801d0554) }
  .text.w3d_registry_release_801d05b0 0x801d05b0 : { *(.text.w3d_registry_release_801d05b0) }
  .text.w3d_registry_release_801d060c 0x801d060c : { *(.text.w3d_registry_release_801d060c) }
  .text.w3d_registry_release_801d0668 0x801d0668 : { *(.text.w3d_registry_release_801d0668) }
  .text.w3d_registry_release_801d06c4 0x801d06c4 : { *(.text.w3d_registry_release_801d06c4) }
  .text.w3d_registry_release_801d0720 0x801d0720 : { *(.text.w3d_registry_release_801d0720) }
  .text.w3d_registry_release_801d077c 0x801d077c : { *(.text.w3d_registry_release_801d077c) }
  .text.w3d_set_801d07d8 0x801d07d8 : { *(.text.w3d_set_801d07d8) }
  .text.w3d_get_801d07e0 0x801d07e0 : { *(.text.w3d_get_801d07e0) }
  .text.w3d_get_801d092c 0x801d092c : { *(.text.w3d_get_801d092c) }
  .text.w3d_get_801d0998 0x801d0998 : { *(.text.w3d_get_801d0998) }
  .text.w3d_get_801d0a04 0x801d0a04 : { *(.text.w3d_get_801d0a04) }
  .text.w3d_get_801d0a70 0x801d0a70 : { *(.text.w3d_get_801d0a70) }
  .text.w3d_get_801d0adc 0x801d0adc : { *(.text.w3d_get_801d0adc) }
  .text.w3d_get_801d0b48 0x801d0b48 : { *(.text.w3d_get_801d0b48) }
  .text.w3d_get_801d0bb4 0x801d0bb4 : { *(.text.w3d_get_801d0bb4) }
  .text.w3d_get_801d0c70 0x801d0c70 : { *(.text.w3d_get_801d0c70) }
  .text.w3d_get_801d0cdc 0x801d0cdc : { *(.text.w3d_get_801d0cdc) }
  .text.w3d_get_801d0d98 0x801d0d98 : { *(.text.w3d_get_801d0d98) }
  .text.w3d_get_801d0eb8 0x801d0eb8 : { *(.text.w3d_get_801d0eb8) }
  .text.w3d_get_801d0ed8 0x801d0ed8 : { *(.text.w3d_get_801d0ed8) }
  .text.w3d_get_801d0ef8 0x801d0ef8 : { *(.text.w3d_get_801d0ef8) }
  .text.w3d_get_801d0f18 0x801d0f18 : { *(.text.w3d_get_801d0f18) }
  .text.w3d_get_801d0f58 0x801d0f58 : { *(.text.w3d_get_801d0f58) }
  .text.w3d_get_801d0f78 0x801d0f78 : { *(.text.w3d_get_801d0f78) }
  .text.w3d_get_801d0fb8 0x801d0fb8 : { *(.text.w3d_get_801d0fb8) }
  .text.w3d_get_801d0fd8 0x801d0fd8 : { *(.text.w3d_get_801d0fd8) }
  .text.w3d_get_801d0ff8 0x801d0ff8 : { *(.text.w3d_get_801d0ff8) }
  .text.w3d_get_801d1018 0x801d1018 : { *(.text.w3d_get_801d1018) }
  .text.w3d_get_801d1038 0x801d1038 : { *(.text.w3d_get_801d1038) }
  .text.w3d_get_801d1058 0x801d1058 : { *(.text.w3d_get_801d1058) }
  .text.w3d_get_801d1078 0x801d1078 : { *(.text.w3d_get_801d1078) }
  .text.w3d_get_801d1098 0x801d1098 : { *(.text.w3d_get_801d1098) }
  .text.w3d_get_801d10b8 0x801d10b8 : { *(.text.w3d_get_801d10b8) }
  .text.w3d_get_801d10d8 0x801d10d8 : { *(.text.w3d_get_801d10d8) }
  .text.w3d_get_801d10f8 0x801d10f8 : { *(.text.w3d_get_801d10f8) }
  .text.w3d_get_801d1118 0x801d1118 : { *(.text.w3d_get_801d1118) }
  .text.w3d_get_801d1138 0x801d1138 : { *(.text.w3d_get_801d1138) }
  .text.w3d_get_801d1198 0x801d1198 : { *(.text.w3d_get_801d1198) }
  .text.w3d_get_801d11b8 0x801d11b8 : { *(.text.w3d_get_801d11b8) }
  .text.w3d_get_801d11d8 0x801d11d8 : { *(.text.w3d_get_801d11d8) }
  .text.w3d_get_801d1238 0x801d1238 : { *(.text.w3d_get_801d1238) }
  .text.w3d_get_801d1258 0x801d1258 : { *(.text.w3d_get_801d1258) }
  .text.w3d_get_801d1278 0x801d1278 : { *(.text.w3d_get_801d1278) }
  .text.w3d_get_801d1298 0x801d1298 : { *(.text.w3d_get_801d1298) }
  .text.w3d_get_801d12b8 0x801d12b8 : { *(.text.w3d_get_801d12b8) }
  .text.w3d_get_801d12d8 0x801d12d8 : { *(.text.w3d_get_801d12d8) }
  .text.w3d_get_801d1338 0x801d1338 : { *(.text.w3d_get_801d1338) }
  .text.w3d_get_801d1358 0x801d1358 : { *(.text.w3d_get_801d1358) }
  .text.w3d_get_801d1458 0x801d1458 : { *(.text.w3d_get_801d1458) }
  .text.w3d_get_801d1478 0x801d1478 : { *(.text.w3d_get_801d1478) }
  .text.w3d_set_801d14f0 0x801d14f0 : { *(.text.w3d_set_801d14f0) }
  /DISCARD/ : { *(.text*) *(.rodata*) *(.data*) *(.bss*) *(.sdata*) *(.sbss*) *(.comment) }
}
