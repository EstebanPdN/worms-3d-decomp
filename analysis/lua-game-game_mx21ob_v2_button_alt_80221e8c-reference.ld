/* Generated reference-only placements. All bodies are source-built. */
OUTPUT_FORMAT("elf32-powerpc")
OUTPUT_ARCH(powerpc)
ENTRY(__17Mx21obFeButtonAltUs)
_SDA_BASE_ = 0x804b2540;
_SDA2_BASE_ = 0x804c2540;
__14Mx21obFeWidgetUs = 0x8021ef08;
_vt.17Mx21obFeButtonAlt = 0x8041a4b0;
w3d_empty_string_804b06a0 = 0x804b06a0;
w3d_string_base_init = 0x8020c5c0;
w3d_string_from_text = 0x8020bb54;
w3d_string_header = 0x80341884;
w3d_text_fe_button_pattern_803b61f8 = 0x803b61f8;
SECTIONS {
  .text.__17Mx21obFeButtonAltUs 0x80221e8c : { *(.text.__17Mx21obFeButtonAltUs) }
  /DISCARD/ : { *(.text*) *(.rodata*) *(.data*) *(.bss*) *(.sdata*) *(.sbss*) *(.comment) }
}
