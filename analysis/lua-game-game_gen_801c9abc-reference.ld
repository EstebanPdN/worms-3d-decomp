/* Generated reference-only placements. All bodies are source-built. */
OUTPUT_FORMAT("elf32-powerpc")
OUTPUT_ARCH(powerpc)
ENTRY(w3d_address_801c9abc)
_SDA_BASE_ = 0x804b2540;
_SDA2_BASE_ = 0x804c2540;
w3d_fn_801c907c = 0x801c907c;
w3d_fn_801c9134 = 0x801c9134;
w3d_fn_801c92dc = 0x801c92dc;
w3d_fn_801c939c = 0x801c939c;
w3d_fn_801c9618 = 0x801c9618;
w3d_fn_801c96b8 = 0x801c96b8;
w3d_fn_801c9874 = 0x801c9874;
w3d_fn_801c9920 = 0x801c9920;
w3d_fn_801c9c04 = 0x801c9c04;
w3d_fn_801c9fb0 = 0x801c9fb0;
w3d_global_803647d4 = 0x803647d4;
w3d_global_80364824 = 0x80364824;
w3d_global_80364874 = 0x80364874;
w3d_global_803648c4 = 0x803648c4;
w3d_global_80364914 = 0x80364914;
w3d_global_80364964 = 0x80364964;
w3d_global_803649b4 = 0x803649b4;
w3d_global_80364a04 = 0x80364a04;
w3d_global_80364a54 = 0x80364a54;
w3d_global_80364aa4 = 0x80364aa4;
w3d_global_80364af4 = 0x80364af4;
w3d_global_80364b44 = 0x80364b44;
w3d_global_80364b94 = 0x80364b94;
w3d_global_80364be4 = 0x80364be4;
w3d_global_80364c34 = 0x80364c34;
w3d_global_80364c84 = 0x80364c84;
w3d_global_80364cd4 = 0x80364cd4;
w3d_global_80364d24 = 0x80364d24;
w3d_global_80364d74 = 0x80364d74;
w3d_global_80364dc4 = 0x80364dc4;
w3d_global_80364e14 = 0x80364e14;
w3d_global_80364e64 = 0x80364e64;
w3d_global_80364eb4 = 0x80364eb4;
w3d_global_80364f04 = 0x80364f04;
w3d_global_80364f54 = 0x80364f54;
w3d_global_80364fa4 = 0x80364fa4;
w3d_global_80364ff4 = 0x80364ff4;
w3d_global_80365044 = 0x80365044;
w3d_global_80365094 = 0x80365094;
w3d_global_803650e4 = 0x803650e4;
w3d_global_80365134 = 0x80365134;
w3d_global_80365184 = 0x80365184;
w3d_global_803651d4 = 0x803651d4;
w3d_global_80365224 = 0x80365224;
w3d_global_80365274 = 0x80365274;
w3d_global_803652c4 = 0x803652c4;
w3d_global_80365314 = 0x80365314;
w3d_owner_list_remove = 0x8020fd2c;
w3d_registry_list_803647d4 = 0x803647d4;
w3d_registry_list_80364824 = 0x80364824;
w3d_registry_list_80364874 = 0x80364874;
w3d_registry_list_803648c4 = 0x803648c4;
w3d_registry_list_80364914 = 0x80364914;
w3d_registry_list_80364964 = 0x80364964;
w3d_registry_list_803649b4 = 0x803649b4;
w3d_registry_list_80364a04 = 0x80364a04;
w3d_registry_list_80364a54 = 0x80364a54;
w3d_registry_list_80364aa4 = 0x80364aa4;
w3d_registry_list_80364af4 = 0x80364af4;
w3d_registry_list_80364b44 = 0x80364b44;
w3d_registry_list_80364b94 = 0x80364b94;
w3d_registry_list_80364be4 = 0x80364be4;
w3d_registry_list_80364c34 = 0x80364c34;
w3d_registry_list_80364c84 = 0x80364c84;
w3d_registry_list_80364cd4 = 0x80364cd4;
w3d_registry_list_80364d24 = 0x80364d24;
w3d_registry_list_80364d74 = 0x80364d74;
w3d_registry_list_80364dc4 = 0x80364dc4;
w3d_registry_list_80364e14 = 0x80364e14;
w3d_registry_list_80364e64 = 0x80364e64;
w3d_registry_list_80364eb4 = 0x80364eb4;
w3d_registry_list_80364f04 = 0x80364f04;
w3d_registry_list_80364f54 = 0x80364f54;
w3d_registry_list_80364fa4 = 0x80364fa4;
w3d_registry_list_80364ff4 = 0x80364ff4;
w3d_registry_list_80365044 = 0x80365044;
w3d_registry_list_80365094 = 0x80365094;
w3d_registry_list_803650e4 = 0x803650e4;
w3d_registry_list_80365134 = 0x80365134;
w3d_registry_list_80365184 = 0x80365184;
w3d_registry_list_803651d4 = 0x803651d4;
w3d_registry_list_80365224 = 0x80365224;
w3d_registry_list_80365274 = 0x80365274;
w3d_registry_list_803652c4 = 0x803652c4;
w3d_registry_list_80365314 = 0x80365314;
SECTIONS {
  .text.w3d_address_801c9abc 0x801c9abc : { *(.text.w3d_address_801c9abc) }
  .text.w3d_registry_unlink_801c9b30 0x801c9b30 : { *(.text.w3d_registry_unlink_801c9b30) }
  .text.w3d_address_801c9e74 0x801c9e74 : { *(.text.w3d_address_801c9e74) }
  .text.w3d_registry_unlink_801c9ee8 0x801c9ee8 : { *(.text.w3d_registry_unlink_801c9ee8) }
  .text.w3d_address_801ca19c 0x801ca19c : { *(.text.w3d_address_801ca19c) }
  .text.w3d_registry_unlink_801ca210 0x801ca210 : { *(.text.w3d_registry_unlink_801ca210) }
  .text.w3d_address_801ca4c0 0x801ca4c0 : { *(.text.w3d_address_801ca4c0) }
  .text.w3d_registry_unlink_801ca534 0x801ca534 : { *(.text.w3d_registry_unlink_801ca534) }
  .text.w3d_address_801caa90 0x801caa90 : { *(.text.w3d_address_801caa90) }
  .text.w3d_registry_unlink_801cab04 0x801cab04 : { *(.text.w3d_registry_unlink_801cab04) }
  .text.w3d_address_801caf74 0x801caf74 : { *(.text.w3d_address_801caf74) }
  .text.w3d_registry_unlink_801cafe8 0x801cafe8 : { *(.text.w3d_registry_unlink_801cafe8) }
  .text.w3d_address_801cb364 0x801cb364 : { *(.text.w3d_address_801cb364) }
  .text.w3d_registry_unlink_801cb3d8 0x801cb3d8 : { *(.text.w3d_registry_unlink_801cb3d8) }
  .text.w3d_address_801cb4d8 0x801cb4d8 : { *(.text.w3d_address_801cb4d8) }
  .text.w3d_registry_unlink_801cb54c 0x801cb54c : { *(.text.w3d_registry_unlink_801cb54c) }
  .text.w3d_address_801cb87c 0x801cb87c : { *(.text.w3d_address_801cb87c) }
  .text.w3d_registry_unlink_801cb8f0 0x801cb8f0 : { *(.text.w3d_registry_unlink_801cb8f0) }
  .text.w3d_address_801cba3c 0x801cba3c : { *(.text.w3d_address_801cba3c) }
  .text.w3d_registry_unlink_801cbab0 0x801cbab0 : { *(.text.w3d_registry_unlink_801cbab0) }
  .text.w3d_address_801cbbc8 0x801cbbc8 : { *(.text.w3d_address_801cbbc8) }
  .text.w3d_registry_unlink_801cbc3c 0x801cbc3c : { *(.text.w3d_registry_unlink_801cbc3c) }
  .text.w3d_address_801cbd54 0x801cbd54 : { *(.text.w3d_address_801cbd54) }
  .text.w3d_registry_unlink_801cbdc8 0x801cbdc8 : { *(.text.w3d_registry_unlink_801cbdc8) }
  .text.w3d_address_801cbee0 0x801cbee0 : { *(.text.w3d_address_801cbee0) }
  .text.w3d_registry_unlink_801cbf54 0x801cbf54 : { *(.text.w3d_registry_unlink_801cbf54) }
  .text.w3d_address_801cc0ec 0x801cc0ec : { *(.text.w3d_address_801cc0ec) }
  .text.w3d_registry_unlink_801cc160 0x801cc160 : { *(.text.w3d_registry_unlink_801cc160) }
  .text.w3d_address_801cc278 0x801cc278 : { *(.text.w3d_address_801cc278) }
  .text.w3d_registry_unlink_801cc2ec 0x801cc2ec : { *(.text.w3d_registry_unlink_801cc2ec) }
  .text.w3d_address_801cc454 0x801cc454 : { *(.text.w3d_address_801cc454) }
  .text.w3d_registry_unlink_801cc4c8 0x801cc4c8 : { *(.text.w3d_registry_unlink_801cc4c8) }
  .text.w3d_address_801cc5e0 0x801cc5e0 : { *(.text.w3d_address_801cc5e0) }
  .text.w3d_registry_unlink_801cc654 0x801cc654 : { *(.text.w3d_registry_unlink_801cc654) }
  .text.w3d_address_801cc76c 0x801cc76c : { *(.text.w3d_address_801cc76c) }
  .text.w3d_registry_unlink_801cc7e0 0x801cc7e0 : { *(.text.w3d_registry_unlink_801cc7e0) }
  .text.w3d_address_801cc8f8 0x801cc8f8 : { *(.text.w3d_address_801cc8f8) }
  .text.w3d_registry_unlink_801cc96c 0x801cc96c : { *(.text.w3d_registry_unlink_801cc96c) }
  .text.w3d_address_801cca88 0x801cca88 : { *(.text.w3d_address_801cca88) }
  .text.w3d_registry_unlink_801ccafc 0x801ccafc : { *(.text.w3d_registry_unlink_801ccafc) }
  .text.w3d_address_801ccc18 0x801ccc18 : { *(.text.w3d_address_801ccc18) }
  .text.w3d_registry_unlink_801ccc8c 0x801ccc8c : { *(.text.w3d_registry_unlink_801ccc8c) }
  .text.w3d_address_801ccdbc 0x801ccdbc : { *(.text.w3d_address_801ccdbc) }
  .text.w3d_registry_unlink_801cce30 0x801cce30 : { *(.text.w3d_registry_unlink_801cce30) }
  .text.w3d_address_801cd004 0x801cd004 : { *(.text.w3d_address_801cd004) }
  .text.w3d_registry_unlink_801cd078 0x801cd078 : { *(.text.w3d_registry_unlink_801cd078) }
  .text.w3d_address_801cd25c 0x801cd25c : { *(.text.w3d_address_801cd25c) }
  .text.w3d_registry_unlink_801cd2d0 0x801cd2d0 : { *(.text.w3d_registry_unlink_801cd2d0) }
  .text.w3d_address_801cd400 0x801cd400 : { *(.text.w3d_address_801cd400) }
  .text.w3d_registry_unlink_801cd474 0x801cd474 : { *(.text.w3d_registry_unlink_801cd474) }
  .text.w3d_address_801cd5a4 0x801cd5a4 : { *(.text.w3d_address_801cd5a4) }
  .text.w3d_registry_unlink_801cd618 0x801cd618 : { *(.text.w3d_registry_unlink_801cd618) }
  .text.w3d_address_801cdb04 0x801cdb04 : { *(.text.w3d_address_801cdb04) }
  .text.w3d_registry_unlink_801cdb78 0x801cdb78 : { *(.text.w3d_registry_unlink_801cdb78) }
  .text.w3d_address_801cdc90 0x801cdc90 : { *(.text.w3d_address_801cdc90) }
  .text.w3d_registry_unlink_801cdd04 0x801cdd04 : { *(.text.w3d_registry_unlink_801cdd04) }
  .text.w3d_address_801cdf34 0x801cdf34 : { *(.text.w3d_address_801cdf34) }
  .text.w3d_registry_unlink_801cdfa8 0x801cdfa8 : { *(.text.w3d_registry_unlink_801cdfa8) }
  .text.w3d_address_801ce1d4 0x801ce1d4 : { *(.text.w3d_address_801ce1d4) }
  .text.w3d_registry_unlink_801ce248 0x801ce248 : { *(.text.w3d_registry_unlink_801ce248) }
  .text.w3d_address_801ce33c 0x801ce33c : { *(.text.w3d_address_801ce33c) }
  .text.w3d_registry_unlink_801ce3b0 0x801ce3b0 : { *(.text.w3d_registry_unlink_801ce3b0) }
  .text.w3d_address_801ce5a0 0x801ce5a0 : { *(.text.w3d_address_801ce5a0) }
  .text.w3d_registry_unlink_801ce614 0x801ce614 : { *(.text.w3d_registry_unlink_801ce614) }
  .text.w3d_address_801ce7a8 0x801ce7a8 : { *(.text.w3d_address_801ce7a8) }
  .text.w3d_registry_unlink_801ce81c 0x801ce81c : { *(.text.w3d_registry_unlink_801ce81c) }
  .text.w3d_address_801ce910 0x801ce910 : { *(.text.w3d_address_801ce910) }
  .text.w3d_registry_unlink_801ce984 0x801ce984 : { *(.text.w3d_registry_unlink_801ce984) }
  .text.w3d_address_801ceb64 0x801ceb64 : { *(.text.w3d_address_801ceb64) }
  .text.w3d_registry_unlink_801cebd8 0x801cebd8 : { *(.text.w3d_registry_unlink_801cebd8) }
  .text.w3d_address_801ced10 0x801ced10 : { *(.text.w3d_address_801ced10) }
  .text.w3d_registry_unlink_801ced84 0x801ced84 : { *(.text.w3d_registry_unlink_801ced84) }
  .text.w3d_address_801cef1c 0x801cef1c : { *(.text.w3d_address_801cef1c) }
  .text.w3d_registry_unlink_801cef90 0x801cef90 : { *(.text.w3d_registry_unlink_801cef90) }
  .text.w3d_registry_release_801cf91c 0x801cf91c : { *(.text.w3d_registry_release_801cf91c) }
  .text.w3d_registry_release_801cf978 0x801cf978 : { *(.text.w3d_registry_release_801cf978) }
  .text.w3d_registry_release_801cf9d4 0x801cf9d4 : { *(.text.w3d_registry_release_801cf9d4) }
  .text.w3d_registry_release_801cfa30 0x801cfa30 : { *(.text.w3d_registry_release_801cfa30) }
  .text.w3d_registry_release_801cfa8c 0x801cfa8c : { *(.text.w3d_registry_release_801cfa8c) }
  .text.w3d_registry_release_801cfae8 0x801cfae8 : { *(.text.w3d_registry_release_801cfae8) }
  /DISCARD/ : { *(.text*) *(.rodata*) *(.data*) *(.bss*) *(.sdata*) *(.sbss*) *(.comment) }
}
