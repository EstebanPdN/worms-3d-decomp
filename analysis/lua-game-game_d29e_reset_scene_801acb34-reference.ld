/* Generated reference-only placements. All bodies are source-built. */
OUTPUT_FORMAT("elf32-powerpc")
OUTPUT_ARCH(powerpc)
ENTRY(w3d_d29e_reset_scene_801acb34)
_SDA_BASE_ = 0x804b2540;
_SDA2_BASE_ = 0x804c2540;
f4c_inverse_transpose_801acd6c = 0x801acd6c;
lbl_80413b28 = 0x80413b28;
lbl_8045e748 = 0x8045e748;
w3d_auto_801f2758 = 0x801f2758;
w3d_auto_80355800 = 0x80355800;
w3d_s10_service_forward_8020b680 = 0x8020b680;
SECTIONS {
  .text.w3d_d29e_reset_scene_801acb34 0x801acb34 : { *(.text.w3d_d29e_reset_scene_801acb34) }
  /DISCARD/ : { *(.text*) *(.rodata*) *(.data*) *(.bss*) *(.sdata*) *(.sbss*) *(.comment) }
}
