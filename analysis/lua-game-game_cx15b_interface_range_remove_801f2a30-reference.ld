/* Generated reference-only placements. All bodies are source-built. */
OUTPUT_FORMAT("elf32-powerpc")
OUTPUT_ARCH(powerpc)
ENTRY(w3d_cx15b_interface_range_remove_801f2a30)
_SDA_BASE_ = 0x804b2540;
_SDA2_BASE_ = 0x804c2540;
clear_802eefe0 = 0x802eefe0;
SECTIONS {
  .text.w3d_cx15b_interface_range_remove_801f2a30 0x801f2a30 : { *(.text.w3d_cx15b_interface_range_remove_801f2a30) }
  /DISCARD/ : { *(.text*) *(.rodata*) *(.data*) *(.bss*) *(.sdata*) *(.sbss*) *(.comment) }
}
