/* Generated reference-only placements. All bodies are source-built. */
OUTPUT_FORMAT("elf32-powerpc")
OUTPUT_ARCH(powerpc)
ENTRY(w3d_s21_forward_inner_8021bf14)
_SDA_BASE_ = 0x804b2540;
_SDA2_BASE_ = 0x804c2540;
fn_8021bffc = 0x8021bffc;
SECTIONS {
  .text.w3d_s21_forward_inner_8021bf14 0x8021bf14 : { *(.text.w3d_s21_forward_inner_8021bf14) }
  /DISCARD/ : { *(.text*) *(.rodata*) *(.data*) *(.bss*) *(.sdata*) *(.sbss*) *(.comment) }
}
