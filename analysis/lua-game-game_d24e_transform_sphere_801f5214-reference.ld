/* Generated reference-only placements. All bodies are source-built. */
OUTPUT_FORMAT("elf32-powerpc")
OUTPUT_ARCH(powerpc)
ENTRY(w3d_d24e_transform_sphere_801f5214)
_SDA_BASE_ = 0x804b2540;
_SDA2_BASE_ = 0x804c2540;
constant_803b159c = 0x803b159c;
fn_802e82c0 = 0x802e82c0;
SECTIONS {
  .text.w3d_d24e_transform_sphere_801f5214 0x801f5214 : { *(.text.w3d_d24e_transform_sphere_801f5214) }
  /DISCARD/ : { *(.text*) *(.rodata*) *(.data*) *(.bss*) *(.sdata*) *(.sbss*) *(.comment) }
}
