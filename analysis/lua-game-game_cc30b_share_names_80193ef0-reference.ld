/* Generated reference-only placements. All bodies are source-built. */
OUTPUT_FORMAT("elf32-powerpc")
OUTPUT_ARCH(powerpc)
ENTRY(w3d_cc30b_share_names_80193ef0)
_SDA_BASE_ = 0x804b2540;
_SDA2_BASE_ = 0x804c2540;
__21cc30b_String_803426b8 = 0x803426b8;
fn_8020bb2c = 0x8020bb2c;
fn_8020c5c4 = 0x8020c5c4;
fn_802ef234 = 0x802ef234;
fn_80341588 = 0x80341588;
SECTIONS {
  .text.w3d_cc30b_share_names_80193ef0 0x80193ef0 : { *(.text.w3d_cc30b_share_names_80193ef0) }
  /DISCARD/ : { *(.text*) *(.rodata*) *(.data*) *(.bss*) *(.sdata*) *(.sbss*) *(.comment) }
}
