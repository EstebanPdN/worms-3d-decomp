/* Generated reference-only placements. All bodies are source-built. */
OUTPUT_FORMAT("elf32-powerpc")
OUTPUT_ARCH(powerpc)
ENTRY(s19_probe_value_8001b8f0)
_SDA_BASE_ = 0x804b2540;
_SDA2_BASE_ = 0x804c2540;
FUN_8001b830 = 0x8001b830;
FUN_80118aac = 0x80118aac;
lbl_8041e780 = 0x8041e780;
w3d_auto_80118268 = 0x80118268;
SECTIONS {
  .text.s19_probe_value_8001b8f0 0x8001b8f0 : { *(.text.s19_probe_value_8001b8f0) }
  /DISCARD/ : { *(.text*) *(.rodata*) *(.data*) *(.bss*) *(.sdata*) *(.sbss*) *(.comment) }
}
