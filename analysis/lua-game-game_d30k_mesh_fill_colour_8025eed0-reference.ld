/* Generated reference-only placements. All bodies are source-built. */
OUTPUT_FORMAT("elf32-powerpc")
OUTPUT_ARCH(powerpc)
ENTRY(w3d_d30k_mesh_fill_colour_8025eed0)
_SDA_BASE_ = 0x804b2540;
_SDA2_BASE_ = 0x804c2540;
fn_801750d4 = 0x801750d4;
fn_801ef048 = 0x801ef048;
SECTIONS {
  .text.w3d_d30k_mesh_fill_colour_8025eed0 0x8025eed0 : { *(.text.w3d_d30k_mesh_fill_colour_8025eed0) }
  /DISCARD/ : { *(.text*) *(.rodata*) *(.data*) *(.bss*) *(.sdata*) *(.sbss*) *(.comment) }
}
