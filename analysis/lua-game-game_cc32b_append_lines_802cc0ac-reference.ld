/* Generated reference-only placements. All bodies are source-built. */
OUTPUT_FORMAT("elf32-powerpc")
OUTPUT_ARCH(powerpc)
ENTRY(w3d_cc32b_append_lines_802cc0ac)
_SDA_BASE_ = 0x804b2540;
_SDA2_BASE_ = 0x804c2540;
__24Cc32bLineString_802cc0ac = 0x803426b8;
fn_8020bdf4 = 0x8020bdf4;
fn_8020bf2c = 0x8020bf2c;
fn_8020c5c0 = 0x8020c5c0;
fn_8020c5c4 = 0x8020c5c4;
fn_802ef198 = 0x802ef198;
fn_80341588 = 0x80341588;
fn_80341884 = 0x80341884;
lbl_803d9448 = 0x803d9448;
lbl_80403f54 = 0x80403f54;
SECTIONS {
  .text.w3d_cc32b_append_lines_802cc0ac 0x802cc0ac : { *(.text.w3d_cc32b_append_lines_802cc0ac) }
  /DISCARD/ : { *(.text*) *(.rodata*) *(.data*) *(.bss*) *(.sdata*) *(.sbss*) *(.comment) }
}
