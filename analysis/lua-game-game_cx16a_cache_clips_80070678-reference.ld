/* Generated reference-only placements. All bodies are source-built. */
OUTPUT_FORMAT("elf32-powerpc")
OUTPUT_ARCH(powerpc)
ENTRY(w3d_cx16a_cache_clips_80070678)
_SDA_BASE_ = 0x804b2540;
_SDA2_BASE_ = 0x804c2540;
cast_80341584 = 0x80341584;
find_80181598 = 0x80181598;
length_80181d30 = 0x80181d30;
parameters_801797b4 = 0x801797b4;
zero_8037ca04 = 0x8037ca04;
SECTIONS {
  .text.w3d_cx16a_cache_clips_80070678 0x80070678 : { *(.text.w3d_cx16a_cache_clips_80070678) }
  /DISCARD/ : { *(.text*) *(.rodata*) *(.data*) *(.bss*) *(.sdata*) *(.sbss*) *(.comment) }
}
