/* Generated reference-only placements. All bodies are source-built. */
OUTPUT_FORMAT("elf32-powerpc")
OUTPUT_ARCH(powerpc)
ENTRY(w3d_cx12b_movie_frame_read_async_802e128c)
_SDA_BASE_ = 0x804b2540;
_SDA2_BASE_ = 0x804c2540;
done_802e1360 = 0x802e1360;
read_802f5568 = 0x802f5568;
SECTIONS {
  .text.w3d_cx12b_movie_frame_read_async_802e128c 0x802e128c : { *(.text.w3d_cx12b_movie_frame_read_async_802e128c) }
  /DISCARD/ : { *(.text*) *(.rodata*) *(.data*) *(.bss*) *(.sdata*) *(.sbss*) *(.comment) }
}
