/* Generated reference-only placements. All bodies are source-built. */
OUTPUT_FORMAT("elf32-powerpc")
OUTPUT_ARCH(powerpc)
ENTRY(sol35e2_choose_string_8027befc)
_SDA_BASE_ = 0x804b2540;
_SDA2_BASE_ = 0x804c2540;
__22Sol35e2String_8020bb54PCc = 0x8020bb54;
sol35e2_failed_803cea20 = 0x803cea20;
sol35e2_release_header_8020bb2c = 0x8020bb2c;
sol35e2_string_finish_8020c5c4 = 0x8020c5c4;
sol35e2_string_header_80341884 = 0x80341884;
sol35e2_string_init_8020c5c0 = 0x8020c5c0;
sol35e2_string_release_80341588 = 0x80341588;
SECTIONS {
  .text.sol35e2_choose_string_8027befc 0x8027befc : { *(.text.sol35e2_choose_string_8027befc) }
  /DISCARD/ : { *(.text*) *(.rodata*) *(.data*) *(.bss*) *(.sdata*) *(.sbss*) *(.comment) }
}
