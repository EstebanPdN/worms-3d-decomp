/* Generated reference-only placements. All bodies are source-built. */
OUTPUT_FORMAT("elf32-powerpc")
OUTPUT_ARCH(powerpc)
ENTRY(w3d_cc18a_palette_cursor_sinit_801190d8)
_SDA_BASE_ = 0x804b2540;
_SDA2_BASE_ = 0x804c2540;
lbl_8044d254 = 0x8044d254;
SECTIONS {
  .text.w3d_cc18a_palette_cursor_sinit_801190d8 0x801190d8 : { *(.text.w3d_cc18a_palette_cursor_sinit_801190d8) }
  /DISCARD/ : { *(.text*) *(.rodata*) *(.data*) *(.bss*) *(.sdata*) *(.sbss*) *(.comment) }
}
