/* Generated reference-only placements. All bodies are source-built. */
OUTPUT_FORMAT("elf32-powerpc")
OUTPUT_ARCH(powerpc)
ENTRY(w3d_getf_8024ad18)
_SDA_BASE_ = 0x804b2540;
_SDA2_BASE_ = 0x804c2540;
SECTIONS {
  .text.w3d_getf_8024ad18 0x8024ad18 : { *(.text.w3d_getf_8024ad18) }
  .text.w3d_setf_8024ad20 0x8024ad20 : { *(.text.w3d_setf_8024ad20) }
  .text.w3d_getf_8024ad28 0x8024ad28 : { *(.text.w3d_getf_8024ad28) }
  .text.w3d_setf_8024ad30 0x8024ad30 : { *(.text.w3d_setf_8024ad30) }
  .text.w3d_getf_8024ad38 0x8024ad38 : { *(.text.w3d_getf_8024ad38) }
  .text.w3d_setf_8024ad40 0x8024ad40 : { *(.text.w3d_setf_8024ad40) }
  .text.w3d_getf_8024ad48 0x8024ad48 : { *(.text.w3d_getf_8024ad48) }
  .text.w3d_setf_8024ad50 0x8024ad50 : { *(.text.w3d_setf_8024ad50) }
  .text.w3d_getf_8024ad58 0x8024ad58 : { *(.text.w3d_getf_8024ad58) }
  .text.w3d_setf_8024ad60 0x8024ad60 : { *(.text.w3d_setf_8024ad60) }
  .text.w3d_getf_8024ad68 0x8024ad68 : { *(.text.w3d_getf_8024ad68) }
  .text.w3d_setf_8024ad70 0x8024ad70 : { *(.text.w3d_setf_8024ad70) }
  .text.w3d_getf_8024ad78 0x8024ad78 : { *(.text.w3d_getf_8024ad78) }
  .text.w3d_setf_8024ad80 0x8024ad80 : { *(.text.w3d_setf_8024ad80) }
  .text.w3d_getf_8024ad88 0x8024ad88 : { *(.text.w3d_getf_8024ad88) }
  .text.w3d_setf_8024ad90 0x8024ad90 : { *(.text.w3d_setf_8024ad90) }
  .text.w3d_getf_8024ad98 0x8024ad98 : { *(.text.w3d_getf_8024ad98) }
  .text.w3d_setf_8024ada0 0x8024ada0 : { *(.text.w3d_setf_8024ada0) }
  .text.w3d_getf_8024ada8 0x8024ada8 : { *(.text.w3d_getf_8024ada8) }
  .text.w3d_setf_8024adb0 0x8024adb0 : { *(.text.w3d_setf_8024adb0) }
  .text.w3d_getf_8024adb8 0x8024adb8 : { *(.text.w3d_getf_8024adb8) }
  .text.w3d_setf_8024adc0 0x8024adc0 : { *(.text.w3d_setf_8024adc0) }
  .text.w3d_getf_8024adc8 0x8024adc8 : { *(.text.w3d_getf_8024adc8) }
  .text.w3d_setf_8024add0 0x8024add0 : { *(.text.w3d_setf_8024add0) }
  .text.w3d_getf_8024add8 0x8024add8 : { *(.text.w3d_getf_8024add8) }
  .text.w3d_setf_8024ade0 0x8024ade0 : { *(.text.w3d_setf_8024ade0) }
  .text.w3d_getf_8024ade8 0x8024ade8 : { *(.text.w3d_getf_8024ade8) }
  .text.w3d_setf_8024adf0 0x8024adf0 : { *(.text.w3d_setf_8024adf0) }
  .text.w3d_getf_8024adf8 0x8024adf8 : { *(.text.w3d_getf_8024adf8) }
  .text.w3d_setf_8024ae00 0x8024ae00 : { *(.text.w3d_setf_8024ae00) }
  .text.w3d_getf_8024ae08 0x8024ae08 : { *(.text.w3d_getf_8024ae08) }
  .text.w3d_setf_8024ae10 0x8024ae10 : { *(.text.w3d_setf_8024ae10) }
  .text.w3d_getf_8024ae18 0x8024ae18 : { *(.text.w3d_getf_8024ae18) }
  .text.w3d_setf_8024ae20 0x8024ae20 : { *(.text.w3d_setf_8024ae20) }
  .text.w3d_getf_8024ae28 0x8024ae28 : { *(.text.w3d_getf_8024ae28) }
  .text.w3d_setf_8024ae30 0x8024ae30 : { *(.text.w3d_setf_8024ae30) }
  .text.w3d_getf_8024ae38 0x8024ae38 : { *(.text.w3d_getf_8024ae38) }
  .text.w3d_setf_8024ae40 0x8024ae40 : { *(.text.w3d_setf_8024ae40) }
  .text.w3d_getf_8024ae48 0x8024ae48 : { *(.text.w3d_getf_8024ae48) }
  .text.w3d_setf_8024ae50 0x8024ae50 : { *(.text.w3d_setf_8024ae50) }
  .text.w3d_getf_8024ae58 0x8024ae58 : { *(.text.w3d_getf_8024ae58) }
  .text.w3d_setf_8024ae60 0x8024ae60 : { *(.text.w3d_setf_8024ae60) }
  .text.w3d_getf_8024ae68 0x8024ae68 : { *(.text.w3d_getf_8024ae68) }
  .text.w3d_setf_8024ae70 0x8024ae70 : { *(.text.w3d_setf_8024ae70) }
  .text.w3d_getf_8024ae78 0x8024ae78 : { *(.text.w3d_getf_8024ae78) }
  .text.w3d_setf_8024ae80 0x8024ae80 : { *(.text.w3d_setf_8024ae80) }
  .text.w3d_getf_8024ae88 0x8024ae88 : { *(.text.w3d_getf_8024ae88) }
  .text.w3d_setf_8024ae90 0x8024ae90 : { *(.text.w3d_setf_8024ae90) }
  .text.w3d_getf_8024ae98 0x8024ae98 : { *(.text.w3d_getf_8024ae98) }
  .text.w3d_setf_8024aea0 0x8024aea0 : { *(.text.w3d_setf_8024aea0) }
  .text.w3d_getf_8024aea8 0x8024aea8 : { *(.text.w3d_getf_8024aea8) }
  .text.w3d_setf_8024aeb0 0x8024aeb0 : { *(.text.w3d_setf_8024aeb0) }
  .text.w3d_getf_8024aeb8 0x8024aeb8 : { *(.text.w3d_getf_8024aeb8) }
  .text.w3d_setf_8024aec0 0x8024aec0 : { *(.text.w3d_setf_8024aec0) }
  .text.w3d_getf_8024aec8 0x8024aec8 : { *(.text.w3d_getf_8024aec8) }
  .text.w3d_setf_8024aed0 0x8024aed0 : { *(.text.w3d_setf_8024aed0) }
  .text.w3d_getf_8024aed8 0x8024aed8 : { *(.text.w3d_getf_8024aed8) }
  .text.w3d_setf_8024aee0 0x8024aee0 : { *(.text.w3d_setf_8024aee0) }
  .text.w3d_getf_8024aee8 0x8024aee8 : { *(.text.w3d_getf_8024aee8) }
  .text.w3d_setf_8024aef0 0x8024aef0 : { *(.text.w3d_setf_8024aef0) }
  .text.w3d_getf_8024aef8 0x8024aef8 : { *(.text.w3d_getf_8024aef8) }
  .text.w3d_member_8024af0c 0x8024af0c : { *(.text.w3d_member_8024af0c) }
  .text.w3d_setf_8024af34 0x8024af34 : { *(.text.w3d_setf_8024af34) }
  .text.w3d_getf_8024af3c 0x8024af3c : { *(.text.w3d_getf_8024af3c) }
  .text.w3d_setf_8024af44 0x8024af44 : { *(.text.w3d_setf_8024af44) }
  .text.w3d_getf_8024af4c 0x8024af4c : { *(.text.w3d_getf_8024af4c) }
  .text.w3d_setf_8024af54 0x8024af54 : { *(.text.w3d_setf_8024af54) }
  .text.w3d_getf_8024af5c 0x8024af5c : { *(.text.w3d_getf_8024af5c) }
  .text.w3d_setf_8024af64 0x8024af64 : { *(.text.w3d_setf_8024af64) }
  .text.w3d_getf_8024af6c 0x8024af6c : { *(.text.w3d_getf_8024af6c) }
  .text.w3d_setf_8024af74 0x8024af74 : { *(.text.w3d_setf_8024af74) }
  .text.w3d_getf_8024af7c 0x8024af7c : { *(.text.w3d_getf_8024af7c) }
  .text.w3d_setf_8024af84 0x8024af84 : { *(.text.w3d_setf_8024af84) }
  .text.w3d_getf_8024af8c 0x8024af8c : { *(.text.w3d_getf_8024af8c) }
  .text.w3d_setf_8024af94 0x8024af94 : { *(.text.w3d_setf_8024af94) }
  .text.w3d_getf_8024af9c 0x8024af9c : { *(.text.w3d_getf_8024af9c) }
  .text.w3d_member_8024b170 0x8024b170 : { *(.text.w3d_member_8024b170) }
  .text.w3d_member_8024b184 0x8024b184 : { *(.text.w3d_member_8024b184) }
  .text.w3d_member_8024b198 0x8024b198 : { *(.text.w3d_member_8024b198) }
  .text.w3d_member_8024b1ac 0x8024b1ac : { *(.text.w3d_member_8024b1ac) }
  /DISCARD/ : { *(.text*) *(.rodata*) *(.data*) *(.bss*) *(.sdata*) *(.sbss*) *(.comment) }
}
