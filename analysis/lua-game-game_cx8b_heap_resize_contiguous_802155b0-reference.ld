/* Generated reference-only placements. All bodies are source-built. */
OUTPUT_FORMAT("elf32-powerpc")
OUTPUT_ARCH(powerpc)
ENTRY(w3d_cx8b_heap_resize_contiguous_802155b0)
_SDA_BASE_ = 0x804b2540;
_SDA2_BASE_ = 0x804c2540;
fn_801fdfc8 = 0x801fdfc8;
SECTIONS {
  .text.w3d_cx8b_heap_resize_contiguous_802155b0 0x802155b0 : { *(.text.w3d_cx8b_heap_resize_contiguous_802155b0) }
  /DISCARD/ : { *(.text*) *(.rodata*) *(.data*) *(.bss*) *(.sdata*) *(.sbss*) *(.comment) }
}
