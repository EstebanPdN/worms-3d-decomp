/* Generated reference-only placements. All bodies are source-built. */
OUTPUT_FORMAT("elf32-powerpc")
OUTPUT_ARCH(powerpc)
ENTRY(w3d_k5b_iface_array_field_set_801ef2ec)
_SDA_BASE_ = 0x804b2540;
_SDA2_BASE_ = 0x804c2540;
w3d_k5b_array_ref_lock_801ef048 = 0x801ef048;
SECTIONS {
  .text.w3d_k5b_iface_array_field_set_801ef2ec 0x801ef2ec : { *(.text.w3d_k5b_iface_array_field_set_801ef2ec) }
  /DISCARD/ : { *(.text*) *(.rodata*) *(.data*) *(.bss*) *(.sdata*) *(.sbss*) *(.comment) }
}
