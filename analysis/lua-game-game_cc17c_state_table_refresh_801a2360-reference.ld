/* Generated reference-only placements. All bodies are source-built. */
OUTPUT_FORMAT("elf32-powerpc")
OUTPUT_ARCH(powerpc)
ENTRY(w3d_cc17c_state_table_refresh_801a2360)
_SDA_BASE_ = 0x804b2540;
_SDA2_BASE_ = 0x804c2540;
lbl_8045ce40 = 0x8045ce40;
SECTIONS {
  .text.w3d_cc17c_state_table_refresh_801a2360 0x801a2360 : { *(.text.w3d_cc17c_state_table_refresh_801a2360) }
  /DISCARD/ : { *(.text*) *(.rodata*) *(.data*) *(.bss*) *(.sdata*) *(.sbss*) *(.comment) }
}
