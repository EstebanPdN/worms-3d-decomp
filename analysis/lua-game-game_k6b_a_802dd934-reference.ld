/* Generated reference-only placements. All bodies are source-built. */
OUTPUT_FORMAT("elf32-powerpc")
OUTPUT_ARCH(powerpc)
ENTRY(w3d_k6b_lua_getF_802dd934)
_SDA_BASE_ = 0x804b2540;
_SDA2_BASE_ = 0x804c2540;
fread = 0x802eb624;
SECTIONS {
  .text.w3d_k6b_lua_getF_802dd934 0x802dd934 : { *(.text.w3d_k6b_lua_getF_802dd934) }
  /DISCARD/ : { *(.text*) *(.rodata*) *(.data*) *(.bss*) *(.sdata*) *(.sbss*) *(.comment) }
}
