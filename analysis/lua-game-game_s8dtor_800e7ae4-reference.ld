/* Generated reference-only placements. All bodies are source-built. */
OUTPUT_FORMAT("elf32-powerpc")
OUTPUT_ARCH(powerpc)
ENTRY(s8_destroy_800e7ae4)
_SDA_BASE_ = 0x804b2540;
_SDA2_BASE_ = 0x804c2540;
fn_801628ec = 0x801628ec;
w3d_vtable_80410170 = 0x80410170;
SECTIONS {
  .text.s8_destroy_800e7ae4 0x800e7ae4 : { *(.text.s8_destroy_800e7ae4) }
  /DISCARD/ : { *(.text*) *(.rodata*) *(.data*) *(.bss*) *(.sdata*) *(.sbss*) *(.comment) }
}
