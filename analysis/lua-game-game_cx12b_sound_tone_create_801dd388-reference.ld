/* Generated reference-only placements. All bodies are source-built. */
OUTPUT_FORMAT("elf32-powerpc")
OUTPUT_ARCH(powerpc)
ENTRY(w3d_cx12b_sound_tone_create_801dd388)
_SDA_BASE_ = 0x804b2540;
_SDA2_BASE_ = 0x804c2540;
append_801ddf5c = 0x801ddf5c;
create_8020fcb4 = 0x8020fcb4;
default_803b01c0 = 0x803b01c0;
descriptor_8036564c = 0x8036564c;
set_801df1dc = 0x801df1dc;
set_801df1e4 = 0x801df1e4;
set_801df1f0 = 0x801df1f0;
set_801df1fc = 0x801df1fc;
set_801df204 = 0x801df204;
set_801df20c = 0x801df20c;
set_801df234 = 0x801df234;
set_801df280 = 0x801df280;
SECTIONS {
  .text.w3d_cx12b_sound_tone_create_801dd388 0x801dd388 : { *(.text.w3d_cx12b_sound_tone_create_801dd388) }
  /DISCARD/ : { *(.text*) *(.rodata*) *(.data*) *(.bss*) *(.sdata*) *(.sbss*) *(.comment) }
}
