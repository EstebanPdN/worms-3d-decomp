/* Generated reference-only placements. All bodies are source-built. */
OUTPUT_FORMAT("elf32-powerpc")
OUTPUT_ARCH(powerpc)
ENTRY(w3d_cx11b_record_interface_assign_8021a2ac)
_SDA_BASE_ = 0x804b2540;
_SDA2_BASE_ = 0x804c2540;
acquire_802078b4 = 0x802078b4;
SECTIONS {
  .text.w3d_cx11b_record_interface_assign_8021a2ac 0x8021a2ac : { *(.text.w3d_cx11b_record_interface_assign_8021a2ac) }
  /DISCARD/ : { *(.text*) *(.rodata*) *(.data*) *(.bss*) *(.sdata*) *(.sbss*) *(.comment) }
}
