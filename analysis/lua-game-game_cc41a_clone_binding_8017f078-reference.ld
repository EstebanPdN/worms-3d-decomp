/* Generated reference-only placements. All bodies are source-built. */
OUTPUT_FORMAT("elf32-powerpc")
OUTPUT_ARCH(powerpc)
ENTRY(cc41a_clone_binding_8017f078)
_SDA_BASE_ = 0x804b2540;
_SDA2_BASE_ = 0x804c2540;
cc41a_identity_80341348 = 0x80341348;
cc41a_queryKey_8040e078 = 0x8040e078;
cc41a_scene_8017fb8c = 0x8017fb8c;
SECTIONS {
  .text.cc41a_clone_binding_8017f078 0x8017f078 : { *(.text.cc41a_clone_binding_8017f078) }
  /DISCARD/ : { *(.text*) *(.rodata*) *(.data*) *(.bss*) *(.sdata*) *(.sbss*) *(.comment) }
}
