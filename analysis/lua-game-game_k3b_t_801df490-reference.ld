/* Generated reference-only placements. All bodies are source-built. */
OUTPUT_FORMAT("elf32-powerpc")
OUTPUT_ARCH(powerpc)
ENTRY(w3d_k3b_tagged_construct_801df490)
_SDA_BASE_ = 0x804b2540;
_SDA2_BASE_ = 0x804c2540;
w3d_vtable_80416c48 = 0x80416c48;
w3d_vtable_80416c80 = 0x80416c80;
SECTIONS {
  .text.w3d_k3b_tagged_construct_801df490 0x801df490 : { *(.text.w3d_k3b_tagged_construct_801df490) }
  /DISCARD/ : { *(.text*) *(.rodata*) *(.data*) *(.bss*) *(.sdata*) *(.sbss*) *(.comment) }
}
