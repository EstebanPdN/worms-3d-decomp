/* Generated reference-only placements. All bodies are source-built. */
OUTPUT_FORMAT("elf32-powerpc")
OUTPUT_ARCH(powerpc)
ENTRY(d29f_fade_state_machine_8028d004)
_SDA_BASE_ = 0x804b2540;
_SDA2_BASE_ = 0x804c2540;
fn_8028d34c = 0x8028d34c;
fn_8028d3b8 = 0x8028d3b8;
fn_802b0668 = 0x802b0668;
lbl_803cff38 = 0x803cff38;
lbl_803cff3c = 0x803cff3c;
w3d_engine_get_context = 0x80165254;
SECTIONS {
  .text.d29f_fade_state_machine_8028d004 0x8028d004 : { *(.text.d29f_fade_state_machine_8028d004) }
  /DISCARD/ : { *(.text*) *(.rodata*) *(.data*) *(.bss*) *(.sdata*) *(.sbss*) *(.comment) }
}
