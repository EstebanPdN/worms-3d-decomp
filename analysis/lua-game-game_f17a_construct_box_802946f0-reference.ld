/* Generated reference-only placements. All bodies are source-built. */
OUTPUT_FORMAT("elf32-powerpc")
OUTPUT_ARCH(powerpc)
ENTRY(__7F17aBox)
_SDA_BASE_ = 0x804b2540;
_SDA2_BASE_ = 0x804c2540;
__20F17aBoxBase_8015fef0 = 0x8015fef0;
__20F17aBoxText_803426b8 = 0x803426b8;
scalar_803d0768 = 0x803d0768;
scalar_803d076c = 0x803d076c;
scalar_803d0770 = 0x803d0770;
scalar_803d0774 = 0x803d0774;
table_8041c230 = 0x8041c230;
vec_8045e788 = 0x8045e788;
SECTIONS {
  .text.__7F17aBox 0x802946f0 : { *(.text.__7F17aBox) }
  /DISCARD/ : { *(.text*) *(.rodata*) *(.data*) *(.bss*) *(.sdata*) *(.sbss*) *(.comment) }
}
