/* Generated reference-only placements. All bodies are source-built. */
OUTPUT_FORMAT("elf32-powerpc")
OUTPUT_ARCH(powerpc)
ENTRY(d30s_member_list_clear_80210660)
_SDA_BASE_ = 0x804b2540;
_SDA2_BASE_ = 0x804c2540;
_M_erase__Q24_STLt8_Rb_tree5ZUiZUiZQ24_STLt9_Identity1ZUiZQ24_STLt4less1ZUiZQ24_STLt9allocator1ZUiPQ24_STLt13_Rb_tree_node1ZUi = 0x80351ea0;
_M_increment__Q24_STLt10_Rb_global1ZbPQ24_STL18_Rb_tree_node_base = 0x80351ef8;
_Rebalance_for_erase__Q24_STLt10_Rb_global1ZbPQ24_STL18_Rb_tree_node_baseRPQ24_STL18_Rb_tree_node_baseN22 = 0x80352010;
free = 0x802134fc;
w3d_actor_member_delete_backend = 0x801fe1f8;
SECTIONS {
  .text.d30s_member_list_clear_80210660 0x80210660 : { *(.text.d30s_member_list_clear_80210660) }
  /DISCARD/ : { *(.text*) *(.rodata*) *(.data*) *(.bss*) *(.sdata*) *(.sbss*) *(.comment) }
}
