/* Generated reference-only placements. All bodies are source-built. */
OUTPUT_FORMAT("elf32-powerpc")
OUTPUT_ARCH(powerpc)
ENTRY(tsonnet_c29_slot_mark_801e59b4)
_SDA_BASE_ = 0x804b2540;
_SDA2_BASE_ = 0x804c2540;
fn_802f5320 = 0x802f5320;
lbl_8045dbc8 = 0x8045dbc8;
SECTIONS {
  .text.tsonnet_c29_slot_mark_801e59b4 0x801e59b4 : { *(.text.tsonnet_c29_slot_mark_801e59b4) }
  .text.tsonnet_c29_slots_release_801e5e74 0x801e5e74 : { *(.text.tsonnet_c29_slots_release_801e5e74) }
  /DISCARD/ : { *(.text*) *(.rodata*) *(.data*) *(.bss*) *(.sdata*) *(.sbss*) *(.comment) }
}
