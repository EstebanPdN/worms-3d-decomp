/* Generated reference-only placements. All bodies are source-built. */
OUTPUT_FORMAT("elf32-powerpc")
OUTPUT_ARCH(powerpc)
ENTRY(w3d_s20_construct_header_8016f2d8)
_SDA_BASE_ = 0x804b2540;
_SDA2_BASE_ = 0x804c2540;
lbl_80411ef8 = 0x80411ef8;
lbl_80411f40 = 0x80411f40;
lbl_80413830 = 0x80413830;
lbl_80413858 = 0x80413858;
SECTIONS {
  .text.w3d_s20_construct_header_8016f2d8 0x8016f2d8 : { *(.text.w3d_s20_construct_header_8016f2d8) }
  .text.w3d_s20_construct_header_8019e5b0 0x8019e5b0 : { *(.text.w3d_s20_construct_header_8019e5b0) }
  /DISCARD/ : { *(.text*) *(.rodata*) *(.data*) *(.bss*) *(.sdata*) *(.sbss*) *(.comment) }
}
