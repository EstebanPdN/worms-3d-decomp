/* Generated reference-only placements. All bodies are source-built. */
OUTPUT_FORMAT("elf32-powerpc")
OUTPUT_ARCH(powerpc)
ENTRY(w3d_cx13b_changed_interface_assign_802bdc88)
_SDA_BASE_ = 0x804b2540;
_SDA2_BASE_ = 0x804c2540;
changed_802bdd24 = 0x802bdd24;
SECTIONS {
  .text.w3d_cx13b_changed_interface_assign_802bdc88 0x802bdc88 : { *(.text.w3d_cx13b_changed_interface_assign_802bdc88) }
  /DISCARD/ : { *(.text*) *(.rodata*) *(.data*) *(.bss*) *(.sdata*) *(.sbss*) *(.comment) }
}
