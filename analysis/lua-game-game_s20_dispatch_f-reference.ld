/* Generated reference-only placements. All bodies are source-built. */
OUTPUT_FORMAT("elf32-powerpc")
OUTPUT_ARCH(powerpc)
ENTRY(w3d_s20_dispatch_record_then_lookup_801a3ba0)
_SDA_BASE_ = 0x804b2540;
_SDA2_BASE_ = 0x804c2540;
fn_801d0858 = 0x801d0858;
SECTIONS {
  .text.w3d_s20_dispatch_record_then_lookup_801a3ba0 0x801a3ba0 : { *(.text.w3d_s20_dispatch_record_then_lookup_801a3ba0) }
  /DISCARD/ : { *(.text*) *(.rodata*) *(.data*) *(.bss*) *(.sdata*) *(.sbss*) *(.comment) }
}
