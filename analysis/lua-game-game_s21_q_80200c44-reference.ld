/* Generated reference-only placements. All bodies are source-built. */
OUTPUT_FORMAT("elf32-powerpc")
OUTPUT_ARCH(powerpc)
ENTRY(w3d_s21_finish_node_80200c44)
_SDA_BASE_ = 0x804b2540;
_SDA2_BASE_ = 0x804c2540;
fn_80200ca4__FPv = 0x80200ca4;
SECTIONS {
  .text.w3d_s21_finish_node_80200c44 0x80200c44 : { *(.text.w3d_s21_finish_node_80200c44) }
  /DISCARD/ : { *(.text*) *(.rodata*) *(.data*) *(.bss*) *(.sdata*) *(.sbss*) *(.comment) }
}
