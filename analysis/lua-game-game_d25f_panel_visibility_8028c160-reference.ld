/* Generated reference-only placements. All bodies are source-built. */
OUTPUT_FORMAT("elf32-powerpc")
OUTPUT_ARCH(powerpc)
ENTRY(d25f_panel_visibility_8028c160)
_SDA_BASE_ = 0x804b2540;
_SDA2_BASE_ = 0x804c2540;
w3d_auto_80178f54 = 0x80178f54;
w3d_auto_8025f064 = 0x8025f064;
w3d_mesh_set_colour_80173df0 = 0x80173df0;
SECTIONS {
  .text.d25f_panel_visibility_8028c160 0x8028c160 : { *(.text.d25f_panel_visibility_8028c160) }
  /DISCARD/ : { *(.text*) *(.rodata*) *(.data*) *(.bss*) *(.sdata*) *(.sbss*) *(.comment) }
}
