/* Generated reference-only placements. All bodies are source-built. */
OUTPUT_FORMAT("elf32-powerpc")
OUTPUT_ARCH(powerpc)
ENTRY(w3d_d24e_register_weapon_panel_properties_802240e0)
_SDA_BASE_ = 0x804b2540;
_SDA2_BASE_ = 0x804c2540;
__15String_8020bb54PCc = 0x8020bb54;
d20e_empty_804b06a0 = 0x804b06a0;
d20e_release_header_8020bb2c = 0x8020bb2c;
d20e_string_finish_8020c5c4 = 0x8020c5c4;
d20e_string_header_80341884 = 0x80341884;
d20e_string_init_8020c5c0 = 0x8020c5c0;
d20e_string_release_80341588 = 0x80341588;
desc_803b7700 = 0x803b7700;
desc_803b7734 = 0x803b7734;
desc_803b7764 = 0x803b7764;
desc_803b7790 = 0x803b7790;
desc_803b77bc = 0x803b77bc;
desc_803b77ec = 0x803b77ec;
desc_803b7810 = 0x803b7810;
desc_803b7834 = 0x803b7834;
desc_803b785c = 0x803b785c;
desc_803b7880 = 0x803b7880;
fn_801e8d9c = 0x801e8d9c;
fn_801ece2c = 0x801ece2c;
fn_801ed24c = 0x801ed24c;
lit_803b76e4 = 0x803b76e4;
SECTIONS {
  .text.w3d_d24e_register_weapon_panel_properties_802240e0 0x802240e0 : { *(.text.w3d_d24e_register_weapon_panel_properties_802240e0) }
  /DISCARD/ : { *(.text*) *(.rodata*) *(.data*) *(.bss*) *(.sdata*) *(.sbss*) *(.comment) }
}
