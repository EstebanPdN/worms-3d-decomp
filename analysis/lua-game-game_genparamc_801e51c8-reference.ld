/* Generated reference-only placements. All bodies are source-built. */
OUTPUT_FORMAT("elf32-powerpc")
OUTPUT_ARCH(powerpc)
ENTRY(w3d_facing_term_801e51c8)
_SDA_BASE_ = 0x804b2540;
_SDA2_BASE_ = 0x804c2540;
fn_802e7e5c = 0x802e7e5c;
fn_802e88ac = 0x802e88ac;
lbl_803b06f4 = 0x803b06f4;
lbl_803b06f8 = 0x803b06f8;
lbl_803b06fc = 0x803b06fc;
lbl_803b0700 = 0x803b0700;
lbl_803b0704 = 0x803b0704;
lbl_803b07d0 = 0x803b07d0;
lbl_803b07d4 = 0x803b07d4;
lbl_803b07d8 = 0x803b07d8;
lbl_803b07dc = 0x803b07dc;
lbl_803b07e0 = 0x803b07e0;
SECTIONS {
  .text.w3d_facing_term_801e51c8 0x801e51c8 : { *(.text.w3d_facing_term_801e51c8) }
  .text.w3d_facing_term_801e663c 0x801e663c : { *(.text.w3d_facing_term_801e663c) }
  /DISCARD/ : { *(.text*) *(.rodata*) *(.data*) *(.bss*) *(.sdata*) *(.sbss*) *(.comment) }
}
