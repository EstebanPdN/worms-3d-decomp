/* Generated reference-only placements. All bodies are source-built. */
OUTPUT_FORMAT("elf32-powerpc")
OUTPUT_ARCH(powerpc)
ENTRY(w3d_cx13a_initialize_property_owner_8011bf6c)
_SDA_BASE_ = 0x804b2540;
_SDA2_BASE_ = 0x804c2540;
base_80161014 = 0x80161014;
cast_80342a78 = 0x80342a78;
key_8039afbc = 0x8039afbc;
query_800fc1b0 = 0x800fc1b0;
vtable_80410a70 = 0x80410a70;
SECTIONS {
  .text.w3d_cx13a_initialize_property_owner_8011bf6c 0x8011bf6c : { *(.text.w3d_cx13a_initialize_property_owner_8011bf6c) }
  /DISCARD/ : { *(.text*) *(.rodata*) *(.data*) *(.bss*) *(.sdata*) *(.sbss*) *(.comment) }
}
