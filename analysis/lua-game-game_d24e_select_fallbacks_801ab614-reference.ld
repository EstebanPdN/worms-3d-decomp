/* Generated reference-only placements. All bodies are source-built. */
OUTPUT_FORMAT("elf32-powerpc")
OUTPUT_ARCH(powerpc)
ENTRY(w3d_d24e_select_fallbacks_801ab614)
_SDA_BASE_ = 0x804b2540;
_SDA2_BASE_ = 0x804c2540;
table_803aa2b0 = 0x803aa2b0;
SECTIONS {
  .text.w3d_d24e_select_fallbacks_801ab614 0x801ab614 : { *(.text.w3d_d24e_select_fallbacks_801ab614) }
  /DISCARD/ : { *(.text*) *(.rodata*) *(.data*) *(.bss*) *(.sdata*) *(.sbss*) *(.comment) }
}
