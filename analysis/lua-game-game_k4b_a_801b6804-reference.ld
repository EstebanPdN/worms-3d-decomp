/* Generated reference-only placements. All bodies are source-built. */
OUTPUT_FORMAT("elf32-powerpc")
OUTPUT_ARCH(powerpc)
ENTRY(w3d_k4b_linked_box_construct_801b6804)
_SDA_BASE_ = 0x804b2540;
_SDA2_BASE_ = 0x804c2540;
lbl_80415a50 = 0x80415a50;
w3d_k4b_box_construct_801b5b30 = 0x801b5b30;
SECTIONS {
  .text.w3d_k4b_linked_box_construct_801b6804 0x801b6804 : { *(.text.w3d_k4b_linked_box_construct_801b6804) }
  /DISCARD/ : { *(.text*) *(.rodata*) *(.data*) *(.bss*) *(.sdata*) *(.sbss*) *(.comment) }
}
