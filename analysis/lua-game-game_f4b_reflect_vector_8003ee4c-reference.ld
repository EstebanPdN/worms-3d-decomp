/* Generated reference-only placements. All bodies are source-built. */
OUTPUT_FORMAT("elf32-powerpc")
OUTPUT_ARCH(powerpc)
ENTRY(f4b_reflect_vector_8003ee4c)
_SDA_BASE_ = 0x804b2540;
_SDA2_BASE_ = 0x804c2540;
high_80374690 = 0x80374690;
low_8037468c = 0x8037468c;
scale_80374694 = 0x80374694;
SECTIONS {
  .text.f4b_reflect_vector_8003ee4c 0x8003ee4c : { *(.text.f4b_reflect_vector_8003ee4c) }
  /DISCARD/ : { *(.text*) *(.rodata*) *(.data*) *(.bss*) *(.sdata*) *(.sbss*) *(.comment) }
}
