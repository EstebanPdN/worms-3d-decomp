/* Generated reference-only placements. All bodies are source-built. */
OUTPUT_FORMAT("elf32-powerpc")
OUTPUT_ARCH(powerpc)
ENTRY(w3d_d24g_land_theme_name_800606e4)
_SDA_BASE_ = 0x804b2540;
_SDA2_BASE_ = 0x804c2540;
__4NamePCc = 0x8020bb54;
append_8020bf2c = 0x8020bf2c;
assign_8020bd38 = 0x8020bd38;
empty_8037917c = 0x8037917c;
prefix_8020c048 = 0x8020c048;
read_800fc2b0 = 0x800fc2b0;
s_80379180 = 0x80379180;
s_80379188 = 0x80379188;
s_80379190 = 0x80379190;
s_80379198 = 0x80379198;
s_8037919c = 0x8037919c;
s_803791a4 = 0x803791a4;
strcmp = 0x802ef234;
string_finish_8020c5c4 = 0x8020c5c4;
string_release_80341588 = 0x80341588;
suffix_8020c0fc = 0x8020c0fc;
SECTIONS {
  .text.w3d_d24g_land_theme_name_800606e4 0x800606e4 : { *(.text.w3d_d24g_land_theme_name_800606e4) }
  /DISCARD/ : { *(.text*) *(.rodata*) *(.data*) *(.bss*) *(.sdata*) *(.sbss*) *(.comment) }
}
