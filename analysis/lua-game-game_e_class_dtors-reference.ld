/* Generated reference-only placements. All bodies are source-built. */
OUTPUT_FORMAT("elf32-powerpc")
OUTPUT_ARCH(powerpc)
ENTRY(w3d_class_destroy_803415c8)
_SDA_BASE_ = 0x804b2540;
_SDA2_BASE_ = 0x804c2540;
w3d_actor_method_member_destroy = 0x80118200;
w3d_class_destroy_80015d18 = 0x80015d18;
w3d_name_resolve_800fc330 = 0x800fc330;
w3d_name_table_803eb63c = 0x803eb63c;
w3d_object_base_destroy_80006388 = 0x80006388;
w3d_object_base_destroy_8000a20c = 0x8000a20c;
w3d_object_base_destroy_80017304 = 0x80017304;
w3d_object_base_destroy_80021468 = 0x80021468;
w3d_operator_delete_80015264 = 0x80015264;
SECTIONS {
  .text.w3d_class_destroy_803415c8 0x803415c8 : { *(.text.w3d_class_destroy_803415c8) }
  .text.w3d_class_destroy_8034160c 0x8034160c : { *(.text.w3d_class_destroy_8034160c) }
  .text.w3d_class_destroy_80341650 0x80341650 : { *(.text.w3d_class_destroy_80341650) }
  .text.w3d_cached_name_lookup_80341694 0x80341694 : { *(.text.w3d_cached_name_lookup_80341694) }
  .text.w3d_cached_name_lookup_80341710 0x80341710 : { *(.text.w3d_cached_name_lookup_80341710) }
  .text.w3d_cached_name_lookup_8034178c 0x8034178c : { *(.text.w3d_cached_name_lookup_8034178c) }
  .text.w3d_cached_name_lookup_80341808 0x80341808 : { *(.text.w3d_cached_name_lookup_80341808) }
  .text.w3d_class_destroy_80341890 0x80341890 : { *(.text.w3d_class_destroy_80341890) }
  .text.w3d_class_destroy_803418d4 0x803418d4 : { *(.text.w3d_class_destroy_803418d4) }
  .text.w3d_class_destroy_80341918 0x80341918 : { *(.text.w3d_class_destroy_80341918) }
  .text.w3d_class_destroy_8034195c 0x8034195c : { *(.text.w3d_class_destroy_8034195c) }
  .text.w3d_class_destroy_803419a0 0x803419a0 : { *(.text.w3d_class_destroy_803419a0) }
  .text.w3d_class_destroy_803419e4 0x803419e4 : { *(.text.w3d_class_destroy_803419e4) }
  .text.w3d_class_destroy_80341a28 0x80341a28 : { *(.text.w3d_class_destroy_80341a28) }
  .text.w3d_class_destroy_80341a6c 0x80341a6c : { *(.text.w3d_class_destroy_80341a6c) }
  .text.w3d_class_destroy_80341ab0 0x80341ab0 : { *(.text.w3d_class_destroy_80341ab0) }
  .text.w3d_class_destroy_80341af4 0x80341af4 : { *(.text.w3d_class_destroy_80341af4) }
  .text.w3d_class_destroy_80341b38 0x80341b38 : { *(.text.w3d_class_destroy_80341b38) }
  .text.w3d_class_destroy_80341b7c 0x80341b7c : { *(.text.w3d_class_destroy_80341b7c) }
  .text.w3d_class_destroy_80341bc0 0x80341bc0 : { *(.text.w3d_class_destroy_80341bc0) }
  .text.w3d_class_destroy_80341c04 0x80341c04 : { *(.text.w3d_class_destroy_80341c04) }
  .text.w3d_class_destroy_80341c48 0x80341c48 : { *(.text.w3d_class_destroy_80341c48) }
  .text.w3d_class_destroy_80341c8c 0x80341c8c : { *(.text.w3d_class_destroy_80341c8c) }
  .text.w3d_class_destroy_80341cd0 0x80341cd0 : { *(.text.w3d_class_destroy_80341cd0) }
  .text.w3d_class_destroy_80341d14 0x80341d14 : { *(.text.w3d_class_destroy_80341d14) }
  .text.w3d_class_destroy_80341d58 0x80341d58 : { *(.text.w3d_class_destroy_80341d58) }
  .text.w3d_class_destroy_80341d9c 0x80341d9c : { *(.text.w3d_class_destroy_80341d9c) }
  .text.w3d_class_destroy_80341de0 0x80341de0 : { *(.text.w3d_class_destroy_80341de0) }
  .text.w3d_class_destroy_80341e24 0x80341e24 : { *(.text.w3d_class_destroy_80341e24) }
  .text.w3d_class_destroy_80341e68 0x80341e68 : { *(.text.w3d_class_destroy_80341e68) }
  .text.w3d_class_destroy_80341eac 0x80341eac : { *(.text.w3d_class_destroy_80341eac) }
  .text.w3d_class_destroy_80341ef0 0x80341ef0 : { *(.text.w3d_class_destroy_80341ef0) }
  .text.w3d_class_destroy_80341f34 0x80341f34 : { *(.text.w3d_class_destroy_80341f34) }
  .text.w3d_class_destroy_80341f78 0x80341f78 : { *(.text.w3d_class_destroy_80341f78) }
  .text.w3d_class_destroy_80341fbc 0x80341fbc : { *(.text.w3d_class_destroy_80341fbc) }
  .text.w3d_class_destroy_80342000 0x80342000 : { *(.text.w3d_class_destroy_80342000) }
  .text.w3d_class_destroy_80342044 0x80342044 : { *(.text.w3d_class_destroy_80342044) }
  .text.w3d_class_destroy_80342088 0x80342088 : { *(.text.w3d_class_destroy_80342088) }
  .text.w3d_class_destroy_803420cc 0x803420cc : { *(.text.w3d_class_destroy_803420cc) }
  .text.w3d_class_destroy_80342110 0x80342110 : { *(.text.w3d_class_destroy_80342110) }
  .text.w3d_class_destroy_80342154 0x80342154 : { *(.text.w3d_class_destroy_80342154) }
  .text.w3d_class_destroy_80342198 0x80342198 : { *(.text.w3d_class_destroy_80342198) }
  .text.w3d_class_destroy_803421dc 0x803421dc : { *(.text.w3d_class_destroy_803421dc) }
  .text.w3d_class_destroy_80342220 0x80342220 : { *(.text.w3d_class_destroy_80342220) }
  .text.w3d_class_destroy_80342264 0x80342264 : { *(.text.w3d_class_destroy_80342264) }
  .text.w3d_class_destroy_803422a8 0x803422a8 : { *(.text.w3d_class_destroy_803422a8) }
  .text.w3d_class_destroy_803422ec 0x803422ec : { *(.text.w3d_class_destroy_803422ec) }
  .text.w3d_class_destroy_80342330 0x80342330 : { *(.text.w3d_class_destroy_80342330) }
  .text.w3d_class_destroy_80342374 0x80342374 : { *(.text.w3d_class_destroy_80342374) }
  .text.w3d_class_destroy_803423b8 0x803423b8 : { *(.text.w3d_class_destroy_803423b8) }
  .text.w3d_class_destroy_803423fc 0x803423fc : { *(.text.w3d_class_destroy_803423fc) }
  .text.w3d_class_destroy_80342440 0x80342440 : { *(.text.w3d_class_destroy_80342440) }
  .text.w3d_class_destroy_80342484 0x80342484 : { *(.text.w3d_class_destroy_80342484) }
  .text.w3d_class_destroy_803424d8 0x803424d8 : { *(.text.w3d_class_destroy_803424d8) }
  .text.w3d_class_destroy_8034251c 0x8034251c : { *(.text.w3d_class_destroy_8034251c) }
  .text.w3d_class_destroy_80342560 0x80342560 : { *(.text.w3d_class_destroy_80342560) }
  .text.w3d_class_destroy_803425a4 0x803425a4 : { *(.text.w3d_class_destroy_803425a4) }
  .text.w3d_class_destroy_803425e8 0x803425e8 : { *(.text.w3d_class_destroy_803425e8) }
  .text.w3d_class_destroy_8034262c 0x8034262c : { *(.text.w3d_class_destroy_8034262c) }
  .text.w3d_class_destroy_80342670 0x80342670 : { *(.text.w3d_class_destroy_80342670) }
  .text.w3d_empty_803426b4 0x803426b4 : { *(.text.w3d_empty_803426b4) }
  .text.w3d_vector_destroy_80342730 0x80342730 : { *(.text.w3d_vector_destroy_80342730) }
  .text.w3d_class_destroy_80342788 0x80342788 : { *(.text.w3d_class_destroy_80342788) }
  .text.w3d_class_destroy_803427cc 0x803427cc : { *(.text.w3d_class_destroy_803427cc) }
  .text.w3d_class_destroy_80342810 0x80342810 : { *(.text.w3d_class_destroy_80342810) }
  .text.w3d_class_destroy_80342854 0x80342854 : { *(.text.w3d_class_destroy_80342854) }
  .text.w3d_class_destroy_80342898 0x80342898 : { *(.text.w3d_class_destroy_80342898) }
  .text.w3d_class_destroy_803428dc 0x803428dc : { *(.text.w3d_class_destroy_803428dc) }
  .text.w3d_class_destroy_80342920 0x80342920 : { *(.text.w3d_class_destroy_80342920) }
  .text.w3d_class_destroy_80342964 0x80342964 : { *(.text.w3d_class_destroy_80342964) }
  .text.w3d_class_destroy_803429a8 0x803429a8 : { *(.text.w3d_class_destroy_803429a8) }
  .text.w3d_class_destroy_803429ec 0x803429ec : { *(.text.w3d_class_destroy_803429ec) }
  .text.w3d_class_destroy_80342a30 0x80342a30 : { *(.text.w3d_class_destroy_80342a30) }
  .text.w3d_empty_80342a74 0x80342a74 : { *(.text.w3d_empty_80342a74) }
  .sdata 0x804aa690 (NOLOAD) : {
    . = 0x0; w3d_cached_key_804aa690 = .;
    . = 0x4; w3d_cached_value_804aa694 = .;
    . = 0x8; w3d_cached_key_804aa698 = .;
    . = 0xc; w3d_cached_value_804aa69c = .;
    . = 0x10; w3d_cached_key_804aa6a0 = .;
    . = 0x14; w3d_cached_value_804aa6a4 = .;
    . = 0x18; w3d_cached_key_804aa6a8 = .;
    . = 0x1c; w3d_cached_value_804aa6ac = .;
    . += 1; }
  /DISCARD/ : { *(.text*) *(.rodata*) *(.data*) *(.bss*) *(.sdata*) *(.sbss*) *(.comment) }
}
