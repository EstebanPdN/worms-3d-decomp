/* Generated reference-only placements. All bodies are source-built. */
OUTPUT_FORMAT("elf32-powerpc")
OUTPUT_ARCH(powerpc)
ENTRY(f3c_propagate_tag_801ea4c8)
_SDA_BASE_ = 0x804b2540;
_SDA2_BASE_ = 0x804c2540;
fn_801e9db8 = 0x801e9db8;
SECTIONS {
  .text.f3c_propagate_tag_801ea4c8 0x801ea4c8 : { *(.text.f3c_propagate_tag_801ea4c8) }
  /DISCARD/ : { *(.text*) *(.rodata*) *(.data*) *(.bss*) *(.sdata*) *(.sbss*) *(.comment) }
}
