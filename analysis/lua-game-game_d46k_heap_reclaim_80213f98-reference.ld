/* Generated reference-only placements. All bodies are source-built. */
OUTPUT_FORMAT("elf32-powerpc")
OUTPUT_ARCH(powerpc)
ENTRY(w3d_d46k_heap_reclaim_80213f98)
_SDA_BASE_ = 0x804b2540;
_SDA2_BASE_ = 0x804c2540;
fn_80213d90 = 0x80213d90;
SECTIONS {
  .text.w3d_d46k_heap_reclaim_80213f98 0x80213f98 : { *(.text.w3d_d46k_heap_reclaim_80213f98) }
  /DISCARD/ : { *(.text*) *(.rodata*) *(.data*) *(.bss*) *(.sdata*) *(.sbss*) *(.comment) }
}
