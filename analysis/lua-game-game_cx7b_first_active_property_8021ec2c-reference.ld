/* Generated reference-only placements. All bodies are source-built. */
OUTPUT_FORMAT("elf32-powerpc")
OUTPUT_ARCH(powerpc)
ENTRY(w3d_cx7b_first_active_property_8021ec2c)
_SDA_BASE_ = 0x804b2540;
_SDA2_BASE_ = 0x804c2540;
fn_8021ed0c = 0x8021ed0c;
fn_80240994 = 0x80240994;
SECTIONS {
  .text.w3d_cx7b_first_active_property_8021ec2c 0x8021ec2c : { *(.text.w3d_cx7b_first_active_property_8021ec2c) }
  /DISCARD/ : { *(.text*) *(.rodata*) *(.data*) *(.bss*) *(.sdata*) *(.sbss*) *(.comment) }
}
