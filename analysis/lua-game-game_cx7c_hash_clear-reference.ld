/* Generated reference-only placements. All bodies are source-built. */
OUTPUT_FORMAT("elf32-powerpc")
OUTPUT_ARCH(powerpc)
ENTRY(w3d_cx7c_hash_clear_8035c81c)
_SDA_BASE_ = 0x804b2540;
_SDA2_BASE_ = 0x804c2540;
cx7c_deallocate_802134fc = 0x802134fc;
SECTIONS {
  .text.w3d_cx7c_hash_clear_8035c81c 0x8035c81c : { *(.text.w3d_cx7c_hash_clear_8035c81c) }
  /DISCARD/ : { *(.text*) *(.rodata*) *(.data*) *(.bss*) *(.sdata*) *(.sbss*) *(.comment) }
}
