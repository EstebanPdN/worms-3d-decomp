/* Generated reference-only placements. All bodies are source-built. */
OUTPUT_FORMAT("elf32-powerpc")
OUTPUT_ARCH(powerpc)
ENTRY(d24j_compile_mesh_data_8017fe2c)
_SDA_BASE_ = 0x804b2540;
_SDA2_BASE_ = 0x804c2540;
fn_801801b0 = 0x801801b0;
fn_801fe0b8 = 0x801fe0b8;
fn_801fe160 = 0x801fe160;
fn_80208aac = 0x80208aac;
fn_8020b680 = 0x8020b680;
fn_8020f4b0 = 0x8020f4b0;
fn_80343944 = 0x80343944;
iid_8040e078 = 0x8040e078;
memcpy = 0x802eee50;
name_80418f78 = 0x80418f78;
SECTIONS {
  .text.d24j_compile_mesh_data_8017fe2c 0x8017fe2c : { *(.text.d24j_compile_mesh_data_8017fe2c) }
  /DISCARD/ : { *(.text*) *(.rodata*) *(.data*) *(.bss*) *(.sdata*) *(.sbss*) *(.comment) }
}
