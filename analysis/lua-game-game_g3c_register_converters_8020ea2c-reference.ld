/* Generated reference-only placements. All bodies are source-built. */
OUTPUT_FORMAT("elf32-powerpc")
OUTPUT_ARCH(powerpc)
ENTRY(g3c_register_converters_8020ea2c)
_SDA_BASE_ = 0x804b2540;
_SDA2_BASE_ = 0x804c2540;
data_80419500 = 0x80419500;
data_8045ed10 = 0x8045ed10;
data_8045ed1c = 0x8045ed1c;
data_8045ed28 = 0x8045ed28;
data_8045ed34 = 0x8045ed34;
data_8045ed40 = 0x8045ed40;
data_8045ed4c = 0x8045ed4c;
data_8045ed58 = 0x8045ed58;
data_8045ed7c = 0x8045ed7c;
fn_8020b648 = 0x8020b648;
fn_8020e560 = 0x8020e560;
fn_8020e590 = 0x8020e590;
fn_8020e5d0 = 0x8020e5d0;
fn_8020e600 = 0x8020e600;
fn_8020e630 = 0x8020e630;
fn_8020e660 = 0x8020e660;
fn_8020e690 = 0x8020e690;
fn_8020e6c0 = 0x8020e6c0;
fn_8020e700 = 0x8020e700;
fn_8020e740 = 0x8020e740;
fn_8020e780 = 0x8020e780;
fn_8020e7c0 = 0x8020e7c0;
fn_8020e834 = 0x8020e834;
fn_8020e88c = 0x8020e88c;
fn_8020e8cc = 0x8020e8cc;
fn_8020e90c = 0x8020e90c;
fn_8020e94c = 0x8020e94c;
fn_8020e98c = 0x8020e98c;
fn_8020e9d0 = 0x8020e9d0;
SECTIONS {
  .text.g3c_register_converters_8020ea2c 0x8020ea2c : { *(.text.g3c_register_converters_8020ea2c) }
  /DISCARD/ : { *(.text*) *(.rodata*) *(.data*) *(.bss*) *(.sdata*) *(.sbss*) *(.comment) }
}
