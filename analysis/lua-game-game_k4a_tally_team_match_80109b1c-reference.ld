/* Generated reference-only placements. All bodies are source-built. */
OUTPUT_FORMAT("elf32-powerpc")
OUTPUT_ARCH(powerpc)
ENTRY(k4a_tally_team_match_80109b1c)
_SDA_BASE_ = 0x804b2540;
_SDA2_BASE_ = 0x804c2540;
s8_index_query_800fc6dc = 0x800fc6dc;
w3d_auto_800fc1f0 = 0x800fc1f0;
w3d_string_80399cd8 = 0x80399cd8;
SECTIONS {
  .text.k4a_tally_team_match_80109b1c 0x80109b1c : { *(.text.k4a_tally_team_match_80109b1c) }
  /DISCARD/ : { *(.text*) *(.rodata*) *(.data*) *(.bss*) *(.sdata*) *(.sbss*) *(.comment) }
}
