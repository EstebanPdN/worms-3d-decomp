/* Generated reference-only placements. All bodies are source-built. */
OUTPUT_FORMAT("elf32-powerpc")
OUTPUT_ARCH(powerpc)
ENTRY(_._13F11c_Owner588)
_SDA_BASE_ = 0x804b2540;
_SDA2_BASE_ = 0x804c2540;
_._9F11c_Node = 0x80209d10;
__dl__11F11c_BlockAPv = 0x801fe1f8;
__dl__11F11c_BlockBPv = 0x801fe1f8;
__dl__13F11c_Owner588Pv = 0x801fe1f8;
fn_801bde2c = 0x801bde2c;
fn_801be020 = 0x801be020;
fn_801e828c = 0x801e828c;
fn_802134fc = 0x802134fc;
vt_80413cc0 = 0x80413cc0;
vt_80413d30 = 0x80413d30;
SECTIONS {
  .text._._13F11c_Owner588 0x801a8adc : { *(.text._._13F11c_Owner588) }
  /DISCARD/ : { *(.text*) *(.rodata*) *(.data*) *(.bss*) *(.sdata*) *(.sbss*) *(.comment) }
}
