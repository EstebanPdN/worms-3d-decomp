/* Generated reference-only placements. All bodies are source-built. */
OUTPUT_FORMAT("elf32-powerpc")
OUTPUT_ARCH(powerpc)
ENTRY(w3d_cc17a_apply_active_key_800368ac)
_SDA_BASE_ = 0x804b2540;
_SDA2_BASE_ = 0x804c2540;
active_80036c8c = 0x80036c8c;
apply_80036afc = 0x80036afc;
SECTIONS {
  .text.w3d_cc17a_apply_active_key_800368ac 0x800368ac : { *(.text.w3d_cc17a_apply_active_key_800368ac) }
  /DISCARD/ : { *(.text*) *(.rodata*) *(.data*) *(.bss*) *(.sdata*) *(.sbss*) *(.comment) }
}
