/* Generated reference-only placements. All bodies are source-built. */
OUTPUT_FORMAT("elf32-powerpc")
OUTPUT_ARCH(powerpc)
ENTRY(w3d_d29e_downsample_a_801b01bc)
_SDA_BASE_ = 0x804b2540;
_SDA2_BASE_ = 0x804c2540;
sol11b_filter_select_801d7750 = 0x801d7750;
SECTIONS {
  .text.w3d_d29e_downsample_a_801b01bc 0x801b01bc : { *(.text.w3d_d29e_downsample_a_801b01bc) }
  /DISCARD/ : { *(.text*) *(.rodata*) *(.data*) *(.bss*) *(.sdata*) *(.sbss*) *(.comment) }
}
