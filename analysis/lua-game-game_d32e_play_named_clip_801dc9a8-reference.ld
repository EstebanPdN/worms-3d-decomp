/* Generated reference-only placements. All bodies are source-built. */
OUTPUT_FORMAT("elf32-powerpc")
OUTPUT_ARCH(powerpc)
ENTRY(w3d_d32e_play_named_clip_801dc9a8)
_SDA_BASE_ = 0x804b2540;
_SDA2_BASE_ = 0x804c2540;
rand = 0x802ee7dc;
strcmp = 0x802ef234;
w3d_s21_get_item_801de10c = 0x801de10c;
w3d_s21_has_name_801ddff4 = 0x801ddff4;
w3d_s21_index_of_name_801de080 = 0x801de080;
SECTIONS {
  .text.w3d_d32e_play_named_clip_801dc9a8 0x801dc9a8 : { *(.text.w3d_d32e_play_named_clip_801dc9a8) }
  /DISCARD/ : { *(.text*) *(.rodata*) *(.data*) *(.bss*) *(.sdata*) *(.sbss*) *(.comment) }
}
