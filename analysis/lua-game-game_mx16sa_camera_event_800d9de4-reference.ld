/* Generated reference-only placements. All bodies are source-built. */
OUTPUT_FORMAT("elf32-powerpc")
OUTPUT_ARCH(powerpc)
ENTRY(mx16sa_camera_event_800d9de4)
_SDA_BASE_ = 0x804b2540;
_SDA2_BASE_ = 0x804c2540;
compare_802ef234 = 0x802ef234;
empty_8038956c = 0x8038956c;
first_type_80367b08 = 0x80367b08;
lookup_80164fc8 = 0x80164fc8;
min_event_time_8038958c = 0x8038958c;
play_first_800edc28 = 0x800edc28;
play_second_800edca0 = 0x800edca0;
point_visible_80121330 = 0x80121330;
query_entry_800fc330 = 0x800fc330;
query_uint_800fc230 = 0x800fc230;
second_type_80367b58 = 0x80367b58;
SECTIONS {
  .text.mx16sa_camera_event_800d9de4 0x800d9de4 : { *(.text.mx16sa_camera_event_800d9de4) }
  /DISCARD/ : { *(.text*) *(.rodata*) *(.data*) *(.bss*) *(.sdata*) *(.sbss*) *(.comment) }
}
