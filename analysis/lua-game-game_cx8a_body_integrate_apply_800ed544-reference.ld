/* Generated reference-only placements. All bodies are source-built. */
OUTPUT_FORMAT("elf32-powerpc")
OUTPUT_ARCH(powerpc)
ENTRY(w3d_cx8a_body_integrate_apply_800ed544)
_SDA_BASE_ = 0x804b2540;
_SDA2_BASE_ = 0x804c2540;
position_apply_800eac84 = 0x800eac84;
step_8038b610 = 0x8038b610;
SECTIONS {
  .text.w3d_cx8a_body_integrate_apply_800ed544 0x800ed544 : { *(.text.w3d_cx8a_body_integrate_apply_800ed544) }
  /DISCARD/ : { *(.text*) *(.rodata*) *(.data*) *(.bss*) *(.sdata*) *(.sbss*) *(.comment) }
}
