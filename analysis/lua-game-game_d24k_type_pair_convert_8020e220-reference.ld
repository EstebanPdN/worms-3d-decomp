/* Generated reference-only placements. All bodies are source-built. */
OUTPUT_FORMAT("elf32-powerpc")
OUTPUT_ARCH(powerpc)
ENTRY(w3d_d24k_type_pair_convert_8020e220)
_SDA_BASE_ = 0x804b2540;
_SDA2_BASE_ = 0x804c2540;
element_size_80200050 = 0x80200050;
memcpy_802eee50 = 0x802eee50;
SECTIONS {
  .text.w3d_d24k_type_pair_convert_8020e220 0x8020e220 : { *(.text.w3d_d24k_type_pair_convert_8020e220) }
  /DISCARD/ : { *(.text*) *(.rodata*) *(.data*) *(.bss*) *(.sdata*) *(.sbss*) *(.comment) }
}
