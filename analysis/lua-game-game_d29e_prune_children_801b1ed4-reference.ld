/* Generated reference-only placements. All bodies are source-built. */
OUTPUT_FORMAT("elf32-powerpc")
OUTPUT_ARCH(powerpc)
ENTRY(w3d_d29e_prune_children_801b1ed4)
_SDA_BASE_ = 0x804b2540;
_SDA2_BASE_ = 0x804c2540;
fn_801ef380 = 0x801ef380;
w3d_k4b_scanner_has_missing_801b1e48 = 0x801b1e48;
w3d_k5b_iface_array_field_set_801ef2ec = 0x801ef2ec;
w3d_s10_has_ancestor_801b1de0 = 0x801b1de0;
SECTIONS {
  .text.w3d_d29e_prune_children_801b1ed4 0x801b1ed4 : { *(.text.w3d_d29e_prune_children_801b1ed4) }
  /DISCARD/ : { *(.text*) *(.rodata*) *(.data*) *(.bss*) *(.sdata*) *(.sbss*) *(.comment) }
}
