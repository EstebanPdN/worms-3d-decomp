/* Generated reference-only placements. All bodies are source-built. */
OUTPUT_FORMAT("elf32-powerpc")
OUTPUT_ARCH(powerpc)
ENTRY(w3d_k5b_array_field_lock_801ef618)
_SDA_BASE_ = 0x804b2540;
_SDA2_BASE_ = 0x804c2540;
w3d_auto_80200050 = 0x80200050;
w3d_k5b_array_ref_lock_801ef048 = 0x801ef048;
SECTIONS {
  .text.w3d_k5b_array_field_lock_801ef618 0x801ef618 : { *(.text.w3d_k5b_array_field_lock_801ef618) }
  /DISCARD/ : { *(.text*) *(.rodata*) *(.data*) *(.bss*) *(.sdata*) *(.sbss*) *(.comment) }
}
