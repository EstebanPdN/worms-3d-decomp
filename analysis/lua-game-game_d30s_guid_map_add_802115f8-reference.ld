/* Generated reference-only placements. All bodies are source-built. */
OUTPUT_FORMAT("elf32-powerpc")
OUTPUT_ARCH(powerpc)
ENTRY(d30s_guid_map_add_802115f8)
_SDA_BASE_ = 0x804b2540;
_SDA2_BASE_ = 0x804c2540;
_M_insert__Q24_STLt9hashtable6ZQ24_STLt4pair2ZC11D30sGuidKeyZP11D30sServiceZ11D30sGuidKeyZ12D30sGuidHashZQ24_STLt10_Select1st1ZQ24_STLt4pair2ZC11D30sGuidKeyZP11D30sServiceZ10D30sGuidEqZQ24_STLt9allocator1ZQ24_STLt4pair2ZC11D30sGuidKeyZP11D30sServiceRCQ24_STLt4pair2ZC11D30sGuidKeyZP11D30sService = 0x8035c75c;
memcmp = 0x802eedc0;
w3d_auto_801fff3c = 0x801fff3c;
SECTIONS {
  .text.d30s_guid_map_add_802115f8 0x802115f8 : { *(.text.d30s_guid_map_add_802115f8) }
  /DISCARD/ : { *(.text*) *(.rodata*) *(.data*) *(.bss*) *(.sdata*) *(.sbss*) *(.comment) }
}
