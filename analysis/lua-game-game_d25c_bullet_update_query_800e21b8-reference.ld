/* Generated reference-only placements. All bodies are source-built. */
OUTPUT_FORMAT("elf32-powerpc")
OUTPUT_ARCH(powerpc)
ENTRY(d25c_bullet_update_query_800e21b8)
_SDA_BASE_ = 0x804b2540;
_SDA2_BASE_ = 0x804c2540;
flag_800dfd48 = 0x800dfd48;
lookup_80164fc8 = 0x80164fc8;
query_800e25dc = 0x800e25dc;
step_800df7b8 = 0x800df7b8;
type_80360cf0 = 0x80360cf0;
type_80360e10 = 0x80360e10;
SECTIONS {
  .text.d25c_bullet_update_query_800e21b8 0x800e21b8 : { *(.text.d25c_bullet_update_query_800e21b8) }
  /DISCARD/ : { *(.text*) *(.rodata*) *(.data*) *(.bss*) *(.sdata*) *(.sbss*) *(.comment) }
}
