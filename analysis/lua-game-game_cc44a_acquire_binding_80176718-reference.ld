/* Generated reference-only placements. All bodies are source-built. */
OUTPUT_FORMAT("elf32-powerpc")
OUTPUT_ARCH(powerpc)
ENTRY(cc44a_acquire_binding_80176718)
_SDA_BASE_ = 0x804b2540;
_SDA2_BASE_ = 0x804c2540;
cc44a_lookup_group_80177eb0 = 0x80177eb0;
SECTIONS {
  .text.cc44a_acquire_binding_80176718 0x80176718 : { *(.text.cc44a_acquire_binding_80176718) }
  /DISCARD/ : { *(.text*) *(.rodata*) *(.data*) *(.bss*) *(.sdata*) *(.sbss*) *(.comment) }
}
