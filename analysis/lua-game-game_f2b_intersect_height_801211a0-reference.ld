/* Generated reference-only placements. All bodies are source-built. */
OUTPUT_FORMAT("elf32-powerpc")
OUTPUT_ARCH(powerpc)
ENTRY(f2b_intersect_height_801211a0)
_SDA_BASE_ = 0x804b2540;
_SDA2_BASE_ = 0x804c2540;
one_8039b704 = 0x8039b704;
value_80178df0 = 0x80178df0;
zero_8039b700 = 0x8039b700;
SECTIONS {
  .text.f2b_intersect_height_801211a0 0x801211a0 : { *(.text.f2b_intersect_height_801211a0) }
  /DISCARD/ : { *(.text*) *(.rodata*) *(.data*) *(.bss*) *(.sdata*) *(.sbss*) *(.comment) }
}
