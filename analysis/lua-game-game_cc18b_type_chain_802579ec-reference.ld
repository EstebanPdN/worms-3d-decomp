/* Generated reference-only placements. All bodies are source-built. */
OUTPUT_FORMAT("elf32-powerpc")
OUTPUT_ARCH(powerpc)
ENTRY(w3d_cc18b_type_chain_802579ec)
_SDA_BASE_ = 0x804b2540;
_SDA2_BASE_ = 0x804c2540;
fn_801e8a88 = 0x801e8a88;
fn_80251e94 = 0x80251e94;
fn_802525c4 = 0x802525c4;
fn_80253284 = 0x80253284;
fn_80253c80 = 0x80253c80;
fn_80255074 = 0x80255074;
fn_802551dc = 0x802551dc;
fn_802552a8 = 0x802552a8;
fn_80255418 = 0x80255418;
fn_80255504 = 0x80255504;
fn_80255850 = 0x80255850;
fn_80255d30 = 0x80255d30;
fn_80256158 = 0x80256158;
fn_80256890 = 0x80256890;
fn_80256b3c = 0x80256b3c;
fn_80256f00 = 0x80256f00;
fn_80257110 = 0x80257110;
fn_8025747c = 0x8025747c;
fn_8025768c = 0x8025768c;
lbl_80365788 = 0x80365788;
lbl_803682d8 = 0x803682d8;
lbl_80368328 = 0x80368328;
lbl_80368378 = 0x80368378;
lbl_803683c8 = 0x803683c8;
lbl_80368418 = 0x80368418;
lbl_80368468 = 0x80368468;
lbl_803684b8 = 0x803684b8;
lbl_80368508 = 0x80368508;
lbl_80368558 = 0x80368558;
lbl_803eb10c = 0x803eb10c;
lbl_803eb128 = 0x803eb128;
lbl_803eb144 = 0x803eb144;
lbl_803eb160 = 0x803eb160;
lbl_803eb17c = 0x803eb17c;
lbl_803eb198 = 0x803eb198;
lbl_803eb1b4 = 0x803eb1b4;
lbl_803eb1d0 = 0x803eb1d0;
lbl_803eb1ec = 0x803eb1ec;
SECTIONS {
  .text.w3d_cc18b_type_chain_802579ec 0x802579ec : { *(.text.w3d_cc18b_type_chain_802579ec) }
  /DISCARD/ : { *(.text*) *(.rodata*) *(.data*) *(.bss*) *(.sdata*) *(.sbss*) *(.comment) }
}
