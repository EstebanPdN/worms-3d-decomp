/* Generated reference-only placements. All bodies are source-built. */
OUTPUT_FORMAT("elf32-powerpc")
OUTPUT_ARCH(powerpc)
ENTRY(f13a_clip_list_800e2464)
_SDA_BASE_ = 0x804b2540;
_SDA2_BASE_ = 0x804c2540;
blend_80389f0c = 0x80389f0c;
compare_802ef074 = 0x802ef074;
control_8018179c = 0x8018179c;
flag_80389f04 = 0x80389f04;
one_80389f14 = 0x80389f14;
play_80181640 = 0x80181640;
zero_80389f10 = 0x80389f10;
SECTIONS {
  .text.f13a_clip_list_800e2464 0x800e2464 : { *(.text.f13a_clip_list_800e2464) }
  /DISCARD/ : { *(.text*) *(.rodata*) *(.data*) *(.bss*) *(.sdata*) *(.sbss*) *(.comment) }
}
