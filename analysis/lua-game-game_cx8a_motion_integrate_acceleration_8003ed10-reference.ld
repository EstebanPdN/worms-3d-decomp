/* Generated reference-only placements. All bodies are source-built. */
OUTPUT_FORMAT("elf32-powerpc")
OUTPUT_ARCH(powerpc)
ENTRY(w3d_cx8a_motion_integrate_acceleration_8003ed10)
_SDA_BASE_ = 0x804b2540;
_SDA2_BASE_ = 0x804c2540;
half_80374688 = 0x80374688;
step_80374684 = 0x80374684;
SECTIONS {
  .text.w3d_cx8a_motion_integrate_acceleration_8003ed10 0x8003ed10 : { *(.text.w3d_cx8a_motion_integrate_acceleration_8003ed10) }
  /DISCARD/ : { *(.text*) *(.rodata*) *(.data*) *(.bss*) *(.sdata*) *(.sbss*) *(.comment) }
}
