/* Generated reference-only placements. All bodies are source-built. */
OUTPUT_FORMAT("elf32-powerpc")
OUTPUT_ARCH(powerpc)
ENTRY(w3d_d25k_gauge_smooth_8026e884)
_SDA_BASE_ = 0x804b2540;
_SDA2_BASE_ = 0x804c2540;
fn_80296410 = 0x80296410;
fn_802bc790 = 0x802bc790;
gain_803cbe00 = 0x803cbe00;
high_803cbdf8 = 0x803cbdf8;
low_803cbdfc = 0x803cbdfc;
one_803cbe04 = 0x803cbe04;
SECTIONS {
  .text.w3d_d25k_gauge_smooth_8026e884 0x8026e884 : { *(.text.w3d_d25k_gauge_smooth_8026e884) }
  /DISCARD/ : { *(.text*) *(.rodata*) *(.data*) *(.bss*) *(.sdata*) *(.sbss*) *(.comment) }
}
