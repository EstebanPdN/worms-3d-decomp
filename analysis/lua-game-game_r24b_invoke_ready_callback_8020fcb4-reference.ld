/* Generated reference-only placements. All bodies are source-built. */
OUTPUT_FORMAT("elf32-powerpc")
OUTPUT_ARCH(powerpc)
ENTRY(w3d_r24b_invoke_ready_callback_8020fcb4)
_SDA_BASE_ = 0x804b2540;
_SDA2_BASE_ = 0x804c2540;
r24b_prepare_80210370 = 0x80210370;
SECTIONS {
  .text.w3d_r24b_invoke_ready_callback_8020fcb4 0x8020fcb4 : { *(.text.w3d_r24b_invoke_ready_callback_8020fcb4) }
  /DISCARD/ : { *(.text*) *(.rodata*) *(.data*) *(.bss*) *(.sdata*) *(.sbss*) *(.comment) }
}
