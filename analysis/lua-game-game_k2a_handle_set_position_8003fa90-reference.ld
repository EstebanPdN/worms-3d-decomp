/* Generated reference-only placements. All bodies are source-built. */
OUTPUT_FORMAT("elf32-powerpc")
OUTPUT_ARCH(powerpc)
ENTRY(k2a_handle_set_position_8003fa90)
_SDA_BASE_ = 0x804b2540;
_SDA2_BASE_ = 0x804c2540;
w3d_handle_table_804273ec = 0x804273ec;
w3d_handle_update_resource = 0x8003fb0c;
SECTIONS {
  .text.k2a_handle_set_position_8003fa90 0x8003fa90 : { *(.text.k2a_handle_set_position_8003fa90) }
  /DISCARD/ : { *(.text*) *(.rodata*) *(.data*) *(.bss*) *(.sdata*) *(.sbss*) *(.comment) }
}
