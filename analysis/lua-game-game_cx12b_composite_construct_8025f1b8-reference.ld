/* Generated reference-only placements. All bodies are source-built. */
OUTPUT_FORMAT("elf32-powerpc")
OUTPUT_ARCH(powerpc)
ENTRY(w3d_cx12b_composite_construct_8025f1b8)
_SDA_BASE_ = 0x804b2540;
_SDA2_BASE_ = 0x804c2540;
base_8015fef0 = 0x8015fef0;
member_802afb20 = 0x802afb20;
table_8041bb30 = 0x8041bb30;
table_8041bb80 = 0x8041bb80;
SECTIONS {
  .text.w3d_cx12b_composite_construct_8025f1b8 0x8025f1b8 : { *(.text.w3d_cx12b_composite_construct_8025f1b8) }
  /DISCARD/ : { *(.text*) *(.rodata*) *(.data*) *(.bss*) *(.sdata*) *(.sbss*) *(.comment) }
}
