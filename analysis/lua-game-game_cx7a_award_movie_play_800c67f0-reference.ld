/* Generated reference-only placements. All bodies are source-built. */
OUTPUT_FORMAT("elf32-powerpc")
OUTPUT_ARCH(powerpc)
ENTRY(w3d_cx7a_award_movie_play_800c67f0)
_SDA_BASE_ = 0x804b2540;
_SDA2_BASE_ = 0x804c2540;
assign_8020bd38 = 0x8020bd38;
empty_80387410 = 0x80387410;
finish_8020c5c4 = 0x8020c5c4;
init_803426b8 = 0x803426b8;
key_803877f4 = 0x803877f4;
play_800c6660 = 0x800c6660;
read_800fc2b0 = 0x800fc2b0;
release_80341588 = 0x80341588;
write_800fc550 = 0x800fc550;
SECTIONS {
  .text.w3d_cx7a_award_movie_play_800c67f0 0x800c67f0 : { *(.text.w3d_cx7a_award_movie_play_800c67f0) }
  /DISCARD/ : { *(.text*) *(.rodata*) *(.data*) *(.bss*) *(.sdata*) *(.sbss*) *(.comment) }
}
