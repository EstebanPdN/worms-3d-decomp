/* Generated reference-only placements. All bodies are source-built. */
OUTPUT_FORMAT("elf32-powerpc")
OUTPUT_ARCH(powerpc)
ENTRY(k5a_grid_cell_slot_8001e1a0)
_SDA_BASE_ = 0x804b2540;
_SDA2_BASE_ = 0x804c2540;
FUN_8001df1c = 0x8001df1c;
SECTIONS {
  .text.k5a_grid_cell_slot_8001e1a0 0x8001e1a0 : { *(.text.k5a_grid_cell_slot_8001e1a0) }
  /DISCARD/ : { *(.text*) *(.rodata*) *(.data*) *(.bss*) *(.sdata*) *(.sbss*) *(.comment) }
}
