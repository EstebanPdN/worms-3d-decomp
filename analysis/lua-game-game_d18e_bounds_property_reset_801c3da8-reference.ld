/* Generated reference-only placements. All bodies are source-built. */
OUTPUT_FORMAT("elf32-powerpc")
OUTPUT_ARCH(powerpc)
ENTRY(w3d_d18e_reset_bounds_801c3da8)
_SDA_BASE_ = 0x804b2540;
_SDA2_BASE_ = 0x804c2540;
fn_801e8d9c = 0x801e8d9c;
fn_801ebbb8 = 0x801ebbb8;
fn_801f0504 = 0x801f0504;
key_803ac900 = 0x803ac900;
key_803ac924 = 0x803ac924;
key_803ac948 = 0x803ac948;
key_803ac970 = 0x803ac970;
key_803ac9a0 = 0x803ac9a0;
key_803ac9d0 = 0x803ac9d0;
value_803ac9f8 = 0x803ac9f8;
SECTIONS {
  .text.w3d_d18e_reset_bounds_801c3da8 0x801c3da8 : { *(.text.w3d_d18e_reset_bounds_801c3da8) }
  /DISCARD/ : { *(.text*) *(.rodata*) *(.data*) *(.bss*) *(.sdata*) *(.sbss*) *(.comment) }
}
