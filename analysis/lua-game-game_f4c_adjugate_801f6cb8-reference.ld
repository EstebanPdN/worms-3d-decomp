/* Generated reference-only placements. All bodies are source-built. */
OUTPUT_FORMAT("elf32-powerpc")
OUTPUT_ARCH(powerpc)
ENTRY(f4c_adjugate_801f6cb8)
_SDA_BASE_ = 0x804b2540;
_SDA2_BASE_ = 0x804c2540;
fn_801f7084 = 0x801f7084;
SECTIONS {
  .text.f4c_adjugate_801f6cb8 0x801f6cb8 : { *(.text.f4c_adjugate_801f6cb8) }
  /DISCARD/ : { *(.text*) *(.rodata*) *(.data*) *(.bss*) *(.sdata*) *(.sbss*) *(.comment) }
}
