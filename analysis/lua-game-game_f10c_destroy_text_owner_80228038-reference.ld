/* Generated reference-only placements. All bodies are source-built. */
OUTPUT_FORMAT("elf32-powerpc")
OUTPUT_ARCH(powerpc)
ENTRY(_._19F10c_80228038_Owner)
_SDA_BASE_ = 0x804b2540;
_SDA2_BASE_ = 0x804c2540;
_._27F10c_80228038_Base_801ea138 = 0x801ea138;
__dl__19F10c_80228038_OwnerPv = 0x801ea740;
fn_8020c5c4 = 0x8020c5c4;
fn_80341588 = 0x80341588;
vt_8041a118 = 0x8041a118;
SECTIONS {
  .text._._19F10c_80228038_Owner 0x80228038 : { *(.text._._19F10c_80228038_Owner) }
  /DISCARD/ : { *(.text*) *(.rodata*) *(.data*) *(.bss*) *(.sdata*) *(.sbss*) *(.comment) }
}
