/* Generated reference-only placements. All bodies are source-built. */
OUTPUT_FORMAT("elf32-powerpc")
OUTPUT_ARCH(powerpc)
ENTRY(d20d_text_range_width_8018c938)
_SDA_BASE_ = 0x804b2540;
_SDA2_BASE_ = 0x804c2540;
lbl_803a7e30 = 0x803a7e30;
w3d_auto_8018ca1c = 0x8018ca1c;
SECTIONS {
  .text.d20d_text_range_width_8018c938 0x8018c938 : { *(.text.d20d_text_range_width_8018c938) }
  /DISCARD/ : { *(.text*) *(.rodata*) *(.data*) *(.bss*) *(.sdata*) *(.sbss*) *(.comment) }
}
