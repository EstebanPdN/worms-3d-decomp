/* Generated reference-only placements. All bodies are source-built. */
OUTPUT_FORMAT("elf32-powerpc")
OUTPUT_ARCH(powerpc)
ENTRY(w3d_d22d_count_categories_8017d60c)
_SDA_BASE_ = 0x804b2540;
_SDA2_BASE_ = 0x804c2540;
fn_80170b2c = 0x80170b2c;
fn_8017453c = 0x8017453c;
fn_8017f540 = 0x8017f540;
fn_80187768 = 0x80187768;
fn_8018a800 = 0x8018a800;
fn_8020c5c0 = 0x8020c5c0;
fn_8020c5c4 = 0x8020c5c4;
fn_80341588 = 0x80341588;
fn_80341884 = 0x80341884;
memset = 0x802eefe0;
SECTIONS {
  .text.w3d_d22d_count_categories_8017d60c 0x8017d60c : { *(.text.w3d_d22d_count_categories_8017d60c) }
  /DISCARD/ : { *(.text*) *(.rodata*) *(.data*) *(.bss*) *(.sdata*) *(.sbss*) *(.comment) }
}
