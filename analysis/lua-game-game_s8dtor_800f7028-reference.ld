/* Generated reference-only placements. All bodies are source-built. */
OUTPUT_FORMAT("elf32-powerpc")
OUTPUT_ARCH(powerpc)
ENTRY(s8_destroy_800f7028)
_SDA_BASE_ = 0x804b2540;
_SDA2_BASE_ = 0x804c2540;
fn_8002a978 = 0x8002a978;
w3d_vtable_80410428 = 0x80410428;
SECTIONS {
  .text.s8_destroy_800f7028 0x800f7028 : { *(.text.s8_destroy_800f7028) }
  /DISCARD/ : { *(.text*) *(.rodata*) *(.data*) *(.bss*) *(.sdata*) *(.sbss*) *(.comment) }
}
