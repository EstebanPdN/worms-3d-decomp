/* Generated reference-only placements. All bodies are source-built. */
OUTPUT_FORMAT("elf32-powerpc")
OUTPUT_ARCH(powerpc)
ENTRY(w3d_d28k_heap_resize_802149d0)
_SDA_BASE_ = 0x804b2540;
_SDA2_BASE_ = 0x804c2540;
fn_80213d90 = 0x80213d90;
fn_80213f98 = 0x80213f98;
fn_80214344 = 0x80214344;
fn_80214718 = 0x80214718;
fn_80214894 = 0x80214894;
fn_802eee50 = 0x802eee50;
fn_802eefe0 = 0x802eefe0;
lbl_8040077c = 0x8040077c;
SECTIONS {
  .text.w3d_d28k_heap_resize_802149d0 0x802149d0 : { *(.text.w3d_d28k_heap_resize_802149d0) }
  /DISCARD/ : { *(.text*) *(.rodata*) *(.data*) *(.bss*) *(.sdata*) *(.sbss*) *(.comment) }
}
