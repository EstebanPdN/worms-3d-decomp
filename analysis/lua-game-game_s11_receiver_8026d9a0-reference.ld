/* Generated reference-only placements. All bodies are source-built. */
OUTPUT_FORMAT("elf32-powerpc")
OUTPUT_ARCH(powerpc)
ENTRY(s11_transfer_interface_8026d9a0)
_SDA_BASE_ = 0x804b2540;
_SDA2_BASE_ = 0x804c2540;
fn_8026DBE8 = 0x8026dbe8;
SECTIONS {
  .text.s11_transfer_interface_8026d9a0 0x8026d9a0 : { *(.text.s11_transfer_interface_8026d9a0) }
  /DISCARD/ : { *(.text*) *(.rodata*) *(.data*) *(.bss*) *(.sdata*) *(.sbss*) *(.comment) }
}
