/* Generated reference-only placements. All bodies are source-built. */
OUTPUT_FORMAT("elf32-powerpc")
OUTPUT_ARCH(powerpc)
ENTRY(f5b_update_tilt_targets_800285a8)
_SDA_BASE_ = 0x804b2540;
_SDA2_BASE_ = 0x804c2540;
fn_80028d10 = 0x80028d10;
fn_80028e10 = 0x80028e10;
fn_80028f48 = 0x80028f48;
fn_80178ec4 = 0x80178ec4;
SECTIONS {
  .text.f5b_update_tilt_targets_800285a8 0x800285a8 : { *(.text.f5b_update_tilt_targets_800285a8) }
  /DISCARD/ : { *(.text*) *(.rodata*) *(.data*) *(.bss*) *(.sdata*) *(.sbss*) *(.comment) }
}
