/* Generated reference-only placements. All bodies are source-built. */
OUTPUT_FORMAT("elf32-powerpc")
OUTPUT_ARCH(powerpc)
ENTRY(w3d_binding_create_801ecab4)
_SDA_BASE_ = 0x804b2540;
_SDA2_BASE_ = 0x804c2540;
__23W3dBindingBase_801eb058 = 0x801eb058;
__nw__19W3dBinding_80417360Ui = 0x801fe1d8;
__nw__19W3dBinding_80417cd0Ui = 0x801fe1d8;
fn_801e8bc4 = 0x801e8bc4;
fn_801eb0a8 = 0x801eb0a8;
w3d_vtable_80417360 = 0x80417360;
w3d_vtable_80417cd0 = 0x80417cd0;
SECTIONS {
  .text.w3d_binding_create_801ecab4 0x801ecab4 : { *(.text.w3d_binding_create_801ecab4) }
  .text.w3d_binding_create_801f00f0 0x801f00f0 : { *(.text.w3d_binding_create_801f00f0) }
  /DISCARD/ : { *(.text*) *(.rodata*) *(.data*) *(.bss*) *(.sdata*) *(.sbss*) *(.comment) }
}
