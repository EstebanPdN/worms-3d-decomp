/* Generated reference-only placements. All bodies are source-built. */
OUTPUT_FORMAT("elf32-powerpc")
OUTPUT_ARCH(powerpc)
ENTRY(d24d_open_package_8015c154)
_SDA_BASE_ = 0x804b2540;
_SDA2_BASE_ = 0x804c2540;
__20d24d_String_803426b8 = 0x803426b8;
d24d_archive_id_80418070 = 0x80418070;
d24d_service_8020b648 = 0x8020b648;
d24d_string_finish_8020c5c4 = 0x8020c5c4;
d24d_string_release_80341588 = 0x80341588;
d24d_string_suffix_8020c0fc = 0x8020c0fc;
d24d_string_to_lower_8020c230 = 0x8020c230;
d24d_zip_suffix_803a4360 = 0x803a4360;
strcmp = 0x802ef234;
SECTIONS {
  .text.d24d_open_package_8015c154 0x8015c154 : { *(.text.d24d_open_package_8015c154) }
  /DISCARD/ : { *(.text*) *(.rodata*) *(.data*) *(.bss*) *(.sdata*) *(.sbss*) *(.comment) }
}
