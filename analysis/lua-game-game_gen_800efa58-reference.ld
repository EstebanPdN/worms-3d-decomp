/* Generated reference-only placements. All bodies are source-built. */
OUTPUT_FORMAT("elf32-powerpc")
OUTPUT_ARCH(powerpc)
ENTRY(w3d_registry_unlink_800efa58)
_SDA_BASE_ = 0x804b2540;
_SDA2_BASE_ = 0x804c2540;
w3d_fn_800efb70 = 0x800efb70;
w3d_fn_800efbb4 = 0x800efbb4;
w3d_fn_800efe34 = 0x800efe34;
w3d_fn_800efec0 = 0x800efec0;
w3d_fn_800f0ea0 = 0x800f0ea0;
w3d_fn_800f0ef0 = 0x800f0ef0;
w3d_fn_800f1730 = 0x800f1730;
w3d_fn_800f177c = 0x800f177c;
w3d_fn_800f1e2c = 0x800f1e2c;
w3d_fn_800f1e88 = 0x800f1e88;
w3d_fn_800f2ad0 = 0x800f2ad0;
w3d_fn_800f2bac = 0x800f2bac;
w3d_fn_800f6fe4 = 0x800f6fe4;
w3d_fn_800f7028 = 0x800f7028;
w3d_fn_800f76cc = 0x800f76cc;
w3d_fn_800f7908 = 0x800f7908;
w3d_fn_800fd8c8 = 0x800fd8c8;
w3d_fn_800fd964 = 0x800fd964;
w3d_fn_800fe364 = 0x800fe364;
w3d_fn_800fe3a8 = 0x800fe3a8;
w3d_fn_800fe8f4 = 0x800fe8f4;
w3d_fn_800fe96c = 0x800fe96c;
w3d_fn_800ffe54 = 0x800ffe54;
w3d_fn_800fff24 = 0x800fff24;
w3d_global_80360ea0 = 0x80360ea0;
w3d_global_80360ed0 = 0x80360ed0;
w3d_global_80360f00 = 0x80360f00;
w3d_global_80360f30 = 0x80360f30;
w3d_global_80360f60 = 0x80360f60;
w3d_global_80360f90 = 0x80360f90;
w3d_global_80360fc0 = 0x80360fc0;
w3d_global_80360ff0 = 0x80360ff0;
w3d_global_80361020 = 0x80361020;
w3d_global_80361050 = 0x80361050;
w3d_global_80361080 = 0x80361080;
w3d_heap_allocate_entry_a = 0x801fe1d8;
w3d_owner_list_remove = 0x8020fd2c;
w3d_registry_list_80360e70 = 0x80360e70;
w3d_registry_list_80360ea0 = 0x80360ea0;
w3d_registry_list_80360ed0 = 0x80360ed0;
w3d_registry_list_80360f00 = 0x80360f00;
w3d_registry_list_80360f30 = 0x80360f30;
w3d_registry_list_80360f60 = 0x80360f60;
w3d_registry_list_80360f90 = 0x80360f90;
w3d_registry_list_80360fc0 = 0x80360fc0;
w3d_registry_list_80360ff0 = 0x80360ff0;
w3d_registry_list_80361020 = 0x80361020;
w3d_registry_list_80361050 = 0x80361050;
w3d_registry_list_80361080 = 0x80361080;
w3d_state_register = 0x8020fd04;
SECTIONS {
  .text.w3d_registry_unlink_800efa58 0x800efa58 : { *(.text.w3d_registry_unlink_800efa58) }
  .text.w3d_registry_create_800efa9c 0x800efa9c : { *(.text.w3d_registry_create_800efa9c) }
  .text.w3d_registry_release_800efafc 0x800efafc : { *(.text.w3d_registry_release_800efafc) }
  .text.w3d_registry_retain_800efb58 0x800efb58 : { *(.text.w3d_registry_retain_800efb58) }
  .text.w3d_constant_800efc78 0x800efc78 : { *(.text.w3d_constant_800efc78) }
  .text.w3d_empty_800efc80 0x800efc80 : { *(.text.w3d_empty_800efc80) }
  .text.w3d_address_800efd10 0x800efd10 : { *(.text.w3d_address_800efd10) }
  .text.w3d_registry_unlink_800efd1c 0x800efd1c : { *(.text.w3d_registry_unlink_800efd1c) }
  .text.w3d_registry_create_800efd60 0x800efd60 : { *(.text.w3d_registry_create_800efd60) }
  .text.w3d_registry_release_800efdc0 0x800efdc0 : { *(.text.w3d_registry_release_800efdc0) }
  .text.w3d_registry_retain_800efe1c 0x800efe1c : { *(.text.w3d_registry_retain_800efe1c) }
  .text.w3d_address_800f0d7c 0x800f0d7c : { *(.text.w3d_address_800f0d7c) }
  .text.w3d_registry_unlink_800f0d88 0x800f0d88 : { *(.text.w3d_registry_unlink_800f0d88) }
  .text.w3d_registry_create_800f0dcc 0x800f0dcc : { *(.text.w3d_registry_create_800f0dcc) }
  .text.w3d_registry_release_800f0e2c 0x800f0e2c : { *(.text.w3d_registry_release_800f0e2c) }
  .text.w3d_registry_retain_800f0e88 0x800f0e88 : { *(.text.w3d_registry_retain_800f0e88) }
  .text.w3d_address_800f160c 0x800f160c : { *(.text.w3d_address_800f160c) }
  .text.w3d_registry_unlink_800f1618 0x800f1618 : { *(.text.w3d_registry_unlink_800f1618) }
  .text.w3d_registry_create_800f165c 0x800f165c : { *(.text.w3d_registry_create_800f165c) }
  .text.w3d_registry_release_800f16bc 0x800f16bc : { *(.text.w3d_registry_release_800f16bc) }
  .text.w3d_registry_retain_800f1718 0x800f1718 : { *(.text.w3d_registry_retain_800f1718) }
  .text.w3d_empty_800f1a6c 0x800f1a6c : { *(.text.w3d_empty_800f1a6c) }
  .text.w3d_address_800f1d08 0x800f1d08 : { *(.text.w3d_address_800f1d08) }
  .text.w3d_registry_unlink_800f1d14 0x800f1d14 : { *(.text.w3d_registry_unlink_800f1d14) }
  .text.w3d_registry_create_800f1d58 0x800f1d58 : { *(.text.w3d_registry_create_800f1d58) }
  .text.w3d_registry_release_800f1db8 0x800f1db8 : { *(.text.w3d_registry_release_800f1db8) }
  .text.w3d_registry_retain_800f1e14 0x800f1e14 : { *(.text.w3d_registry_retain_800f1e14) }
  .text.w3d_empty_800f280c 0x800f280c : { *(.text.w3d_empty_800f280c) }
  .text.w3d_address_800f29ac 0x800f29ac : { *(.text.w3d_address_800f29ac) }
  .text.w3d_registry_unlink_800f29b8 0x800f29b8 : { *(.text.w3d_registry_unlink_800f29b8) }
  .text.w3d_registry_create_800f29fc 0x800f29fc : { *(.text.w3d_registry_create_800f29fc) }
  .text.w3d_registry_release_800f2a5c 0x800f2a5c : { *(.text.w3d_registry_release_800f2a5c) }
  .text.w3d_registry_retain_800f2ab8 0x800f2ab8 : { *(.text.w3d_registry_retain_800f2ab8) }
  .text.w3d_get_800f34f0 0x800f34f0 : { *(.text.w3d_get_800f34f0) }
  .text.w3d_address_800f6ec0 0x800f6ec0 : { *(.text.w3d_address_800f6ec0) }
  .text.w3d_registry_unlink_800f6ecc 0x800f6ecc : { *(.text.w3d_registry_unlink_800f6ecc) }
  .text.w3d_registry_create_800f6f10 0x800f6f10 : { *(.text.w3d_registry_create_800f6f10) }
  .text.w3d_registry_release_800f6f70 0x800f6f70 : { *(.text.w3d_registry_release_800f6f70) }
  .text.w3d_registry_retain_800f6fcc 0x800f6fcc : { *(.text.w3d_registry_retain_800f6fcc) }
  .text.w3d_constant_800f70e0 0x800f70e0 : { *(.text.w3d_constant_800f70e0) }
  .text.w3d_empty_800f70e8 0x800f70e8 : { *(.text.w3d_empty_800f70e8) }
  .text.w3d_empty_800f70ec 0x800f70ec : { *(.text.w3d_empty_800f70ec) }
  .text.w3d_empty_800f74cc 0x800f74cc : { *(.text.w3d_empty_800f74cc) }
  .text.w3d_set_800f7500 0x800f7500 : { *(.text.w3d_set_800f7500) }
  .text.w3d_get_800f7508 0x800f7508 : { *(.text.w3d_get_800f7508) }
  .text.w3d_set_800f7510 0x800f7510 : { *(.text.w3d_set_800f7510) }
  .text.w3d_get_800f7518 0x800f7518 : { *(.text.w3d_get_800f7518) }
  .text.w3d_set_800f7520 0x800f7520 : { *(.text.w3d_set_800f7520) }
  .text.w3d_get_800f7528 0x800f7528 : { *(.text.w3d_get_800f7528) }
  .text.w3d_address_800f75a8 0x800f75a8 : { *(.text.w3d_address_800f75a8) }
  .text.w3d_registry_unlink_800f75b4 0x800f75b4 : { *(.text.w3d_registry_unlink_800f75b4) }
  .text.w3d_registry_create_800f75f8 0x800f75f8 : { *(.text.w3d_registry_create_800f75f8) }
  .text.w3d_registry_release_800f7658 0x800f7658 : { *(.text.w3d_registry_release_800f7658) }
  .text.w3d_registry_retain_800f76b4 0x800f76b4 : { *(.text.w3d_registry_retain_800f76b4) }
  .text.w3d_address_800fd7a4 0x800fd7a4 : { *(.text.w3d_address_800fd7a4) }
  .text.w3d_registry_unlink_800fd7b0 0x800fd7b0 : { *(.text.w3d_registry_unlink_800fd7b0) }
  .text.w3d_registry_create_800fd7f4 0x800fd7f4 : { *(.text.w3d_registry_create_800fd7f4) }
  .text.w3d_registry_release_800fd854 0x800fd854 : { *(.text.w3d_registry_release_800fd854) }
  .text.w3d_registry_retain_800fd8b0 0x800fd8b0 : { *(.text.w3d_registry_retain_800fd8b0) }
  .text.w3d_empty_800fdc7c 0x800fdc7c : { *(.text.w3d_empty_800fdc7c) }
  .text.w3d_empty_800fdf58 0x800fdf58 : { *(.text.w3d_empty_800fdf58) }
  .text.w3d_address_800fe240 0x800fe240 : { *(.text.w3d_address_800fe240) }
  .text.w3d_registry_unlink_800fe24c 0x800fe24c : { *(.text.w3d_registry_unlink_800fe24c) }
  .text.w3d_registry_create_800fe290 0x800fe290 : { *(.text.w3d_registry_create_800fe290) }
  .text.w3d_registry_release_800fe2f0 0x800fe2f0 : { *(.text.w3d_registry_release_800fe2f0) }
  .text.w3d_registry_retain_800fe34c 0x800fe34c : { *(.text.w3d_registry_retain_800fe34c) }
  .text.w3d_constant_800fe4ac 0x800fe4ac : { *(.text.w3d_constant_800fe4ac) }
  .text.w3d_empty_800fe4fc 0x800fe4fc : { *(.text.w3d_empty_800fe4fc) }
  .text.w3d_address_800fe7d0 0x800fe7d0 : { *(.text.w3d_address_800fe7d0) }
  .text.w3d_registry_unlink_800fe7dc 0x800fe7dc : { *(.text.w3d_registry_unlink_800fe7dc) }
  .text.w3d_registry_create_800fe820 0x800fe820 : { *(.text.w3d_registry_create_800fe820) }
  .text.w3d_registry_release_800fe880 0x800fe880 : { *(.text.w3d_registry_release_800fe880) }
  .text.w3d_registry_retain_800fe8dc 0x800fe8dc : { *(.text.w3d_registry_retain_800fe8dc) }
  .text.w3d_set_800ffb58 0x800ffb58 : { *(.text.w3d_set_800ffb58) }
  .text.w3d_get_800ffb60 0x800ffb60 : { *(.text.w3d_get_800ffb60) }
  .text.w3d_address_800ffd30 0x800ffd30 : { *(.text.w3d_address_800ffd30) }
  .text.w3d_registry_unlink_800ffd3c 0x800ffd3c : { *(.text.w3d_registry_unlink_800ffd3c) }
  .text.w3d_registry_create_800ffd80 0x800ffd80 : { *(.text.w3d_registry_create_800ffd80) }
  .text.w3d_registry_release_800ffde0 0x800ffde0 : { *(.text.w3d_registry_release_800ffde0) }
  .text.w3d_registry_retain_800ffe3c 0x800ffe3c : { *(.text.w3d_registry_retain_800ffe3c) }
  /DISCARD/ : { *(.text*) *(.rodata*) *(.data*) *(.bss*) *(.sdata*) *(.sbss*) *(.comment) }
}
