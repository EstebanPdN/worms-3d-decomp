/* Generated reference-only placements. All bodies are source-built. */
OUTPUT_FORMAT("elf32-powerpc")
OUTPUT_ARCH(powerpc)
ENTRY(w3d_get_802321f4)
_SDA_BASE_ = 0x804b2540;
_SDA2_BASE_ = 0x804c2540;
SECTIONS {
  .text.w3d_get_802321f4 0x802321f4 : { *(.text.w3d_get_802321f4) }
  .text.w3d_set_802321fc 0x802321fc : { *(.text.w3d_set_802321fc) }
  .text.w3d_get_80232204 0x80232204 : { *(.text.w3d_get_80232204) }
  .text.w3d_set_8023220c 0x8023220c : { *(.text.w3d_set_8023220c) }
  .text.w3d_get_80232214 0x80232214 : { *(.text.w3d_get_80232214) }
  .text.w3d_set_8023221c 0x8023221c : { *(.text.w3d_set_8023221c) }
  .text.w3d_get_80232224 0x80232224 : { *(.text.w3d_get_80232224) }
  .text.w3d_set_8023230c 0x8023230c : { *(.text.w3d_set_8023230c) }
  .text.w3d_get_80232314 0x80232314 : { *(.text.w3d_get_80232314) }
  .text.w3d_set_802325bc 0x802325bc : { *(.text.w3d_set_802325bc) }
  .text.w3d_get_802325c4 0x802325c4 : { *(.text.w3d_get_802325c4) }
  .text.w3d_set_802325cc 0x802325cc : { *(.text.w3d_set_802325cc) }
  .text.w3d_get_802325d4 0x802325d4 : { *(.text.w3d_get_802325d4) }
  .text.w3d_set_802325dc 0x802325dc : { *(.text.w3d_set_802325dc) }
  .text.w3d_get_802325e4 0x802325e4 : { *(.text.w3d_get_802325e4) }
  .text.w3d_set_802326cc 0x802326cc : { *(.text.w3d_set_802326cc) }
  .text.w3d_get_802326d4 0x802326d4 : { *(.text.w3d_get_802326d4) }
  .text.w3d_set_802326dc 0x802326dc : { *(.text.w3d_set_802326dc) }
  .text.w3d_get_802326e4 0x802326e4 : { *(.text.w3d_get_802326e4) }
  .text.w3d_set_802326ec 0x802326ec : { *(.text.w3d_set_802326ec) }
  .text.w3d_get_802326f4 0x802326f4 : { *(.text.w3d_get_802326f4) }
  .text.w3d_set_802327dc 0x802327dc : { *(.text.w3d_set_802327dc) }
  .text.w3d_get_802327e4 0x802327e4 : { *(.text.w3d_get_802327e4) }
  .text.w3d_set_80232a8c 0x80232a8c : { *(.text.w3d_set_80232a8c) }
  .text.w3d_get_80232a94 0x80232a94 : { *(.text.w3d_get_80232a94) }
  .text.w3d_set_80232a9c 0x80232a9c : { *(.text.w3d_set_80232a9c) }
  .text.w3d_get_80232aa4 0x80232aa4 : { *(.text.w3d_get_80232aa4) }
  .text.w3d_set_80232aac 0x80232aac : { *(.text.w3d_set_80232aac) }
  .text.w3d_get_80232ab4 0x80232ab4 : { *(.text.w3d_get_80232ab4) }
  .text.w3d_set_80232b9c 0x80232b9c : { *(.text.w3d_set_80232b9c) }
  .text.w3d_get_80232ba4 0x80232ba4 : { *(.text.w3d_get_80232ba4) }
  .text.w3d_set_80232bac 0x80232bac : { *(.text.w3d_set_80232bac) }
  .text.w3d_get_80232bb4 0x80232bb4 : { *(.text.w3d_get_80232bb4) }
  .text.w3d_set_80232bbc 0x80232bbc : { *(.text.w3d_set_80232bbc) }
  .text.w3d_get_80232bc4 0x80232bc4 : { *(.text.w3d_get_80232bc4) }
  .text.w3d_set_80232cac 0x80232cac : { *(.text.w3d_set_80232cac) }
  .text.w3d_get_80232cb4 0x80232cb4 : { *(.text.w3d_get_80232cb4) }
  .text.w3d_set_80232f5c 0x80232f5c : { *(.text.w3d_set_80232f5c) }
  .text.w3d_get_80232f64 0x80232f64 : { *(.text.w3d_get_80232f64) }
  .text.w3d_set_80232f6c 0x80232f6c : { *(.text.w3d_set_80232f6c) }
  .text.w3d_get_80232f74 0x80232f74 : { *(.text.w3d_get_80232f74) }
  .text.w3d_set_80232f7c 0x80232f7c : { *(.text.w3d_set_80232f7c) }
  .text.w3d_get_80232f84 0x80232f84 : { *(.text.w3d_get_80232f84) }
  .text.w3d_set_8023306c 0x8023306c : { *(.text.w3d_set_8023306c) }
  .text.w3d_get_80233074 0x80233074 : { *(.text.w3d_get_80233074) }
  .text.w3d_set_8023307c 0x8023307c : { *(.text.w3d_set_8023307c) }
  .text.w3d_get_80233084 0x80233084 : { *(.text.w3d_get_80233084) }
  .text.w3d_set_8023308c 0x8023308c : { *(.text.w3d_set_8023308c) }
  .text.w3d_get_80233094 0x80233094 : { *(.text.w3d_get_80233094) }
  .text.w3d_set_8023317c 0x8023317c : { *(.text.w3d_set_8023317c) }
  .text.w3d_get_80233184 0x80233184 : { *(.text.w3d_get_80233184) }
  .text.w3d_set_8023342c 0x8023342c : { *(.text.w3d_set_8023342c) }
  .text.w3d_get_80233434 0x80233434 : { *(.text.w3d_get_80233434) }
  .text.w3d_set_8023343c 0x8023343c : { *(.text.w3d_set_8023343c) }
  .text.w3d_get_80233444 0x80233444 : { *(.text.w3d_get_80233444) }
  .text.w3d_set_8023344c 0x8023344c : { *(.text.w3d_set_8023344c) }
  .text.w3d_get_80233454 0x80233454 : { *(.text.w3d_get_80233454) }
  .text.w3d_set_8023353c 0x8023353c : { *(.text.w3d_set_8023353c) }
  .text.w3d_get_80233544 0x80233544 : { *(.text.w3d_get_80233544) }
  .text.w3d_set_8023354c 0x8023354c : { *(.text.w3d_set_8023354c) }
  .text.w3d_get_80233554 0x80233554 : { *(.text.w3d_get_80233554) }
  .text.w3d_set_8023355c 0x8023355c : { *(.text.w3d_set_8023355c) }
  .text.w3d_get_80233564 0x80233564 : { *(.text.w3d_get_80233564) }
  .text.w3d_set_802335dc 0x802335dc : { *(.text.w3d_set_802335dc) }
  .text.w3d_get_802335e4 0x802335e4 : { *(.text.w3d_get_802335e4) }
  .text.w3d_set_8023365c 0x8023365c : { *(.text.w3d_set_8023365c) }
  .text.w3d_get_80233664 0x80233664 : { *(.text.w3d_get_80233664) }
  .text.w3d_set_802336dc 0x802336dc : { *(.text.w3d_set_802336dc) }
  .text.w3d_get_802336e4 0x802336e4 : { *(.text.w3d_get_802336e4) }
  .text.w3d_set_802336ec 0x802336ec : { *(.text.w3d_set_802336ec) }
  .text.w3d_get_802336f4 0x802336f4 : { *(.text.w3d_get_802336f4) }
  .text.w3d_set_802336fc 0x802336fc : { *(.text.w3d_set_802336fc) }
  .text.w3d_get_80233704 0x80233704 : { *(.text.w3d_get_80233704) }
  .text.w3d_set_8023370c 0x8023370c : { *(.text.w3d_set_8023370c) }
  .text.w3d_get_80233714 0x80233714 : { *(.text.w3d_get_80233714) }
  .text.w3d_set_8023371c 0x8023371c : { *(.text.w3d_set_8023371c) }
  .text.w3d_get_80233724 0x80233724 : { *(.text.w3d_get_80233724) }
  .text.w3d_set_8023379c 0x8023379c : { *(.text.w3d_set_8023379c) }
  .text.w3d_get_802337a4 0x802337a4 : { *(.text.w3d_get_802337a4) }
  .text.w3d_get_80233880 0x80233880 : { *(.text.w3d_get_80233880) }
  /DISCARD/ : { *(.text*) *(.rodata*) *(.data*) *(.bss*) *(.sdata*) *(.sbss*) *(.comment) }
}
