/* Generated reference-only placements. All bodies are source-built. */
OUTPUT_FORMAT("elf32-powerpc")
OUTPUT_ARCH(powerpc)
ENTRY(f7b_heading_800dbaf4)
_SDA_BASE_ = 0x804b2540;
_SDA2_BASE_ = 0x804c2540;
__14F7HeadingBasisffff = 0x801f7538;
__20F7HeadingTranslation = 0x80343740;
one_80389878 = 0x80389878;
sqrt_802e82c0 = 0x802e82c0;
zero_80389874 = 0x80389874;
SECTIONS {
  .text.f7b_heading_800dbaf4 0x800dbaf4 : { *(.text.f7b_heading_800dbaf4) }
  /DISCARD/ : { *(.text*) *(.rodata*) *(.data*) *(.bss*) *(.sdata*) *(.sbss*) *(.comment) }
}
