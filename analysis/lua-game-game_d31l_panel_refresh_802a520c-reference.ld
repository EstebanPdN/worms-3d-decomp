/* Generated reference-only placements. All bodies are source-built. */
OUTPUT_FORMAT("elf32-powerpc")
OUTPUT_ARCH(powerpc)
ENTRY(d31l_panel_refresh_802a520c)
_SDA_BASE_ = 0x804b2540;
_SDA2_BASE_ = 0x804c2540;
__3StrPCc = 0x8020bb54;
fn_8015adf4 = 0x8015adf4;
fn_80173df0 = 0x80173df0;
fn_80173f88 = 0x80173f88;
fn_8020bd38 = 0x8020bd38;
fn_8020c510 = 0x8020c510;
fn_8020c5c0 = 0x8020c5c0;
fn_8020c5c4 = 0x8020c5c4;
fn_80263608 = 0x80263608;
fn_80263bb8 = 0x80263bb8;
fn_802a7998 = 0x802a7998;
fn_802b1510 = 0x802b1510;
fn_80341588 = 0x80341588;
fn_80341884 = 0x80341884;
fn_803426b8 = 0x803426b8;
fn_8034357c = 0x8034357c;
str_803d6024 = 0x803d6024;
str_803d6030 = 0x803d6030;
str_803d6054 = 0x803d6054;
str_803d605c = 0x803d605c;
str_803d6064 = 0x803d6064;
str_803d606c = 0x803d606c;
str_803d6070 = 0x803d6070;
str_803d60a4 = 0x803d60a4;
str_803d60ac = 0x803d60ac;
str_803d60c0 = 0x803d60c0;
SECTIONS {
  .text.d31l_panel_refresh_802a520c 0x802a520c : { *(.text.d31l_panel_refresh_802a520c) }
  .rodata 0x803d60cc : { *(.rodata) }
  /DISCARD/ : { *(.text*) *(.rodata*) *(.data*) *(.bss*) *(.sdata*) *(.sbss*) *(.comment) }
}
