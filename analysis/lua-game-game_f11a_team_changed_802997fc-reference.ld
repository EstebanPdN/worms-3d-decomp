/* Generated reference-only placements. All bodies are source-built. */
OUTPUT_FORMAT("elf32-powerpc")
OUTPUT_ARCH(powerpc)
ENTRY(w3d_f11a_team_changed_802997fc)
_SDA_BASE_ = 0x804b2540;
_SDA2_BASE_ = 0x804c2540;
__21F11aTeamText_803426b8 = 0x803426b8;
fn_800fc1b0 = 0x800fc1b0;
fn_800fc230 = 0x800fc230;
fn_800fc2b0 = 0x800fc2b0;
fn_801797b4 = 0x801797b4;
fn_8020bd38 = 0x8020bd38;
fn_8020c510 = 0x8020c510;
fn_8020c5c4 = 0x8020c5c4;
fn_802ef234 = 0x802ef234;
fn_80341584 = 0x80341584;
fn_80341588 = 0x80341588;
key_803d0940 = 0x803d0940;
key_803d0a0c = 0x803d0a0c;
key_803d0a20 = 0x803d0a20;
key_803d0a2c = 0x803d0a2c;
key_803d0a3c = 0x803d0a3c;
key_803d0a48 = 0x803d0a48;
key_803d0a54 = 0x803d0a54;
SECTIONS {
  .text.w3d_f11a_team_changed_802997fc 0x802997fc : { *(.text.w3d_f11a_team_changed_802997fc) }
  /DISCARD/ : { *(.text*) *(.rodata*) *(.data*) *(.bss*) *(.sdata*) *(.sbss*) *(.comment) }
}
