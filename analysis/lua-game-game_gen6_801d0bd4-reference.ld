/* Generated reference-only placements. All bodies are source-built. */
OUTPUT_FORMAT("elf32-powerpc")
OUTPUT_ARCH(powerpc)
ENTRY(w3d_getf_801d0bd4)
_SDA_BASE_ = 0x804b2540;
_SDA2_BASE_ = 0x804c2540;
w3d_data_803ea2f0 = 0x803ea2f0;
w3d_empty_801f9480 = 0x801f9480;
w3d_empty_80206a08 = 0x80206a08;
w3d_fn_801629f8 = 0x801629f8;
w3d_fn_801f92e4 = 0x801f92e4;
w3d_global_803618f0 = 0x803618f0;
w3d_global_80365aa8 = 0x80365aa8;
w3d_registry_create_8021caf4 = 0x8021caf4;
SECTIONS {
  .text.w3d_getf_801d0bd4 0x801d0bd4 : { *(.text.w3d_getf_801d0bd4) }
  .text.w3d_setf_801d0bdc 0x801d0bdc : { *(.text.w3d_setf_801d0bdc) }
  .text.w3d_getf_801d0be4 0x801d0be4 : { *(.text.w3d_getf_801d0be4) }
  .text.w3d_setf_801d0bec 0x801d0bec : { *(.text.w3d_setf_801d0bec) }
  .text.w3d_getf_801d0bf4 0x801d0bf4 : { *(.text.w3d_getf_801d0bf4) }
  .text.w3d_setf_801d0bfc 0x801d0bfc : { *(.text.w3d_setf_801d0bfc) }
  .text.w3d_getf_801d0c04 0x801d0c04 : { *(.text.w3d_getf_801d0c04) }
  .text.w3d_setf_801d0ce4 0x801d0ce4 : { *(.text.w3d_setf_801d0ce4) }
  .text.w3d_getf_801d0cec 0x801d0cec : { *(.text.w3d_getf_801d0cec) }
  .text.w3d_setf_801d0cf4 0x801d0cf4 : { *(.text.w3d_setf_801d0cf4) }
  .text.w3d_getf_801d0cfc 0x801d0cfc : { *(.text.w3d_getf_801d0cfc) }
  .text.w3d_setf_801d0d04 0x801d0d04 : { *(.text.w3d_setf_801d0d04) }
  .text.w3d_getf_801d0d0c 0x801d0d0c : { *(.text.w3d_getf_801d0d0c) }
  .text.w3d_setf_801d0d14 0x801d0d14 : { *(.text.w3d_setf_801d0d14) }
  .text.w3d_getf_801d0d1c 0x801d0d1c : { *(.text.w3d_getf_801d0d1c) }
  .text.w3d_setf_801d0d24 0x801d0d24 : { *(.text.w3d_setf_801d0d24) }
  .text.w3d_getf_801d0d2c 0x801d0d2c : { *(.text.w3d_getf_801d0d2c) }
  .text.w3d_member_801d0dd8 0x801d0dd8 : { *(.text.w3d_member_801d0dd8) }
  .text.w3d_member_801d0e18 0x801d0e18 : { *(.text.w3d_member_801d0e18) }
  .text.w3d_member_801d0e58 0x801d0e58 : { *(.text.w3d_member_801d0e58) }
  .text.w3d_member_801d0e98 0x801d0e98 : { *(.text.w3d_member_801d0e98) }
  .text.w3d_getf_801d0f38 0x801d0f38 : { *(.text.w3d_getf_801d0f38) }
  .text.w3d_getf_801d0f98 0x801d0f98 : { *(.text.w3d_getf_801d0f98) }
  .text.w3d_getf_801d1158 0x801d1158 : { *(.text.w3d_getf_801d1158) }
  .text.w3d_getf_801d1178 0x801d1178 : { *(.text.w3d_getf_801d1178) }
  .text.w3d_getf_801d11f8 0x801d11f8 : { *(.text.w3d_getf_801d11f8) }
  .text.w3d_getf_801d1218 0x801d1218 : { *(.text.w3d_getf_801d1218) }
  .text.w3d_member_801d1318 0x801d1318 : { *(.text.w3d_member_801d1318) }
  .text.w3d_member_801d1398 0x801d1398 : { *(.text.w3d_member_801d1398) }
  .text.w3d_getf_801d13b8 0x801d13b8 : { *(.text.w3d_getf_801d13b8) }
  .text.w3d_getf_801d13d8 0x801d13d8 : { *(.text.w3d_getf_801d13d8) }
  .text.w3d_getf_801d13f8 0x801d13f8 : { *(.text.w3d_getf_801d13f8) }
  .text.w3d_getf_801d1418 0x801d1418 : { *(.text.w3d_getf_801d1418) }
  .text.w3d_getf_801d1438 0x801d1438 : { *(.text.w3d_getf_801d1438) }
  .text.w3d_member_801d14e8 0x801d14e8 : { *(.text.w3d_member_801d14e8) }
  .text.w3d_setf_801d160c 0x801d160c : { *(.text.w3d_setf_801d160c) }
  .text.w3d_getf_801d1614 0x801d1614 : { *(.text.w3d_getf_801d1614) }
  .text.w3d_member_801d1764 0x801d1764 : { *(.text.w3d_member_801d1764) }
  .text.w3d_member_801d1790 0x801d1790 : { *(.text.w3d_member_801d1790) }
  .text.w3d_member_801d17bc 0x801d17bc : { *(.text.w3d_member_801d17bc) }
  .text.w3d_getf_801d17dc 0x801d17dc : { *(.text.w3d_getf_801d17dc) }
  .text.w3d_member_801d1888 0x801d1888 : { *(.text.w3d_member_801d1888) }
  .text.w3d_getf_801dcc08 0x801dcc08 : { *(.text.w3d_getf_801dcc08) }
  .text.w3d_getf_801de9c8 0x801de9c8 : { *(.text.w3d_getf_801de9c8) }
  .text.w3d_getf_801de9dc 0x801de9dc : { *(.text.w3d_getf_801de9dc) }
  .text.w3d_getf_801de9f0 0x801de9f0 : { *(.text.w3d_getf_801de9f0) }
  .text.w3d_getf_801df1b4 0x801df1b4 : { *(.text.w3d_getf_801df1b4) }
  .text.w3d_getf_801df1bc 0x801df1bc : { *(.text.w3d_getf_801df1bc) }
  .text.w3d_getf_801df1c4 0x801df1c4 : { *(.text.w3d_getf_801df1c4) }
  .text.w3d_getf_801df1cc 0x801df1cc : { *(.text.w3d_getf_801df1cc) }
  .text.w3d_getf_801df1d4 0x801df1d4 : { *(.text.w3d_getf_801df1d4) }
  .text.w3d_setf_801df1fc 0x801df1fc : { *(.text.w3d_setf_801df1fc) }
  .text.w3d_setf_801df204 0x801df204 : { *(.text.w3d_setf_801df204) }
  .text.w3d_registry_release_801f91d4 0x801f91d4 : { *(.text.w3d_registry_release_801f91d4) }
  .text.w3d_member_801fac44 0x801fac44 : { *(.text.w3d_member_801fac44) }
  .text.w3d_member_801fac4c 0x801fac4c : { *(.text.w3d_member_801fac4c) }
  .text.w3d_member_801fac54 0x801fac54 : { *(.text.w3d_member_801fac54) }
  .text.w3d_static_init_80206a0c 0x80206a0c : { *(.text.w3d_static_init_80206a0c) }
  .text.w3d_sinit_body_8021cf8c 0x8021cf8c : { *(.text.w3d_sinit_body_8021cf8c) }
  .text.w3d_copy12_8022ee3c 0x8022ee3c : { *(.text.w3d_copy12_8022ee3c) }
  .text.w3d_member_8022ee5c 0x8022ee5c : { *(.text.w3d_member_8022ee5c) }
  .text.w3d_copy12_8022ee64 0x8022ee64 : { *(.text.w3d_copy12_8022ee64) }
  .text.w3d_member_8022ee84 0x8022ee84 : { *(.text.w3d_member_8022ee84) }
  .text.w3d_member_8022eef4 0x8022eef4 : { *(.text.w3d_member_8022eef4) }
  .text.w3d_member_8022ef64 0x8022ef64 : { *(.text.w3d_member_8022ef64) }
  .text.w3d_member_8022efd4 0x8022efd4 : { *(.text.w3d_member_8022efd4) }
  .text.w3d_member_8022f044 0x8022f044 : { *(.text.w3d_member_8022f044) }
  .text.w3d_member_8022f0b4 0x8022f0b4 : { *(.text.w3d_member_8022f0b4) }
  .text.w3d_member_8022f124 0x8022f124 : { *(.text.w3d_member_8022f124) }
  .text.w3d_member_8022f194 0x8022f194 : { *(.text.w3d_member_8022f194) }
  .text.w3d_member_8022f204 0x8022f204 : { *(.text.w3d_member_8022f204) }
  .text.w3d_member_8022f274 0x8022f274 : { *(.text.w3d_member_8022f274) }
  .text.w3d_member_8022f2e4 0x8022f2e4 : { *(.text.w3d_member_8022f2e4) }
  .text.w3d_setf_8022f2ec 0x8022f2ec : { *(.text.w3d_setf_8022f2ec) }
  .text.w3d_getf_8022f2f4 0x8022f2f4 : { *(.text.w3d_getf_8022f2f4) }
  .text.w3d_member_8022f364 0x8022f364 : { *(.text.w3d_member_8022f364) }
  /DISCARD/ : { *(.text*) *(.rodata*) *(.data*) *(.bss*) *(.sdata*) *(.sbss*) *(.comment) }
}
