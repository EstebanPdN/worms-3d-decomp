/* Generated reference-only placements. All bodies are source-built. */
OUTPUT_FORMAT("elf32-powerpc")
OUTPUT_ARCH(powerpc)
ENTRY(d28f_fill_held_array_80294408)
_SDA_BASE_ = 0x804b2540;
_SDA2_BASE_ = 0x804c2540;
w3d_auto_801750d4 = 0x801750d4;
w3d_k5b_array_ref_lock_8 = 0x801ef048;
SECTIONS {
  .text.d28f_fill_held_array_80294408 0x80294408 : { *(.text.d28f_fill_held_array_80294408) }
  /DISCARD/ : { *(.text*) *(.rodata*) *(.data*) *(.bss*) *(.sdata*) *(.sbss*) *(.comment) }
}
