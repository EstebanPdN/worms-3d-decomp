/* Generated reference-only placements. All bodies are source-built. */
OUTPUT_FORMAT("elf32-powerpc")
OUTPUT_ARCH(powerpc)
ENTRY(d33f_card_screen_ctor_80287f64)
_SDA_BASE_ = 0x804b2540;
_SDA2_BASE_ = 0x804c2540;
lbl_803cf8a8 = 0x803cf8a8;
lbl_803cf8ac = 0x803cf8ac;
lbl_803cf8b0 = 0x803cf8b0;
lbl_803cf8b4 = 0x803cf8b4;
lbl_8041c050 = 0x8041c050;
w3d_ctor_801628b0 = 0x801628b0;
w3d_cx9c_ceilf_802e85fc = 0x802e85fc;
SECTIONS {
  .text.d33f_card_screen_ctor_80287f64 0x80287f64 : { *(.text.d33f_card_screen_ctor_80287f64) }
  /DISCARD/ : { *(.text*) *(.rodata*) *(.data*) *(.bss*) *(.sdata*) *(.sbss*) *(.comment) }
}
