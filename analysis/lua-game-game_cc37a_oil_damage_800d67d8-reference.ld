/* Generated reference-only placements. All bodies are source-built. */
OUTPUT_FORMAT("elf32-powerpc")
OUTPUT_ARCH(powerpc)
ENTRY(cc37a_oil_damage_800d67d8)
_SDA_BASE_ = 0x804b2540;
_SDA2_BASE_ = 0x804c2540;
cc37a_context_80165254 = 0x80165254;
cc37a_file_80388e94 = 0x80388e94;
cc37a_log_80022e20 = 0x80022e20;
cc37a_text_80388e78 = 0x80388e78;
cc37a_type_80361860 = 0x80361860;
cc37a_type_803618f0 = 0x803618f0;
SECTIONS {
  .text.cc37a_oil_damage_800d67d8 0x800d67d8 : { *(.text.cc37a_oil_damage_800d67d8) }
  /DISCARD/ : { *(.text*) *(.rodata*) *(.data*) *(.bss*) *(.sdata*) *(.sbss*) *(.comment) }
}
