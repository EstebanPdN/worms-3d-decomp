/* Generated reference-only placements. All bodies are source-built. */
OUTPUT_FORMAT("elf32-powerpc")
OUTPUT_ARCH(powerpc)
ENTRY(w3d_f2a_initialize_orientation_8002d2c8)
_SDA_BASE_ = 0x804b2540;
_SDA2_BASE_ = 0x804c2540;
fn_800fc6dc = 0x800fc6dc;
fn_80178c48 = 0x80178c48;
fn_80178df0 = 0x80178df0;
fn_802e86d4 = 0x802e86d4;
fn_802e88ac = 0x802e88ac;
lbl_80372964 = 0x80372964;
lbl_80372968 = 0x80372968;
SECTIONS {
  .text.w3d_f2a_initialize_orientation_8002d2c8 0x8002d2c8 : { *(.text.w3d_f2a_initialize_orientation_8002d2c8) }
  /DISCARD/ : { *(.text*) *(.rodata*) *(.data*) *(.bss*) *(.sdata*) *(.sbss*) *(.comment) }
}
