/* Generated reference-only placements. All bodies are source-built. */
OUTPUT_FORMAT("elf32-powerpc")
OUTPUT_ARCH(powerpc)
ENTRY(w3d_cx12a_query_selected_delta_80035b50)
_SDA_BASE_ = 0x804b2540;
_SDA2_BASE_ = 0x804c2540;
query_800b0788 = 0x800b0788;
SECTIONS {
  .text.w3d_cx12a_query_selected_delta_80035b50 0x80035b50 : { *(.text.w3d_cx12a_query_selected_delta_80035b50) }
  /DISCARD/ : { *(.text*) *(.rodata*) *(.data*) *(.bss*) *(.sdata*) *(.sbss*) *(.comment) }
}
