/* Generated reference-only placements. All bodies are source-built. */
OUTPUT_FORMAT("elf32-powerpc")
OUTPUT_ARCH(powerpc)
ENTRY(f9b_weapon_voice_8013bbc8)
_SDA_BASE_ = 0x804b2540;
_SDA2_BASE_ = 0x804c2540;
a_8039f834 = 0x8039f834;
dragon_8039f848 = 0x8039f848;
fireball_8039f854 = 0x8039f854;
get_800fc230 = 0x800fc230;
incoming_8039f860 = 0x8039f860;
laugh_8039f190 = 0x8039f190;
option_8039f824 = 0x8039f824;
orders_8039f86c = 0x8039f86c;
random_80162c20 = 0x80162c20;
record_800fc6dc = 0x800fc6dc;
say_8013bd0c = 0x8013bd0c;
watch_8039f83c = 0x8039f83c;
yes_8039f874 = 0x8039f874;
SECTIONS {
  .text.f9b_weapon_voice_8013bbc8 0x8013bbc8 : { *(.text.f9b_weapon_voice_8013bbc8) }
  /DISCARD/ : { *(.text*) *(.rodata*) *(.data*) *(.bss*) *(.sdata*) *(.sbss*) *(.comment) }
}
