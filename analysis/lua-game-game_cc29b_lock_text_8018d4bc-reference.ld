/* Generated reference-only placements. All bodies are source-built. */
OUTPUT_FORMAT("elf32-powerpc")
OUTPUT_ARCH(powerpc)
ENTRY(w3d_cc29b_lock_text_8018d4bc)
_SDA_BASE_ = 0x804b2540;
_SDA2_BASE_ = 0x804c2540;
fn_801ef048 = 0x801ef048;
fn_8034435c = 0x8034435c;
SECTIONS {
  .text.w3d_cc29b_lock_text_8018d4bc 0x8018d4bc : { *(.text.w3d_cc29b_lock_text_8018d4bc) }
  /DISCARD/ : { *(.text*) *(.rodata*) *(.data*) *(.bss*) *(.sdata*) *(.sbss*) *(.comment) }
}
