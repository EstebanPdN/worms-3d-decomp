/* Generated reference-only placements. All bodies are source-built. */
OUTPUT_FORMAT("elf32-powerpc")
OUTPUT_ARCH(powerpc)
ENTRY(w3d_cx7c_bucket_capacity_8035c518)
_SDA_BASE_ = 0x804b2540;
_SDA2_BASE_ = 0x804c2540;
cx7c_prime_lower_bound_8035c4d0 = 0x8035c4d0;
cx7c_prime_table_803e7650 = 0x803e7650;
cx7c_tag_initialize_8035c4c4 = 0x8035c4c4;
SECTIONS {
  .text.w3d_cx7c_bucket_capacity_8035c518 0x8035c518 : { *(.text.w3d_cx7c_bucket_capacity_8035c518) }
  /DISCARD/ : { *(.text*) *(.rodata*) *(.data*) *(.bss*) *(.sdata*) *(.sbss*) *(.comment) }
}
