/* Generated reference-only placements. All bodies are source-built. */
OUTPUT_FORMAT("elf32-powerpc")
OUTPUT_ARCH(powerpc)
ENTRY(w3d_d24k_entity_properties_8023cd2c)
_SDA_BASE_ = 0x804b2540;
_SDA2_BASE_ = 0x804c2540;
constant_803bc3b0 = 0x803bc3b0;
d20e_empty_804b06a0 = 0x804b06a0;
d20e_release_header_8020bb2c = 0x8020bb2c;
d20e_string_finish_8020c5c4 = 0x8020c5c4;
d20e_string_header_80341884 = 0x80341884;
d20e_string_init_8020c5c0 = 0x8020c5c0;
d20e_string_release_80341588 = 0x80341588;
desc_803bbed4 = 0x803bbed4;
desc_803bbf04 = 0x803bbf04;
desc_803bbf38 = 0x803bbf38;
desc_803bbf74 = 0x803bbf74;
desc_803bbfa4 = 0x803bbfa4;
desc_803bbfd8 = 0x803bbfd8;
desc_803bc00c = 0x803bc00c;
desc_803bc040 = 0x803bc040;
desc_803bc074 = 0x803bc074;
desc_803bc0a8 = 0x803bc0a8;
desc_803bc0d8 = 0x803bc0d8;
desc_803bc108 = 0x803bc108;
desc_803bc138 = 0x803bc138;
desc_803bc16c = 0x803bc16c;
desc_803bc198 = 0x803bc198;
desc_803bc1c8 = 0x803bc1c8;
desc_803bc1fc = 0x803bc1fc;
desc_803bc22c = 0x803bc22c;
desc_803bc260 = 0x803bc260;
desc_803bc294 = 0x803bc294;
desc_803bc2c0 = 0x803bc2c0;
desc_803bc2f0 = 0x803bc2f0;
desc_803bc320 = 0x803bc320;
desc_803bc354 = 0x803bc354;
desc_803bc388 = 0x803bc388;
fn_801e8d9c = 0x801e8d9c;
fn_801ebf38 = 0x801ebf38;
fn_801ec52c = 0x801ec52c;
fn_801ecc6c = 0x801ecc6c;
fn_801ed24c = 0x801ed24c;
fn_801f0210 = 0x801f0210;
fn_801f0d2c = 0x801f0d2c;
matrix_8045e708 = 0x8045e708;
SECTIONS {
  .text.w3d_d24k_entity_properties_8023cd2c 0x8023cd2c : { *(.text.w3d_d24k_entity_properties_8023cd2c) }
  /DISCARD/ : { *(.text*) *(.rodata*) *(.data*) *(.bss*) *(.sdata*) *(.sbss*) *(.comment) }
}
