/* Generated reference-only placements. All bodies are source-built. */
OUTPUT_FORMAT("elf32-powerpc")
OUTPUT_ARCH(powerpc)
ENTRY(w3d_d41e_heap_config_802092c8)
_SDA_BASE_ = 0x804b2540;
_SDA2_BASE_ = 0x804c2540;
lbl_803b2ee4 = 0x803b2ee4;
lbl_803b2ef4 = 0x803b2ef4;
lbl_803b2f00 = 0x803b2f00;
lbl_803b2f18 = 0x803b2f18;
tsonnet_c26_lookup_int_80206920 = 0x80206920;
w3d_d30e_heap_init_8020941c = 0x8020941c;
w3d_empty_802092c0 = 0x802092c0;
w3d_empty_802092c4 = 0x802092c4;
w3d_format_into_8034cb64 = 0x8034cb64;
w3d_get_802092b8 = 0x802092b8;
SECTIONS {
  .text.w3d_d41e_heap_config_802092c8 0x802092c8 : { *(.text.w3d_d41e_heap_config_802092c8) }
  /DISCARD/ : { *(.text*) *(.rodata*) *(.data*) *(.bss*) *(.sdata*) *(.sbss*) *(.comment) }
}
