/* Generated reference-only placements. All bodies are source-built. */
OUTPUT_FORMAT("elf32-powerpc")
OUTPUT_ARCH(powerpc)
ENTRY(w3d_s10_cleanup_801b2dac)
_SDA_BASE_ = 0x804b2540;
_SDA2_BASE_ = 0x804c2540;
fn_801FE1F8 = 0x801fe1f8;
fn_8020C5C4 = 0x8020c5c4;
fn_80210990 = 0x80210990;
fn_80210ABC = 0x80210abc;
fn_802134FC = 0x802134fc;
fn_80341588 = 0x80341588;
lbl_804143F0 = 0x804143f0;
lbl_80414430 = 0x80414430;
SECTIONS {
  .text.w3d_s10_cleanup_801b2dac 0x801b2dac : { *(.text.w3d_s10_cleanup_801b2dac) }
  /DISCARD/ : { *(.text*) *(.rodata*) *(.data*) *(.bss*) *(.sdata*) *(.sbss*) *(.comment) }
}
