/* Generated reference-only placements. All bodies are source-built. */
OUTPUT_FORMAT("elf32-powerpc")
OUTPUT_ARCH(powerpc)
ENTRY(d26f_scroll_or_page_edit_page_802737d8)
_SDA_BASE_ = 0x804b2540;
_SDA2_BASE_ = 0x804c2540;
__17D26fText_803426b8 = 0x803426b8;
lbl_803cc0d8 = 0x803cc0d8;
lbl_803cc8b4 = 0x803cc8b4;
lbl_803cc9f0 = 0x803cc9f0;
lbl_803cca10 = 0x803cca10;
lbl_803ccaa4 = 0x803ccaa4;
lbl_803cce08 = 0x803cce08;
lbl_803cce1c = 0x803cce1c;
lbl_803cce3c = 0x803cce3c;
lbl_803cce5c = 0x803cce5c;
lbl_803cce7c = 0x803cce7c;
lbl_803cce9c = 0x803cce9c;
lbl_803ccebc = 0x803ccebc;
lbl_803ccedc = 0x803ccedc;
lbl_803ccefc = 0x803ccefc;
w3d_auto_802cbf2c = 0x802cbf2c;
w3d_auto_802cd128 = 0x802cd128;
w3d_cc32b_append_lines_v2_802cc0ac = 0x802cc0ac;
w3d_cx7b_script_flag_set_8027a934 = 0x8027a934;
w3d_dtor_node_8020d36c = 0x8020d36c;
w3d_registry_retain_8020d2b8 = 0x8020d2b8;
w3d_s21_append_position_802cd26c = 0x802cd26c;
w3d_s21_repeat_request_802cd220 = 0x802cd220;
w3d_s21_sink_write_indexed_802cbdf8 = 0x802cbdf8;
w3d_s21_vector_get_801e9db8 = 0x801e9db8;
w3d_string_base_finish = 0x8020c5c4;
w3d_string_release = 0x80341588;
w3d_tagged_construct_8020d318 = 0x8020d318;
SECTIONS {
  .text.d26f_scroll_or_page_edit_page_802737d8 0x802737d8 : { *(.text.d26f_scroll_or_page_edit_page_802737d8) }
  /DISCARD/ : { *(.text*) *(.rodata*) *(.data*) *(.bss*) *(.sdata*) *(.sbss*) *(.comment) }
}
