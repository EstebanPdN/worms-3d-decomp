/* Generated reference-only placements. All bodies are source-built. */
OUTPUT_FORMAT("elf32-powerpc")
OUTPUT_ARCH(powerpc)
ENTRY(w3d_member_802588bc)
_SDA_BASE_ = 0x804b2540;
_SDA2_BASE_ = 0x804c2540;
SECTIONS {
  .text.w3d_member_802588bc 0x802588bc : { *(.text.w3d_member_802588bc) }
  .text.w3d_member_8025892c 0x8025892c : { *(.text.w3d_member_8025892c) }
  .text.w3d_member_80258abc 0x80258abc : { *(.text.w3d_member_80258abc) }
  .text.w3d_setf_80258ac4 0x80258ac4 : { *(.text.w3d_setf_80258ac4) }
  .text.w3d_getf_80258acc 0x80258acc : { *(.text.w3d_getf_80258acc) }
  .text.w3d_setf_80258ad4 0x80258ad4 : { *(.text.w3d_setf_80258ad4) }
  .text.w3d_getf_80258adc 0x80258adc : { *(.text.w3d_getf_80258adc) }
  .text.w3d_member_80258b4c 0x80258b4c : { *(.text.w3d_member_80258b4c) }
  .text.w3d_member_80258bbc 0x80258bbc : { *(.text.w3d_member_80258bbc) }
  .text.w3d_member_80258c2c 0x80258c2c : { *(.text.w3d_member_80258c2c) }
  .text.w3d_member_80258c9c 0x80258c9c : { *(.text.w3d_member_80258c9c) }
  .text.w3d_member_80258d0c 0x80258d0c : { *(.text.w3d_member_80258d0c) }
  .text.w3d_member_80258d7c 0x80258d7c : { *(.text.w3d_member_80258d7c) }
  .text.w3d_setf_80258d84 0x80258d84 : { *(.text.w3d_setf_80258d84) }
  .text.w3d_getf_80258d8c 0x80258d8c : { *(.text.w3d_getf_80258d8c) }
  .text.w3d_setf_80258d94 0x80258d94 : { *(.text.w3d_setf_80258d94) }
  .text.w3d_getf_80258d9c 0x80258d9c : { *(.text.w3d_getf_80258d9c) }
  .text.w3d_setf_80258da4 0x80258da4 : { *(.text.w3d_setf_80258da4) }
  .text.w3d_getf_80258dac 0x80258dac : { *(.text.w3d_getf_80258dac) }
  .text.w3d_setf_80258db4 0x80258db4 : { *(.text.w3d_setf_80258db4) }
  .text.w3d_getf_80258dbc 0x80258dbc : { *(.text.w3d_getf_80258dbc) }
  .text.w3d_setf_80258dc4 0x80258dc4 : { *(.text.w3d_setf_80258dc4) }
  .text.w3d_getf_80258dcc 0x80258dcc : { *(.text.w3d_getf_80258dcc) }
  .text.w3d_setf_80258dd4 0x80258dd4 : { *(.text.w3d_setf_80258dd4) }
  .text.w3d_getf_80258ddc 0x80258ddc : { *(.text.w3d_getf_80258ddc) }
  .text.w3d_setf_80258df4 0x80258df4 : { *(.text.w3d_setf_80258df4) }
  .text.w3d_getf_80258dfc 0x80258dfc : { *(.text.w3d_getf_80258dfc) }
  .text.w3d_setf_80258e84 0x80258e84 : { *(.text.w3d_setf_80258e84) }
  .text.w3d_getf_80258e8c 0x80258e8c : { *(.text.w3d_getf_80258e8c) }
  .text.w3d_setf_80258e94 0x80258e94 : { *(.text.w3d_setf_80258e94) }
  .text.w3d_getf_80258e9c 0x80258e9c : { *(.text.w3d_getf_80258e9c) }
  .text.w3d_setf_80258ea4 0x80258ea4 : { *(.text.w3d_setf_80258ea4) }
  .text.w3d_getf_80258eac 0x80258eac : { *(.text.w3d_getf_80258eac) }
  .text.w3d_setf_80258eb4 0x80258eb4 : { *(.text.w3d_setf_80258eb4) }
  .text.w3d_getf_80258ebc 0x80258ebc : { *(.text.w3d_getf_80258ebc) }
  .text.w3d_setf_80258ec4 0x80258ec4 : { *(.text.w3d_setf_80258ec4) }
  .text.w3d_getf_80258ecc 0x80258ecc : { *(.text.w3d_getf_80258ecc) }
  .text.w3d_setf_80258ed4 0x80258ed4 : { *(.text.w3d_setf_80258ed4) }
  .text.w3d_getf_80258edc 0x80258edc : { *(.text.w3d_getf_80258edc) }
  .text.w3d_setf_80258ee4 0x80258ee4 : { *(.text.w3d_setf_80258ee4) }
  .text.w3d_getf_80258eec 0x80258eec : { *(.text.w3d_getf_80258eec) }
  .text.w3d_setf_80258f04 0x80258f04 : { *(.text.w3d_setf_80258f04) }
  .text.w3d_getf_80258f0c 0x80258f0c : { *(.text.w3d_getf_80258f0c) }
  .text.w3d_setf_80258f14 0x80258f14 : { *(.text.w3d_setf_80258f14) }
  .text.w3d_getf_80258f1c 0x80258f1c : { *(.text.w3d_getf_80258f1c) }
  .text.w3d_setf_80258f24 0x80258f24 : { *(.text.w3d_setf_80258f24) }
  .text.w3d_getf_80258f2c 0x80258f2c : { *(.text.w3d_getf_80258f2c) }
  .text.w3d_setf_80258f34 0x80258f34 : { *(.text.w3d_setf_80258f34) }
  .text.w3d_getf_80258f3c 0x80258f3c : { *(.text.w3d_getf_80258f3c) }
  .text.w3d_setf_80258f54 0x80258f54 : { *(.text.w3d_setf_80258f54) }
  .text.w3d_getf_80258f5c 0x80258f5c : { *(.text.w3d_getf_80258f5c) }
  .text.w3d_setf_80258f64 0x80258f64 : { *(.text.w3d_setf_80258f64) }
  .text.w3d_getf_80258f6c 0x80258f6c : { *(.text.w3d_getf_80258f6c) }
  .text.w3d_copy12_80258f74 0x80258f74 : { *(.text.w3d_copy12_80258f74) }
  .text.w3d_member_80258f94 0x80258f94 : { *(.text.w3d_member_80258f94) }
  .text.w3d_setf_80258f9c 0x80258f9c : { *(.text.w3d_setf_80258f9c) }
  .text.w3d_getf_80258fa4 0x80258fa4 : { *(.text.w3d_getf_80258fa4) }
  .text.w3d_setf_80258fbc 0x80258fbc : { *(.text.w3d_setf_80258fbc) }
  .text.w3d_getf_80258fc4 0x80258fc4 : { *(.text.w3d_getf_80258fc4) }
  .text.w3d_setf_80258fcc 0x80258fcc : { *(.text.w3d_setf_80258fcc) }
  .text.w3d_getf_80258fd4 0x80258fd4 : { *(.text.w3d_getf_80258fd4) }
  .text.w3d_setf_80258fdc 0x80258fdc : { *(.text.w3d_setf_80258fdc) }
  .text.w3d_getf_80258fe4 0x80258fe4 : { *(.text.w3d_getf_80258fe4) }
  .text.w3d_member_80259054 0x80259054 : { *(.text.w3d_member_80259054) }
  .text.w3d_member_802590c4 0x802590c4 : { *(.text.w3d_member_802590c4) }
  .text.w3d_member_80259134 0x80259134 : { *(.text.w3d_member_80259134) }
  .text.w3d_member_802591a4 0x802591a4 : { *(.text.w3d_member_802591a4) }
  .text.w3d_member_80259214 0x80259214 : { *(.text.w3d_member_80259214) }
  .text.w3d_member_80259284 0x80259284 : { *(.text.w3d_member_80259284) }
  .text.w3d_member_802592f4 0x802592f4 : { *(.text.w3d_member_802592f4) }
  .text.w3d_member_80259364 0x80259364 : { *(.text.w3d_member_80259364) }
  .text.w3d_member_802593d4 0x802593d4 : { *(.text.w3d_member_802593d4) }
  .text.w3d_member_80259444 0x80259444 : { *(.text.w3d_member_80259444) }
  .text.w3d_member_802594c4 0x802594c4 : { *(.text.w3d_member_802594c4) }
  .text.w3d_member_80259534 0x80259534 : { *(.text.w3d_member_80259534) }
  .text.w3d_member_802595a4 0x802595a4 : { *(.text.w3d_member_802595a4) }
  .text.w3d_member_80259614 0x80259614 : { *(.text.w3d_member_80259614) }
  .text.w3d_member_80259684 0x80259684 : { *(.text.w3d_member_80259684) }
  .text.w3d_member_802596f4 0x802596f4 : { *(.text.w3d_member_802596f4) }
  .text.w3d_member_80259764 0x80259764 : { *(.text.w3d_member_80259764) }
  /DISCARD/ : { *(.text*) *(.rodata*) *(.data*) *(.bss*) *(.sdata*) *(.sbss*) *(.comment) }
}
