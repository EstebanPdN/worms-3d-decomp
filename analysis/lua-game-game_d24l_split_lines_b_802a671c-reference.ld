/* Generated reference-only placements. All bodies are source-built. */
OUTPUT_FORMAT("elf32-powerpc")
OUTPUT_ARCH(powerpc)
ENTRY(d24l_split_lines_b_802a671c)
_SDA_BASE_ = 0x804b2540;
_SDA2_BASE_ = 0x804c2540;
lbl_803d611c = 0x803d611c;
strcspn = 0x802ef380;
w3d_release_header_8020bb2c = 0x8020bb2c;
w3d_string_assign_8020bd38 = 0x8020bd38;
w3d_string_finish_8020c5c4 = 0x8020c5c4;
w3d_string_header_80341884 = 0x80341884;
w3d_string_init_8020c5c0 = 0x8020c5c0;
w3d_string_release_80341588 = 0x80341588;
w3d_truncate_8020c3a0 = 0x8020c3a0;
SECTIONS {
  .text.d24l_split_lines_b_802a671c 0x802a671c : { *(.text.d24l_split_lines_b_802a671c) }
  /DISCARD/ : { *(.text*) *(.rodata*) *(.data*) *(.bss*) *(.sdata*) *(.sbss*) *(.comment) }
}
