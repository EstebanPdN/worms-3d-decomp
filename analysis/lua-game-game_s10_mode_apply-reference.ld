/* Generated reference-only placements. All bodies are source-built. */
OUTPUT_FORMAT("elf32-powerpc")
OUTPUT_ARCH(powerpc)
ENTRY(w3d_s10_apply_mode_801b12ec)
_SDA_BASE_ = 0x804b2540;
_SDA2_BASE_ = 0x804c2540;
fn_801a3ba0 = 0x801a3ba0;
fn_801d4544 = 0x801d4544;
fn_801edf88 = 0x801edf88;
fn_801ee034 = 0x801ee034;
lbl_80364a54 = 0x80364a54;
lbl_80364f54 = 0x80364f54;
SECTIONS {
  .text.w3d_s10_apply_mode_801b12ec 0x801b12ec : { *(.text.w3d_s10_apply_mode_801b12ec) }
  /DISCARD/ : { *(.text*) *(.rodata*) *(.data*) *(.bss*) *(.sdata*) *(.sbss*) *(.comment) }
}
