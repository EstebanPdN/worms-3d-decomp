/* Generated reference-only placements. All bodies are source-built. */
OUTPUT_FORMAT("elf32-powerpc")
OUTPUT_ARCH(powerpc)
ENTRY(d27h_blimp_camera_ctor_800a8348)
_SDA_BASE_ = 0x804b2540;
_SDA2_BASE_ = 0x804c2540;
base_8015a0d4 = 0x8015a0d4;
cast_80342a74 = 0x80342a74;
cast_80342fa4 = 0x80342fa4;
n_803816d0 = 0x803816d0;
n_803816e0 = 0x803816e0;
n_803816fc = 0x803816fc;
n_8038171c = 0x8038171c;
n_80381738 = 0x80381738;
n_80381754 = 0x80381754;
n_8038176c = 0x8038176c;
n_80381788 = 0x80381788;
n_803817a4 = 0x803817a4;
n_803817c4 = 0x803817c4;
n_803817e4 = 0x803817e4;
n_80381800 = 0x80381800;
n_8038181c = 0x8038181c;
n_80381834 = 0x80381834;
n_80381840 = 0x80381840;
read_setting_800fc1b0 = 0x800fc1b0;
vtable_8040f658 = 0x8040f658;
write_setting_800fc43c = 0x800fc43c;
SECTIONS {
  .text.d27h_blimp_camera_ctor_800a8348 0x800a8348 : { *(.text.d27h_blimp_camera_ctor_800a8348) }
  /DISCARD/ : { *(.text*) *(.rodata*) *(.data*) *(.bss*) *(.sdata*) *(.sbss*) *(.comment) }
}
