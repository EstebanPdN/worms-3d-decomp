/* Generated reference-only placements. All bodies are source-built. */
OUTPUT_FORMAT("elf32-powerpc")
OUTPUT_ARCH(powerpc)
ENTRY(w3d_d24b_remove_id_8008db88)
_SDA_BASE_ = 0x804b2540;
_SDA2_BASE_ = 0x804c2540;
w3d_copy_802eee50 = 0x802eee50;
w3d_get_801190d0 = 0x801190d0;
SECTIONS {
  .text.w3d_d24b_remove_id_8008db88 0x8008db88 : { *(.text.w3d_d24b_remove_id_8008db88) }
  /DISCARD/ : { *(.text*) *(.rodata*) *(.data*) *(.bss*) *(.sdata*) *(.sbss*) *(.comment) }
}
