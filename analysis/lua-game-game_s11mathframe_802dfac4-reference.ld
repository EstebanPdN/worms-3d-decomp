/* Generated reference-only placements. All bodies are source-built. */
OUTPUT_FORMAT("elf32-powerpc")
OUTPUT_ARCH(powerpc)
ENTRY(w3d_auto_802dfac4)
_SDA_BASE_ = 0x804b2540;
_SDA2_BASE_ = 0x804c2540;
fn_802CDF40__Fif = 0x802cdf40;
fn_802DD10C__Fii = 0x802dd10c;
fn_802E5F48__Fff = 0x802e5f48;
SECTIONS {
  .text.w3d_auto_802dfac4 0x802dfac4 : { *(.text.w3d_auto_802dfac4) }
  /DISCARD/ : { *(.text*) *(.rodata*) *(.data*) *(.bss*) *(.sdata*) *(.sbss*) *(.comment) }
}
