/* Generated reference-only placements. All bodies are source-built. */
OUTPUT_FORMAT("elf32-powerpc")
OUTPUT_ARCH(powerpc)
ENTRY(__25s8_PartialObject_800dc634)
_SDA_BASE_ = 0x804b2540;
_SDA2_BASE_ = 0x804c2540;
fn_800dc6a8 = 0x800dc6a8;
lbl_8040fe70 = 0x8040fe70;
SECTIONS {
  .text.__25s8_PartialObject_800dc634 0x800dc634 : { *(.text.__25s8_PartialObject_800dc634) }
  /DISCARD/ : { *(.text*) *(.rodata*) *(.data*) *(.bss*) *(.sdata*) *(.sbss*) *(.comment) }
}
