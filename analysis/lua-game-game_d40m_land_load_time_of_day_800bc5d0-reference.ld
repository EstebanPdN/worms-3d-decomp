/* Generated reference-only placements. All bodies are source-built. */
OUTPUT_FORMAT("elf32-powerpc")
OUTPUT_ARCH(powerpc)
ENTRY(d40m_land_load_time_of_day_800bc5d0)
_SDA_BASE_ = 0x804b2540;
_SDA2_BASE_ = 0x804c2540;
__15Stream_80207fec = 0x80207fec;
__15String_803426b8 = 0x803426b8;
fn_800bc7c4 = 0x800bc7c4;
fn_800fc2b0 = 0x800fc2b0;
fn_801fe0b8 = 0x801fe0b8;
fn_801fe160 = 0x801fe160;
fn_8020803c = 0x8020803c;
fn_802080a0 = 0x802080a0;
fn_8020810c = 0x8020810c;
fn_802081c8 = 0x802081c8;
fn_80208298 = 0x80208298;
fn_8020b6e8 = 0x8020b6e8;
fn_8020bf2c = 0x8020bf2c;
fn_8020c048 = 0x8020c048;
fn_8020c5c0 = 0x8020c5c0;
fn_8020c5c4 = 0x8020c5c4;
fn_80341588 = 0x80341588;
fn_80341884 = 0x80341884;
lbl_80382c24 = 0x80382c24;
lbl_80382c34 = 0x80382c34;
SECTIONS {
  .text.d40m_land_load_time_of_day_800bc5d0 0x800bc5d0 : { *(.text.d40m_land_load_time_of_day_800bc5d0) }
  /DISCARD/ : { *(.text*) *(.rodata*) *(.data*) *(.bss*) *(.sdata*) *(.sbss*) *(.comment) }
}
