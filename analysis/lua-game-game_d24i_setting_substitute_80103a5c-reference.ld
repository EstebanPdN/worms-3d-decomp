/* Generated reference-only placements. All bodies are source-built. */
OUTPUT_FORMAT("elf32-powerpc")
OUTPUT_ARCH(powerpc)
ENTRY(d24i_setting_substitute_80103a5c)
_SDA_BASE_ = 0x804b2540;
_SDA2_BASE_ = 0x804c2540;
__11d24i_String = 0x803426b8;
__11d24i_StringPCc = 0x8020bb54;
d24i_item_text_80179170 = 0x80179170;
d24i_release_header_8020bb2c = 0x8020bb2c;
d24i_setting_read_800fc2b0 = 0x800fc2b0;
d24i_setting_write_800fc550 = 0x800fc550;
d24i_string_append_8020bf2c = 0x8020bf2c;
d24i_string_finish_8020c5c4 = 0x8020c5c4;
d24i_string_header_80341884 = 0x80341884;
d24i_string_init_8020c5c0 = 0x8020c5c0;
d24i_string_prefix_8020c048 = 0x8020c048;
d24i_string_release_80341588 = 0x80341588;
strstr = 0x802efd14;
SECTIONS {
  .text.d24i_setting_substitute_80103a5c 0x80103a5c : { *(.text.d24i_setting_substitute_80103a5c) }
  /DISCARD/ : { *(.text*) *(.rodata*) *(.data*) *(.bss*) *(.sdata*) *(.sbss*) *(.comment) }
}
