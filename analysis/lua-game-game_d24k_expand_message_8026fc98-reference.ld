/* Generated reference-only placements. All bodies are source-built. */
OUTPUT_FORMAT("elf32-powerpc")
OUTPUT_ARCH(powerpc)
ENTRY(w3d_d24k_expand_message_8026fc98)
_SDA_BASE_ = 0x804b2540;
_SDA2_BASE_ = 0x804c2540;
__20MessageFrom_8020bb54PCc = 0x8020bb54;
__23MessageDefault_803426b8 = 0x803426b8;
empty_803cbf34 = 0x803cbf34;
fn_801797b4 = 0x801797b4;
fn_8020bb2c = 0x8020bb2c;
fn_8020c3a0 = 0x8020c3a0;
fn_8020c510 = 0x8020c510;
fn_8020c5c0 = 0x8020c5c0;
fn_8020c5c4 = 0x8020c5c4;
fn_802b1258 = 0x802b1258;
fn_802ef380 = 0x802ef380;
fn_80341584 = 0x80341584;
fn_80341588 = 0x80341588;
fn_80341884 = 0x80341884;
format_803cbf3c = 0x803cbf3c;
marker_803cbf38 = 0x803cbf38;
SECTIONS {
  .text.w3d_d24k_expand_message_8026fc98 0x8026fc98 : { *(.text.w3d_d24k_expand_message_8026fc98) }
  /DISCARD/ : { *(.text*) *(.rodata*) *(.data*) *(.bss*) *(.sdata*) *(.sbss*) *(.comment) }
}
