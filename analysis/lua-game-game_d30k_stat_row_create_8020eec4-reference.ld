/* Generated reference-only placements. All bodies are source-built. */
OUTPUT_FORMAT("elf32-powerpc")
OUTPUT_ARCH(powerpc)
ENTRY(w3d_d30k_stat_row_create_8020eec4)
_SDA_BASE_ = 0x804b2540;
_SDA2_BASE_ = 0x804c2540;
Take__6ColumnG4Text = 0x80208768;
__4TextPCc = 0x8020bb54;
__6Columni = 0x80208a4c;
fn_801fe1d8 = 0x801fe1d8;
fn_8020c5c0 = 0x8020c5c0;
fn_8020c5c4 = 0x8020c5c4;
fn_80341588 = 0x80341588;
fn_80341884 = 0x80341884;
fn_8035cb74 = 0x8035cb74;
lbl_803b3310 = 0x803b3310;
lbl_8045e99c = 0x8045e99c;
lbl_8045e9ac = 0x8045e9ac;
SECTIONS {
  .text.w3d_d30k_stat_row_create_8020eec4 0x8020eec4 : { *(.text.w3d_d30k_stat_row_create_8020eec4) }
  /DISCARD/ : { *(.text*) *(.rodata*) *(.data*) *(.bss*) *(.sdata*) *(.sbss*) *(.comment) }
}
