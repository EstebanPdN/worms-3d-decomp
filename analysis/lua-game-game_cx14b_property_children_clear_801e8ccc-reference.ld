/* Generated reference-only placements. All bodies are source-built. */
OUTPUT_FORMAT("elf32-powerpc")
OUTPUT_ARCH(powerpc)
ENTRY(w3d_cx14b_property_children_clear_801e8ccc)
_SDA_BASE_ = 0x804b2540;
_SDA2_BASE_ = 0x804c2540;
cache_8020cb38 = 0x8020cb38;
child_801eb074 = 0x801eb074;
copy_802eee50 = 0x802eee50;
SECTIONS {
  .text.w3d_cx14b_property_children_clear_801e8ccc 0x801e8ccc : { *(.text.w3d_cx14b_property_children_clear_801e8ccc) }
  /DISCARD/ : { *(.text*) *(.rodata*) *(.data*) *(.bss*) *(.sdata*) *(.sbss*) *(.comment) }
}
