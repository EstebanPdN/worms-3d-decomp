/* Generated reference-only placements. All bodies are source-built. */
OUTPUT_FORMAT("elf32-powerpc")
OUTPUT_ARCH(powerpc)
ENTRY(w3d_cx13b_child_vector_destroy_802bbeb4)
_SDA_BASE_ = 0x804b2540;
_SDA2_BASE_ = 0x804c2540;
base_8015ff2c = 0x8015ff2c;
storage_802134fc = 0x802134fc;
table_8041c860 = 0x8041c860;
SECTIONS {
  .text.w3d_cx13b_child_vector_destroy_802bbeb4 0x802bbeb4 : { *(.text.w3d_cx13b_child_vector_destroy_802bbeb4) }
  /DISCARD/ : { *(.text*) *(.rodata*) *(.data*) *(.bss*) *(.sdata*) *(.sbss*) *(.comment) }
}
