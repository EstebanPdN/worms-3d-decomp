/* Generated reference-only placements. All bodies are source-built. */
OUTPUT_FORMAT("elf32-powerpc")
OUTPUT_ARCH(powerpc)
ENTRY(w3d_d31e_check_array_unique_801d6220)
_SDA_BASE_ = 0x804b2540;
_SDA2_BASE_ = 0x804c2540;
s_first = 0x803af428;
s_kind = 0x803af490;
s_same = 0x803af3c8;
s_second = 0x803af45c;
w3d_auto_801ffea8 = 0x801ffea8;
w3d_cx16b_stream_format_801d6000 = 0x801d6000;
w3d_s21_vector_get_801e9db8 = 0x801e9db8;
SECTIONS {
  .text.w3d_d31e_check_array_unique_801d6220 0x801d6220 : { *(.text.w3d_d31e_check_array_unique_801d6220) }
  /DISCARD/ : { *(.text*) *(.rodata*) *(.data*) *(.bss*) *(.sdata*) *(.sbss*) *(.comment) }
}
