/* Generated reference-only placements. All bodies are source-built. */
OUTPUT_FORMAT("elf32-powerpc")
OUTPUT_ARCH(powerpc)
ENTRY(s8_destroy_dual_base_800e366c)
_SDA_BASE_ = 0x804b2540;
_SDA2_BASE_ = 0x804c2540;
fn_800DE958 = 0x800de958;
fn_800DEB44 = 0x800deb44;
fn_80126230 = 0x80126230;
fn_80161050 = 0x80161050;
fn_801FE240 = 0x801fe240;
lbl_80410058 = 0x80410058;
lbl_80410078 = 0x80410078;
SECTIONS {
  .text.s8_destroy_dual_base_800e366c 0x800e366c : { *(.text.s8_destroy_dual_base_800e366c) }
  /DISCARD/ : { *(.text*) *(.rodata*) *(.data*) *(.bss*) *(.sdata*) *(.sbss*) *(.comment) }
}
