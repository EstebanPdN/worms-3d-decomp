/* Generated reference-only placements. All bodies are source-built. */
OUTPUT_FORMAT("elf32-powerpc")
OUTPUT_ARCH(powerpc)
ENTRY(d27f_delete_barracks_team_80298abc)
_SDA_BASE_ = 0x804b2540;
_SDA2_BASE_ = 0x804c2540;
_._19Descriptor_80178474 = 0x80178474;
__15String_803426b8 = 0x803426b8;
__15String_803426b8PCc = 0x8020bb54;
fn_801ef380 = 0x801ef380;
fn_80297620 = 0x80297620;
lbl_803d097c = 0x803d097c;
lbl_803d09ec = 0x803d09ec;
lbl_803d0b1c = 0x803d0b1c;
strcmp = 0x802ef234;
w3d_auto_800fc2b0 = 0x800fc2b0;
w3d_auto_80179598 = 0x80179598;
w3d_constructor_lookup_name = 0x800fc1b0;
w3d_empty_80341584 = 0x80341584;
w3d_string_assign = 0x8020bd38;
w3d_string_base_finish = 0x8020c5c4;
w3d_string_base_init = 0x8020c5c0;
w3d_string_header = 0x80341884;
w3d_string_release = 0x80341588;
SECTIONS {
  .text.d27f_delete_barracks_team_80298abc 0x80298abc : { *(.text.d27f_delete_barracks_team_80298abc) }
  /DISCARD/ : { *(.text*) *(.rodata*) *(.data*) *(.bss*) *(.sdata*) *(.sbss*) *(.comment) }
}
