/* Generated reference-only placements. All bodies are source-built. */
OUTPUT_FORMAT("elf32-powerpc")
OUTPUT_ARCH(powerpc)
ENTRY(w3d_d24e_register_cycle_button_properties_8022205c)
_SDA_BASE_ = 0x804b2540;
_SDA2_BASE_ = 0x804c2540;
__15String_8020bb54PCc = 0x8020bb54;
d20e_empty_804b06a0 = 0x804b06a0;
d20e_release_header_8020bb2c = 0x8020bb2c;
d20e_string_finish_8020c5c4 = 0x8020c5c4;
d20e_string_header_80341884 = 0x80341884;
d20e_string_init_8020c5c0 = 0x8020c5c0;
d20e_string_release_80341588 = 0x80341588;
desc_803b6b24 = 0x803b6b24;
desc_803b6b54 = 0x803b6b54;
desc_803b6b78 = 0x803b6b78;
desc_803b6b9c = 0x803b6b9c;
desc_803b6bc0 = 0x803b6bc0;
desc_803b6be4 = 0x803b6be4;
desc_803b6c0c = 0x803b6c0c;
desc_803b6c34 = 0x803b6c34;
desc_803b6c68 = 0x803b6c68;
fn_801e8d9c = 0x801e8d9c;
fn_801eb674 = 0x801eb674;
fn_801ece2c = 0x801ece2c;
fn_801ed24c = 0x801ed24c;
lit_803b61f8 = 0x803b61f8;
SECTIONS {
  .text.w3d_d24e_register_cycle_button_properties_8022205c 0x8022205c : { *(.text.w3d_d24e_register_cycle_button_properties_8022205c) }
  /DISCARD/ : { *(.text*) *(.rodata*) *(.data*) *(.bss*) *(.sdata*) *(.sbss*) *(.comment) }
}
