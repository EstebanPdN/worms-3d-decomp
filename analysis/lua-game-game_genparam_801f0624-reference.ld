/* Generated reference-only placements. All bodies are source-built. */
OUTPUT_FORMAT("elf32-powerpc")
OUTPUT_ARCH(powerpc)
ENTRY(w3d_binding_create_801f0624)
_SDA_BASE_ = 0x804b2540;
_SDA2_BASE_ = 0x804c2540;
__23W3dBindingBase_801eb058 = 0x801eb058;
__nw__19W3dBinding_804177c0Ui = 0x801fe1d8;
__nw__19W3dBinding_80417880Ui = 0x801fe1d8;
__nw__19W3dBinding_80417a60Ui = 0x801fe1d8;
__nw__19W3dBinding_80417bb0Ui = 0x801fe1d8;
fn_801e8bc4 = 0x801e8bc4;
fn_801eb0a8 = 0x801eb0a8;
w3d_vtable_804177c0 = 0x804177c0;
w3d_vtable_80417880 = 0x80417880;
w3d_vtable_80417a60 = 0x80417a60;
w3d_vtable_80417bb0 = 0x80417bb0;
SECTIONS {
  .text.w3d_binding_create_801f0624 0x801f0624 : { *(.text.w3d_binding_create_801f0624) }
  .text.w3d_binding_create_801f0b70 0x801f0b70 : { *(.text.w3d_binding_create_801f0b70) }
  .text.w3d_binding_create_801f0f74 0x801f0f74 : { *(.text.w3d_binding_create_801f0f74) }
  .text.w3d_binding_create_801f12ec 0x801f12ec : { *(.text.w3d_binding_create_801f12ec) }
  /DISCARD/ : { *(.text*) *(.rodata*) *(.data*) *(.bss*) *(.sdata*) *(.sbss*) *(.comment) }
}
