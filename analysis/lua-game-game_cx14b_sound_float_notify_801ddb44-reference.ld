/* Generated reference-only placements. All bodies are source-built. */
OUTPUT_FORMAT("elf32-powerpc")
OUTPUT_ARCH(powerpc)
ENTRY(w3d_cx14b_sound_float_notify_801ddb44)
_SDA_BASE_ = 0x804b2540;
_SDA2_BASE_ = 0x804c2540;
epsilon_803b0270 = 0x803b0270;
SECTIONS {
  .text.w3d_cx14b_sound_float_notify_801ddb44 0x801ddb44 : { *(.text.w3d_cx14b_sound_float_notify_801ddb44) }
  /DISCARD/ : { *(.text*) *(.rodata*) *(.data*) *(.bss*) *(.sdata*) *(.sbss*) *(.comment) }
}
