/* Generated reference-only placements. All bodies are source-built. */
OUTPUT_FORMAT("elf32-powerpc")
OUTPUT_ARCH(powerpc)
ENTRY(k5a_audio_volumes_apply_8002a12c)
_SDA_BASE_ = 0x804b2540;
_SDA2_BASE_ = 0x804c2540;
w3d_auto_800fc270 = 0x800fc270;
w3d_f32_8037237c = 0x8037237c;
w3d_f32_80372380 = 0x80372380;
w3d_string_80372340 = 0x80372340;
w3d_string_80372350 = 0x80372350;
SECTIONS {
  .text.k5a_audio_volumes_apply_8002a12c 0x8002a12c : { *(.text.k5a_audio_volumes_apply_8002a12c) }
  /DISCARD/ : { *(.text*) *(.rodata*) *(.data*) *(.bss*) *(.sdata*) *(.sbss*) *(.comment) }
}
