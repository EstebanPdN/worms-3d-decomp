/* Generated reference-only placements. All bodies are source-built. */
OUTPUT_FORMAT("elf32-powerpc")
OUTPUT_ARCH(powerpc)
ENTRY(d27i_weapon_panel_label_8012f368)
_SDA_BASE_ = 0x804b2540;
_SDA2_BASE_ = 0x804c2540;
__15String_803426b8 = 0x803426b8;
a_80178c48 = 0x80178c48;
atol_802ed8c4 = 0x802ed8c4;
b_800fc6dc = 0x800fc6dc;
c_800fc7f8 = 0x800fc7f8;
cfg_801797b4 = 0x801797b4;
d_800fca30 = 0x800fca30;
e_801ea4c8 = 0x801ea4c8;
f_800fcc68 = 0x800fcc68;
fmt_8020c510 = 0x8020c510;
g_800fcd84 = 0x800fcd84;
get_80178f54 = 0x80178f54;
h_8025cb4c = 0x8025cb4c;
i_8025cbe0 = 0x8025cbe0;
key_80178d1c = 0x80178d1c;
left_8020c048 = 0x8020c048;
look_80164fc8 = 0x80164fc8;
ref_80341584 = 0x80341584;
rename_801790bc = 0x801790bc;
s_8039d9b0 = 0x8039d9b0;
s_8039dcec = 0x8039dcec;
s_8039dd04 = 0x8039dd04;
s_8039dd0c = 0x8039dd0c;
set_80178f60 = 0x80178f60;
slot_8025c3a8 = 0x8025c3a8;
str_finish_8020c5c4 = 0x8020c5c4;
str_init_8020c5c0 = 0x8020c5c0;
str_refs_80341884 = 0x80341884;
str_release_80341588 = 0x80341588;
strcmp_802ef234 = 0x802ef234;
strlen_802ef9c0 = 0x802ef9c0;
svc_8020b680 = 0x8020b680;
svc_8041b958 = 0x8041b958;
type_80365b28 = 0x80365b28;
type_803685d8 = 0x803685d8;
SECTIONS {
  .text.d27i_weapon_panel_label_8012f368 0x8012f368 : { *(.text.d27i_weapon_panel_label_8012f368) }
  /DISCARD/ : { *(.text*) *(.rodata*) *(.data*) *(.bss*) *(.sdata*) *(.sbss*) *(.comment) }
}
