/* Generated reference-only placements. All bodies are source-built. */
OUTPUT_FORMAT("elf32-powerpc")
OUTPUT_ARCH(powerpc)
ENTRY(w3d_dtor_interfaces7_801c0eec)
_SDA_BASE_ = 0x804b2540;
_SDA2_BASE_ = 0x804c2540;
fn_801b4ef0 = 0x801b4ef0;
fn_801b5bd4 = 0x801b5bd4;
fn_801ea138 = 0x801ea138;
fn_801ea740 = 0x801ea740;
w3d_vtable_80414d08 = 0x80414d08;
w3d_vtable_80414e20 = 0x80414e20;
w3d_vtable_8041b8c0 = 0x8041b8c0;
SECTIONS {
  .text.w3d_dtor_interfaces7_801c0eec 0x801c0eec : { *(.text.w3d_dtor_interfaces7_801c0eec) }
  .text.w3d_dtor_interfaces7_801c2d14 0x801c2d14 : { *(.text.w3d_dtor_interfaces7_801c2d14) }
  .text.w3d_dtor_interfaces7_8024c144 0x8024c144 : { *(.text.w3d_dtor_interfaces7_8024c144) }
  /DISCARD/ : { *(.text*) *(.rodata*) *(.data*) *(.bss*) *(.sdata*) *(.sbss*) *(.comment) }
}
