/* Generated reference-only placements. All bodies are source-built. */
OUTPUT_FORMAT("elf32-powerpc")
OUTPUT_ARCH(powerpc)
ENTRY(f3b_advance_direction_8014c6f4)
_SDA_BASE_ = 0x804b2540;
_SDA2_BASE_ = 0x804c2540;
direction_80146f10 = 0x80146f10;
limit_803a1510 = 0x803a1510;
scale_803a1514 = 0x803a1514;
vector_8045e788 = 0x8045e788;
SECTIONS {
  .text.f3b_advance_direction_8014c6f4 0x8014c6f4 : { *(.text.f3b_advance_direction_8014c6f4) }
  /DISCARD/ : { *(.text*) *(.rodata*) *(.data*) *(.bss*) *(.sdata*) *(.sbss*) *(.comment) }
}
