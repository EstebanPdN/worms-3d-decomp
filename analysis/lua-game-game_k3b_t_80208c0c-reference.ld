/* Generated reference-only placements. All bodies are source-built. */
OUTPUT_FORMAT("elf32-powerpc")
OUTPUT_ARCH(powerpc)
ENTRY(w3d_k3b_tagged_construct_80208c0c)
_SDA_BASE_ = 0x804b2540;
_SDA2_BASE_ = 0x804c2540;
w3d_vtable_80419318 = 0x80419318;
w3d_vtable_80419348 = 0x80419348;
SECTIONS {
  .text.w3d_k3b_tagged_construct_80208c0c 0x80208c0c : { *(.text.w3d_k3b_tagged_construct_80208c0c) }
  /DISCARD/ : { *(.text*) *(.rodata*) *(.data*) *(.bss*) *(.sdata*) *(.sbss*) *(.comment) }
}
