/* Generated reference-only placements. All bodies are source-built. */
OUTPUT_FORMAT("elf32-powerpc")
OUTPUT_ARCH(powerpc)
ENTRY(w3d_d28e_close_node_801d3be0)
_SDA_BASE_ = 0x804b2540;
_SDA2_BASE_ = 0x804c2540;
alloc_80212fd4 = 0x80212fd4;
fn_801d3930 = 0x801d3930;
free_802134fc = 0x802134fc;
memmove_802eeef4 = 0x802eeef4;
w3d_handle_storage_fallback_803413d8 = 0x803413d8;
w3d_s20_dispatch_item_record_801a37a0 = 0x801a37a0;
SECTIONS {
  .text.w3d_d28e_close_node_801d3be0 0x801d3be0 : { *(.text.w3d_d28e_close_node_801d3be0) }
  /DISCARD/ : { *(.text*) *(.rodata*) *(.data*) *(.bss*) *(.sdata*) *(.sbss*) *(.comment) }
}
