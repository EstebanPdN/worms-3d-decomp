/* Generated reference-only placements. All bodies are source-built. */
OUTPUT_FORMAT("elf32-powerpc")
OUTPUT_ARCH(powerpc)
ENTRY(cc41a_remove_created_8017e7a0)
_SDA_BASE_ = 0x804b2540;
_SDA2_BASE_ = 0x804c2540;
cc41a_find_801ee0e0 = 0x801ee0e0;
cc41a_update_801ef380 = 0x801ef380;
SECTIONS {
  .text.cc41a_remove_created_8017e7a0 0x8017e7a0 : { *(.text.cc41a_remove_created_8017e7a0) }
  /DISCARD/ : { *(.text*) *(.rodata*) *(.data*) *(.bss*) *(.sdata*) *(.sbss*) *(.comment) }
}
