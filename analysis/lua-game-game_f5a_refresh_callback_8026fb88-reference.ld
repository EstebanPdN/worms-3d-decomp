/* Generated reference-only placements. All bodies are source-built. */
OUTPUT_FORMAT("elf32-powerpc")
OUTPUT_ARCH(powerpc)
ENTRY(w3d_f5a_refresh_callback_8026fb88)
_SDA_BASE_ = 0x804b2540;
_SDA2_BASE_ = 0x804c2540;
fn_8015fd1c = 0x8015fd1c;
fn_8026f528 = 0x8026f528;
fn_8026f948 = 0x8026f948;
fn_802700a8 = 0x802700a8;
fn_80296410 = 0x80296410;
fn_802bc6a8 = 0x802bc6a8;
fn_802bc71c = 0x802bc71c;
fn_802bc790 = 0x802bc790;
initial_803cbf30 = 0x803cbf30;
SECTIONS {
  .text.w3d_f5a_refresh_callback_8026fb88 0x8026fb88 : { *(.text.w3d_f5a_refresh_callback_8026fb88) }
  /DISCARD/ : { *(.text*) *(.rodata*) *(.data*) *(.bss*) *(.sdata*) *(.sbss*) *(.comment) }
}
