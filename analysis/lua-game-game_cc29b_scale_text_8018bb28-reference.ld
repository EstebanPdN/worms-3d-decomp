/* Generated reference-only placements. All bodies are source-built. */
OUTPUT_FORMAT("elf32-powerpc")
OUTPUT_ARCH(powerpc)
ENTRY(w3d_cc29b_scale_text_8018bb28)
_SDA_BASE_ = 0x804b2540;
_SDA2_BASE_ = 0x804c2540;
fn_801b14e8 = 0x801b14e8;
fn_801ee034 = 0x801ee034;
fn_801ee0e0 = 0x801ee0e0;
fn_801ef380 = 0x801ef380;
fn_8020b680 = 0x8020b680;
lbl_80364f04 = 0x80364f04;
lbl_803a7dec = 0x803a7dec;
lbl_80415ca0 = 0x80415ca0;
SECTIONS {
  .text.w3d_cc29b_scale_text_8018bb28 0x8018bb28 : { *(.text.w3d_cc29b_scale_text_8018bb28) }
  /DISCARD/ : { *(.text*) *(.rodata*) *(.data*) *(.bss*) *(.sdata*) *(.sbss*) *(.comment) }
}
