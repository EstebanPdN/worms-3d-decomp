/* Generated reference-only placements. All bodies are source-built. */
OUTPUT_FORMAT("elf32-powerpc")
OUTPUT_ARCH(powerpc)
ENTRY(w3d_cx9a_ballistic_sample_800d75f0)
_SDA_BASE_ = 0x804b2540;
_SDA2_BASE_ = 0x804c2540;
half_803891a4 = 0x803891a4;
SECTIONS {
  .text.w3d_cx9a_ballistic_sample_800d75f0 0x800d75f0 : { *(.text.w3d_cx9a_ballistic_sample_800d75f0) }
  /DISCARD/ : { *(.text*) *(.rodata*) *(.data*) *(.bss*) *(.sdata*) *(.sbss*) *(.comment) }
}
