/* Generated reference-only placements. All bodies are source-built. */
OUTPUT_FORMAT("elf32-powerpc")
OUTPUT_ARCH(powerpc)
ENTRY(w3d_k3b_tagged_construct_801f8f68)
_SDA_BASE_ = 0x804b2540;
_SDA2_BASE_ = 0x804c2540;
w3d_vtable_80418140 = 0x80418140;
w3d_vtable_80418168 = 0x80418168;
SECTIONS {
  .text.w3d_k3b_tagged_construct_801f8f68 0x801f8f68 : { *(.text.w3d_k3b_tagged_construct_801f8f68) }
  /DISCARD/ : { *(.text*) *(.rodata*) *(.data*) *(.bss*) *(.sdata*) *(.sbss*) *(.comment) }
}
