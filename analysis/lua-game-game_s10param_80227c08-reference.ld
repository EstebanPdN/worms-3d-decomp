/* Generated reference-only placements. All bodies are source-built. */
OUTPUT_FORMAT("elf32-powerpc")
OUTPUT_ARCH(powerpc)
ENTRY(w3d_s10_init_two_properties_80227c08)
_SDA_BASE_ = 0x804b2540;
_SDA2_BASE_ = 0x804c2540;
fn_801e8d9c = 0x801e8d9c;
fn_801ebf38 = 0x801ebf38;
lbl_803b83b4 = 0x803b83b4;
lbl_803b83e8 = 0x803b83e8;
SECTIONS {
  .text.w3d_s10_init_two_properties_80227c08 0x80227c08 : { *(.text.w3d_s10_init_two_properties_80227c08) }
  /DISCARD/ : { *(.text*) *(.rodata*) *(.data*) *(.bss*) *(.sdata*) *(.sbss*) *(.comment) }
}
