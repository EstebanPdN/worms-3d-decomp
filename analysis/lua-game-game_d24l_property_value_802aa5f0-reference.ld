/* Generated reference-only placements. All bodies are source-built. */
OUTPUT_FORMAT("elf32-powerpc")
OUTPUT_ARCH(powerpc)
ENTRY(d24l_property_value_802aa5f0)
_SDA_BASE_ = 0x804b2540;
_SDA2_BASE_ = 0x804c2540;
w3d_as_a_803426b4 = 0x803426b4;
w3d_as_b_80342a78 = 0x80342a78;
w3d_lookup_800fc1b0 = 0x800fc1b0;
w3d_string_finish_8020c5c4 = 0x8020c5c4;
w3d_string_header_80341884 = 0x80341884;
w3d_string_init_8020c5c0 = 0x8020c5c0;
w3d_string_release_80341588 = 0x80341588;
w3d_value_a_80178c48 = 0x80178c48;
w3d_value_b_80178d1c = 0x80178d1c;
SECTIONS {
  .text.d24l_property_value_802aa5f0 0x802aa5f0 : { *(.text.d24l_property_value_802aa5f0) }
  /DISCARD/ : { *(.text*) *(.rodata*) *(.data*) *(.bss*) *(.sdata*) *(.sbss*) *(.comment) }
}
