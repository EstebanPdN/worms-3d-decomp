/* Generated reference-only placements. All bodies are source-built. */
OUTPUT_FORMAT("elf32-powerpc")
OUTPUT_ARCH(powerpc)
ENTRY(w3d_cx12b_four_ranges_construct_8025d818)
_SDA_BASE_ = 0x804b2540;
_SDA2_BASE_ = 0x804c2540;
base_801628b0 = 0x801628b0;
table_8041baf0 = 0x8041baf0;
SECTIONS {
  .text.w3d_cx12b_four_ranges_construct_8025d818 0x8025d818 : { *(.text.w3d_cx12b_four_ranges_construct_8025d818) }
  /DISCARD/ : { *(.text*) *(.rodata*) *(.data*) *(.bss*) *(.sdata*) *(.sbss*) *(.comment) }
}
