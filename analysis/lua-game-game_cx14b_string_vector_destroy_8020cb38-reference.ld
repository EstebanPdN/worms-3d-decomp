/* Generated reference-only placements. All bodies are source-built. */
OUTPUT_FORMAT("elf32-powerpc")
OUTPUT_ARCH(powerpc)
ENTRY(w3d_cx14b_string_vector_destroy_8020cb38)
_SDA_BASE_ = 0x804b2540;
_SDA2_BASE_ = 0x804c2540;
destroy_801fe1f8 = 0x801fe1f8;
finish_8020c5c4 = 0x8020c5c4;
free_801fe240 = 0x801fe240;
release_80341588 = 0x80341588;
storage_802134fc = 0x802134fc;
SECTIONS {
  .text.w3d_cx14b_string_vector_destroy_8020cb38 0x8020cb38 : { *(.text.w3d_cx14b_string_vector_destroy_8020cb38) }
  /DISCARD/ : { *(.text*) *(.rodata*) *(.data*) *(.bss*) *(.sdata*) *(.sbss*) *(.comment) }
}
