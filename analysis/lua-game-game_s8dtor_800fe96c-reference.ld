/* Generated reference-only placements. All bodies are source-built. */
OUTPUT_FORMAT("elf32-powerpc")
OUTPUT_ARCH(powerpc)
ENTRY(s8_destroy_800fe96c)
_SDA_BASE_ = 0x804b2540;
_SDA2_BASE_ = 0x804c2540;
fn_8015ff2c = 0x8015ff2c;
w3d_vtable_804105b8 = 0x804105b8;
SECTIONS {
  .text.s8_destroy_800fe96c 0x800fe96c : { *(.text.s8_destroy_800fe96c) }
  /DISCARD/ : { *(.text*) *(.rodata*) *(.data*) *(.bss*) *(.sdata*) *(.sbss*) *(.comment) }
}
