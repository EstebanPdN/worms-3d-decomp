/* Generated reference-only placements. All bodies are source-built. */
OUTPUT_FORMAT("elf32-powerpc")
OUTPUT_ARCH(powerpc)
ENTRY(f10b_crate_defaults_8008a044)
_SDA_BASE_ = 0x804b2540;
_SDA2_BASE_ = 0x804c2540;
set_800fc3b0 = 0x800fc3b0;
set_800fc4c8 = 0x800fc4c8;
set_800fc550 = 0x800fc550;
text_8037d930 = 0x8037d930;
text_8037d944 = 0x8037d944;
text_8037d950 = 0x8037d950;
text_8037d964 = 0x8037d964;
text_8037d978 = 0x8037d978;
text_8037d988 = 0x8037d988;
text_8037d998 = 0x8037d998;
text_8037d9b0 = 0x8037d9b0;
text_8037d9c8 = 0x8037d9c8;
text_8037d9d4 = 0x8037d9d4;
text_8037d9e4 = 0x8037d9e4;
text_8037d9f4 = 0x8037d9f4;
text_8037da08 = 0x8037da08;
text_8037da18 = 0x8037da18;
text_8037da30 = 0x8037da30;
text_8037da44 = 0x8037da44;
text_8037da54 = 0x8037da54;
text_8037da60 = 0x8037da60;
text_8037da6c = 0x8037da6c;
text_8037da74 = 0x8037da74;
text_8037da84 = 0x8037da84;
text_8037da90 = 0x8037da90;
text_8037da9c = 0x8037da9c;
text_8037daa8 = 0x8037daa8;
text_8037dac0 = 0x8037dac0;
text_8037dad8 = 0x8037dad8;
value_8037dae8 = 0x8037dae8;
value_8037daec = 0x8037daec;
value_8037daf0 = 0x8037daf0;
SECTIONS {
  .text.f10b_crate_defaults_8008a044 0x8008a044 : { *(.text.f10b_crate_defaults_8008a044) }
  /DISCARD/ : { *(.text*) *(.rodata*) *(.data*) *(.bss*) *(.sdata*) *(.sbss*) *(.comment) }
}
