/* Generated reference-only placements. All bodies are source-built. */
OUTPUT_FORMAT("elf32-powerpc")
OUTPUT_ARCH(powerpc)
ENTRY(d31f_scroll_box_parts_80295cec)
_SDA_BASE_ = 0x804b2540;
_SDA2_BASE_ = 0x804c2540;
d29f_scroll_box_layout_8029556c = 0x8029556c;
fn_80263608 = 0x80263608;
w3d_empty_8034357c = 0x8034357c;
w3d_handle_set_name = 0x8015adf4;
w3d_s20_store_byte_value_80173f88 = 0x80173f88;
w3d_string_base_init = 0x8020c5c0;
w3d_string_header = 0x80341884;
SECTIONS {
  .text.d31f_scroll_box_parts_80295cec 0x80295cec : { *(.text.d31f_scroll_box_parts_80295cec) }
  /DISCARD/ : { *(.text*) *(.rodata*) *(.data*) *(.bss*) *(.sdata*) *(.sbss*) *(.comment) }
}
