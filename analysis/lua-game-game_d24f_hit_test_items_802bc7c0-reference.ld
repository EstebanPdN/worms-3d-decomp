/* Generated reference-only placements. All bodies are source-built. */
OUTPUT_FORMAT("elf32-powerpc")
OUTPUT_ARCH(powerpc)
ENTRY(d24f_hit_test_items_802bc7c0)
_SDA_BASE_ = 0x804b2540;
_SDA2_BASE_ = 0x804c2540;
w3d_cc37b_hit_line_802bfa70 = 0x802bfa70;
w3d_get_802bd2bc = 0x802bd2bc;
SECTIONS {
  .text.d24f_hit_test_items_802bc7c0 0x802bc7c0 : { *(.text.d24f_hit_test_items_802bc7c0) }
  /DISCARD/ : { *(.text*) *(.rodata*) *(.data*) *(.bss*) *(.sdata*) *(.sbss*) *(.comment) }
}
