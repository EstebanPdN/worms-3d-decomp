/* Generated reference-only placements. All bodies are source-built. */
OUTPUT_FORMAT("elf32-powerpc")
OUTPUT_ARCH(powerpc)
ENTRY(f2c_tag_init_80194234)
_SDA_BASE_ = 0x804b2540;
_SDA2_BASE_ = 0x804c2540;
lbl_803a82b4 = 0x803a82b4;
lbl_80413378 = 0x80413378;
lbl_804133c8 = 0x804133c8;
SECTIONS {
  .text.f2c_tag_init_80194234 0x80194234 : { *(.text.f2c_tag_init_80194234) }
  /DISCARD/ : { *(.text*) *(.rodata*) *(.data*) *(.bss*) *(.sdata*) *(.sbss*) *(.comment) }
}
