/* Generated reference-only placements. All bodies are source-built. */
OUTPUT_FORMAT("elf32-powerpc")
OUTPUT_ARCH(powerpc)
ENTRY(k2a_curve_eval_8009dfd4)
_SDA_BASE_ = 0x804b2540;
_SDA2_BASE_ = 0x804c2540;
FUN_802e88ac = 0x802e88ac;
SECTIONS {
  .text.k2a_curve_eval_8009dfd4 0x8009dfd4 : { *(.text.k2a_curve_eval_8009dfd4) }
  /DISCARD/ : { *(.text*) *(.rodata*) *(.data*) *(.bss*) *(.sdata*) *(.sbss*) *(.comment) }
}
