/* Generated reference-only placements. All bodies are source-built. */
OUTPUT_FORMAT("elf32-powerpc")
OUTPUT_ARCH(powerpc)
ENTRY(w3d_cc17b_wind_control_80130ed8)
_SDA_BASE_ = 0x804b2540;
_SDA2_BASE_ = 0x804c2540;
fn_80165254 = 0x80165254;
fn_80178df0 = 0x80178df0;
fn_80181640 = 0x80181640;
fn_8018179c = 0x8018179c;
fn_80342a74 = 0x80342a74;
fn_80343584 = 0x80343584;
name_8039e19c = 0x8039e19c;
value_8039e1b0 = 0x8039e1b0;
value_8039e1b4 = 0x8039e1b4;
SECTIONS {
  .text.w3d_cc17b_wind_control_80130ed8 0x80130ed8 : { *(.text.w3d_cc17b_wind_control_80130ed8) }
  /DISCARD/ : { *(.text*) *(.rodata*) *(.data*) *(.bss*) *(.sdata*) *(.sbss*) *(.comment) }
}
