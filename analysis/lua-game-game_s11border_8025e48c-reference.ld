/* Generated reference-only placements. All bodies are source-built. */
OUTPUT_FORMAT("elf32-powerpc")
OUTPUT_ARCH(powerpc)
ENTRY(s11_attach_border_8025e48c)
_SDA_BASE_ = 0x804b2540;
_SDA2_BASE_ = 0x804c2540;
fn_80174820 = 0x80174820;
fn_8020B680 = 0x8020b680;
fn_8020BB2C = 0x8020bb2c;
fn_8020BB54 = 0x8020bb54;
fn_8020C5C4 = 0x8020c5c4;
fn_80341588 = 0x80341588;
lbl_803CAA7C = 0x803caa7c;
lbl_804144E8 = 0x804144e8;
SECTIONS {
  .text.s11_attach_border_8025e48c 0x8025e48c : { *(.text.s11_attach_border_8025e48c) }
  /DISCARD/ : { *(.text*) *(.rodata*) *(.data*) *(.bss*) *(.sdata*) *(.sbss*) *(.comment) }
}
