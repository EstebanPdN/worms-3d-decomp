/* Generated reference-only placements. All bodies are source-built. */
OUTPUT_FORMAT("elf32-powerpc")
OUTPUT_ARCH(powerpc)
ENTRY(s9_initialize_video_buffer_8016e608)
_SDA_BASE_ = 0x804b2540;
_SDA2_BASE_ = 0x804c2540;
fn_801fe2a8 = 0x801fe2a8;
fn_802fb7ac = 0x802fb7ac;
fn_802fce18 = 0x802fce18;
fn_802fd8e4 = 0x802fd8e4;
lbl_803a6368 = 0x803a6368;
lbl_803a6380 = 0x803a6380;
SECTIONS {
  .text.s9_initialize_video_buffer_8016e608 0x8016e608 : { *(.text.s9_initialize_video_buffer_8016e608) }
  /DISCARD/ : { *(.text*) *(.rodata*) *(.data*) *(.bss*) *(.sdata*) *(.sbss*) *(.comment) }
}
