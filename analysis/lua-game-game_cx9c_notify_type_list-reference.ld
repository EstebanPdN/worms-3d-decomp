/* Generated reference-only placements. All bodies are source-built. */
OUTPUT_FORMAT("elf32-powerpc")
OUTPUT_ARCH(powerpc)
ENTRY(w3d_cx9c_notify_type_list_80356c10)
_SDA_BASE_ = 0x804b2540;
_SDA2_BASE_ = 0x804c2540;
cx9c_base_type_80365788 = 0x80365788;
cx9c_manager_801ea954 = 0x801ea954;
SECTIONS {
  .text.w3d_cx9c_notify_type_list_80356c10 0x80356c10 : { *(.text.w3d_cx9c_notify_type_list_80356c10) }
  /DISCARD/ : { *(.text*) *(.rodata*) *(.data*) *(.bss*) *(.sdata*) *(.sbss*) *(.comment) }
}
