/* Generated reference-only placements. All bodies are source-built. */
OUTPUT_FORMAT("elf32-powerpc")
OUTPUT_ARCH(powerpc)
ENTRY(w3d_s20_compute_scaled_offset_8013c844)
_SDA_BASE_ = 0x804b2540;
_SDA2_BASE_ = 0x804c2540;
lbl_8039f900 = 0x8039f900;
lbl_8039f904 = 0x8039f904;
lbl_8039f908 = 0x8039f908;
lbl_8039f90c = 0x8039f90c;
SECTIONS {
  .text.w3d_s20_compute_scaled_offset_8013c844 0x8013c844 : { *(.text.w3d_s20_compute_scaled_offset_8013c844) }
  /DISCARD/ : { *(.text*) *(.rodata*) *(.data*) *(.bss*) *(.sdata*) *(.sbss*) *(.comment) }
}
