/* Generated reference-only placements. All bodies are source-built. */
OUTPUT_FORMAT("elf32-powerpc")
OUTPUT_ARCH(powerpc)
ENTRY(w3d_k5b_binding_write_enum_801ecff0)
_SDA_BASE_ = 0x804b2540;
_SDA2_BASE_ = 0x804c2540;
fn_8020d6bc = 0x8020d6bc;
lbl_803b0c74 = 0x803b0c74;
w3d_s10_format_number_8020da90 = 0x8020da90;
w3d_s21_write_text_8020dbf8 = 0x8020dbf8;
SECTIONS {
  .text.w3d_k5b_binding_write_enum_801ecff0 0x801ecff0 : { *(.text.w3d_k5b_binding_write_enum_801ecff0) }
  /DISCARD/ : { *(.text*) *(.rodata*) *(.data*) *(.bss*) *(.sdata*) *(.sbss*) *(.comment) }
}
