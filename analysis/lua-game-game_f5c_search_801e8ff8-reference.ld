/* Generated reference-only placements. All bodies are source-built. */
OUTPUT_FORMAT("elf32-powerpc")
OUTPUT_ARCH(powerpc)
ENTRY(f5c_search_801e8ff8)
_SDA_BASE_ = 0x804b2540;
_SDA2_BASE_ = 0x804c2540;
fn_801fff3c = 0x801fff3c;
fn_802eedc0 = 0x802eedc0;
lbl_8045e0a4 = 0x8045e0a4;
SECTIONS {
  .text.f5c_search_801e8ff8 0x801e8ff8 : { *(.text.f5c_search_801e8ff8) }
  /DISCARD/ : { *(.text*) *(.rodata*) *(.data*) *(.bss*) *(.sdata*) *(.sbss*) *(.comment) }
}
