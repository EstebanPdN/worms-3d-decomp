/* Generated reference-only placements. All bodies are source-built. */
OUTPUT_FORMAT("elf32-powerpc")
OUTPUT_ARCH(powerpc)
ENTRY(d25c_bullet_update_800e4414)
_SDA_BASE_ = 0x804b2540;
_SDA2_BASE_ = 0x804c2540;
lookup_80164fc8 = 0x80164fc8;
query_800dfd48 = 0x800dfd48;
step_800df7b8 = 0x800df7b8;
type_80360cf0 = 0x80360cf0;
type_80360e10 = 0x80360e10;
zero_8038a0c8 = 0x8038a0c8;
SECTIONS {
  .text.d25c_bullet_update_800e4414 0x800e4414 : { *(.text.d25c_bullet_update_800e4414) }
  /DISCARD/ : { *(.text*) *(.rodata*) *(.data*) *(.bss*) *(.sdata*) *(.sbss*) *(.comment) }
}
