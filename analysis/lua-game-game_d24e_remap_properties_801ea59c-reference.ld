/* Generated reference-only placements. All bodies are source-built. */
OUTPUT_FORMAT("elf32-powerpc")
OUTPUT_ARCH(powerpc)
ENTRY(w3d_d24e_remap_properties_801ea59c)
_SDA_BASE_ = 0x804b2540;
_SDA2_BASE_ = 0x804c2540;
fn_801e9db8 = 0x801e9db8;
fn_8020fe00 = 0x8020fe00;
fn_8020fe18 = 0x8020fe18;
fn_8020ff3c = 0x8020ff3c;
SECTIONS {
  .text.w3d_d24e_remap_properties_801ea59c 0x801ea59c : { *(.text.w3d_d24e_remap_properties_801ea59c) }
  /DISCARD/ : { *(.text*) *(.rodata*) *(.data*) *(.bss*) *(.sdata*) *(.sbss*) *(.comment) }
}
