/* Generated reference-only placements. All bodies are source-built. */
OUTPUT_FORMAT("elf32-powerpc")
OUTPUT_ARCH(powerpc)
ENTRY(w3d_registry_retain_800d2470)
_SDA_BASE_ = 0x804b2540;
_SDA2_BASE_ = 0x804c2540;
w3d_fn_800d5364 = 0x800d5364;
w3d_fn_800d53ac = 0x800d53ac;
w3d_fn_800d58ec = 0x800d58ec;
w3d_fn_800d5a14 = 0x800d5a14;
w3d_fn_800d78ec = 0x800d78ec;
w3d_fn_800d797c = 0x800d797c;
w3d_fn_800da250 = 0x800da250;
w3d_fn_800da2a0 = 0x800da2a0;
w3d_fn_800daa2c = 0x800daa2c;
w3d_fn_800daad8 = 0x800daad8;
w3d_fn_800e06fc = 0x800e06fc;
w3d_fn_800e28b0 = 0x800e28b0;
w3d_fn_800e2908 = 0x800e2908;
w3d_fn_800e366c = 0x800e366c;
w3d_fn_800e50cc = 0x800e50cc;
w3d_fn_800e5154 = 0x800e5154;
w3d_fn_800e7a98 = 0x800e7a98;
w3d_fn_800e7ae4 = 0x800e7ae4;
w3d_fn_800e7e20 = 0x800e7e20;
w3d_fn_800e7ed8 = 0x800e7ed8;
w3d_fn_800ea180 = 0x800ea180;
w3d_fn_800ea324 = 0x800ea324;
w3d_fn_800ee274 = 0x800ee274;
w3d_fn_800ee2d8 = 0x800ee2d8;
w3d_global_80360c00 = 0x80360c00;
w3d_global_80360c30 = 0x80360c30;
w3d_global_80360c60 = 0x80360c60;
w3d_global_80360c90 = 0x80360c90;
w3d_global_80360cc0 = 0x80360cc0;
w3d_global_80360cf0 = 0x80360cf0;
w3d_global_80360d20 = 0x80360d20;
w3d_global_80360d50 = 0x80360d50;
w3d_global_80360d80 = 0x80360d80;
w3d_global_80360db0 = 0x80360db0;
w3d_global_80360de0 = 0x80360de0;
w3d_global_80360e10 = 0x80360e10;
w3d_global_80360e40 = 0x80360e40;
w3d_global_80360e70 = 0x80360e70;
w3d_heap_allocate_entry_a = 0x801fe1d8;
w3d_owner_list_remove = 0x8020fd2c;
w3d_registry_list_80360c00 = 0x80360c00;
w3d_registry_list_80360c30 = 0x80360c30;
w3d_registry_list_80360c60 = 0x80360c60;
w3d_registry_list_80360c90 = 0x80360c90;
w3d_registry_list_80360cc0 = 0x80360cc0;
w3d_registry_list_80360cf0 = 0x80360cf0;
w3d_registry_list_80360d20 = 0x80360d20;
w3d_registry_list_80360d50 = 0x80360d50;
w3d_registry_list_80360d80 = 0x80360d80;
w3d_registry_list_80360db0 = 0x80360db0;
w3d_registry_list_80360de0 = 0x80360de0;
w3d_registry_list_80360e10 = 0x80360e10;
w3d_registry_list_80360e40 = 0x80360e40;
w3d_state_register = 0x8020fd04;
SECTIONS {
  .text.w3d_registry_retain_800d2470 0x800d2470 : { *(.text.w3d_registry_retain_800d2470) }
  .text.w3d_empty_800d278c 0x800d278c : { *(.text.w3d_empty_800d278c) }
  .text.w3d_address_800d5240 0x800d5240 : { *(.text.w3d_address_800d5240) }
  .text.w3d_registry_unlink_800d524c 0x800d524c : { *(.text.w3d_registry_unlink_800d524c) }
  .text.w3d_registry_create_800d5290 0x800d5290 : { *(.text.w3d_registry_create_800d5290) }
  .text.w3d_registry_release_800d52f0 0x800d52f0 : { *(.text.w3d_registry_release_800d52f0) }
  .text.w3d_registry_retain_800d534c 0x800d534c : { *(.text.w3d_registry_retain_800d534c) }
  .text.w3d_address_800d57c8 0x800d57c8 : { *(.text.w3d_address_800d57c8) }
  .text.w3d_registry_unlink_800d57d4 0x800d57d4 : { *(.text.w3d_registry_unlink_800d57d4) }
  .text.w3d_registry_create_800d5818 0x800d5818 : { *(.text.w3d_registry_create_800d5818) }
  .text.w3d_registry_release_800d5878 0x800d5878 : { *(.text.w3d_registry_release_800d5878) }
  .text.w3d_registry_retain_800d58d4 0x800d58d4 : { *(.text.w3d_registry_retain_800d58d4) }
  .text.w3d_address_800d77c8 0x800d77c8 : { *(.text.w3d_address_800d77c8) }
  .text.w3d_registry_unlink_800d77d4 0x800d77d4 : { *(.text.w3d_registry_unlink_800d77d4) }
  .text.w3d_registry_create_800d7818 0x800d7818 : { *(.text.w3d_registry_create_800d7818) }
  .text.w3d_registry_release_800d7878 0x800d7878 : { *(.text.w3d_registry_release_800d7878) }
  .text.w3d_registry_retain_800d78d4 0x800d78d4 : { *(.text.w3d_registry_retain_800d78d4) }
  .text.w3d_address_800da12c 0x800da12c : { *(.text.w3d_address_800da12c) }
  .text.w3d_registry_unlink_800da138 0x800da138 : { *(.text.w3d_registry_unlink_800da138) }
  .text.w3d_registry_create_800da17c 0x800da17c : { *(.text.w3d_registry_create_800da17c) }
  .text.w3d_registry_release_800da1dc 0x800da1dc : { *(.text.w3d_registry_release_800da1dc) }
  .text.w3d_registry_retain_800da238 0x800da238 : { *(.text.w3d_registry_retain_800da238) }
  .text.w3d_address_800da908 0x800da908 : { *(.text.w3d_address_800da908) }
  .text.w3d_registry_unlink_800da914 0x800da914 : { *(.text.w3d_registry_unlink_800da914) }
  .text.w3d_registry_create_800da958 0x800da958 : { *(.text.w3d_registry_create_800da958) }
  .text.w3d_registry_release_800da9b8 0x800da9b8 : { *(.text.w3d_registry_release_800da9b8) }
  .text.w3d_registry_retain_800daa14 0x800daa14 : { *(.text.w3d_registry_retain_800daa14) }
  .text.w3d_constant_800dae14 0x800dae14 : { *(.text.w3d_constant_800dae14) }
  .text.w3d_empty_800ddb1c 0x800ddb1c : { *(.text.w3d_empty_800ddb1c) }
  .text.w3d_constant_800ddb20 0x800ddb20 : { *(.text.w3d_constant_800ddb20) }
  .text.w3d_empty_800ddfe0 0x800ddfe0 : { *(.text.w3d_empty_800ddfe0) }
  .text.w3d_constant_800de688 0x800de688 : { *(.text.w3d_constant_800de688) }
  .text.w3d_set_800de690 0x800de690 : { *(.text.w3d_set_800de690) }
  .text.w3d_address_800e0554 0x800e0554 : { *(.text.w3d_address_800e0554) }
  .text.w3d_registry_unlink_800e0560 0x800e0560 : { *(.text.w3d_registry_unlink_800e0560) }
  .text.w3d_registry_release_800e0604 0x800e0604 : { *(.text.w3d_registry_release_800e0604) }
  .text.w3d_registry_retain_800e0660 0x800e0660 : { *(.text.w3d_registry_retain_800e0660) }
  .text.w3d_address_800e278c 0x800e278c : { *(.text.w3d_address_800e278c) }
  .text.w3d_registry_unlink_800e2798 0x800e2798 : { *(.text.w3d_registry_unlink_800e2798) }
  .text.w3d_registry_create_800e27dc 0x800e27dc : { *(.text.w3d_registry_create_800e27dc) }
  .text.w3d_registry_release_800e283c 0x800e283c : { *(.text.w3d_registry_release_800e283c) }
  .text.w3d_registry_retain_800e2898 0x800e2898 : { *(.text.w3d_registry_retain_800e2898) }
  .text.w3d_constant_800e3434 0x800e3434 : { *(.text.w3d_constant_800e3434) }
  .text.w3d_address_800e34d8 0x800e34d8 : { *(.text.w3d_address_800e34d8) }
  .text.w3d_registry_unlink_800e34e4 0x800e34e4 : { *(.text.w3d_registry_unlink_800e34e4) }
  .text.w3d_registry_release_800e3588 0x800e3588 : { *(.text.w3d_registry_release_800e3588) }
  .text.w3d_registry_retain_800e35e4 0x800e35e4 : { *(.text.w3d_registry_retain_800e35e4) }
  .text.w3d_address_800e4fa8 0x800e4fa8 : { *(.text.w3d_address_800e4fa8) }
  .text.w3d_registry_unlink_800e4fb4 0x800e4fb4 : { *(.text.w3d_registry_unlink_800e4fb4) }
  .text.w3d_registry_create_800e4ff8 0x800e4ff8 : { *(.text.w3d_registry_create_800e4ff8) }
  .text.w3d_registry_release_800e5058 0x800e5058 : { *(.text.w3d_registry_release_800e5058) }
  .text.w3d_registry_retain_800e50b4 0x800e50b4 : { *(.text.w3d_registry_retain_800e50b4) }
  .text.w3d_constant_800e5a68 0x800e5a68 : { *(.text.w3d_constant_800e5a68) }
  .text.w3d_get_800e7230 0x800e7230 : { *(.text.w3d_get_800e7230) }
  .text.w3d_constant_800e7244 0x800e7244 : { *(.text.w3d_constant_800e7244) }
  .text.w3d_address_800e7974 0x800e7974 : { *(.text.w3d_address_800e7974) }
  .text.w3d_registry_unlink_800e7980 0x800e7980 : { *(.text.w3d_registry_unlink_800e7980) }
  .text.w3d_registry_create_800e79c4 0x800e79c4 : { *(.text.w3d_registry_create_800e79c4) }
  .text.w3d_registry_release_800e7a24 0x800e7a24 : { *(.text.w3d_registry_release_800e7a24) }
  .text.w3d_registry_retain_800e7a80 0x800e7a80 : { *(.text.w3d_registry_retain_800e7a80) }
  .text.w3d_constant_800e7be0 0x800e7be0 : { *(.text.w3d_constant_800e7be0) }
  .text.w3d_empty_800e7be8 0x800e7be8 : { *(.text.w3d_empty_800e7be8) }
  .text.w3d_address_800e7cfc 0x800e7cfc : { *(.text.w3d_address_800e7cfc) }
  .text.w3d_registry_unlink_800e7d08 0x800e7d08 : { *(.text.w3d_registry_unlink_800e7d08) }
  .text.w3d_registry_create_800e7d4c 0x800e7d4c : { *(.text.w3d_registry_create_800e7d4c) }
  .text.w3d_registry_release_800e7dac 0x800e7dac : { *(.text.w3d_registry_release_800e7dac) }
  .text.w3d_registry_retain_800e7e08 0x800e7e08 : { *(.text.w3d_registry_retain_800e7e08) }
  .text.w3d_address_800ea05c 0x800ea05c : { *(.text.w3d_address_800ea05c) }
  .text.w3d_registry_unlink_800ea068 0x800ea068 : { *(.text.w3d_registry_unlink_800ea068) }
  .text.w3d_registry_create_800ea0ac 0x800ea0ac : { *(.text.w3d_registry_create_800ea0ac) }
  .text.w3d_registry_release_800ea10c 0x800ea10c : { *(.text.w3d_registry_release_800ea10c) }
  .text.w3d_registry_retain_800ea168 0x800ea168 : { *(.text.w3d_registry_retain_800ea168) }
  .text.w3d_empty_800ee120 0x800ee120 : { *(.text.w3d_empty_800ee120) }
  .text.w3d_address_800ee150 0x800ee150 : { *(.text.w3d_address_800ee150) }
  .text.w3d_registry_unlink_800ee15c 0x800ee15c : { *(.text.w3d_registry_unlink_800ee15c) }
  .text.w3d_registry_create_800ee1a0 0x800ee1a0 : { *(.text.w3d_registry_create_800ee1a0) }
  .text.w3d_registry_release_800ee200 0x800ee200 : { *(.text.w3d_registry_release_800ee200) }
  .text.w3d_registry_retain_800ee25c 0x800ee25c : { *(.text.w3d_registry_retain_800ee25c) }
  .text.w3d_constant_800ee630 0x800ee630 : { *(.text.w3d_constant_800ee630) }
  .text.w3d_address_800efa4c 0x800efa4c : { *(.text.w3d_address_800efa4c) }
  /DISCARD/ : { *(.text*) *(.rodata*) *(.data*) *(.bss*) *(.sdata*) *(.sbss*) *(.comment) }
}
