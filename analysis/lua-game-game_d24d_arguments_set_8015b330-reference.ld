/* Generated reference-only placements. All bodies are source-built. */
OUTPUT_FORMAT("elf32-powerpc")
OUTPUT_ARCH(powerpc)
ENTRY(d24d_arguments_set_8015b330)
_SDA_BASE_ = 0x804b2540;
_SDA2_BASE_ = 0x804c2540;
__20d24d_String_803426b8 = 0x803426b8;
d24d_fill_insert_80347570 = 0x80347570;
d24d_string_assign_8020bd38 = 0x8020bd38;
d24d_string_finish_8020c5c4 = 0x8020c5c4;
d24d_string_release_80341588 = 0x80341588;
SECTIONS {
  .text.d24d_arguments_set_8015b330 0x8015b330 : { *(.text.d24d_arguments_set_8015b330) }
  /DISCARD/ : { *(.text*) *(.rodata*) *(.data*) *(.bss*) *(.sdata*) *(.sbss*) *(.comment) }
}
