/* Generated reference-only placements. All bodies are source-built. */
OUTPUT_FORMAT("elf32-powerpc")
OUTPUT_ARCH(powerpc)
ENTRY(w3d_s20_set_blend_mode_8016830c)
_SDA_BASE_ = 0x804b2540;
_SDA2_BASE_ = 0x804c2540;
fn_8030c410 = 0x8030c410;
lbl_cc008000 = 0xcc008000;
SECTIONS {
  .text.w3d_s20_set_blend_mode_8016830c 0x8016830c : { *(.text.w3d_s20_set_blend_mode_8016830c) }
  /DISCARD/ : { *(.text*) *(.rodata*) *(.data*) *(.bss*) *(.sdata*) *(.sbss*) *(.comment) }
}
