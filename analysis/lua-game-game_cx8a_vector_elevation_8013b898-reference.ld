/* Generated reference-only placements. All bodies are source-built. */
OUTPUT_FORMAT("elf32-powerpc")
OUTPUT_ARCH(powerpc)
ENTRY(w3d_cx8a_vector_elevation_8013b898)
_SDA_BASE_ = 0x804b2540;
_SDA2_BASE_ = 0x804c2540;
angle_802e83ec = 0x802e83ec;
root_802e82c0 = 0x802e82c0;
zero_8039f800 = 0x8039f800;
SECTIONS {
  .text.w3d_cx8a_vector_elevation_8013b898 0x8013b898 : { *(.text.w3d_cx8a_vector_elevation_8013b898) }
  /DISCARD/ : { *(.text*) *(.rodata*) *(.data*) *(.bss*) *(.sdata*) *(.sbss*) *(.comment) }
}
