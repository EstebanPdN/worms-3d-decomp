/* Generated reference-only placements. All bodies are source-built. */
OUTPUT_FORMAT("elf32-powerpc")
OUTPUT_ARCH(powerpc)
ENTRY(w3d_d21e_register_table_column_properties_802262c4)
_SDA_BASE_ = 0x804b2540;
_SDA2_BASE_ = 0x804c2540;
d20e_empty_804b06a0 = 0x804b06a0;
d20e_release_header_8020bb2c = 0x8020bb2c;
d20e_string_finish_8020c5c4 = 0x8020c5c4;
d20e_string_header_80341884 = 0x80341884;
d20e_string_init_8020c5c0 = 0x8020c5c0;
d20e_string_release_80341588 = 0x80341588;
desc_803b7ed8 = 0x803b7ed8;
desc_803b7f0c = 0x803b7f0c;
desc_803b7f3c = 0x803b7f3c;
desc_803b7f64 = 0x803b7f64;
desc_803b7f9c = 0x803b7f9c;
fn_801e8d9c = 0x801e8d9c;
fn_801eb674 = 0x801eb674;
fn_801ec52c = 0x801ec52c;
fn_801ece2c = 0x801ece2c;
fn_801ed24c = 0x801ed24c;
fn_801efe60 = 0x801efe60;
fn_801efff0 = 0x801efff0;
lbl_803b7fc4 = 0x803b7fc4;
lbl_803b7fcc = 0x803b7fcc;
lbl_8045ed58 = 0x8045ed58;
lbl_8045ed94 = 0x8045ed94;
memset = 0x802eefe0;
SECTIONS {
  .text.w3d_d21e_register_table_column_properties_802262c4 0x802262c4 : { *(.text.w3d_d21e_register_table_column_properties_802262c4) }
  .bss 0x80464a54 : { *(.bss) }
  .sbss 0x804b07dc : { *(.sbss) }
  /DISCARD/ : { *(.text*) *(.rodata*) *(.data*) *(.bss*) *(.sdata*) *(.sbss*) *(.comment) }
}
