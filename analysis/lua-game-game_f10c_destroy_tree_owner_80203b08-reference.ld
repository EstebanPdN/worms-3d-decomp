/* Generated reference-only placements. All bodies are source-built. */
OUTPUT_FORMAT("elf32-powerpc")
OUTPUT_ARCH(powerpc)
ENTRY(_._19F10c_80203b08_Owner)
_SDA_BASE_ = 0x804b2540;
_SDA2_BASE_ = 0x804c2540;
__dl__19F10c_80203b08_OwnerPv = 0x801fe1f8;
fn_80210990 = 0x80210990;
fn_802134fc = 0x802134fc;
fn_8035a3f8 = 0x8035a3f8;
fn_8035b2d4 = 0x8035b2d4;
fn_8035b84c = 0x8035b84c;
fn_8035b8a4 = 0x8035b8a4;
fn_8035b8fc = 0x8035b8fc;
vt_80418f88 = 0x80418f88;
vt_80419038 = 0x80419038;
SECTIONS {
  .text._._19F10c_80203b08_Owner 0x80203b08 : { *(.text._._19F10c_80203b08_Owner) }
  /DISCARD/ : { *(.text*) *(.rodata*) *(.data*) *(.bss*) *(.sdata*) *(.sbss*) *(.comment) }
}
