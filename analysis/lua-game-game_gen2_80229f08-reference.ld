/* Generated reference-only placements. All bodies are source-built. */
OUTPUT_FORMAT("elf32-powerpc")
OUTPUT_ARCH(powerpc)
ENTRY(w3d_registry_create_typed_80229f08)
_SDA_BASE_ = 0x804b2540;
_SDA2_BASE_ = 0x804c2540;
w3d_fn_801ea70c = 0x801ea70c;
w3d_fn_80229fb4 = 0x80229fb4;
w3d_fn_8022a180 = 0x8022a180;
w3d_fn_8022be48 = 0x8022be48;
w3d_fn_8022c09c = 0x8022c09c;
w3d_fn_8022c2f0 = 0x8022c2f0;
w3d_fn_8022c860 = 0x8022c860;
w3d_fn_8022cc48 = 0x8022cc48;
w3d_fn_8022ce9c = 0x8022ce9c;
w3d_registry_list_80366578 = 0x80366578;
w3d_registry_list_803665c8 = 0x803665c8;
w3d_registry_list_80366618 = 0x80366618;
w3d_registry_list_80366668 = 0x80366668;
w3d_registry_list_803666b8 = 0x803666b8;
w3d_registry_list_80366708 = 0x80366708;
w3d_registry_list_80366758 = 0x80366758;
w3d_registry_list_803667a8 = 0x803667a8;
w3d_state_register = 0x8020fd04;
w3d_string_release_header = 0x8020bb2c;
SECTIONS {
  .text.w3d_registry_create_typed_80229f08 0x80229f08 : { *(.text.w3d_registry_create_typed_80229f08) }
  .text.w3d_registry_create_typed_8022a0d4 0x8022a0d4 : { *(.text.w3d_registry_create_typed_8022a0d4) }
  .text.w3d_registry_create_typed_8022bd9c 0x8022bd9c : { *(.text.w3d_registry_create_typed_8022bd9c) }
  .text.w3d_registry_create_typed_8022bff0 0x8022bff0 : { *(.text.w3d_registry_create_typed_8022bff0) }
  .text.w3d_registry_create_typed_8022c244 0x8022c244 : { *(.text.w3d_registry_create_typed_8022c244) }
  .text.w3d_registry_create_typed_8022c7b4 0x8022c7b4 : { *(.text.w3d_registry_create_typed_8022c7b4) }
  .text.w3d_registry_create_typed_8022cb9c 0x8022cb9c : { *(.text.w3d_registry_create_typed_8022cb9c) }
  .text.w3d_registry_create_typed_8022cdf0 0x8022cdf0 : { *(.text.w3d_registry_create_typed_8022cdf0) }
  .text.w3d_strassign_8022ee8c 0x8022ee8c : { *(.text.w3d_strassign_8022ee8c) }
  .text.w3d_strassign_8022eefc 0x8022eefc : { *(.text.w3d_strassign_8022eefc) }
  .text.w3d_strassign_8022ef6c 0x8022ef6c : { *(.text.w3d_strassign_8022ef6c) }
  .text.w3d_strassign_8022efdc 0x8022efdc : { *(.text.w3d_strassign_8022efdc) }
  .text.w3d_strassign_8022f04c 0x8022f04c : { *(.text.w3d_strassign_8022f04c) }
  .text.w3d_strassign_8022f0bc 0x8022f0bc : { *(.text.w3d_strassign_8022f0bc) }
  .text.w3d_strassign_8022f12c 0x8022f12c : { *(.text.w3d_strassign_8022f12c) }
  .text.w3d_strassign_8022f19c 0x8022f19c : { *(.text.w3d_strassign_8022f19c) }
  .text.w3d_strassign_8022f20c 0x8022f20c : { *(.text.w3d_strassign_8022f20c) }
  .text.w3d_strassign_8022f27c 0x8022f27c : { *(.text.w3d_strassign_8022f27c) }
  .text.w3d_strassign_8022f2fc 0x8022f2fc : { *(.text.w3d_strassign_8022f2fc) }
  .text.w3d_strassign_8022f36c 0x8022f36c : { *(.text.w3d_strassign_8022f36c) }
  .text.w3d_strassign_8022f3dc 0x8022f3dc : { *(.text.w3d_strassign_8022f3dc) }
  .text.w3d_strassign_8022f44c 0x8022f44c : { *(.text.w3d_strassign_8022f44c) }
  .text.w3d_strassign_8022f4bc 0x8022f4bc : { *(.text.w3d_strassign_8022f4bc) }
  .text.w3d_strassign_8022f52c 0x8022f52c : { *(.text.w3d_strassign_8022f52c) }
  .text.w3d_strassign_8022f59c 0x8022f59c : { *(.text.w3d_strassign_8022f59c) }
  .text.w3d_strassign_8022f60c 0x8022f60c : { *(.text.w3d_strassign_8022f60c) }
  .text.w3d_strassign_8022f67c 0x8022f67c : { *(.text.w3d_strassign_8022f67c) }
  .text.w3d_strassign_8022f73c 0x8022f73c : { *(.text.w3d_strassign_8022f73c) }
  .text.w3d_strassign_8022f7ac 0x8022f7ac : { *(.text.w3d_strassign_8022f7ac) }
  .text.w3d_strassign_8022f82c 0x8022f82c : { *(.text.w3d_strassign_8022f82c) }
  .text.w3d_strassign_8022f89c 0x8022f89c : { *(.text.w3d_strassign_8022f89c) }
  .text.w3d_strassign_8022f91c 0x8022f91c : { *(.text.w3d_strassign_8022f91c) }
  .text.w3d_strassign_8022f98c 0x8022f98c : { *(.text.w3d_strassign_8022f98c) }
  .text.w3d_strassign_8022f9fc 0x8022f9fc : { *(.text.w3d_strassign_8022f9fc) }
  .text.w3d_strassign_8022fa6c 0x8022fa6c : { *(.text.w3d_strassign_8022fa6c) }
  .text.w3d_strassign_8022fadc 0x8022fadc : { *(.text.w3d_strassign_8022fadc) }
  .text.w3d_strassign_8022fb4c 0x8022fb4c : { *(.text.w3d_strassign_8022fb4c) }
  .text.w3d_strassign_8022fc00 0x8022fc00 : { *(.text.w3d_strassign_8022fc00) }
  .text.w3d_strassign_8022fc70 0x8022fc70 : { *(.text.w3d_strassign_8022fc70) }
  .text.w3d_strassign_8022fce0 0x8022fce0 : { *(.text.w3d_strassign_8022fce0) }
  .text.w3d_strassign_8022fd50 0x8022fd50 : { *(.text.w3d_strassign_8022fd50) }
  .text.w3d_strassign_8022fdc0 0x8022fdc0 : { *(.text.w3d_strassign_8022fdc0) }
  .text.w3d_strassign_8022fe30 0x8022fe30 : { *(.text.w3d_strassign_8022fe30) }
  .text.w3d_strassign_8022fea0 0x8022fea0 : { *(.text.w3d_strassign_8022fea0) }
  .text.w3d_strassign_8022ff10 0x8022ff10 : { *(.text.w3d_strassign_8022ff10) }
  .text.w3d_strassign_8022ff80 0x8022ff80 : { *(.text.w3d_strassign_8022ff80) }
  .text.w3d_strassign_8022fff0 0x8022fff0 : { *(.text.w3d_strassign_8022fff0) }
  .text.w3d_strassign_80230060 0x80230060 : { *(.text.w3d_strassign_80230060) }
  .text.w3d_strassign_802300d0 0x802300d0 : { *(.text.w3d_strassign_802300d0) }
  .text.w3d_strassign_80230140 0x80230140 : { *(.text.w3d_strassign_80230140) }
  .text.w3d_strassign_802301b0 0x802301b0 : { *(.text.w3d_strassign_802301b0) }
  .text.w3d_strassign_80230220 0x80230220 : { *(.text.w3d_strassign_80230220) }
  .text.w3d_strassign_802302a0 0x802302a0 : { *(.text.w3d_strassign_802302a0) }
  .text.w3d_strassign_80230310 0x80230310 : { *(.text.w3d_strassign_80230310) }
  .text.w3d_strassign_80230380 0x80230380 : { *(.text.w3d_strassign_80230380) }
  .text.w3d_strassign_802303f0 0x802303f0 : { *(.text.w3d_strassign_802303f0) }
  .text.w3d_strassign_80230460 0x80230460 : { *(.text.w3d_strassign_80230460) }
  .text.w3d_strassign_80230510 0x80230510 : { *(.text.w3d_strassign_80230510) }
  .text.w3d_strassign_80230580 0x80230580 : { *(.text.w3d_strassign_80230580) }
  .text.w3d_strassign_802305f0 0x802305f0 : { *(.text.w3d_strassign_802305f0) }
  .text.w3d_strassign_802306d4 0x802306d4 : { *(.text.w3d_strassign_802306d4) }
  .text.w3d_strassign_80230744 0x80230744 : { *(.text.w3d_strassign_80230744) }
  .text.w3d_strassign_80230814 0x80230814 : { *(.text.w3d_strassign_80230814) }
  .text.w3d_strassign_80230884 0x80230884 : { *(.text.w3d_strassign_80230884) }
  .text.w3d_strassign_802308f4 0x802308f4 : { *(.text.w3d_strassign_802308f4) }
  .text.w3d_strassign_80230964 0x80230964 : { *(.text.w3d_strassign_80230964) }
  .text.w3d_strassign_80230a54 0x80230a54 : { *(.text.w3d_strassign_80230a54) }
  .text.w3d_strassign_80230ac4 0x80230ac4 : { *(.text.w3d_strassign_80230ac4) }
  .text.w3d_strassign_80230b34 0x80230b34 : { *(.text.w3d_strassign_80230b34) }
  .text.w3d_strassign_80230ba4 0x80230ba4 : { *(.text.w3d_strassign_80230ba4) }
  .text.w3d_strassign_80230c14 0x80230c14 : { *(.text.w3d_strassign_80230c14) }
  .text.w3d_strassign_80230d04 0x80230d04 : { *(.text.w3d_strassign_80230d04) }
  .text.w3d_strassign_80230d74 0x80230d74 : { *(.text.w3d_strassign_80230d74) }
  .text.w3d_strassign_80230e04 0x80230e04 : { *(.text.w3d_strassign_80230e04) }
  .text.w3d_strassign_80230e74 0x80230e74 : { *(.text.w3d_strassign_80230e74) }
  .text.w3d_strassign_80230ee4 0x80230ee4 : { *(.text.w3d_strassign_80230ee4) }
  .text.w3d_strassign_80230f54 0x80230f54 : { *(.text.w3d_strassign_80230f54) }
  .text.w3d_strassign_80231024 0x80231024 : { *(.text.w3d_strassign_80231024) }
  .text.w3d_strassign_80231094 0x80231094 : { *(.text.w3d_strassign_80231094) }
  .text.w3d_strassign_80231104 0x80231104 : { *(.text.w3d_strassign_80231104) }
  /DISCARD/ : { *(.text*) *(.rodata*) *(.data*) *(.bss*) *(.sdata*) *(.sbss*) *(.comment) }
}
