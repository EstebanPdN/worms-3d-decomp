/* Generated reference-only placements. All bodies are source-built. */
OUTPUT_FORMAT("elf32-powerpc")
OUTPUT_ARCH(powerpc)
ENTRY(w3d_k10a_texture_set_destroy_800f2bac)
_SDA_BASE_ = 0x804b2540;
_SDA2_BASE_ = 0x804c2540;
w3d_auto_8026c860 = 0x8026c860;
w3d_handle_storage_release = 0x802134fc;
w3d_service_destroy_801628ec = 0x801628ec;
w3d_string_base_finish = 0x8020c5c4;
w3d_string_release = 0x80341588;
w3d_vtable_804103e8 = 0x804103e8;
SECTIONS {
  .text.w3d_k10a_texture_set_destroy_800f2bac 0x800f2bac : { *(.text.w3d_k10a_texture_set_destroy_800f2bac) }
  /DISCARD/ : { *(.text*) *(.rodata*) *(.data*) *(.bss*) *(.sdata*) *(.sbss*) *(.comment) }
}
