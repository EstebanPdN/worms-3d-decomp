/* Generated reference-only placements. All bodies are source-built. */
OUTPUT_FORMAT("elf32-powerpc")
OUTPUT_ARCH(powerpc)
ENTRY(w3d_s21_write_float_8020dcc8)
_SDA_BASE_ = 0x804b2540;
_SDA2_BASE_ = 0x804c2540;
fn_802ef9c0 = 0x802ef9c0;
fn_8035cb74 = 0x8035cb74;
lbl_803b3258 = 0x803b3258;
SECTIONS {
  .text.w3d_s21_write_float_8020dcc8 0x8020dcc8 : { *(.text.w3d_s21_write_float_8020dcc8) }
  /DISCARD/ : { *(.text*) *(.rodata*) *(.data*) *(.bss*) *(.sdata*) *(.sbss*) *(.comment) }
}
