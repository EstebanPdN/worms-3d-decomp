/* Generated reference-only placements. All bodies are source-built. */
OUTPUT_FORMAT("elf32-powerpc")
OUTPUT_ARCH(powerpc)
ENTRY(d24i_material_link_8010682c)
_SDA_BASE_ = 0x804b2540;
_SDA2_BASE_ = 0x804c2540;
d24i_class_80415c30 = 0x80415c30;
d24i_class_80416560 = 0x80416560;
d24i_create_8020b680 = 0x8020b680;
d24i_manager_8020b648 = 0x8020b648;
d24i_record_8040e078 = 0x8040e078;
d24i_record_804143e0 = 0x804143e0;
SECTIONS {
  .text.d24i_material_link_8010682c 0x8010682c : { *(.text.d24i_material_link_8010682c) }
  /DISCARD/ : { *(.text*) *(.rodata*) *(.data*) *(.bss*) *(.sdata*) *(.sbss*) *(.comment) }
}
