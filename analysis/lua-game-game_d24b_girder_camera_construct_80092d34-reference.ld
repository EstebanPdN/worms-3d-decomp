/* Generated reference-only placements. All bodies are source-built. */
OUTPUT_FORMAT("elf32-powerpc")
OUTPUT_ARCH(powerpc)
ENTRY(w3d_d24b_girder_camera_construct_80092d34)
_SDA_BASE_ = 0x804b2540;
_SDA2_BASE_ = 0x804c2540;
w3d_camera_construct_800d2dec = 0x800d2dec;
w3d_camera_set_name_800d31d8 = 0x800d31d8;
w3d_identity_803426b4 = 0x803426b4;
w3d_identity_80342fa4 = 0x80342fa4;
w3d_resource_property_800fc1b0 = 0x800fc1b0;
w3d_string_8037e8b8 = 0x8037e8b8;
w3d_string_8037e8c4 = 0x8037e8c4;
w3d_string_8037e8d4 = 0x8037e8d4;
w3d_string_8037e8e4 = 0x8037e8e4;
w3d_string_8037e8f4 = 0x8037e8f4;
w3d_vtable_8040f180 = 0x8040f180;
SECTIONS {
  .text.w3d_d24b_girder_camera_construct_80092d34 0x80092d34 : { *(.text.w3d_d24b_girder_camera_construct_80092d34) }
  /DISCARD/ : { *(.text*) *(.rodata*) *(.data*) *(.bss*) *(.sdata*) *(.sbss*) *(.comment) }
}
