/* Generated reference-only placements. All bodies are source-built. */
OUTPUT_FORMAT("elf32-powerpc")
OUTPUT_ARCH(powerpc)
ENTRY(w3d_d25e_write_float_swapped_802041d4)
_SDA_BASE_ = 0x804b2540;
_SDA2_BASE_ = 0x804c2540;
fn_802047e0 = 0x802047e0;
SECTIONS {
  .text.w3d_d25e_write_float_swapped_802041d4 0x802041d4 : { *(.text.w3d_d25e_write_float_swapped_802041d4) }
  /DISCARD/ : { *(.text*) *(.rodata*) *(.data*) *(.bss*) *(.sdata*) *(.sbss*) *(.comment) }
}
