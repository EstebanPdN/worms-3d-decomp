/* Generated reference-only placements. All bodies are source-built. */
OUTPUT_FORMAT("elf32-powerpc")
OUTPUT_ARCH(powerpc)
ENTRY(w3d_sol35d4_initialize_strings_802214c8)
_SDA_BASE_ = 0x804b2540;
_SDA2_BASE_ = 0x804c2540;
fn_801e8d9c = 0x801e8d9c;
fn_801ed24c = 0x801ed24c;
fn_8020bb2c = 0x8020bb2c;
fn_8020c5c0 = 0x8020c5c0;
fn_8020c5c4 = 0x8020c5c4;
fn_80341588 = 0x80341588;
fn_80341884 = 0x80341884;
lbl_803b6810 = 0x803b6810;
lbl_803b6844 = 0x803b6844;
lbl_803b6878 = 0x803b6878;
lbl_803b68ac = 0x803b68ac;
lbl_803b68e4 = 0x803b68e4;
lbl_803b691c = 0x803b691c;
lbl_803b6954 = 0x803b6954;
lbl_803b698c = 0x803b698c;
lbl_803b69c4 = 0x803b69c4;
lbl_803b69fc = 0x803b69fc;
lbl_803b6a2c = 0x803b6a2c;
lbl_804b06a0 = 0x804b06a0;
SECTIONS {
  .text.w3d_sol35d4_initialize_strings_802214c8 0x802214c8 : { *(.text.w3d_sol35d4_initialize_strings_802214c8) }
  /DISCARD/ : { *(.text*) *(.rodata*) *(.data*) *(.bss*) *(.sdata*) *(.sbss*) *(.comment) }
}
