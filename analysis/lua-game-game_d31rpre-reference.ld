/* Generated reference-only placements. All bodies are source-built. */
OUTPUT_FORMAT("elf32-powerpc")
OUTPUT_ARCH(powerpc)
ENTRY(d29j_apply_properties_801763e4)
_SDA_BASE_ = 0x804b2540;
_SDA2_BASE_ = 0x804c2540;
fn_80178c48 = 0x80178c48;
fn_80178d1c = 0x80178d1c;
fn_80178df0 = 0x80178df0;
fn_80178ec4 = 0x80178ec4;
fn_80179170 = 0x80179170;
fn_801797b4 = 0x801797b4;
fn_8020c5c0 = 0x8020c5c0;
fn_8020c5c4 = 0x8020c5c4;
fn_80341584 = 0x80341584;
fn_80341588 = 0x80341588;
fn_80341884 = 0x80341884;
fn_803426b4 = 0x803426b4;
fn_80342a74 = 0x80342a74;
fn_80342a78 = 0x80342a78;
fn_80342fa4 = 0x80342fa4;
fn_80343744 = 0x80343744;
SECTIONS {
  .text.d29j_apply_properties_801763e4 0x801763e4 : { *(.text.d29j_apply_properties_801763e4) }
  /DISCARD/ : { *(.text*) *(.rodata*) *(.data*) *(.bss*) *(.sdata*) *(.sbss*) *(.comment) }
}
