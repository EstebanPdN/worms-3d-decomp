/* Generated reference-only placements. All bodies are source-built. */
OUTPUT_FORMAT("elf32-powerpc")
OUTPUT_ARCH(powerpc)
ENTRY(d24c_v2_worm_drop_ctor_800d2dec)
_SDA_BASE_ = 0x804b2540;
_SDA2_BASE_ = 0x804c2540;
as_a_80342a74 = 0x80342a74;
base_8015a0d4 = 0x8015a0d4;
k_80388cb4 = 0x80388cb4;
name_80388c94 = 0x80388c94;
one_80388cb0 = 0x80388cb0;
read_800fc1b0 = 0x800fc1b0;
vtable_8040fc90 = 0x8040fc90;
z_80388cac = 0x80388cac;
SECTIONS {
  .text.d24c_v2_worm_drop_ctor_800d2dec 0x800d2dec : { *(.text.d24c_v2_worm_drop_ctor_800d2dec) }
  /DISCARD/ : { *(.text*) *(.rodata*) *(.data*) *(.bss*) *(.sdata*) *(.sbss*) *(.comment) }
}
