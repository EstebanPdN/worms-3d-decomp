/* Generated reference-only placements. All bodies are source-built. */
OUTPUT_FORMAT("elf32-powerpc")
OUTPUT_ARCH(powerpc)
ENTRY(s11_attach_border_80293994)
_SDA_BASE_ = 0x804b2540;
_SDA2_BASE_ = 0x804c2540;
fn_80174820 = 0x80174820;
fn_8020B680 = 0x8020b680;
fn_8020BB2C = 0x8020bb2c;
fn_8020BB54 = 0x8020bb54;
fn_8020C5C4 = 0x8020c5c4;
fn_80341588 = 0x80341588;
lbl_803D06F4 = 0x803d06f4;
lbl_804144E8 = 0x804144e8;
SECTIONS {
  .text.s11_attach_border_80293994 0x80293994 : { *(.text.s11_attach_border_80293994) }
  /DISCARD/ : { *(.text*) *(.rodata*) *(.data*) *(.bss*) *(.sdata*) *(.sbss*) *(.comment) }
}
