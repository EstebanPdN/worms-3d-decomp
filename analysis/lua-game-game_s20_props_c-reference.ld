/* Generated reference-only placements. All bodies are source-built. */
OUTPUT_FORMAT("elf32-powerpc")
OUTPUT_ARCH(powerpc)
ENTRY(w3d_s20_register_vector_entries_801bfcf4)
_SDA_BASE_ = 0x804b2540;
_SDA2_BASE_ = 0x804c2540;
fn_801e8d9c = 0x801e8d9c;
fn_801ec52c = 0x801ec52c;
fn_801f0504 = 0x801f0504;
lbl_803ac12c = 0x803ac12c;
lbl_803ac150 = 0x803ac150;
lbl_803ac18c = 0x803ac18c;
lbl_803ac1c8 = 0x803ac1c8;
lbl_803ac208 = 0x803ac208;
lbl_803ac230 = 0x803ac230;
SECTIONS {
  .text.w3d_s20_register_vector_entries_801bfcf4 0x801bfcf4 : { *(.text.w3d_s20_register_vector_entries_801bfcf4) }
  /DISCARD/ : { *(.text*) *(.rodata*) *(.data*) *(.bss*) *(.sdata*) *(.sbss*) *(.comment) }
}
