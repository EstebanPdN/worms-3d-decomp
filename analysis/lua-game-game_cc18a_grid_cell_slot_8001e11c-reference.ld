/* Generated reference-only placements. All bodies are source-built. */
OUTPUT_FORMAT("elf32-powerpc")
OUTPUT_ARCH(powerpc)
ENTRY(w3d_cc18a_grid_cell_slot_8001e11c)
_SDA_BASE_ = 0x804b2540;
_SDA2_BASE_ = 0x804c2540;
FUN_8001df1c = 0x8001df1c;
SECTIONS {
  .text.w3d_cc18a_grid_cell_slot_8001e11c 0x8001e11c : { *(.text.w3d_cc18a_grid_cell_slot_8001e11c) }
  /DISCARD/ : { *(.text*) *(.rodata*) *(.data*) *(.bss*) *(.sdata*) *(.sbss*) *(.comment) }
}
