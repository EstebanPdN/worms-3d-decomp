/* Generated reference-only placements. All bodies are source-built. */
OUTPUT_FORMAT("elf32-powerpc")
OUTPUT_ARCH(powerpc)
ENTRY(d30l_textbox_start_8029e584)
_SDA_BASE_ = 0x804b2540;
_SDA2_BASE_ = 0x804c2540;
__3StrPCc = 0x8020bb54;
fn_800fc1b0 = 0x800fc1b0;
fn_800fd62c = 0x800fd62c;
fn_8015adf4 = 0x8015adf4;
fn_80165254 = 0x80165254;
fn_80178df0 = 0x80178df0;
fn_80178f54 = 0x80178f54;
fn_80179170 = 0x80179170;
fn_801fe45c = 0x801fe45c;
fn_8020c5c4 = 0x8020c5c4;
fn_8029fb54 = 0x8029fb54;
fn_8029fc78 = 0x8029fc78;
fn_802b0b84 = 0x802b0b84;
fn_80341588 = 0x80341588;
fn_803426b8 = 0x803426b8;
fn_80342a74 = 0x80342a74;
fn_8034357c = 0x8034357c;
fn_80343744 = 0x80343744;
fn_80343df4 = 0x80343df4;
strcmp = 0x802ef234;
SECTIONS {
  .text.d30l_textbox_start_8029e584 0x8029e584 : { *(.text.d30l_textbox_start_8029e584) }
  .rodata 0x803d1d18 : { *(.rodata) }
  /DISCARD/ : { *(.text*) *(.rodata*) *(.data*) *(.bss*) *(.sdata*) *(.sbss*) *(.comment) }
}
