/* Generated reference-only placements. All bodies are source-built. */
OUTPUT_FORMAT("elf32-powerpc")
OUTPUT_ARCH(powerpc)
ENTRY(w3d_dtor_801c150c)
_SDA_BASE_ = 0x804b2540;
_SDA2_BASE_ = 0x804c2540;
w3d_address_801d1c04 = 0x801d1c04;
w3d_address_801d3088 = 0x801d3088;
w3d_address_801d4184 = 0x801d4184;
w3d_address_801d46f0 = 0x801d46f0;
w3d_address_801d4f90 = 0x801d4f90;
w3d_address_801d5384 = 0x801d5384;
w3d_address_801d5cf8 = 0x801d5cf8;
w3d_fn_801c0818 = 0x801c0818;
w3d_fn_801c9134 = 0x801c9134;
w3d_fn_801cd750 = 0x801cd750;
w3d_fn_801ce3f4 = 0x801ce3f4;
w3d_fn_801ea0ec = 0x801ea0ec;
w3d_fn_801ea138 = 0x801ea138;
w3d_fn_801ea740 = 0x801ea740;
w3d_fn_8020b460 = 0x8020b460;
w3d_vtable_80414bf0 = 0x80414bf0;
w3d_vtable_80414c68 = 0x80414c68;
w3d_vtable_80414c90 = 0x80414c90;
w3d_vtable_80414d80 = 0x80414d80;
w3d_vtable_80414dd0 = 0x80414dd0;
w3d_vtable_80414df8 = 0x80414df8;
w3d_vtable_80415da8 = 0x80415da8;
w3d_vtable_80415dd0 = 0x80415dd0;
w3d_vtable_80415df8 = 0x80415df8;
w3d_vtable_80415e20 = 0x80415e20;
w3d_vtable_80415e48 = 0x80415e48;
w3d_vtable_80415e70 = 0x80415e70;
w3d_vtable_80415e98 = 0x80415e98;
w3d_vtable_80415ec0 = 0x80415ec0;
w3d_vtable_80415ee8 = 0x80415ee8;
w3d_vtable_80415f10 = 0x80415f10;
w3d_vtable_80415f60 = 0x80415f60;
w3d_vtable_80415f88 = 0x80415f88;
w3d_vtable_80415fb0 = 0x80415fb0;
w3d_vtable_80415fd8 = 0x80415fd8;
w3d_vtable_80416000 = 0x80416000;
w3d_vtable_80416028 = 0x80416028;
w3d_vtable_80416050 = 0x80416050;
w3d_vtable_80416078 = 0x80416078;
w3d_vtable_804160a0 = 0x804160a0;
w3d_vtable_804160c8 = 0x804160c8;
w3d_vtable_804160f0 = 0x804160f0;
w3d_vtable_80416118 = 0x80416118;
w3d_vtable_80416140 = 0x80416140;
w3d_vtable_80416168 = 0x80416168;
w3d_vtable_80416190 = 0x80416190;
w3d_vtable_804161b8 = 0x804161b8;
w3d_vtable_804161e0 = 0x804161e0;
w3d_vtable_80416208 = 0x80416208;
w3d_vtable_80416230 = 0x80416230;
w3d_vtable_80416370 = 0x80416370;
SECTIONS {
  .text.w3d_dtor_801c150c 0x801c150c : { *(.text.w3d_dtor_801c150c) }
  .text.w3d_dtor_801c169c 0x801c169c : { *(.text.w3d_dtor_801c169c) }
  .text.w3d_dtor_held_801c1f5c 0x801c1f5c : { *(.text.w3d_dtor_held_801c1f5c) }
  .text.w3d_dtor_held_801c3af4 0x801c3af4 : { *(.text.w3d_dtor_held_801c3af4) }
  .text.w3d_dtor_801c3d58 0x801c3d58 : { *(.text.w3d_dtor_801c3d58) }
  .text.w3d_dtor_held_801c48c0 0x801c48c0 : { *(.text.w3d_dtor_held_801c48c0) }
  .text.w3d_ifaceset_801c7e84 0x801c7e84 : { *(.text.w3d_ifaceset_801c7e84) }
  .text.w3d_ifaceset_801c7f10 0x801c7f10 : { *(.text.w3d_ifaceset_801c7f10) }
  .text.w3d_ifaceset_801c7f7c 0x801c7f7c : { *(.text.w3d_ifaceset_801c7f7c) }
  .text.w3d_ifaceset_801c7fe8 0x801c7fe8 : { *(.text.w3d_ifaceset_801c7fe8) }
  .text.w3d_ifaceset_801c8054 0x801c8054 : { *(.text.w3d_ifaceset_801c8054) }
  .text.w3d_ifaceset_801c80c0 0x801c80c0 : { *(.text.w3d_ifaceset_801c80c0) }
  .text.w3d_ifaceset_801c812c 0x801c812c : { *(.text.w3d_ifaceset_801c812c) }
  .text.w3d_ifaceset_801c8238 0x801c8238 : { *(.text.w3d_ifaceset_801c8238) }
  .text.w3d_ifaceset_801c82a4 0x801c82a4 : { *(.text.w3d_ifaceset_801c82a4) }
  .text.w3d_ifaceset_801c8310 0x801c8310 : { *(.text.w3d_ifaceset_801c8310) }
  .text.w3d_ifaceset_801c837c 0x801c837c : { *(.text.w3d_ifaceset_801c837c) }
  .text.w3d_ifaceset_801c8754 0x801c8754 : { *(.text.w3d_ifaceset_801c8754) }
  .text.w3d_ifaceset_801c87c0 0x801c87c0 : { *(.text.w3d_ifaceset_801c87c0) }
  .text.w3d_ifaceset_801c8924 0x801c8924 : { *(.text.w3d_ifaceset_801c8924) }
  .text.w3d_ifaceset_801c8ca4 0x801c8ca4 : { *(.text.w3d_ifaceset_801c8ca4) }
  .text.w3d_ifaceset_801c8e30 0x801c8e30 : { *(.text.w3d_ifaceset_801c8e30) }
  .text.w3d_dtor_held_801c96b8 0x801c96b8 : { *(.text.w3d_dtor_held_801c96b8) }
  .text.w3d_dtor_801cb464 0x801cb464 : { *(.text.w3d_dtor_801cb464) }
  .text.w3d_dtor_801cb654 0x801cb654 : { *(.text.w3d_dtor_801cb654) }
  .text.w3d_dtor_801cb98c 0x801cb98c : { *(.text.w3d_dtor_801cb98c) }
  .text.w3d_dtor_801cbb38 0x801cbb38 : { *(.text.w3d_dtor_801cbb38) }
  .text.w3d_dtor_801cbcc4 0x801cbcc4 : { *(.text.w3d_dtor_801cbcc4) }
  .text.w3d_dtor_801cbe50 0x801cbe50 : { *(.text.w3d_dtor_801cbe50) }
  .text.w3d_dtor_801cbffc 0x801cbffc : { *(.text.w3d_dtor_801cbffc) }
  .text.w3d_dtor_801cc1e8 0x801cc1e8 : { *(.text.w3d_dtor_801cc1e8) }
  .text.w3d_dtor_801cc394 0x801cc394 : { *(.text.w3d_dtor_801cc394) }
  .text.w3d_dtor_801cc550 0x801cc550 : { *(.text.w3d_dtor_801cc550) }
  .text.w3d_dtor_801cc6dc 0x801cc6dc : { *(.text.w3d_dtor_801cc6dc) }
  .text.w3d_dtor_801cc868 0x801cc868 : { *(.text.w3d_dtor_801cc868) }
  .text.w3d_dtor_801cc9f8 0x801cc9f8 : { *(.text.w3d_dtor_801cc9f8) }
  .text.w3d_dtor_801ccb88 0x801ccb88 : { *(.text.w3d_dtor_801ccb88) }
  .text.w3d_dtor_801ccd1c 0x801ccd1c : { *(.text.w3d_dtor_801ccd1c) }
  .text.w3d_dtor_801ccee8 0x801ccee8 : { *(.text.w3d_dtor_801ccee8) }
  .text.w3d_dtor_801cd138 0x801cd138 : { *(.text.w3d_dtor_801cd138) }
  .text.w3d_dtor_801cd360 0x801cd360 : { *(.text.w3d_dtor_801cd360) }
  .text.w3d_dtor_801cd504 0x801cd504 : { *(.text.w3d_dtor_801cd504) }
  .text.w3d_dtor_801cdc00 0x801cdc00 : { *(.text.w3d_dtor_801cdc00) }
  .text.w3d_dtor_held_801cddbc 0x801cddbc : { *(.text.w3d_dtor_held_801cddbc) }
  .text.w3d_dtor_held_801ce064 0x801ce064 : { *(.text.w3d_dtor_held_801ce064) }
  .text.w3d_ctor_801ce28c 0x801ce28c : { *(.text.w3d_ctor_801ce28c) }
  .text.w3d_dtor_801ce2c8 0x801ce2c8 : { *(.text.w3d_dtor_801ce2c8) }
  .text.w3d_dtor_801ce4a0 0x801ce4a0 : { *(.text.w3d_dtor_801ce4a0) }
  .text.w3d_dtor_801ce6b8 0x801ce6b8 : { *(.text.w3d_dtor_801ce6b8) }
  .text.w3d_ctor_801ce860 0x801ce860 : { *(.text.w3d_ctor_801ce860) }
  .text.w3d_dtor_801ce89c 0x801ce89c : { *(.text.w3d_dtor_801ce89c) }
  .text.w3d_dtor_held_801cea24 0x801cea24 : { *(.text.w3d_dtor_held_801cea24) }
  .text.w3d_dtor_held_801cec60 0x801cec60 : { *(.text.w3d_dtor_held_801cec60) }
  .text.w3d_dtor_801cee30 0x801cee30 : { *(.text.w3d_dtor_801cee30) }
  .text.w3d_ifaceset_801d08c8 0x801d08c8 : { *(.text.w3d_ifaceset_801d08c8) }
  .text.w3d_ifaceset_801d0934 0x801d0934 : { *(.text.w3d_ifaceset_801d0934) }
  .text.w3d_ifaceset_801d09a0 0x801d09a0 : { *(.text.w3d_ifaceset_801d09a0) }
  .text.w3d_ifaceset_801d0a0c 0x801d0a0c : { *(.text.w3d_ifaceset_801d0a0c) }
  .text.w3d_ifaceset_801d0a78 0x801d0a78 : { *(.text.w3d_ifaceset_801d0a78) }
  .text.w3d_ifaceset_801d0ae4 0x801d0ae4 : { *(.text.w3d_ifaceset_801d0ae4) }
  .text.w3d_ifaceset_801d0b50 0x801d0b50 : { *(.text.w3d_ifaceset_801d0b50) }
  .text.w3d_ifaceset_801d0c0c 0x801d0c0c : { *(.text.w3d_ifaceset_801d0c0c) }
  .text.w3d_ifaceset_801d0c78 0x801d0c78 : { *(.text.w3d_ifaceset_801d0c78) }
  .text.w3d_ifaceset_801d0d34 0x801d0d34 : { *(.text.w3d_ifaceset_801d0d34) }
  .text.w3d_ifaceset_801d1540 0x801d1540 : { *(.text.w3d_ifaceset_801d1540) }
  .text.w3d_ifaceset_801d168c 0x801d168c : { *(.text.w3d_ifaceset_801d168c) }
  .text.w3d_ifaceset_801d17e4 0x801d17e4 : { *(.text.w3d_ifaceset_801d17e4) }
  .text.w3d_ifaceset_801d18a0 0x801d18a0 : { *(.text.w3d_ifaceset_801d18a0) }
  .text.w3d_ifaceset_801d190c 0x801d190c : { *(.text.w3d_ifaceset_801d190c) }
  .text.w3d_ifaceset_801d1978 0x801d1978 : { *(.text.w3d_ifaceset_801d1978) }
  .text.w3d_ifaceset_801d19e4 0x801d19e4 : { *(.text.w3d_ifaceset_801d19e4) }
  .text.w3d_ifaceset_801d1a50 0x801d1a50 : { *(.text.w3d_ifaceset_801d1a50) }
  .text.w3d_ifaceset_801d1abc 0x801d1abc : { *(.text.w3d_ifaceset_801d1abc) }
  .text.w3d_forward_801d1c84 0x801d1c84 : { *(.text.w3d_forward_801d1c84) }
  .text.w3d_forward_801d3108 0x801d3108 : { *(.text.w3d_forward_801d3108) }
  .text.w3d_forward_801d4204 0x801d4204 : { *(.text.w3d_forward_801d4204) }
  .text.w3d_forward_801d4770 0x801d4770 : { *(.text.w3d_forward_801d4770) }
  .text.w3d_forward_801d5010 0x801d5010 : { *(.text.w3d_forward_801d5010) }
  .text.w3d_forward_801d5404 0x801d5404 : { *(.text.w3d_forward_801d5404) }
  .text.w3d_forward_801d5d78 0x801d5d78 : { *(.text.w3d_forward_801d5d78) }
  /DISCARD/ : { *(.text*) *(.rodata*) *(.data*) *(.bss*) *(.sdata*) *(.sbss*) *(.comment) }
}
