/* Generated reference-only placements. All bodies are source-built. */
OUTPUT_FORMAT("elf32-powerpc")
OUTPUT_ARCH(powerpc)
ENTRY(w3d_cx9b_hashed_string_index_8020cbcc)
_SDA_BASE_ = 0x804b2540;
_SDA2_BASE_ = 0x804c2540;
compare_802ef234 = 0x802ef234;
SECTIONS {
  .text.w3d_cx9b_hashed_string_index_8020cbcc 0x8020cbcc : { *(.text.w3d_cx9b_hashed_string_index_8020cbcc) }
  /DISCARD/ : { *(.text*) *(.rodata*) *(.data*) *(.bss*) *(.sdata*) *(.sbss*) *(.comment) }
}
