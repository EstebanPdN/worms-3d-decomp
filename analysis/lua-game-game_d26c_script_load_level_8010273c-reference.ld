/* Generated reference-only placements. All bodies are source-built. */
OUTPUT_FORMAT("elf32-powerpc")
OUTPUT_ARCH(powerpc)
ENTRY(d26c_script_load_level_8010273c)
_SDA_BASE_ = 0x804b2540;
_SDA2_BASE_ = 0x804c2540;
__6String = 0x803426b8;
clear_80102474 = 0x80102474;
comma_80398ebc = 0x80398ebc;
failed_80398ec0 = 0x80398ec0;
file_80102530 = 0x80102530;
format__6StringPCce = 0x8020c510;
forward_800fd4c8 = 0x800fd4c8;
hook_801022e8 = 0x801022e8;
loaded_80398ef8 = 0x80398ef8;
name_80398e7c = 0x80398e7c;
read_800fc2b0 = 0x800fc2b0;
stdlib_80398e94 = 0x80398e94;
strcpy = 0x802ef2fc;
string_finish_8020c5c4 = 0x8020c5c4;
string_release_80341588 = 0x80341588;
strtok = 0x802efd7c;
SECTIONS {
  .text.d26c_script_load_level_8010273c 0x8010273c : { *(.text.d26c_script_load_level_8010273c) }
  /DISCARD/ : { *(.text*) *(.rodata*) *(.data*) *(.bss*) *(.sdata*) *(.sbss*) *(.comment) }
}
