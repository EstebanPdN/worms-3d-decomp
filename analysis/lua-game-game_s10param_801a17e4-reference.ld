/* Generated reference-only placements. All bodies are source-built. */
OUTPUT_FORMAT("elf32-powerpc")
OUTPUT_ARCH(powerpc)
ENTRY(w3d_s10_initialize_type_801a17e4)
_SDA_BASE_ = 0x804b2540;
_SDA2_BASE_ = 0x804c2540;
fn_801a118c = 0x801a118c;
fn_801a1220 = 0x801a1220;
fn_801f3f28 = 0x801f3f28;
fn_801f3fbc = 0x801f3fbc;
fn_80200af8 = 0x80200af8;
fn_80209050 = 0x80209050;
fn_80209058 = 0x80209058;
lbl_803a9b68 = 0x803a9b68;
lbl_803b0ecc = 0x803b0ecc;
lbl_803b2ea4 = 0x803b2ea4;
lbl_8045cdfc = 0x8045cdfc;
lbl_8045cea4 = 0x8045cea4;
lbl_8045e17c = 0x8045e17c;
lbl_8045e6bc = 0x8045e6bc;
lbl_80462e78 = 0x80462e78;
lbl_80463308 = 0x80463308;
SECTIONS {
  .text.w3d_s10_initialize_type_801a17e4 0x801a17e4 : { *(.text.w3d_s10_initialize_type_801a17e4) }
  .text.w3d_s10_initialize_type_801f4064 0x801f4064 : { *(.text.w3d_s10_initialize_type_801f4064) }
  .text.w3d_s10_initialize_type_802090b8 0x802090b8 : { *(.text.w3d_s10_initialize_type_802090b8) }
  /DISCARD/ : { *(.text*) *(.rodata*) *(.data*) *(.bss*) *(.sdata*) *(.sbss*) *(.comment) }
}
