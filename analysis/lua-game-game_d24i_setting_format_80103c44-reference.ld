/* Generated reference-only placements. All bodies are source-built. */
OUTPUT_FORMAT("elf32-powerpc")
OUTPUT_ARCH(powerpc)
ENTRY(d24i_setting_format_80103c44)
_SDA_BASE_ = 0x804b2540;
_SDA2_BASE_ = 0x804c2540;
__11d24i_String = 0x803426b8;
d24i_as_bool_80342a78 = 0x80342a78;
d24i_as_float_80342a74 = 0x80342a74;
d24i_as_int_803426b4 = 0x803426b4;
d24i_as_text_80343744 = 0x80343744;
d24i_error_803994ec = 0x803994ec;
d24i_format_bool_8039948c = 0x8039948c;
d24i_format_float_80399480 = 0x80399480;
d24i_format_int_80399484 = 0x80399484;
d24i_format_text_80399488 = 0x80399488;
d24i_item_rename_801790bc = 0x801790bc;
d24i_item_text_80179170 = 0x80179170;
d24i_read_bool_80178d1c = 0x80178d1c;
d24i_read_float_80178df0 = 0x80178df0;
d24i_read_int_80178c48 = 0x80178c48;
d24i_setting_lookup_800fc1b0 = 0x800fc1b0;
d24i_setting_substitute_80103a5c = 0x80103a5c;
d24i_setting_write_800fc550 = 0x800fc550;
d24i_string_finish_8020c5c4 = 0x8020c5c4;
d24i_string_format_8020c510 = 0x8020c510;
d24i_string_header_80341884 = 0x80341884;
d24i_string_init_8020c5c0 = 0x8020c5c0;
d24i_string_release_80341588 = 0x80341588;
SECTIONS {
  .text.d24i_setting_format_80103c44 0x80103c44 : { *(.text.d24i_setting_format_80103c44) }
  /DISCARD/ : { *(.text*) *(.rodata*) *(.data*) *(.bss*) *(.sdata*) *(.sbss*) *(.comment) }
}
