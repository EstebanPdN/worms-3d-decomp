/* Generated reference-only placements. All bodies are source-built. */
OUTPUT_FORMAT("elf32-powerpc")
OUTPUT_ARCH(powerpc)
ENTRY(w3d_s10_init_two_properties_801cd3b0)
_SDA_BASE_ = 0x804b2540;
_SDA2_BASE_ = 0x804c2540;
fn_801e8d9c = 0x801e8d9c;
fn_801ec52c = 0x801ec52c;
lbl_803ae6ec = 0x803ae6ec;
lbl_803ae720 = 0x803ae720;
SECTIONS {
  .text.w3d_s10_init_two_properties_801cd3b0 0x801cd3b0 : { *(.text.w3d_s10_init_two_properties_801cd3b0) }
  /DISCARD/ : { *(.text*) *(.rodata*) *(.data*) *(.bss*) *(.sdata*) *(.sbss*) *(.comment) }
}
