/* Generated reference-only placements. All bodies are source-built. */
OUTPUT_FORMAT("elf32-powerpc")
OUTPUT_ARCH(powerpc)
ENTRY(w3d_cx12a_draw_animation_8013d730)
_SDA_BASE_ = 0x804b2540;
_SDA2_BASE_ = 0x804c2540;
first_8039fa84 = 0x8039fa84;
name_8039fa20 = 0x8039fa20;
name_8039fa34 = 0x8039fa34;
name_8039fa48 = 0x8039fa48;
name_8039fa54 = 0x8039fa54;
name_8039fa60 = 0x8039fa60;
name_8039fa68 = 0x8039fa68;
name_8039fa78 = 0x8039fa78;
play_801359ec = 0x801359ec;
second_8039fa88 = 0x8039fa88;
third_8039fa8c = 0x8039fa8c;
SECTIONS {
  .text.w3d_cx12a_draw_animation_8013d730 0x8013d730 : { *(.text.w3d_cx12a_draw_animation_8013d730) }
  /DISCARD/ : { *(.text*) *(.rodata*) *(.data*) *(.bss*) *(.sdata*) *(.sbss*) *(.comment) }
}
