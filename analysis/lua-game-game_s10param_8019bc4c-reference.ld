/* Generated reference-only placements. All bodies are source-built. */
OUTPUT_FORMAT("elf32-powerpc")
OUTPUT_ARCH(powerpc)
ENTRY(w3d_s10_init_two_properties_8019bc4c)
_SDA_BASE_ = 0x804b2540;
_SDA2_BASE_ = 0x804c2540;
fn_801e8d9c = 0x801e8d9c;
fn_801eb674 = 0x801eb674;
lbl_803a96fc = 0x803a96fc;
lbl_803a9738 = 0x803a9738;
SECTIONS {
  .text.w3d_s10_init_two_properties_8019bc4c 0x8019bc4c : { *(.text.w3d_s10_init_two_properties_8019bc4c) }
  /DISCARD/ : { *(.text*) *(.rodata*) *(.data*) *(.bss*) *(.sdata*) *(.sbss*) *(.comment) }
}
