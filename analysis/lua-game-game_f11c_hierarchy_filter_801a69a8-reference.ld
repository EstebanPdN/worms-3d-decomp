/* Generated reference-only placements. All bodies are source-built. */
OUTPUT_FORMAT("elf32-powerpc")
OUTPUT_ARCH(powerpc)
ENTRY(f11c_hierarchy_801a69a8)
_SDA_BASE_ = 0x804b2540;
_SDA2_BASE_ = 0x804c2540;
lbl_80362754 = 0x80362754;
lbl_803627f4 = 0x803627f4;
SECTIONS {
  .text.f11c_hierarchy_801a69a8 0x801a69a8 : { *(.text.f11c_hierarchy_801a69a8) }
  /DISCARD/ : { *(.text*) *(.rodata*) *(.data*) *(.bss*) *(.sdata*) *(.sbss*) *(.comment) }
}
