/* Generated reference-only placements. All bodies are source-built. */
OUTPUT_FORMAT("elf32-powerpc")
OUTPUT_ARCH(powerpc)
ENTRY(w3d_s21_node_update_80270fc8)
_SDA_BASE_ = 0x804b2540;
_SDA2_BASE_ = 0x804c2540;
__7S21Texti = 0x8020bb54;
fn_8020c5c4__FP7S21Text = 0x8020c5c4;
fn_8027113c__FP7S21Nodei = 0x8027113c;
fn_80271348__FP7S21NodePc = 0x80271348;
fn_80271420__FP7S21Node = 0x80271420;
fn_802cba50__Fi = 0x802cba50;
fn_802cbacc__Fi = 0x802cbacc;
fn_802cbb5c__Fi = 0x802cbb5c;
fn_802cbc68__Fi = 0x802cbc68;
fn_802ccb00__Fi = 0x802ccb00;
fn_802ccb40__Fi = 0x802ccb40;
fn_80341588__FP7S21Text = 0x80341588;
SECTIONS {
  .text.w3d_s21_node_update_80270fc8 0x80270fc8 : { *(.text.w3d_s21_node_update_80270fc8) }
  /DISCARD/ : { *(.text*) *(.rodata*) *(.data*) *(.bss*) *(.sdata*) *(.sbss*) *(.comment) }
}
