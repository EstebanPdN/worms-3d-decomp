/* Generated reference-only placements. All bodies are source-built. */
OUTPUT_FORMAT("elf32-powerpc")
OUTPUT_ARCH(powerpc)
ENTRY(tterra_b26_visit_node_801aab74)
_SDA_BASE_ = 0x804b2540;
_SDA2_BASE_ = 0x804c2540;
fn_801a9cbc = 0x801a9cbc;
fn_801aa15c = 0x801aa15c;
SECTIONS {
  .text.tterra_b26_visit_node_801aab74 0x801aab74 : { *(.text.tterra_b26_visit_node_801aab74) }
  /DISCARD/ : { *(.text*) *(.rodata*) *(.data*) *(.bss*) *(.sdata*) *(.sbss*) *(.comment) }
}
