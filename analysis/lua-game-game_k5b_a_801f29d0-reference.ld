/* Generated reference-only placements. All bodies are source-built. */
OUTPUT_FORMAT("elf32-powerpc")
OUTPUT_ARCH(powerpc)
ENTRY(w3d_k5b_task_pool_reserve_801f29d0)
_SDA_BASE_ = 0x804b2540;
_SDA2_BASE_ = 0x804c2540;
fn_801f282c = 0x801f282c;
SECTIONS {
  .text.w3d_k5b_task_pool_reserve_801f29d0 0x801f29d0 : { *(.text.w3d_k5b_task_pool_reserve_801f29d0) }
  /DISCARD/ : { *(.text*) *(.rodata*) *(.data*) *(.bss*) *(.sdata*) *(.sbss*) *(.comment) }
}
