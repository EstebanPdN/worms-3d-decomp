/* Generated reference-only placements. All bodies are source-built. */
OUTPUT_FORMAT("elf32-powerpc")
OUTPUT_ARCH(powerpc)
ENTRY(d25d_colour_properties_8015f090)
_SDA_BASE_ = 0x804b2540;
_SDA2_BASE_ = 0x804c2540;
_._5Array = 0x801f2758;
__5Array = 0x801f2678;
forward_8020b680 = 0x8020b680;
resize__5ArrayUi = 0x801f282c;
service_8020b648 = 0x8020b648;
t0_80415c30 = 0x80415c30;
t1_80415c20 = 0x80415c20;
t2_80415c40 = 0x80415c40;
t3_80415bd0 = 0x80415bd0;
t4_804143e0 = 0x804143e0;
SECTIONS {
  .text.d25d_colour_properties_8015f090 0x8015f090 : { *(.text.d25d_colour_properties_8015f090) }
  .rodata 0x803a456c : { *(.rodata) }
  /DISCARD/ : { *(.text*) *(.rodata*) *(.data*) *(.bss*) *(.sdata*) *(.sbss*) *(.comment) }
}
