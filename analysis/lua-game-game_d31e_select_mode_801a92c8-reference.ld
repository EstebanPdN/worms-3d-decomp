/* Generated reference-only placements. All bodies are source-built. */
OUTPUT_FORMAT("elf32-powerpc")
OUTPUT_ARCH(powerpc)
ENTRY(w3d_d31e_select_mode_801a92c8)
_SDA_BASE_ = 0x804b2540;
_SDA2_BASE_ = 0x804c2540;
k_80363b54 = 0x80363b54;
k_80363ba4 = 0x80363ba4;
w3d_r24b_invoke_ready_callback_8020fcb4 = 0x8020fcb4;
SECTIONS {
  .text.w3d_d31e_select_mode_801a92c8 0x801a92c8 : { *(.text.w3d_d31e_select_mode_801a92c8) }
  /DISCARD/ : { *(.text*) *(.rodata*) *(.data*) *(.bss*) *(.sdata*) *(.sbss*) *(.comment) }
}
