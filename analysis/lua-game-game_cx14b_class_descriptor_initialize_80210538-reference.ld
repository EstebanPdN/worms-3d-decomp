/* Generated reference-only placements. All bodies are source-built. */
OUTPUT_FORMAT("elf32-powerpc")
OUTPUT_ARCH(powerpc)
ENTRY(w3d_cx14b_class_descriptor_initialize_80210538)
_SDA_BASE_ = 0x804b2540;
_SDA2_BASE_ = 0x804c2540;
callback_80210344 = 0x80210344;
construct_802109dc = 0x802109dc;
descriptor_80463bec = 0x80463bec;
name_803b35a0 = 0x803b35a0;
object_80463be0 = 0x80463be0;
parent_80463308 = 0x80463308;
register_80200af8 = 0x80200af8;
SECTIONS {
  .text.w3d_cx14b_class_descriptor_initialize_80210538 0x80210538 : { *(.text.w3d_cx14b_class_descriptor_initialize_80210538) }
  /DISCARD/ : { *(.text*) *(.rodata*) *(.data*) *(.bss*) *(.sdata*) *(.sbss*) *(.comment) }
}
