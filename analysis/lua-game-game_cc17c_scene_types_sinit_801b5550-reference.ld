/* Generated reference-only placements. All bodies are source-built. */
OUTPUT_FORMAT("elf32-powerpc")
OUTPUT_ARCH(powerpc)
ENTRY(w3d_cc17c_sinit_801b5550)
_SDA_BASE_ = 0x804b2540;
_SDA2_BASE_ = 0x804c2540;
fn_801b4b20 = 0x801b4b20;
fn_801b4cd4 = 0x801b4cd4;
fn_801b4de8 = 0x801b4de8;
fn_801b4f60 = 0x801b4f60;
fn_801b5044 = 0x801b5044;
fn_801b51a4 = 0x801b51a4;
fn_801b51f0 = 0x801b51f0;
fn_801b5328 = 0x801b5328;
fn_801b5358 = 0x801b5358;
fn_801b54e0 = 0x801b54e0;
fn_801e8a88 = 0x801e8a88;
lbl_80362704 = 0x80362704;
lbl_80362754 = 0x80362754;
lbl_803627a4 = 0x803627a4;
lbl_803627f4 = 0x803627f4;
lbl_80362844 = 0x80362844;
lbl_80365788 = 0x80365788;
lbl_803e8f24 = 0x803e8f24;
lbl_803e8f40 = 0x803e8f40;
lbl_803e8f5c = 0x803e8f5c;
lbl_803e8f78 = 0x803e8f78;
lbl_803e8f94 = 0x803e8f94;
SECTIONS {
  .text.w3d_cc17c_sinit_801b5550 0x801b5550 : { *(.text.w3d_cc17c_sinit_801b5550) }
  /DISCARD/ : { *(.text*) *(.rodata*) *(.data*) *(.bss*) *(.sdata*) *(.sbss*) *(.comment) }
}
