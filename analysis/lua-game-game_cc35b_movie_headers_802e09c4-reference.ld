/* Generated reference-only placements. All bodies are source-built. */
OUTPUT_FORMAT("elf32-powerpc")
OUTPUT_ARCH(powerpc)
ENTRY(w3d_cc35b_movie_headers_802e09c4)
_SDA_BASE_ = 0x804b2540;
_SDA2_BASE_ = 0x804c2540;
fn_801fdcac = 0x801fdcac;
fn_802f5320 = 0x802f5320;
fn_802fb7ac = 0x802fb7ac;
fn_80343994 = 0x80343994;
lbl_803db228 = 0x803db228;
lbl_803db25c = 0x803db25c;
SECTIONS {
  .text.w3d_cc35b_movie_headers_802e09c4 0x802e09c4 : { *(.text.w3d_cc35b_movie_headers_802e09c4) }
  /DISCARD/ : { *(.text*) *(.rodata*) *(.data*) *(.bss*) *(.sdata*) *(.sbss*) *(.comment) }
}
