/* Generated reference-only placements. All bodies are source-built. */
OUTPUT_FORMAT("elf32-powerpc")
OUTPUT_ARCH(powerpc)
ENTRY(w3d_d24k_heap_resize_80213750)
_SDA_BASE_ = 0x804b2540;
_SDA2_BASE_ = 0x804c2540;
fn_80212fd4 = 0x80212fd4;
fn_802134fc = 0x802134fc;
fn_802eafc4 = 0x802eafc4;
lbl_80463c4c = 0x80463c4c;
SECTIONS {
  .text.w3d_d24k_heap_resize_80213750 0x80213750 : { *(.text.w3d_d24k_heap_resize_80213750) }
  /DISCARD/ : { *(.text*) *(.rodata*) *(.data*) *(.bss*) *(.sdata*) *(.sbss*) *(.comment) }
}
