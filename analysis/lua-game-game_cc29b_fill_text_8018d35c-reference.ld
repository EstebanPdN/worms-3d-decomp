/* Generated reference-only placements. All bodies are source-built. */
OUTPUT_FORMAT("elf32-powerpc")
OUTPUT_ARCH(powerpc)
ENTRY(w3d_cc29b_fill_text_8018d35c)
_SDA_BASE_ = 0x804b2540;
_SDA2_BASE_ = 0x804c2540;
fn_8018d4bc = 0x8018d4bc;
fn_801ef048 = 0x801ef048;
fn_8034435c = 0x8034435c;
SECTIONS {
  .text.w3d_cc29b_fill_text_8018d35c 0x8018d35c : { *(.text.w3d_cc29b_fill_text_8018d35c) }
  /DISCARD/ : { *(.text*) *(.rodata*) *(.data*) *(.bss*) *(.sdata*) *(.sbss*) *(.comment) }
}
