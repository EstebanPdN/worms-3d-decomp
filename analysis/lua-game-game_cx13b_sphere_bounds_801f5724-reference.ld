/* Generated reference-only placements. All bodies are source-built. */
OUTPUT_FORMAT("elf32-powerpc")
OUTPUT_ARCH(powerpc)
ENTRY(w3d_cx13b_sphere_bounds_801f5724)
_SDA_BASE_ = 0x804b2540;
_SDA2_BASE_ = 0x804c2540;
empty_8045e690 = 0x8045e690;
zero_803b15b4 = 0x803b15b4;
SECTIONS {
  .text.w3d_cx13b_sphere_bounds_801f5724 0x801f5724 : { *(.text.w3d_cx13b_sphere_bounds_801f5724) }
  /DISCARD/ : { *(.text*) *(.rodata*) *(.data*) *(.bss*) *(.sdata*) *(.sbss*) *(.comment) }
}
