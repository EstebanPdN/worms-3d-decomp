/* Generated reference-only placements. All bodies are source-built. */
OUTPUT_FORMAT("elf32-powerpc")
OUTPUT_ARCH(powerpc)
ENTRY(_._18F1p_802b5740_Owner)
_SDA_BASE_ = 0x804b2540;
_SDA2_BASE_ = 0x804c2540;
_._26F1p_802b5740_Base_8015ff2c = 0x8015ff2c;
_._28F1p_802b5740_Member_802afc40 = 0x802afc40;
vt_8041c740 = 0x8041c740;
vt_8041c790 = 0x8041c790;
SECTIONS {
  .text._._18F1p_802b5740_Owner 0x802b5740 : { *(.text._._18F1p_802b5740_Owner) }
  /DISCARD/ : { *(.text*) *(.rodata*) *(.data*) *(.bss*) *(.sdata*) *(.sbss*) *(.comment) }
}
