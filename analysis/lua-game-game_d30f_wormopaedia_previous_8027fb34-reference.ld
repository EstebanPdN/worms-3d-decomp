/* Generated reference-only placements. All bodies are source-built. */
OUTPUT_FORMAT("elf32-powerpc")
OUTPUT_ARCH(powerpc)
ENTRY(d30f_wormopaedia_previous_8027fb34)
_SDA_BASE_ = 0x804b2540;
_SDA2_BASE_ = 0x804c2540;
f_8027fca8 = 0x8027fca8;
f_8028496c = 0x8028496c;
lbl_803cee10 = 0x803cee10;
lbl_803cee1c = 0x803cee1c;
s8_property_write_800fc43c = 0x800fc43c;
w3d_auto_800fc230 = 0x800fc230;
w3d_auto_801797b4 = 0x801797b4;
w3d_constructor_lookup_name = 0x800fc1b0;
w3d_empty_80341584 = 0x80341584;
w3d_string_base_init = 0x8020c5c0;
w3d_string_header = 0x80341884;
SECTIONS {
  .text.d30f_wormopaedia_previous_8027fb34 0x8027fb34 : { *(.text.d30f_wormopaedia_previous_8027fb34) }
  /DISCARD/ : { *(.text*) *(.rodata*) *(.data*) *(.bss*) *(.sdata*) *(.sbss*) *(.comment) }
}
