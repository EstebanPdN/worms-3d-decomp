/* Generated reference-only placements. All bodies are source-built. */
OUTPUT_FORMAT("elf32-powerpc")
OUTPUT_ARCH(powerpc)
ENTRY(w3d_cx8b_held_binding_refresh_80198b88)
_SDA_BASE_ = 0x804b2540;
_SDA2_BASE_ = 0x804c2540;
fn_8019a010 = 0x8019a010;
SECTIONS {
  .text.w3d_cx8b_held_binding_refresh_80198b88 0x80198b88 : { *(.text.w3d_cx8b_held_binding_refresh_80198b88) }
  /DISCARD/ : { *(.text*) *(.rodata*) *(.data*) *(.bss*) *(.sdata*) *(.sbss*) *(.comment) }
}
