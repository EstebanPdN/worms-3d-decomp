/* Generated reference-only placements. All bodies are source-built. */
OUTPUT_FORMAT("elf32-powerpc")
OUTPUT_ARCH(powerpc)
ENTRY(d44l_bordered_panel_build_8029fc78)
_SDA_BASE_ = 0x804b2540;
_SDA2_BASE_ = 0x804c2540;
__3Str = 0x803426b8;
__3StrPCc = 0x8020bb54;
fn_8015adf4 = 0x8015adf4;
fn_80173df0 = 0x80173df0;
fn_80173f88 = 0x80173f88;
fn_80178df0 = 0x80178df0;
fn_80178f54 = 0x80178f54;
fn_801fe1d8 = 0x801fe1d8;
fn_8020bd38 = 0x8020bd38;
fn_8020c5c0 = 0x8020c5c0;
fn_8020c5c4 = 0x8020c5c4;
fn_8025dffc = 0x8025dffc;
fn_8025e128 = 0x8025e128;
fn_8025ee60 = 0x8025ee60;
fn_8025ee94 = 0x8025ee94;
fn_8025f064 = 0x8025f064;
fn_80263608 = 0x80263608;
fn_80263bb8 = 0x80263bb8;
fn_80263c24 = 0x80263c24;
fn_80263c90 = 0x80263c90;
fn_80293460 = 0x80293460;
fn_8029358c = 0x8029358c;
fn_80294398 = 0x80294398;
fn_802943cc = 0x802943cc;
fn_8029459c = 0x8029459c;
fn_802a0e20 = 0x802a0e20;
fn_80341588 = 0x80341588;
fn_80341884 = 0x80341884;
fn_8034357c = 0x8034357c;
str_803d1de4 = 0x803d1de4;
str_803d1df8 = 0x803d1df8;
str_803d1e0c = 0x803d1e0c;
str_803d1e1c = 0x803d1e1c;
str_803d1e34 = 0x803d1e34;
table_8045e788 = 0x8045e788;
SECTIONS {
  .text.d44l_bordered_panel_build_8029fc78 0x8029fc78 : { *(.text.d44l_bordered_panel_build_8029fc78) }
  .rodata 0x803d1e48 : { *(.rodata) }
  /DISCARD/ : { *(.text*) *(.rodata*) *(.data*) *(.bss*) *(.sdata*) *(.sbss*) *(.comment) }
}
