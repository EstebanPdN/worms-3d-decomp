/* Generated reference-only placements. All bodies are source-built. */
OUTPUT_FORMAT("elf32-powerpc")
OUTPUT_ARCH(powerpc)
ENTRY(d30j_copy_cube_texture_80170374)
_SDA_BASE_ = 0x804b2540;
_SDA2_BASE_ = 0x804c2540;
fn_801720fc = 0x801720fc;
fn_802eee50 = 0x802eee50;
w3d_auto_80171ab8 = 0x80171ab8;
w3d_auto_80171b1c = 0x80171b1c;
w3d_auto_80171b80 = 0x80171b80;
w3d_auto_801720c0 = 0x801720c0;
w3d_empty_80343808 = 0x80343808;
w3d_k5b_array_ref_lock_801ef048 = 0x801ef048;
w3d_s20_get_selected_80172088 = 0x80172088;
SECTIONS {
  .text.d30j_copy_cube_texture_80170374 0x80170374 : { *(.text.d30j_copy_cube_texture_80170374) }
  /DISCARD/ : { *(.text*) *(.rodata*) *(.data*) *(.bss*) *(.sdata*) *(.sbss*) *(.comment) }
}
