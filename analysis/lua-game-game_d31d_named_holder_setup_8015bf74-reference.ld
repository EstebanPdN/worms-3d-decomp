/* Generated reference-only placements. All bodies are source-built. */
OUTPUT_FORMAT("elf32-powerpc")
OUTPUT_ARCH(powerpc)
ENTRY(w3d_d31d_named_holder_setup_8015bf74)
_SDA_BASE_ = 0x804b2540;
_SDA2_BASE_ = 0x804c2540;
__6StringPCc = 0x8020bb54;
desc_80419378 = 0x80419378;
forward_8020b680 = 0x8020b680;
make_80210958__Fv = 0x80210958;
service_8020b648 = 0x8020b648;
set_singleton_8020b960 = 0x8020b960;
singleton_8020b884 = 0x8020b884;
string_assign_8020bd38 = 0x8020bd38;
string_finish_8020c5c4 = 0x8020c5c4;
string_release_80341588 = 0x80341588;
SECTIONS {
  .text.w3d_d31d_named_holder_setup_8015bf74 0x8015bf74 : { *(.text.w3d_d31d_named_holder_setup_8015bf74) }
  .rodata 0x803a435c : { *(.rodata) }
  /DISCARD/ : { *(.text*) *(.rodata*) *(.data*) *(.bss*) *(.sdata*) *(.sbss*) *(.comment) }
}
