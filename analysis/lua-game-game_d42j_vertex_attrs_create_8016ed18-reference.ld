/* Generated reference-only placements. All bodies are source-built. */
OUTPUT_FORMAT("elf32-powerpc")
OUTPUT_ARCH(powerpc)
ENTRY(vertex_attrs_create_8016ed18)
_SDA_BASE_ = 0x804b2540;
_SDA2_BASE_ = 0x804c2540;
table_803a645c = 0x803a645c;
type_80361ad8 = 0x80361ad8;
w3d_auto_8016f8a0 = 0x8016f8a0;
w3d_d30k_compact_vector_resize_80210b90 = 0x80210b90;
w3d_r24b_invoke_ready_callback_8020fcb4 = 0x8020fcb4;
SECTIONS {
  .text.vertex_attrs_create_8016ed18 0x8016ed18 : { *(.text.vertex_attrs_create_8016ed18) }
  /DISCARD/ : { *(.text*) *(.rodata*) *(.data*) *(.bss*) *(.sdata*) *(.sbss*) *(.comment) }
}
