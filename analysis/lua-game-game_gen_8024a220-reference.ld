/* Generated reference-only placements. All bodies are source-built. */
OUTPUT_FORMAT("elf32-powerpc")
OUTPUT_ARCH(powerpc)
ENTRY(w3d_set_8024a220)
_SDA_BASE_ = 0x804b2540;
_SDA2_BASE_ = 0x804c2540;
SECTIONS {
  .text.w3d_set_8024a220 0x8024a220 : { *(.text.w3d_set_8024a220) }
  .text.w3d_get_8024a228 0x8024a228 : { *(.text.w3d_get_8024a228) }
  .text.w3d_set_8024a250 0x8024a250 : { *(.text.w3d_set_8024a250) }
  .text.w3d_get_8024a258 0x8024a258 : { *(.text.w3d_get_8024a258) }
  .text.w3d_set_8024a260 0x8024a260 : { *(.text.w3d_set_8024a260) }
  .text.w3d_get_8024a268 0x8024a268 : { *(.text.w3d_get_8024a268) }
  .text.w3d_set_8024a270 0x8024a270 : { *(.text.w3d_set_8024a270) }
  .text.w3d_get_8024a278 0x8024a278 : { *(.text.w3d_get_8024a278) }
  .text.w3d_set_8024a280 0x8024a280 : { *(.text.w3d_set_8024a280) }
  .text.w3d_get_8024a288 0x8024a288 : { *(.text.w3d_get_8024a288) }
  .text.w3d_set_8024a2a0 0x8024a2a0 : { *(.text.w3d_set_8024a2a0) }
  .text.w3d_get_8024a2a8 0x8024a2a8 : { *(.text.w3d_get_8024a2a8) }
  .text.w3d_set_8024a2b0 0x8024a2b0 : { *(.text.w3d_set_8024a2b0) }
  .text.w3d_get_8024a2b8 0x8024a2b8 : { *(.text.w3d_get_8024a2b8) }
  .text.w3d_set_8024a2c0 0x8024a2c0 : { *(.text.w3d_set_8024a2c0) }
  .text.w3d_get_8024a2c8 0x8024a2c8 : { *(.text.w3d_get_8024a2c8) }
  .text.w3d_set_8024a2d0 0x8024a2d0 : { *(.text.w3d_set_8024a2d0) }
  .text.w3d_get_8024a2d8 0x8024a2d8 : { *(.text.w3d_get_8024a2d8) }
  .text.w3d_set_8024a2e0 0x8024a2e0 : { *(.text.w3d_set_8024a2e0) }
  .text.w3d_get_8024a2e8 0x8024a2e8 : { *(.text.w3d_get_8024a2e8) }
  .text.w3d_set_8024a2f0 0x8024a2f0 : { *(.text.w3d_set_8024a2f0) }
  .text.w3d_get_8024a2f8 0x8024a2f8 : { *(.text.w3d_get_8024a2f8) }
  .text.w3d_set_8024a300 0x8024a300 : { *(.text.w3d_set_8024a300) }
  .text.w3d_get_8024a308 0x8024a308 : { *(.text.w3d_get_8024a308) }
  .text.w3d_set_8024a320 0x8024a320 : { *(.text.w3d_set_8024a320) }
  .text.w3d_set_8024a334 0x8024a334 : { *(.text.w3d_set_8024a334) }
  .text.w3d_set_8024a404 0x8024a404 : { *(.text.w3d_set_8024a404) }
  .text.w3d_get_8024a40c 0x8024a40c : { *(.text.w3d_get_8024a40c) }
  .text.w3d_set_8024a45c 0x8024a45c : { *(.text.w3d_set_8024a45c) }
  .text.w3d_get_8024a464 0x8024a464 : { *(.text.w3d_get_8024a464) }
  .text.w3d_set_8024a498 0x8024a498 : { *(.text.w3d_set_8024a498) }
  .text.w3d_get_8024a4a0 0x8024a4a0 : { *(.text.w3d_get_8024a4a0) }
  .text.w3d_set_8024a548 0x8024a548 : { *(.text.w3d_set_8024a548) }
  .text.w3d_get_8024a550 0x8024a550 : { *(.text.w3d_get_8024a550) }
  .text.w3d_set_8024a558 0x8024a558 : { *(.text.w3d_set_8024a558) }
  .text.w3d_get_8024a560 0x8024a560 : { *(.text.w3d_get_8024a560) }
  .text.w3d_set_8024a568 0x8024a568 : { *(.text.w3d_set_8024a568) }
  .text.w3d_get_8024a570 0x8024a570 : { *(.text.w3d_get_8024a570) }
  .text.w3d_set_8024a5d0 0x8024a5d0 : { *(.text.w3d_set_8024a5d0) }
  .text.w3d_get_8024a5d8 0x8024a5d8 : { *(.text.w3d_get_8024a5d8) }
  .text.w3d_set_8024a5e0 0x8024a5e0 : { *(.text.w3d_set_8024a5e0) }
  .text.w3d_get_8024a5e8 0x8024a5e8 : { *(.text.w3d_get_8024a5e8) }
  .text.w3d_set_8024a610 0x8024a610 : { *(.text.w3d_set_8024a610) }
  .text.w3d_get_8024a618 0x8024a618 : { *(.text.w3d_get_8024a618) }
  .text.w3d_set_8024a620 0x8024a620 : { *(.text.w3d_set_8024a620) }
  .text.w3d_get_8024a628 0x8024a628 : { *(.text.w3d_get_8024a628) }
  .text.w3d_set_8024a8a0 0x8024a8a0 : { *(.text.w3d_set_8024a8a0) }
  .text.w3d_get_8024a8a8 0x8024a8a8 : { *(.text.w3d_get_8024a8a8) }
  .text.w3d_set_8024a9a0 0x8024a9a0 : { *(.text.w3d_set_8024a9a0) }
  .text.w3d_get_8024a9a8 0x8024a9a8 : { *(.text.w3d_get_8024a9a8) }
  .text.w3d_set_8024a9d0 0x8024a9d0 : { *(.text.w3d_set_8024a9d0) }
  .text.w3d_get_8024a9d8 0x8024a9d8 : { *(.text.w3d_get_8024a9d8) }
  .text.w3d_set_8024a9e0 0x8024a9e0 : { *(.text.w3d_set_8024a9e0) }
  .text.w3d_get_8024a9e8 0x8024a9e8 : { *(.text.w3d_get_8024a9e8) }
  .text.w3d_set_8024af14 0x8024af14 : { *(.text.w3d_set_8024af14) }
  .text.w3d_get_8024af1c 0x8024af1c : { *(.text.w3d_get_8024af1c) }
  .text.w3d_set_8024af24 0x8024af24 : { *(.text.w3d_set_8024af24) }
  .text.w3d_get_8024af2c 0x8024af2c : { *(.text.w3d_get_8024af2c) }
  .text.w3d_set_8024afa4 0x8024afa4 : { *(.text.w3d_set_8024afa4) }
  .text.w3d_get_8024afac 0x8024afac : { *(.text.w3d_get_8024afac) }
  .text.w3d_set_8024afb4 0x8024afb4 : { *(.text.w3d_set_8024afb4) }
  .text.w3d_get_8024afbc 0x8024afbc : { *(.text.w3d_get_8024afbc) }
  .text.w3d_set_8024afc4 0x8024afc4 : { *(.text.w3d_set_8024afc4) }
  .text.w3d_get_8024afcc 0x8024afcc : { *(.text.w3d_get_8024afcc) }
  .text.w3d_set_8024afd4 0x8024afd4 : { *(.text.w3d_set_8024afd4) }
  .text.w3d_get_8024afdc 0x8024afdc : { *(.text.w3d_get_8024afdc) }
  .text.w3d_set_8024afe4 0x8024afe4 : { *(.text.w3d_set_8024afe4) }
  .text.w3d_get_8024afec 0x8024afec : { *(.text.w3d_get_8024afec) }
  .text.w3d_set_8024aff4 0x8024aff4 : { *(.text.w3d_set_8024aff4) }
  .text.w3d_get_8024affc 0x8024affc : { *(.text.w3d_get_8024affc) }
  .text.w3d_set_8024b004 0x8024b004 : { *(.text.w3d_set_8024b004) }
  .text.w3d_get_8024b00c 0x8024b00c : { *(.text.w3d_get_8024b00c) }
  .text.w3d_set_8024b014 0x8024b014 : { *(.text.w3d_set_8024b014) }
  .text.w3d_get_8024b01c 0x8024b01c : { *(.text.w3d_get_8024b01c) }
  .text.w3d_set_8024b024 0x8024b024 : { *(.text.w3d_set_8024b024) }
  .text.w3d_get_8024b02c 0x8024b02c : { *(.text.w3d_get_8024b02c) }
  .text.w3d_set_8024b034 0x8024b034 : { *(.text.w3d_set_8024b034) }
  .text.w3d_get_8024b03c 0x8024b03c : { *(.text.w3d_get_8024b03c) }
  .text.w3d_set_8024b044 0x8024b044 : { *(.text.w3d_set_8024b044) }
  .text.w3d_get_8024b04c 0x8024b04c : { *(.text.w3d_get_8024b04c) }
  /DISCARD/ : { *(.text*) *(.rodata*) *(.data*) *(.bss*) *(.sdata*) *(.sbss*) *(.comment) }
}
