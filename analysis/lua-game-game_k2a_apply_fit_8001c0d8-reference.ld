/* Generated reference-only placements. All bodies are source-built. */
OUTPUT_FORMAT("elf32-powerpc")
OUTPUT_ARCH(powerpc)
ENTRY(k2a_apply_fit_8001c0d8)
_SDA_BASE_ = 0x804b2540;
_SDA2_BASE_ = 0x804c2540;
FUN_8001c134 = 0x8001c134;
FUN_8001c36c = 0x8001c36c;
SECTIONS {
  .text.k2a_apply_fit_8001c0d8 0x8001c0d8 : { *(.text.k2a_apply_fit_8001c0d8) }
  /DISCARD/ : { *(.text*) *(.rodata*) *(.data*) *(.bss*) *(.sdata*) *(.sbss*) *(.comment) }
}
