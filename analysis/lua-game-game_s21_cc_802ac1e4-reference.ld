/* Generated reference-only placements. All bodies are source-built. */
OUTPUT_FORMAT("elf32-powerpc")
OUTPUT_ARCH(powerpc)
ENTRY(w3d_s21_apply_record_802ac1e4)
_SDA_BASE_ = 0x804b2540;
_SDA2_BASE_ = 0x804c2540;
fn_802fa95c = 0x802fa95c;
SECTIONS {
  .text.w3d_s21_apply_record_802ac1e4 0x802ac1e4 : { *(.text.w3d_s21_apply_record_802ac1e4) }
  /DISCARD/ : { *(.text*) *(.rodata*) *(.data*) *(.bss*) *(.sdata*) *(.sbss*) *(.comment) }
}
