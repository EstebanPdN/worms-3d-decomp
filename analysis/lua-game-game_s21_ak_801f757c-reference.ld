/* Generated reference-only placements. All bodies are source-built. */
OUTPUT_FORMAT("elf32-powerpc")
OUTPUT_ARCH(powerpc)
ENTRY(w3d_s21_construct_801f757c)
_SDA_BASE_ = 0x804b2540;
_SDA2_BASE_ = 0x804c2540;
fn_801f656c = 0x801f656c;
lbl_803b170c = 0x803b170c;
SECTIONS {
  .text.w3d_s21_construct_801f757c 0x801f757c : { *(.text.w3d_s21_construct_801f757c) }
  /DISCARD/ : { *(.text*) *(.rodata*) *(.data*) *(.bss*) *(.sdata*) *(.sbss*) *(.comment) }
}
