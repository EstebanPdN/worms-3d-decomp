/* Generated reference-only placements. All bodies are source-built. */
OUTPUT_FORMAT("elf32-powerpc")
OUTPUT_ARCH(powerpc)
ENTRY(cc38a_stats_expand_80109604)
_SDA_BASE_ = 0x804b2540;
_SDA2_BASE_ = 0x804c2540;
__21cc38a_String_8020bb54PCc = 0x8020bb54;
cc38a_expand_801096f0 = 0x801096f0;
cc38a_finish_8020c5c4 = 0x8020c5c4;
cc38a_index_80399c8c = 0x80399c8c;
cc38a_index_token_80399c88 = 0x80399c88;
cc38a_output_8010a01c = 0x8010a01c;
cc38a_property_800fc2b0 = 0x800fc2b0;
cc38a_release_80341588 = 0x80341588;
cc38a_source_80399c1c = 0x80399c1c;
cc38a_team_80399c64 = 0x80399c64;
cc38a_team_token_80399c5c = 0x80399c5c;
cc38a_value_80399c9c = 0x80399c9c;
cc38a_value_token_80399c98 = 0x80399c98;
cc38a_worm_80399c78 = 0x80399c78;
cc38a_worm_token_80399c74 = 0x80399c74;
SECTIONS {
  .text.cc38a_stats_expand_80109604 0x80109604 : { *(.text.cc38a_stats_expand_80109604) }
  /DISCARD/ : { *(.text*) *(.rodata*) *(.data*) *(.bss*) *(.sdata*) *(.sbss*) *(.comment) }
}
