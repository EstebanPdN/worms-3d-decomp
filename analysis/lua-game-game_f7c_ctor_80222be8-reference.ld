/* Generated reference-only placements. All bodies are source-built. */
OUTPUT_FORMAT("elf32-powerpc")
OUTPUT_ARCH(powerpc)
ENTRY(f7c_ctor_80222be8)
_SDA_BASE_ = 0x804b2540;
_SDA2_BASE_ = 0x804c2540;
fn_8020c5c0 = 0x8020c5c0;
fn_8021ef08 = 0x8021ef08;
fn_80341884 = 0x80341884;
lbl_803b7018 = 0x803b7018;
lbl_803b701c = 0x803b701c;
lbl_8041a438 = 0x8041a438;
lbl_804b06a0 = 0x804b06a0;
SECTIONS {
  .text.f7c_ctor_80222be8 0x80222be8 : { *(.text.f7c_ctor_80222be8) }
  /DISCARD/ : { *(.text*) *(.rodata*) *(.data*) *(.bss*) *(.sdata*) *(.sbss*) *(.comment) }
}
