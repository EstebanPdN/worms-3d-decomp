/* Generated reference-only placements. All bodies are source-built. */
OUTPUT_FORMAT("elf32-powerpc")
OUTPUT_ARCH(powerpc)
ENTRY(mx25oc_nested_vector_fill_insert_8034e638)
_SDA_BASE_ = 0x804b2540;
_SDA2_BASE_ = 0x804c2540;
native_array_allocate_801907a8 = 0x801907a8;
native_array_free_801907d0 = 0x801907d0;
native_record_vector_assign_8034e408 = 0x8034e408;
SECTIONS {
  .text.mx25oc_nested_vector_fill_insert_8034e638 0x8034e638 : { *(.text.mx25oc_nested_vector_fill_insert_8034e638) }
  /DISCARD/ : { *(.text*) *(.rodata*) *(.data*) *(.bss*) *(.sdata*) *(.sbss*) *(.comment) }
}
