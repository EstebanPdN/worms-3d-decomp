/* Generated reference-only placements. All bodies are source-built. */
OUTPUT_FORMAT("elf32-powerpc")
OUTPUT_ARCH(powerpc)
ENTRY(w3d_f5a_destroy_script_80270e58)
_SDA_BASE_ = 0x804b2540;
_SDA2_BASE_ = 0x804c2540;
fn_801628ec = 0x801628ec;
fn_8020c5c4 = 0x8020c5c4;
fn_80210abc = 0x80210abc;
fn_802134fc = 0x802134fc;
fn_80341588 = 0x80341588;
vt_8041be80 = 0x8041be80;
SECTIONS {
  .text.w3d_f5a_destroy_script_80270e58 0x80270e58 : { *(.text.w3d_f5a_destroy_script_80270e58) }
  /DISCARD/ : { *(.text*) *(.rodata*) *(.data*) *(.bss*) *(.sdata*) *(.sbss*) *(.comment) }
}
