/* Generated reference-only placements. All bodies are source-built. */
OUTPUT_FORMAT("elf32-powerpc")
OUTPUT_ARCH(powerpc)
ENTRY(w3d_cx11a_blend_basis_800a93fc)
_SDA_BASE_ = 0x804b2540;
_SDA2_BASE_ = 0x804c2540;
one_80381910 = 0x80381910;
read_80178df0 = 0x80178df0;
SECTIONS {
  .text.w3d_cx11a_blend_basis_800a93fc 0x800a93fc : { *(.text.w3d_cx11a_blend_basis_800a93fc) }
  /DISCARD/ : { *(.text*) *(.rodata*) *(.data*) *(.bss*) *(.sdata*) *(.sbss*) *(.comment) }
}
