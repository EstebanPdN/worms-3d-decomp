/* Generated reference-only placements. All bodies are source-built. */
OUTPUT_FORMAT("elf32-powerpc")
OUTPUT_ARCH(powerpc)
ENTRY(d31l_box_load_parts_802b8da8)
_SDA_BASE_ = 0x804b2540;
_SDA2_BASE_ = 0x804c2540;
__3StrPCc = 0x8020bb54;
fn_8015adf4 = 0x8015adf4;
fn_80173f88 = 0x80173f88;
fn_8020c5c0 = 0x8020c5c0;
fn_8020c5c4 = 0x8020c5c4;
fn_80263608 = 0x80263608;
fn_80263bb8 = 0x80263bb8;
fn_80341588 = 0x80341588;
fn_80341884 = 0x80341884;
fn_8034357c = 0x8034357c;
str_803d8018 = 0x803d8018;
SECTIONS {
  .text.d31l_box_load_parts_802b8da8 0x802b8da8 : { *(.text.d31l_box_load_parts_802b8da8) }
  /DISCARD/ : { *(.text*) *(.rodata*) *(.data*) *(.bss*) *(.sdata*) *(.sbss*) *(.comment) }
}
