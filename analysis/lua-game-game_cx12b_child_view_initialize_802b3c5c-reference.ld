/* Generated reference-only placements. All bodies are source-built. */
OUTPUT_FORMAT("elf32-powerpc")
OUTPUT_ARCH(powerpc)
ENTRY(w3d_cx12b_child_view_initialize_802b3c5c)
_SDA_BASE_ = 0x804b2540;
_SDA2_BASE_ = 0x804c2540;
setup_802b3148 = 0x802b3148;
setup_802b38d4 = 0x802b38d4;
SECTIONS {
  .text.w3d_cx12b_child_view_initialize_802b3c5c 0x802b3c5c : { *(.text.w3d_cx12b_child_view_initialize_802b3c5c) }
  /DISCARD/ : { *(.text*) *(.rodata*) *(.data*) *(.bss*) *(.sdata*) *(.sbss*) *(.comment) }
}
