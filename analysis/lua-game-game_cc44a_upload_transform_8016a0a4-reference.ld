/* Generated reference-only placements. All bodies are source-built. */
OUTPUT_FORMAT("elf32-powerpc")
OUTPUT_ARCH(powerpc)
ENTRY(cc44a_upload_transform_8016a0a4)
_SDA_BASE_ = 0x804b2540;
_SDA2_BASE_ = 0x804c2540;
cc44a_inverse_80302ca8 = 0x80302ca8;
cc44a_load_normal_8030c044 = 0x8030c044;
cc44a_load_position_8030bff4 = 0x8030bff4;
cc44a_transpose_80302c58 = 0x80302c58;
SECTIONS {
  .text.cc44a_upload_transform_8016a0a4 0x8016a0a4 : { *(.text.cc44a_upload_transform_8016a0a4) }
  /DISCARD/ : { *(.text*) *(.rodata*) *(.data*) *(.bss*) *(.sdata*) *(.sbss*) *(.comment) }
}
