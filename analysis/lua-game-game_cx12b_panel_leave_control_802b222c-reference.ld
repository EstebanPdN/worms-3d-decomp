/* Generated reference-only placements. All bodies are source-built. */
OUTPUT_FORMAT("elf32-powerpc")
OUTPUT_ARCH(powerpc)
ENTRY(w3d_cx12b_panel_leave_control_802b222c)
_SDA_BASE_ = 0x804b2540;
_SDA2_BASE_ = 0x804c2540;
time_803d7af8 = 0x803d7af8;
SECTIONS {
  .text.w3d_cx12b_panel_leave_control_802b222c 0x802b222c : { *(.text.w3d_cx12b_panel_leave_control_802b222c) }
  /DISCARD/ : { *(.text*) *(.rodata*) *(.data*) *(.bss*) *(.sdata*) *(.sbss*) *(.comment) }
}
