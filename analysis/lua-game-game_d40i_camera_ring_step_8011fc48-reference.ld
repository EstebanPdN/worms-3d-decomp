/* Generated reference-only placements. All bodies are source-built. */
OUTPUT_FORMAT("elf32-powerpc")
OUTPUT_ARCH(powerpc)
ENTRY(d40i_camera_ring_step_8011fc48)
_SDA_BASE_ = 0x804b2540;
_SDA2_BASE_ = 0x804c2540;
cfg_801797b4 = 0x801797b4;
height_80178df0 = 0x80178df0;
moved_80121568 = 0x80121568;
ray_8015ac04 = 0x8015ac04;
ref_80341584 = 0x80341584;
sees_80121330 = 0x80121330;
sqrt_802e82c0 = 0x802e82c0;
zero_8044f2b4 = 0x8044f2b4;
SECTIONS {
  .text.d40i_camera_ring_step_8011fc48 0x8011fc48 : { *(.text.d40i_camera_ring_step_8011fc48) }
  .rodata 0x8039b698 : { *(.rodata) }
  /DISCARD/ : { *(.text*) *(.rodata*) *(.data*) *(.bss*) *(.sdata*) *(.sbss*) *(.comment) }
}
