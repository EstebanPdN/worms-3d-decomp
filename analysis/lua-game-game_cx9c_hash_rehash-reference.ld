/* Generated reference-only placements. All bodies are source-built. */
OUTPUT_FORMAT("elf32-powerpc")
OUTPUT_ARCH(powerpc)
ENTRY(w3d_cx9c_hash_rehash_8035c588)
_SDA_BASE_ = 0x804b2540;
_SDA2_BASE_ = 0x804c2540;
cx9c_allocate_80212fd4 = 0x80212fd4;
cx9c_bucket_capacity_8035c518 = 0x8035c518;
cx9c_fallback_803413d8 = 0x803413d8;
cx9c_release_802134fc = 0x802134fc;
SECTIONS {
  .text.w3d_cx9c_hash_rehash_8035c588 0x8035c588 : { *(.text.w3d_cx9c_hash_rehash_8035c588) }
  /DISCARD/ : { *(.text*) *(.rodata*) *(.data*) *(.bss*) *(.sdata*) *(.sbss*) *(.comment) }
}
