/* Generated reference-only placements. All bodies are source-built. */
OUTPUT_FORMAT("elf32-powerpc")
OUTPUT_ARCH(powerpc)
ENTRY(d29i_team_flags_list_fill_8011711c)
_SDA_BASE_ = 0x804b2540;
_SDA2_BASE_ = 0x804c2540;
_._19Descriptor_80178474 = 0x80178474;
__6String = 0x803426b8;
__6StringPCc = 0x8020bb54;
array_lock_801ef048 = 0x801ef048;
as_table_80341584 = 0x80341584;
atoi_802ed89c = 0x802ed89c;
class_80419e88 = 0x80419e88;
create_8020b680 = 0x8020b680;
f_8039a4c8 = 0x8039a4c8;
f_8039a974 = 0x8039a974;
list_append_801ef174 = 0x801ef174;
list_begin_801ef380 = 0x801ef380;
n_8039a188 = 0x8039a188;
n_8039a958 = 0x8039a958;
n_8039a964 = 0x8039a964;
n_8039a970 = 0x8039a970;
read_int_800fc230 = 0x800fc230;
read_key2_800fc2b0 = 0x800fc2b0;
string_finish_8020c5c4 = 0x8020c5c4;
string_format_8020c510 = 0x8020c510;
string_release_8020bb2c = 0x8020bb2c;
string_release_80341588 = 0x80341588;
table_get_80179598 = 0x80179598;
write_800fc550 = 0x800fc550;
SECTIONS {
  .text.d29i_team_flags_list_fill_8011711c 0x8011711c : { *(.text.d29i_team_flags_list_fill_8011711c) }
  .rodata 0x8039a984 : { *(.rodata) }
  /DISCARD/ : { *(.text*) *(.rodata*) *(.data*) *(.bss*) *(.sdata*) *(.sbss*) *(.comment) }
}
