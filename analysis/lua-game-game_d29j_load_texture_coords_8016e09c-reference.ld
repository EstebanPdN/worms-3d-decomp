/* Generated reference-only placements. All bodies are source-built. */
OUTPUT_FORMAT("elf32-powerpc")
OUTPUT_ARCH(powerpc)
ENTRY(d29j_load_texture_coords_8016e09c)
_SDA_BASE_ = 0x804b2540;
_SDA2_BASE_ = 0x804c2540;
fn_80302e9c = 0x80302e9c;
fn_80307e24 = 0x80307e24;
fn_803080a4 = 0x803080a4;
fn_80309c88 = 0x80309c88;
fn_80309f1c = 0x80309f1c;
fn_8030a21c = 0x8030a21c;
fn_8030c0c8 = 0x8030c0c8;
SECTIONS {
  .text.d29j_load_texture_coords_8016e09c 0x8016e09c : { *(.text.d29j_load_texture_coords_8016e09c) }
  .rodata 0x803a6338 : { *(.rodata) }
  /DISCARD/ : { *(.text*) *(.rodata*) *(.data*) *(.bss*) *(.sdata*) *(.sbss*) *(.comment) }
}
