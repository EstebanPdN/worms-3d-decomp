/* Generated reference-only placements. All bodies are source-built. */
OUTPUT_FORMAT("elf32-powerpc")
OUTPUT_ARCH(powerpc)
ENTRY(w3d_s21_set_value_notify_802683b8)
_SDA_BASE_ = 0x804b2540;
_SDA2_BASE_ = 0x804c2540;
fn_80178dfc = 0x80178dfc;
fn_80342a74 = 0x80342a74;
SECTIONS {
  .text.w3d_s21_set_value_notify_802683b8 0x802683b8 : { *(.text.w3d_s21_set_value_notify_802683b8) }
  /DISCARD/ : { *(.text*) *(.rodata*) *(.data*) *(.bss*) *(.sdata*) *(.sbss*) *(.comment) }
}
