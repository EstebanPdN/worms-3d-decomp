/* Generated reference-only placements. All bodies are source-built. */
OUTPUT_FORMAT("elf32-powerpc")
OUTPUT_ARCH(powerpc)
ENTRY(sol35e5a_color_descriptors_8024645c)
_SDA_BASE_ = 0x804b2540;
_SDA2_BASE_ = 0x804c2540;
sol35e5a_desc_803c2bd4 = 0x803c2bd4;
sol35e5a_desc_803c2c08 = 0x803c2c08;
sol35e5a_desc_803c2c40 = 0x803c2c40;
sol35e5a_desc_803c2c74 = 0x803c2c74;
sol35e5a_desc_803c2ca8 = 0x803c2ca8;
sol35e5a_desc_803c2ce0 = 0x803c2ce0;
sol35e5a_desc_803c2d18 = 0x803c2d18;
sol35e5a_desc_803c2d50 = 0x803c2d50;
sol35e5a_desc_803c2d88 = 0x803c2d88;
sol35e5a_desc_803c2dbc = 0x803c2dbc;
sol35e5a_desc_803c2df4 = 0x803c2df4;
sol35e5a_desc_803c2e28 = 0x803c2e28;
sol35e5a_desc_803c2e60 = 0x803c2e60;
sol35e5a_desc_803c2e94 = 0x803c2e94;
sol35e5a_desc_803c2ec8 = 0x803c2ec8;
sol35e5a_desc_803c2f00 = 0x803c2f00;
sol35e5a_desc_803c2f38 = 0x803c2f38;
sol35e5a_desc_803c2f70 = 0x803c2f70;
sol35e5a_desc_803c2fa8 = 0x803c2fa8;
sol35e5a_desc_803c2fdc = 0x803c2fdc;
sol35e5a_desc_803c3018 = 0x803c3018;
sol35e5a_desc_803c3054 = 0x803c3054;
sol35e5a_desc_803c3090 = 0x803c3090;
sol35e5a_desc_803c30cc = 0x803c30cc;
sol35e5a_desc_803c3104 = 0x803c3104;
sol35e5a_desc_803c3138 = 0x803c3138;
sol35e5a_desc_803c316c = 0x803c316c;
sol35e5a_desc_803c31a4 = 0x803c31a4;
sol35e5a_desc_803c31d8 = 0x803c31d8;
sol35e5a_desc_803c320c = 0x803c320c;
sol35e5a_desc_803c3244 = 0x803c3244;
sol35e5a_desc_803c3280 = 0x803c3280;
sol35e5a_desc_803c32bc = 0x803c32bc;
sol35e5a_desc_803c32f8 = 0x803c32f8;
sol35e5a_desc_803c3334 = 0x803c3334;
sol35e5a_desc_803c3370 = 0x803c3370;
sol35e5a_empty_804b06a0 = 0x804b06a0;
sol35e5a_finish_801e8d9c = 0x801e8d9c;
sol35e5a_register_color_801f15e0 = 0x801f15e0;
sol35e5a_register_scalar_801ec52c = 0x801ec52c;
sol35e5a_register_string_801ed24c = 0x801ed24c;
sol35e5a_release_header_8020bb2c = 0x8020bb2c;
sol35e5a_string_finish_8020c5c4 = 0x8020c5c4;
sol35e5a_string_header_80341884 = 0x80341884;
sol35e5a_string_init_8020c5c0 = 0x8020c5c0;
sol35e5a_string_release_80341588 = 0x80341588;
SECTIONS {
  .text.sol35e5a_color_descriptors_8024645c 0x8024645c : { *(.text.sol35e5a_color_descriptors_8024645c) }
  /DISCARD/ : { *(.text*) *(.rodata*) *(.data*) *(.bss*) *(.sdata*) *(.sbss*) *(.comment) }
}
