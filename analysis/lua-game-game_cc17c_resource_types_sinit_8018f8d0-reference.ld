/* Generated reference-only placements. All bodies are source-built. */
OUTPUT_FORMAT("elf32-powerpc")
OUTPUT_ARCH(powerpc)
ENTRY(w3d_cc17c_sinit_8018f8d0)
_SDA_BASE_ = 0x804b2540;
_SDA2_BASE_ = 0x804c2540;
fn_8018e1c0 = 0x8018e1c0;
fn_8018e348 = 0x8018e348;
fn_8018e420 = 0x8018e420;
fn_8018e560 = 0x8018e560;
fn_8018e5ac = 0x8018e5ac;
fn_8018e6ec = 0x8018e6ec;
fn_8018e738 = 0x8018e738;
fn_8018e8b8 = 0x8018e8b8;
fn_8018e980 = 0x8018e980;
fn_8018eac4 = 0x8018eac4;
fn_8018eb10 = 0x8018eb10;
fn_8018ec60 = 0x8018ec60;
fn_8018ece4 = 0x8018ece4;
fn_8018ee44 = 0x8018ee44;
fn_8018ee90 = 0x8018ee90;
fn_8018efe0 = 0x8018efe0;
fn_8018f04c = 0x8018f04c;
fn_8018f370 = 0x8018f370;
fn_801e8a88 = 0x801e8a88;
lbl_80361c88 = 0x80361c88;
lbl_80361cd8 = 0x80361cd8;
lbl_80361d28 = 0x80361d28;
lbl_80361d78 = 0x80361d78;
lbl_80361dc8 = 0x80361dc8;
lbl_80361e18 = 0x80361e18;
lbl_80361e68 = 0x80361e68;
lbl_80361eb8 = 0x80361eb8;
lbl_80361f08 = 0x80361f08;
lbl_80365788 = 0x80365788;
lbl_803e8ac4 = 0x803e8ac4;
lbl_803e8ae0 = 0x803e8ae0;
lbl_803e8afc = 0x803e8afc;
lbl_803e8b18 = 0x803e8b18;
lbl_803e8b34 = 0x803e8b34;
lbl_803e8b50 = 0x803e8b50;
lbl_803e8b6c = 0x803e8b6c;
lbl_803e8b88 = 0x803e8b88;
lbl_803e8ba4 = 0x803e8ba4;
SECTIONS {
  .text.w3d_cc17c_sinit_8018f8d0 0x8018f8d0 : { *(.text.w3d_cc17c_sinit_8018f8d0) }
  /DISCARD/ : { *(.text*) *(.rodata*) *(.data*) *(.bss*) *(.sdata*) *(.sbss*) *(.comment) }
}
