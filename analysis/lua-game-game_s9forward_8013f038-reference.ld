/* Generated reference-only placements. All bodies are source-built. */
OUTPUT_FORMAT("elf32-powerpc")
OUTPUT_ARCH(powerpc)
ENTRY(s9_create_tail_effect_8013f038)
_SDA_BASE_ = 0x804b2540;
_SDA2_BASE_ = 0x804c2540;
fn_800e5cf0 = 0x800e5cf0;
fn_80140240 = 0x80140240;
fn_80343584 = 0x80343584;
lbl_8039fd54 = 0x8039fd54;
lbl_8039fd5c = 0x8039fd5c;
SECTIONS {
  .text.s9_create_tail_effect_8013f038 0x8013f038 : { *(.text.s9_create_tail_effect_8013f038) }
  /DISCARD/ : { *(.text*) *(.rodata*) *(.data*) *(.bss*) *(.sdata*) *(.sbss*) *(.comment) }
}
