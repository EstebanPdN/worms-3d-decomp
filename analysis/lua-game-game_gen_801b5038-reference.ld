/* Generated reference-only placements. All bodies are source-built. */
OUTPUT_FORMAT("elf32-powerpc")
OUTPUT_ARCH(powerpc)
ENTRY(w3d_address_801b5038)
_SDA_BASE_ = 0x804b2540;
_SDA2_BASE_ = 0x804c2540;
w3d_fn_801b4b88 = 0x801b4b88;
w3d_fn_801b4c6c = 0x801b4c6c;
w3d_fn_801b4e50 = 0x801b4e50;
w3d_fn_801b4ef0 = 0x801b4ef0;
w3d_fn_801b5134 = 0x801b5134;
w3d_fn_801b52d8 = 0x801b52d8;
w3d_fn_801b5454 = 0x801b5454;
w3d_global_803627a4 = 0x803627a4;
w3d_global_803627f4 = 0x803627f4;
w3d_global_80362844 = 0x80362844;
w3d_global_80362894 = 0x80362894;
w3d_global_803628e4 = 0x803628e4;
w3d_global_80362934 = 0x80362934;
w3d_global_80362984 = 0x80362984;
w3d_global_803629d4 = 0x803629d4;
w3d_global_80362a24 = 0x80362a24;
w3d_global_80362a74 = 0x80362a74;
w3d_global_80362ac4 = 0x80362ac4;
w3d_global_80362b14 = 0x80362b14;
w3d_global_80362b64 = 0x80362b64;
w3d_global_80362bb4 = 0x80362bb4;
w3d_global_80362c04 = 0x80362c04;
w3d_global_80362c54 = 0x80362c54;
w3d_global_80362ca4 = 0x80362ca4;
w3d_global_80362cf4 = 0x80362cf4;
w3d_global_80362d44 = 0x80362d44;
w3d_global_80362d94 = 0x80362d94;
w3d_global_80362de4 = 0x80362de4;
w3d_global_80362e34 = 0x80362e34;
w3d_global_80362e84 = 0x80362e84;
w3d_global_80362ed4 = 0x80362ed4;
w3d_global_80362f24 = 0x80362f24;
w3d_global_80362f74 = 0x80362f74;
w3d_global_80362fc4 = 0x80362fc4;
w3d_global_80363014 = 0x80363014;
w3d_global_80363064 = 0x80363064;
w3d_global_803630b4 = 0x803630b4;
w3d_global_80363104 = 0x80363104;
w3d_global_80363154 = 0x80363154;
w3d_global_803631a4 = 0x803631a4;
w3d_owner_list_remove = 0x8020fd2c;
w3d_registry_list_803627a4 = 0x803627a4;
w3d_registry_list_803627f4 = 0x803627f4;
w3d_registry_list_80362844 = 0x80362844;
w3d_registry_list_80362894 = 0x80362894;
w3d_registry_list_803628e4 = 0x803628e4;
w3d_registry_list_80362934 = 0x80362934;
w3d_registry_list_80362984 = 0x80362984;
w3d_registry_list_803629d4 = 0x803629d4;
w3d_registry_list_80362a24 = 0x80362a24;
w3d_registry_list_80362a74 = 0x80362a74;
w3d_registry_list_80362ac4 = 0x80362ac4;
w3d_registry_list_80362b14 = 0x80362b14;
w3d_registry_list_80362b64 = 0x80362b64;
w3d_registry_list_80362bb4 = 0x80362bb4;
w3d_registry_list_80362c04 = 0x80362c04;
w3d_registry_list_80362c54 = 0x80362c54;
w3d_registry_list_80362ca4 = 0x80362ca4;
w3d_registry_list_80362cf4 = 0x80362cf4;
w3d_registry_list_80362d44 = 0x80362d44;
w3d_registry_list_80362d94 = 0x80362d94;
w3d_registry_list_80362de4 = 0x80362de4;
w3d_registry_list_80362e34 = 0x80362e34;
w3d_registry_list_80362e84 = 0x80362e84;
w3d_registry_list_80362ed4 = 0x80362ed4;
w3d_registry_list_80362f24 = 0x80362f24;
w3d_registry_list_80362f74 = 0x80362f74;
w3d_registry_list_80362fc4 = 0x80362fc4;
w3d_registry_list_80363014 = 0x80363014;
w3d_registry_list_80363064 = 0x80363064;
w3d_registry_list_803630b4 = 0x803630b4;
w3d_registry_list_80363104 = 0x80363104;
w3d_registry_list_80363154 = 0x80363154;
w3d_registry_list_803631a4 = 0x803631a4;
SECTIONS {
  .text.w3d_address_801b5038 0x801b5038 : { *(.text.w3d_address_801b5038) }
  .text.w3d_registry_unlink_801b50ac 0x801b50ac : { *(.text.w3d_registry_unlink_801b50ac) }
  .text.w3d_address_801b51e4 0x801b51e4 : { *(.text.w3d_address_801b51e4) }
  .text.w3d_registry_unlink_801b5258 0x801b5258 : { *(.text.w3d_registry_unlink_801b5258) }
  .text.w3d_address_801b534c 0x801b534c : { *(.text.w3d_address_801b534c) }
  .text.w3d_registry_unlink_801b53c0 0x801b53c0 : { *(.text.w3d_registry_unlink_801b53c0) }
  .text.w3d_registry_release_801b566c 0x801b566c : { *(.text.w3d_registry_release_801b566c) }
  .text.w3d_registry_release_801b56c8 0x801b56c8 : { *(.text.w3d_registry_release_801b56c8) }
  .text.w3d_registry_release_801b5724 0x801b5724 : { *(.text.w3d_registry_release_801b5724) }
  .text.w3d_registry_release_801b5780 0x801b5780 : { *(.text.w3d_registry_release_801b5780) }
  .text.w3d_registry_release_801b57dc 0x801b57dc : { *(.text.w3d_registry_release_801b57dc) }
  .text.w3d_set_801b5868 0x801b5868 : { *(.text.w3d_set_801b5868) }
  .text.w3d_get_801b5870 0x801b5870 : { *(.text.w3d_get_801b5870) }
  .text.w3d_get_801b594c 0x801b594c : { *(.text.w3d_get_801b594c) }
  .text.w3d_set_801b5954 0x801b5954 : { *(.text.w3d_set_801b5954) }
  .text.w3d_get_801b595c 0x801b595c : { *(.text.w3d_get_801b595c) }
  .text.w3d_get_801b59c8 0x801b59c8 : { *(.text.w3d_get_801b59c8) }
  .text.w3d_get_801b5a34 0x801b5a34 : { *(.text.w3d_get_801b5a34) }
  .text.w3d_set_801b5a3c 0x801b5a3c : { *(.text.w3d_set_801b5a3c) }
  .text.w3d_get_801b5a44 0x801b5a44 : { *(.text.w3d_get_801b5a44) }
  .text.w3d_address_801b5a78 0x801b5a78 : { *(.text.w3d_address_801b5a78) }
  .text.w3d_registry_unlink_801b5aec 0x801b5aec : { *(.text.w3d_registry_unlink_801b5aec) }
  .text.w3d_address_801b5cb0 0x801b5cb0 : { *(.text.w3d_address_801b5cb0) }
  .text.w3d_registry_unlink_801b5d24 0x801b5d24 : { *(.text.w3d_registry_unlink_801b5d24) }
  .text.w3d_address_801b6250 0x801b6250 : { *(.text.w3d_address_801b6250) }
  .text.w3d_registry_unlink_801b62c4 0x801b62c4 : { *(.text.w3d_registry_unlink_801b62c4) }
  .text.w3d_address_801b674c 0x801b674c : { *(.text.w3d_address_801b674c) }
  .text.w3d_registry_unlink_801b67c0 0x801b67c0 : { *(.text.w3d_registry_unlink_801b67c0) }
  .text.w3d_address_801b69fc 0x801b69fc : { *(.text.w3d_address_801b69fc) }
  .text.w3d_registry_unlink_801b6a70 0x801b6a70 : { *(.text.w3d_registry_unlink_801b6a70) }
  .text.w3d_address_801b6b64 0x801b6b64 : { *(.text.w3d_address_801b6b64) }
  .text.w3d_registry_unlink_801b6bd8 0x801b6bd8 : { *(.text.w3d_registry_unlink_801b6bd8) }
  .text.w3d_address_801b6db0 0x801b6db0 : { *(.text.w3d_address_801b6db0) }
  .text.w3d_registry_unlink_801b6e24 0x801b6e24 : { *(.text.w3d_registry_unlink_801b6e24) }
  .text.w3d_address_801b6f18 0x801b6f18 : { *(.text.w3d_address_801b6f18) }
  .text.w3d_registry_unlink_801b6f8c 0x801b6f8c : { *(.text.w3d_registry_unlink_801b6f8c) }
  .text.w3d_address_801b7080 0x801b7080 : { *(.text.w3d_address_801b7080) }
  .text.w3d_registry_unlink_801b70f4 0x801b70f4 : { *(.text.w3d_registry_unlink_801b70f4) }
  .text.w3d_address_801b71e8 0x801b71e8 : { *(.text.w3d_address_801b71e8) }
  .text.w3d_registry_unlink_801b725c 0x801b725c : { *(.text.w3d_registry_unlink_801b725c) }
  .text.w3d_address_801b7434 0x801b7434 : { *(.text.w3d_address_801b7434) }
  .text.w3d_registry_unlink_801b74a8 0x801b74a8 : { *(.text.w3d_registry_unlink_801b74a8) }
  .text.w3d_address_801b7680 0x801b7680 : { *(.text.w3d_address_801b7680) }
  .text.w3d_registry_unlink_801b76f4 0x801b76f4 : { *(.text.w3d_registry_unlink_801b76f4) }
  .text.w3d_address_801b78cc 0x801b78cc : { *(.text.w3d_address_801b78cc) }
  .text.w3d_registry_unlink_801b7940 0x801b7940 : { *(.text.w3d_registry_unlink_801b7940) }
  .text.w3d_address_801b7a78 0x801b7a78 : { *(.text.w3d_address_801b7a78) }
  .text.w3d_registry_unlink_801b7aec 0x801b7aec : { *(.text.w3d_registry_unlink_801b7aec) }
  .text.w3d_address_801b7be0 0x801b7be0 : { *(.text.w3d_address_801b7be0) }
  .text.w3d_registry_unlink_801b7c54 0x801b7c54 : { *(.text.w3d_registry_unlink_801b7c54) }
  .text.w3d_address_801b7d48 0x801b7d48 : { *(.text.w3d_address_801b7d48) }
  .text.w3d_registry_unlink_801b7dbc 0x801b7dbc : { *(.text.w3d_registry_unlink_801b7dbc) }
  .text.w3d_address_801b7eb0 0x801b7eb0 : { *(.text.w3d_address_801b7eb0) }
  .text.w3d_registry_unlink_801b7f24 0x801b7f24 : { *(.text.w3d_registry_unlink_801b7f24) }
  .text.w3d_address_801b8018 0x801b8018 : { *(.text.w3d_address_801b8018) }
  .text.w3d_registry_unlink_801b808c 0x801b808c : { *(.text.w3d_registry_unlink_801b808c) }
  .text.w3d_address_801b8268 0x801b8268 : { *(.text.w3d_address_801b8268) }
  .text.w3d_registry_unlink_801b82dc 0x801b82dc : { *(.text.w3d_registry_unlink_801b82dc) }
  .text.w3d_address_801b84b8 0x801b84b8 : { *(.text.w3d_address_801b84b8) }
  .text.w3d_registry_unlink_801b852c 0x801b852c : { *(.text.w3d_registry_unlink_801b852c) }
  .text.w3d_address_801b8708 0x801b8708 : { *(.text.w3d_address_801b8708) }
  .text.w3d_registry_unlink_801b877c 0x801b877c : { *(.text.w3d_registry_unlink_801b877c) }
  .text.w3d_address_801b8870 0x801b8870 : { *(.text.w3d_address_801b8870) }
  .text.w3d_registry_unlink_801b88e4 0x801b88e4 : { *(.text.w3d_registry_unlink_801b88e4) }
  .text.w3d_address_801b89d8 0x801b89d8 : { *(.text.w3d_address_801b89d8) }
  .text.w3d_registry_unlink_801b8a4c 0x801b8a4c : { *(.text.w3d_registry_unlink_801b8a4c) }
  .text.w3d_address_801b8b40 0x801b8b40 : { *(.text.w3d_address_801b8b40) }
  .text.w3d_registry_unlink_801b8bb4 0x801b8bb4 : { *(.text.w3d_registry_unlink_801b8bb4) }
  .text.w3d_address_801b8ca8 0x801b8ca8 : { *(.text.w3d_address_801b8ca8) }
  .text.w3d_registry_unlink_801b8d1c 0x801b8d1c : { *(.text.w3d_registry_unlink_801b8d1c) }
  .text.w3d_address_801b8e10 0x801b8e10 : { *(.text.w3d_address_801b8e10) }
  .text.w3d_registry_unlink_801b8e84 0x801b8e84 : { *(.text.w3d_registry_unlink_801b8e84) }
  .text.w3d_address_801b9058 0x801b9058 : { *(.text.w3d_address_801b9058) }
  .text.w3d_registry_unlink_801b90cc 0x801b90cc : { *(.text.w3d_registry_unlink_801b90cc) }
  .text.w3d_address_801b92a0 0x801b92a0 : { *(.text.w3d_address_801b92a0) }
  .text.w3d_registry_unlink_801b9314 0x801b9314 : { *(.text.w3d_registry_unlink_801b9314) }
  .text.w3d_address_801b9484 0x801b9484 : { *(.text.w3d_address_801b9484) }
  .text.w3d_registry_unlink_801b94f8 0x801b94f8 : { *(.text.w3d_registry_unlink_801b94f8) }
  .text.w3d_address_801b9610 0x801b9610 : { *(.text.w3d_address_801b9610) }
  .text.w3d_registry_unlink_801b9684 0x801b9684 : { *(.text.w3d_registry_unlink_801b9684) }
  /DISCARD/ : { *(.text*) *(.rodata*) *(.data*) *(.bss*) *(.sdata*) *(.sbss*) *(.comment) }
}
