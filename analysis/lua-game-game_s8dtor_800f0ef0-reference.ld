/* Generated reference-only placements. All bodies are source-built. */
OUTPUT_FORMAT("elf32-powerpc")
OUTPUT_ARCH(powerpc)
ENTRY(s8_destroy_800f0ef0)
_SDA_BASE_ = 0x804b2540;
_SDA2_BASE_ = 0x804c2540;
fn_80161050 = 0x80161050;
w3d_vtable_80410328 = 0x80410328;
SECTIONS {
  .text.s8_destroy_800f0ef0 0x800f0ef0 : { *(.text.s8_destroy_800f0ef0) }
  /DISCARD/ : { *(.text*) *(.rodata*) *(.data*) *(.bss*) *(.sdata*) *(.sbss*) *(.comment) }
}
