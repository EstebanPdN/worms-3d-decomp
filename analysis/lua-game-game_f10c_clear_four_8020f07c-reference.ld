/* Generated reference-only placements. All bodies are source-built. */
OUTPUT_FORMAT("elf32-powerpc")
OUTPUT_ARCH(powerpc)
ENTRY(f10c_clear_four_8020f07c)
_SDA_BASE_ = 0x804b2540;
_SDA2_BASE_ = 0x804c2540;
__dl__18F10c_8020f07c_ItemPv = 0x801fe1f8;
fn_8020c5c4 = 0x8020c5c4;
fn_80210990 = 0x80210990;
fn_80341588 = 0x80341588;
vt_80418490 = 0x80418490;
vt_804192d8 = 0x804192d8;
SECTIONS {
  .text.f10c_clear_four_8020f07c 0x8020f07c : { *(.text.f10c_clear_four_8020f07c) }
  /DISCARD/ : { *(.text*) *(.rodata*) *(.data*) *(.bss*) *(.sdata*) *(.sbss*) *(.comment) }
}
