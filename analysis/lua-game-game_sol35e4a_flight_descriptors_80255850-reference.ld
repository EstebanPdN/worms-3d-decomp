/* Generated reference-only placements. All bodies are source-built. */
OUTPUT_FORMAT("elf32-powerpc")
OUTPUT_ARCH(powerpc)
ENTRY(sol35e4a_flight_descriptors_80255850)
_SDA_BASE_ = 0x804b2540;
_SDA2_BASE_ = 0x804c2540;
sol35e4a_desc_803c806c = 0x803c806c;
sol35e4a_desc_803c80a8 = 0x803c80a8;
sol35e4a_desc_803c80d8 = 0x803c80d8;
sol35e4a_desc_803c810c = 0x803c810c;
sol35e4a_desc_803c8144 = 0x803c8144;
sol35e4a_desc_803c817c = 0x803c817c;
sol35e4a_desc_803c81b8 = 0x803c81b8;
sol35e4a_desc_803c81ec = 0x803c81ec;
sol35e4a_desc_803c8228 = 0x803c8228;
sol35e4a_desc_803c8268 = 0x803c8268;
sol35e4a_desc_803c82a8 = 0x803c82a8;
sol35e4a_desc_803c82e4 = 0x803c82e4;
sol35e4a_desc_803c8324 = 0x803c8324;
sol35e4a_desc_803c835c = 0x803c835c;
sol35e4a_desc_803c8394 = 0x803c8394;
sol35e4a_desc_803c83cc = 0x803c83cc;
sol35e4a_desc_803c83fc = 0x803c83fc;
sol35e4a_desc_803c842c = 0x803c842c;
sol35e4a_desc_803c846c = 0x803c846c;
sol35e4a_desc_803c84a0 = 0x803c84a0;
sol35e4a_desc_803c84d4 = 0x803c84d4;
sol35e4a_desc_803c8500 = 0x803c8500;
sol35e4a_desc_803c8530 = 0x803c8530;
sol35e4a_empty_804b06a0 = 0x804b06a0;
sol35e4a_finish_801e8d9c = 0x801e8d9c;
sol35e4a_register_scalar_801ec52c = 0x801ec52c;
sol35e4a_register_string_801ed24c = 0x801ed24c;
sol35e4a_register_u32_801ebf38 = 0x801ebf38;
sol35e4a_release_header_8020bb2c = 0x8020bb2c;
sol35e4a_string_finish_8020c5c4 = 0x8020c5c4;
sol35e4a_string_header_80341884 = 0x80341884;
sol35e4a_string_init_8020c5c0 = 0x8020c5c0;
sol35e4a_string_release_80341588 = 0x80341588;
SECTIONS {
  .text.sol35e4a_flight_descriptors_80255850 0x80255850 : { *(.text.sol35e4a_flight_descriptors_80255850) }
  /DISCARD/ : { *(.text*) *(.rodata*) *(.data*) *(.bss*) *(.sdata*) *(.sbss*) *(.comment) }
}
