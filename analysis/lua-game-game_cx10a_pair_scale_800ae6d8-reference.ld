/* Generated reference-only placements. All bodies are source-built. */
OUTPUT_FORMAT("elf32-powerpc")
OUTPUT_ARCH(powerpc)
ENTRY(w3d_cx10a_pair_scale_800ae6d8)
_SDA_BASE_ = 0x804b2540;
_SDA2_BASE_ = 0x804c2540;
neutral_803821bc = 0x803821bc;
threshold_803821b8 = 0x803821b8;
SECTIONS {
  .text.w3d_cx10a_pair_scale_800ae6d8 0x800ae6d8 : { *(.text.w3d_cx10a_pair_scale_800ae6d8) }
  /DISCARD/ : { *(.text*) *(.rodata*) *(.data*) *(.bss*) *(.sdata*) *(.sbss*) *(.comment) }
}
