/* Generated reference-only placements. All bodies are source-built. */
OUTPUT_FORMAT("elf32-powerpc")
OUTPUT_ARCH(powerpc)
ENTRY(d27i_script_copy_container_8010336c)
_SDA_BASE_ = 0x804b2540;
_SDA2_BASE_ = 0x804c2540;
_._19Descriptor_80178474 = 0x80178474;
__15String_8020bb54PCc = 0x8020bb54;
as_80179598 = 0x80179598;
cfg_801797b4 = 0x801797b4;
copy_801ea4c8 = 0x801ea4c8;
error_801022ec = 0x801022ec;
lookup_800fc1b0 = 0x800fc1b0;
lua_gettop = 0x802cd7f4;
lua_isstring = 0x802cdaf4;
lua_settop = 0x802cd808;
lua_tostring = 0x802cdd04;
ref_80341584 = 0x80341584;
s_80399288 = 0x80399288;
s_803992c4 = 0x803992c4;
s_803992f4 = 0x803992f4;
s_80399324 = 0x80399324;
s_80399358 = 0x80399358;
str_finish_8020c5c4 = 0x8020c5c4;
str_release_80341588 = 0x80341588;
SECTIONS {
  .text.d27i_script_copy_container_8010336c 0x8010336c : { *(.text.d27i_script_copy_container_8010336c) }
  /DISCARD/ : { *(.text*) *(.rodata*) *(.data*) *(.bss*) *(.sdata*) *(.sbss*) *(.comment) }
}
