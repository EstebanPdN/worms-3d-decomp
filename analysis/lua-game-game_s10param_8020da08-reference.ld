/* Generated reference-only placements. All bodies are source-built. */
OUTPUT_FORMAT("elf32-powerpc")
OUTPUT_ARCH(powerpc)
ENTRY(w3d_s10_format_number_8020da08)
_SDA_BASE_ = 0x804b2540;
_SDA2_BASE_ = 0x804c2540;
fn_8020d600 = 0x8020d600;
fn_80212cf4 = 0x80212cf4;
fn_802ef9c0 = 0x802ef9c0;
SECTIONS {
  .text.w3d_s10_format_number_8020da08 0x8020da08 : { *(.text.w3d_s10_format_number_8020da08) }
  /DISCARD/ : { *(.text*) *(.rodata*) *(.data*) *(.bss*) *(.sdata*) *(.sbss*) *(.comment) }
}
