/* Generated reference-only placements. All bodies are source-built. */
OUTPUT_FORMAT("elf32-powerpc")
OUTPUT_ARCH(powerpc)
ENTRY(d28l_keyboard_type_char_802c4a7c)
_SDA_BASE_ = 0x804b2540;
_SDA2_BASE_ = 0x804c2540;
__3Str = 0x803426b8;
fn_80178df0 = 0x80178df0;
fn_8018b2b0 = 0x8018b2b0;
fn_8018b4cc = 0x8018b4cc;
fn_8020bb2c = 0x8020bb2c;
fn_8020bdf4 = 0x8020bdf4;
fn_8020bf2c = 0x8020bf2c;
fn_8020c43c = 0x8020c43c;
fn_8020c5c4 = 0x8020c5c4;
fn_8020c5cc = 0x8020c5cc;
fn_8020c620 = 0x8020c620;
fn_8020c6a4 = 0x8020c6a4;
fn_802c4080 = 0x802c4080;
fn_802c43ec = 0x802c43ec;
fn_802c4744 = 0x802c4744;
fn_802c4998 = 0x802c4998;
fn_80341588 = 0x80341588;
fn_8034435c = 0x8034435c;
s_803d8728 = 0x803d8728;
s_803d8730 = 0x803d8730;
s_803d8764 = 0x803d8764;
SECTIONS {
  .text.d28l_keyboard_type_char_802c4a7c 0x802c4a7c : { *(.text.d28l_keyboard_type_char_802c4a7c) }
  .rodata 0x803d87f0 : { *(.rodata) }
  /DISCARD/ : { *(.text*) *(.rodata*) *(.data*) *(.bss*) *(.sdata*) *(.sbss*) *(.comment) }
}
