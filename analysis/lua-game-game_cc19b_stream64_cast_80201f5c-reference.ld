/* Generated reference-only placements. All bodies are source-built. */
OUTPUT_FORMAT("elf32-powerpc")
OUTPUT_ARCH(powerpc)
ENTRY(w3d_cc19b_stream64_cast_80201f5c)
_SDA_BASE_ = 0x804b2540;
_SDA2_BASE_ = 0x804c2540;
fn_8035b260 = 0x8035b260;
SECTIONS {
  .text.w3d_cc19b_stream64_cast_80201f5c 0x80201f5c : { *(.text.w3d_cc19b_stream64_cast_80201f5c) }
  /DISCARD/ : { *(.text*) *(.rodata*) *(.data*) *(.bss*) *(.sdata*) *(.sbss*) *(.comment) }
}
