/* Generated reference-only placements. All bodies are source-built. */
OUTPUT_FORMAT("elf32-powerpc")
OUTPUT_ARCH(powerpc)
ENTRY(f2b_radial_value_801256f4)
_SDA_BASE_ = 0x804b2540;
_SDA2_BASE_ = 0x804c2540;
apply_801257f0 = 0x801257f0;
one_8039baa8 = 0x8039baa8;
position_80066894 = 0x80066894;
radius_800668e4 = 0x800668e4;
weight_800668f4 = 0x800668f4;
SECTIONS {
  .text.f2b_radial_value_801256f4 0x801256f4 : { *(.text.f2b_radial_value_801256f4) }
  /DISCARD/ : { *(.text*) *(.rodata*) *(.data*) *(.bss*) *(.sdata*) *(.sbss*) *(.comment) }
}
