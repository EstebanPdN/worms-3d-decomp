/* Generated reference-only placements. All bodies are source-built. */
OUTPUT_FORMAT("elf32-powerpc")
OUTPUT_ARCH(powerpc)
ENTRY(e12d_encode_radices_8026cc60)
_SDA_BASE_ = 0x804b2540;
_SDA2_BASE_ = 0x804c2540;
w3d_nonzero_seed_8026ce3c = 0x8026ce3c;
w3d_radices_803cbcb0 = 0x803cbcb0;
w3d_seed_format_803cbc80 = 0x803cbc80;
w3d_string_format_8020c510 = 0x8020c510;
SECTIONS {
  .text.e12d_encode_radices_8026cc60 0x8026cc60 : { *(.text.e12d_encode_radices_8026cc60) }
  /DISCARD/ : { *(.text*) *(.rodata*) *(.data*) *(.bss*) *(.sdata*) *(.sbss*) *(.comment) }
}
