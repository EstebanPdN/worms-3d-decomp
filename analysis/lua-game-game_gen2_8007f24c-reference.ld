/* Generated reference-only placements. All bodies are source-built. */
OUTPUT_FORMAT("elf32-powerpc")
OUTPUT_ARCH(powerpc)
ENTRY(w3d_static_init_8007f24c)
_SDA_BASE_ = 0x804b2540;
_SDA2_BASE_ = 0x804c2540;
w3d_empty_80086630 = 0x80086630;
w3d_fn_8007f1f0 = 0x8007f1f0;
w3d_fn_80087730 = 0x80087730;
w3d_fn_8008e2e0 = 0x8008e2e0;
w3d_fn_80092ab8 = 0x80092ab8;
w3d_fn_80093240 = 0x80093240;
w3d_fn_800937e4 = 0x800937e4;
w3d_fn_8009659c = 0x8009659c;
w3d_fn_800974e4 = 0x800974e4;
w3d_fn_80097efc = 0x80097efc;
w3d_fn_800989c0 = 0x800989c0;
w3d_fn_8009a770 = 0x8009a770;
w3d_fn_8009b204 = 0x8009b204;
w3d_fn_8009d868 = 0x8009d868;
w3d_fn_8009e998 = 0x8009e998;
w3d_fn_8009fd54 = 0x8009fd54;
w3d_fn_800a1670 = 0x800a1670;
w3d_fn_800a3694 = 0x800a3694;
w3d_fn_800a40b8 = 0x800a40b8;
w3d_fn_800a4800 = 0x800a4800;
w3d_fn_800a4e44 = 0x800a4e44;
w3d_fn_800a5394 = 0x800a5394;
w3d_fn_800a5cd0 = 0x800a5cd0;
w3d_fn_800a814c = 0x800a814c;
w3d_fn_800a9d08 = 0x800a9d08;
w3d_fn_800ac3bc = 0x800ac3bc;
w3d_fn_800ad8b4 = 0x800ad8b4;
w3d_fn_800af134 = 0x800af134;
w3d_fn_800af2b0 = 0x800af2b0;
w3d_fn_800afcd0 = 0x800afcd0;
w3d_fn_800b06d8 = 0x800b06d8;
w3d_fn_800b1240 = 0x800b1240;
w3d_fn_800b9020 = 0x800b9020;
w3d_fn_800b931c = 0x800b931c;
w3d_fn_800ba66c = 0x800ba66c;
w3d_fn_800beb80 = 0x800beb80;
w3d_fn_800bfdac = 0x800bfdac;
w3d_fn_800c1468 = 0x800c1468;
w3d_fn_800c1580 = 0x800c1580;
w3d_fn_800c1674 = 0x800c1674;
w3d_fn_800c1b90 = 0x800c1b90;
w3d_fn_800c2144 = 0x800c2144;
w3d_fn_800c2408 = 0x800c2408;
w3d_fn_800c3d78 = 0x800c3d78;
w3d_fn_800c44b4 = 0x800c44b4;
w3d_fn_800c590c = 0x800c590c;
w3d_fn_800c6ba8 = 0x800c6ba8;
w3d_fn_800c80c0 = 0x800c80c0;
w3d_fn_800c83c4 = 0x800c83c4;
w3d_fn_800cb040 = 0x800cb040;
w3d_fn_800cc620 = 0x800cc620;
w3d_fn_800cd9dc = 0x800cd9dc;
w3d_fn_800d201c = 0x800d201c;
w3d_fn_800d2d10 = 0x800d2d10;
w3d_fn_800d5180 = 0x800d5180;
w3d_fn_800d573c = 0x800d573c;
w3d_fn_800d6a20 = 0x800d6a20;
w3d_fn_800d74c8 = 0x800d74c8;
w3d_fn_800d9f30 = 0x800d9f30;
w3d_fn_800da85c = 0x800da85c;
w3d_fn_800dc418 = 0x800dc418;
w3d_fn_800de60c = 0x800de60c;
w3d_fn_800de850 = 0x800de850;
w3d_fn_800e0450 = 0x800e0450;
w3d_fn_800e265c = 0x800e265c;
w3d_fn_800e343c = 0x800e343c;
w3d_fn_800e4df8 = 0x800e4df8;
w3d_fn_800e4f38 = 0x800e4f38;
w3d_fn_800e6554 = 0x800e6554;
w3d_fn_800e71ac = 0x800e71ac;
w3d_fn_800e78d4 = 0x800e78d4;
w3d_fn_800e7bec = 0x800e7bec;
w3d_fn_800e9ec8 = 0x800e9ec8;
w3d_fn_800edfa8 = 0x800edfa8;
w3d_fn_800ef80c = 0x800ef80c;
w3d_fn_800efc84 = 0x800efc84;
w3d_fn_800f0c6c = 0x800f0c6c;
w3d_fn_800f1394 = 0x800f1394;
w3d_fn_800f1c6c = 0x800f1c6c;
w3d_fn_800f28d8 = 0x800f28d8;
SECTIONS {
  .text.w3d_static_init_8007f24c 0x8007f24c : { *(.text.w3d_static_init_8007f24c) }
  .text.w3d_static_init_80086634 0x80086634 : { *(.text.w3d_static_init_80086634) }
  .text.w3d_static_init_8008778c 0x8008778c : { *(.text.w3d_static_init_8008778c) }
  .text.w3d_static_init_8008e7a8 0x8008e7a8 : { *(.text.w3d_static_init_8008e7a8) }
  .text.w3d_static_init_80092d08 0x80092d08 : { *(.text.w3d_static_init_80092d08) }
  .text.w3d_static_init_80093298 0x80093298 : { *(.text.w3d_static_init_80093298) }
  .text.w3d_static_init_80093844 0x80093844 : { *(.text.w3d_static_init_80093844) }
  .text.w3d_static_init_8009682c 0x8009682c : { *(.text.w3d_static_init_8009682c) }
  .text.w3d_static_init_800975d4 0x800975d4 : { *(.text.w3d_static_init_800975d4) }
  .text.w3d_static_init_80097f5c 0x80097f5c : { *(.text.w3d_static_init_80097f5c) }
  .text.w3d_static_init_80098a68 0x80098a68 : { *(.text.w3d_static_init_80098a68) }
  .text.w3d_static_init_8009a7d0 0x8009a7d0 : { *(.text.w3d_static_init_8009a7d0) }
  .text.w3d_static_init_8009b284 0x8009b284 : { *(.text.w3d_static_init_8009b284) }
  .text.w3d_static_init_8009da78 0x8009da78 : { *(.text.w3d_static_init_8009da78) }
  .text.w3d_static_init_8009ea0c 0x8009ea0c : { *(.text.w3d_static_init_8009ea0c) }
  .text.w3d_static_init_8009fe3c 0x8009fe3c : { *(.text.w3d_static_init_8009fe3c) }
  .text.w3d_static_init_800a1784 0x800a1784 : { *(.text.w3d_static_init_800a1784) }
  .text.w3d_static_init_800a3724 0x800a3724 : { *(.text.w3d_static_init_800a3724) }
  .text.w3d_static_init_800a4158 0x800a4158 : { *(.text.w3d_static_init_800a4158) }
  .text.w3d_static_init_800a4910 0x800a4910 : { *(.text.w3d_static_init_800a4910) }
  .text.w3d_static_init_800a4ea4 0x800a4ea4 : { *(.text.w3d_static_init_800a4ea4) }
  .text.w3d_static_init_800a54ac 0x800a54ac : { *(.text.w3d_static_init_800a54ac) }
  .text.w3d_static_init_800a5d40 0x800a5d40 : { *(.text.w3d_static_init_800a5d40) }
  .text.w3d_static_init_800a82c4 0x800a82c4 : { *(.text.w3d_static_init_800a82c4) }
  .text.w3d_static_init_800a9d90 0x800a9d90 : { *(.text.w3d_static_init_800a9d90) }
  .text.w3d_static_init_800ac55c 0x800ac55c : { *(.text.w3d_static_init_800ac55c) }
  .text.w3d_static_init_800ad908 0x800ad908 : { *(.text.w3d_static_init_800ad908) }
  .text.w3d_static_init_800af1b4 0x800af1b4 : { *(.text.w3d_static_init_800af1b4) }
  .text.w3d_static_init_800af304 0x800af304 : { *(.text.w3d_static_init_800af304) }
  .text.w3d_static_init_800afda8 0x800afda8 : { *(.text.w3d_static_init_800afda8) }
  .text.w3d_static_init_800b075c 0x800b075c : { *(.text.w3d_static_init_800b075c) }
  .text.w3d_static_init_800b129c 0x800b129c : { *(.text.w3d_static_init_800b129c) }
  .text.w3d_static_init_800b9100 0x800b9100 : { *(.text.w3d_static_init_800b9100) }
  .text.w3d_static_init_800b9360 0x800b9360 : { *(.text.w3d_static_init_800b9360) }
  .text.w3d_static_init_800ba734 0x800ba734 : { *(.text.w3d_static_init_800ba734) }
  .text.w3d_static_init_800bed0c 0x800bed0c : { *(.text.w3d_static_init_800bed0c) }
  .text.w3d_static_init_800bfe64 0x800bfe64 : { *(.text.w3d_static_init_800bfe64) }
  .text.w3d_static_init_800c1554 0x800c1554 : { *(.text.w3d_static_init_800c1554) }
  .text.w3d_static_init_800c15f4 0x800c15f4 : { *(.text.w3d_static_init_800c15f4) }
  .text.w3d_static_init_800c16b8 0x800c16b8 : { *(.text.w3d_static_init_800c16b8) }
  .text.w3d_static_init_800c1c30 0x800c1c30 : { *(.text.w3d_static_init_800c1c30) }
  .text.w3d_static_init_800c21a4 0x800c21a4 : { *(.text.w3d_static_init_800c21a4) }
  .text.w3d_static_init_800c2468 0x800c2468 : { *(.text.w3d_static_init_800c2468) }
  .text.w3d_static_init_800c3f28 0x800c3f28 : { *(.text.w3d_static_init_800c3f28) }
  .text.w3d_static_init_800c456c 0x800c456c : { *(.text.w3d_static_init_800c456c) }
  .text.w3d_static_init_800c59a0 0x800c59a0 : { *(.text.w3d_static_init_800c59a0) }
  .text.w3d_static_init_800c6cc8 0x800c6cc8 : { *(.text.w3d_static_init_800c6cc8) }
  .text.w3d_static_init_800c8170 0x800c8170 : { *(.text.w3d_static_init_800c8170) }
  .text.w3d_static_init_800c8424 0x800c8424 : { *(.text.w3d_static_init_800c8424) }
  .text.w3d_static_init_800cb0d0 0x800cb0d0 : { *(.text.w3d_static_init_800cb0d0) }
  .text.w3d_static_init_800cc6a4 0x800cc6a4 : { *(.text.w3d_static_init_800cc6a4) }
  .text.w3d_static_init_800cda7c 0x800cda7c : { *(.text.w3d_static_init_800cda7c) }
  .text.w3d_static_init_800d2338 0x800d2338 : { *(.text.w3d_static_init_800d2338) }
  .text.w3d_static_init_800d2dc0 0x800d2dc0 : { *(.text.w3d_static_init_800d2dc0) }
  .text.w3d_static_init_800d5214 0x800d5214 : { *(.text.w3d_static_init_800d5214) }
  .text.w3d_static_init_800d579c 0x800d579c : { *(.text.w3d_static_init_800d579c) }
  .text.w3d_static_init_800d6b18 0x800d6b18 : { *(.text.w3d_static_init_800d6b18) }
  .text.w3d_static_init_800d757c 0x800d757c : { *(.text.w3d_static_init_800d757c) }
  .text.w3d_static_init_800da100 0x800da100 : { *(.text.w3d_static_init_800da100) }
  .text.w3d_static_init_800da8dc 0x800da8dc : { *(.text.w3d_static_init_800da8dc) }
  .text.w3d_static_init_800dc590 0x800dc590 : { *(.text.w3d_static_init_800dc590) }
  .text.w3d_static_init_800de698 0x800de698 : { *(.text.w3d_static_init_800de698) }
  .text.w3d_static_init_800de8ac 0x800de8ac : { *(.text.w3d_static_init_800de8ac) }
  .text.w3d_static_init_800e0528 0x800e0528 : { *(.text.w3d_static_init_800e0528) }
  .text.w3d_static_init_800e2760 0x800e2760 : { *(.text.w3d_static_init_800e2760) }
  .text.w3d_static_init_800e34ac 0x800e34ac : { *(.text.w3d_static_init_800e34ac) }
  .text.w3d_static_init_800e4f0c 0x800e4f0c : { *(.text.w3d_static_init_800e4f0c) }
  .text.w3d_static_init_800e4f7c 0x800e4f7c : { *(.text.w3d_static_init_800e4f7c) }
  .text.w3d_static_init_800e670c 0x800e670c : { *(.text.w3d_static_init_800e670c) }
  .text.w3d_static_init_800e724c 0x800e724c : { *(.text.w3d_static_init_800e724c) }
  .text.w3d_static_init_800e7948 0x800e7948 : { *(.text.w3d_static_init_800e7948) }
  .text.w3d_static_init_800e7c4c 0x800e7c4c : { *(.text.w3d_static_init_800e7c4c) }
  .text.w3d_static_init_800ea030 0x800ea030 : { *(.text.w3d_static_init_800ea030) }
  .text.w3d_static_init_800ee124 0x800ee124 : { *(.text.w3d_static_init_800ee124) }
  .text.w3d_static_init_800efa20 0x800efa20 : { *(.text.w3d_static_init_800efa20) }
  .text.w3d_static_init_800efce4 0x800efce4 : { *(.text.w3d_static_init_800efce4) }
  .text.w3d_static_init_800f0d50 0x800f0d50 : { *(.text.w3d_static_init_800f0d50) }
  .text.w3d_static_init_800f1464 0x800f1464 : { *(.text.w3d_static_init_800f1464) }
  .text.w3d_static_init_800f1cdc 0x800f1cdc : { *(.text.w3d_static_init_800f1cdc) }
  .text.w3d_static_init_800f2980 0x800f2980 : { *(.text.w3d_static_init_800f2980) }
  /DISCARD/ : { *(.text*) *(.rodata*) *(.data*) *(.bss*) *(.sdata*) *(.sbss*) *(.comment) }
}
