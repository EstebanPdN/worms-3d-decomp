/* Generated reference-only placements. All bodies are source-built. */
OUTPUT_FORMAT("elf32-powerpc")
OUTPUT_ARCH(powerpc)
ENTRY(w3d_s21_i64_to_text_801fee3c)
_SDA_BASE_ = 0x804b2540;
_SDA2_BASE_ = 0x804c2540;
fn_8020db88 = 0x8020db88;
SECTIONS {
  .text.w3d_s21_i64_to_text_801fee3c 0x801fee3c : { *(.text.w3d_s21_i64_to_text_801fee3c) }
  /DISCARD/ : { *(.text*) *(.rodata*) *(.data*) *(.bss*) *(.sdata*) *(.sbss*) *(.comment) }
}
