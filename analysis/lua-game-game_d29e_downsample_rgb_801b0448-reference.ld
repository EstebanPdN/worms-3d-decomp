/* Generated reference-only placements. All bodies are source-built. */
OUTPUT_FORMAT("elf32-powerpc")
OUTPUT_ARCH(powerpc)
ENTRY(w3d_d29e_downsample_rgb_801b0448)
_SDA_BASE_ = 0x804b2540;
_SDA2_BASE_ = 0x804c2540;
sol11b_filter_select_801d7750 = 0x801d7750;
SECTIONS {
  .text.w3d_d29e_downsample_rgb_801b0448 0x801b0448 : { *(.text.w3d_d29e_downsample_rgb_801b0448) }
  /DISCARD/ : { *(.text*) *(.rodata*) *(.data*) *(.bss*) *(.sdata*) *(.sbss*) *(.comment) }
}
