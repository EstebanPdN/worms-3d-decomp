/* Generated reference-only placements. All bodies are source-built. */
OUTPUT_FORMAT("elf32-powerpc")
OUTPUT_ARCH(powerpc)
ENTRY(w3d_k4b_dual_component_construct_8019cbfc)
_SDA_BASE_ = 0x804b2540;
_SDA2_BASE_ = 0x804c2540;
fn_801e81c8 = 0x801e81c8;
lbl_80413680 = 0x80413680;
lbl_804136c0 = 0x804136c0;
SECTIONS {
  .text.w3d_k4b_dual_component_construct_8019cbfc 0x8019cbfc : { *(.text.w3d_k4b_dual_component_construct_8019cbfc) }
  /DISCARD/ : { *(.text*) *(.rodata*) *(.data*) *(.bss*) *(.sdata*) *(.sbss*) *(.comment) }
}
