/* Generated reference-only placements. All bodies are source-built. */
OUTPUT_FORMAT("elf32-powerpc")
OUTPUT_ARCH(powerpc)
ENTRY(w3d_dtor_held_801b79c8)
_SDA_BASE_ = 0x804b2540;
_SDA2_BASE_ = 0x804c2540;
w3d_fn_801b4bcc = 0x801b4bcc;
w3d_fn_801b4c6c = 0x801b4c6c;
w3d_fn_801b4ef0 = 0x801b4ef0;
w3d_fn_801b52d8 = 0x801b52d8;
w3d_fn_801b5404 = 0x801b5404;
w3d_fn_801b5454 = 0x801b5454;
w3d_fn_801b687c = 0x801b687c;
w3d_fn_801b7984 = 0x801b7984;
w3d_fn_801bcb0c = 0x801bcb0c;
w3d_fn_801c0700 = 0x801c0700;
w3d_fn_801ea0ec = 0x801ea0ec;
w3d_fn_801ea138 = 0x801ea138;
w3d_fn_801ea740 = 0x801ea740;
w3d_vtable_80414df8 = 0x80414df8;
w3d_vtable_80414e70 = 0x80414e70;
w3d_vtable_80414e98 = 0x80414e98;
w3d_vtable_80414ec0 = 0x80414ec0;
w3d_vtable_80414ee8 = 0x80414ee8;
w3d_vtable_80414f10 = 0x80414f10;
w3d_vtable_80414f38 = 0x80414f38;
w3d_vtable_80414f60 = 0x80414f60;
w3d_vtable_80414f88 = 0x80414f88;
w3d_vtable_80414fb0 = 0x80414fb0;
w3d_vtable_80414fd8 = 0x80414fd8;
w3d_vtable_80415000 = 0x80415000;
w3d_vtable_80415050 = 0x80415050;
w3d_vtable_80415078 = 0x80415078;
w3d_vtable_804150a0 = 0x804150a0;
w3d_vtable_804150c8 = 0x804150c8;
w3d_vtable_804150f0 = 0x804150f0;
w3d_vtable_80415118 = 0x80415118;
w3d_vtable_80415140 = 0x80415140;
w3d_vtable_80415168 = 0x80415168;
w3d_vtable_80415190 = 0x80415190;
w3d_vtable_804151b8 = 0x804151b8;
w3d_vtable_804151e0 = 0x804151e0;
w3d_vtable_80415208 = 0x80415208;
w3d_vtable_80415230 = 0x80415230;
w3d_vtable_80415258 = 0x80415258;
w3d_vtable_80415280 = 0x80415280;
w3d_vtable_804152a8 = 0x804152a8;
w3d_vtable_804152d0 = 0x804152d0;
w3d_vtable_804152f8 = 0x804152f8;
w3d_vtable_80415320 = 0x80415320;
w3d_vtable_80415370 = 0x80415370;
w3d_vtable_80415398 = 0x80415398;
w3d_vtable_804153c0 = 0x804153c0;
w3d_vtable_804153e8 = 0x804153e8;
w3d_vtable_80415410 = 0x80415410;
w3d_vtable_80415438 = 0x80415438;
w3d_vtable_80415460 = 0x80415460;
w3d_vtable_80415488 = 0x80415488;
w3d_vtable_804154b0 = 0x804154b0;
w3d_vtable_804154d8 = 0x804154d8;
w3d_vtable_80415500 = 0x80415500;
w3d_vtable_80415528 = 0x80415528;
w3d_vtable_80415550 = 0x80415550;
w3d_vtable_80415578 = 0x80415578;
w3d_vtable_804155a0 = 0x804155a0;
w3d_vtable_804155c8 = 0x804155c8;
w3d_vtable_804155f0 = 0x804155f0;
w3d_vtable_80415640 = 0x80415640;
w3d_vtable_80415668 = 0x80415668;
w3d_vtable_80415690 = 0x80415690;
w3d_vtable_804156b8 = 0x804156b8;
w3d_vtable_804156e0 = 0x804156e0;
w3d_vtable_80415708 = 0x80415708;
w3d_vtable_80415730 = 0x80415730;
w3d_vtable_80415758 = 0x80415758;
w3d_vtable_80415780 = 0x80415780;
w3d_vtable_804157a8 = 0x804157a8;
w3d_vtable_804157d0 = 0x804157d0;
w3d_vtable_804157f8 = 0x804157f8;
w3d_vtable_80415820 = 0x80415820;
w3d_vtable_80415848 = 0x80415848;
w3d_vtable_80415870 = 0x80415870;
w3d_vtable_80415898 = 0x80415898;
w3d_vtable_804158c0 = 0x804158c0;
w3d_vtable_804158e8 = 0x804158e8;
SECTIONS {
  .text.w3d_dtor_held_801b79c8 0x801b79c8 : { *(.text.w3d_dtor_held_801b79c8) }
  .text.w3d_ctor_801b7b30 0x801b7b30 : { *(.text.w3d_ctor_801b7b30) }
  .text.w3d_dtor_801b7b6c 0x801b7b6c : { *(.text.w3d_dtor_801b7b6c) }
  .text.w3d_ctor_801b7c98 0x801b7c98 : { *(.text.w3d_ctor_801b7c98) }
  .text.w3d_dtor_801b7cd4 0x801b7cd4 : { *(.text.w3d_dtor_801b7cd4) }
  .text.w3d_ctor_801b7e00 0x801b7e00 : { *(.text.w3d_ctor_801b7e00) }
  .text.w3d_dtor_801b7e3c 0x801b7e3c : { *(.text.w3d_dtor_801b7e3c) }
  .text.w3d_ctor_801b7f68 0x801b7f68 : { *(.text.w3d_ctor_801b7f68) }
  .text.w3d_dtor_801b7fa4 0x801b7fa4 : { *(.text.w3d_dtor_801b7fa4) }
  .text.w3d_dtor_held_801b812c 0x801b812c : { *(.text.w3d_dtor_held_801b812c) }
  .text.w3d_dtor_held_801b837c 0x801b837c : { *(.text.w3d_dtor_held_801b837c) }
  .text.w3d_dtor_held_801b85cc 0x801b85cc : { *(.text.w3d_dtor_held_801b85cc) }
  .text.w3d_ctor_801b87c0 0x801b87c0 : { *(.text.w3d_ctor_801b87c0) }
  .text.w3d_dtor_801b87fc 0x801b87fc : { *(.text.w3d_dtor_801b87fc) }
  .text.w3d_ctor_801b8928 0x801b8928 : { *(.text.w3d_ctor_801b8928) }
  .text.w3d_dtor_801b8964 0x801b8964 : { *(.text.w3d_dtor_801b8964) }
  .text.w3d_ctor_801b8a90 0x801b8a90 : { *(.text.w3d_ctor_801b8a90) }
  .text.w3d_dtor_801b8acc 0x801b8acc : { *(.text.w3d_dtor_801b8acc) }
  .text.w3d_ctor_801b8bf8 0x801b8bf8 : { *(.text.w3d_ctor_801b8bf8) }
  .text.w3d_dtor_801b8c34 0x801b8c34 : { *(.text.w3d_dtor_801b8c34) }
  .text.w3d_ctor_801b8d60 0x801b8d60 : { *(.text.w3d_ctor_801b8d60) }
  .text.w3d_dtor_801b8d9c 0x801b8d9c : { *(.text.w3d_dtor_801b8d9c) }
  .text.w3d_dtor_held_801b8f24 0x801b8f24 : { *(.text.w3d_dtor_held_801b8f24) }
  .text.w3d_dtor_held_801b916c 0x801b916c : { *(.text.w3d_dtor_held_801b916c) }
  .text.w3d_dtor_801b93b0 0x801b93b0 : { *(.text.w3d_dtor_801b93b0) }
  .text.w3d_dtor_801b9580 0x801b9580 : { *(.text.w3d_dtor_801b9580) }
  .text.w3d_dtor_held_801b9724 0x801b9724 : { *(.text.w3d_dtor_held_801b9724) }
  .text.w3d_dtor_held_801b9c88 0x801b9c88 : { *(.text.w3d_dtor_held_801b9c88) }
  .text.w3d_dtor_801b9eb8 0x801b9eb8 : { *(.text.w3d_dtor_801b9eb8) }
  .text.w3d_dtor_held_801ba05c 0x801ba05c : { *(.text.w3d_dtor_held_801ba05c) }
  .text.w3d_dtor_held_801ba2a4 0x801ba2a4 : { *(.text.w3d_dtor_held_801ba2a4) }
  .text.w3d_dtor_held_801ba4ec 0x801ba4ec : { *(.text.w3d_dtor_held_801ba4ec) }
  .text.w3d_dtor_held_801ba734 0x801ba734 : { *(.text.w3d_dtor_held_801ba734) }
  .text.w3d_dtor_held_801ba97c 0x801ba97c : { *(.text.w3d_dtor_held_801ba97c) }
  .text.w3d_dtor_801babc0 0x801babc0 : { *(.text.w3d_dtor_801babc0) }
  .text.w3d_dtor_held_801bada8 0x801bada8 : { *(.text.w3d_dtor_held_801bada8) }
  .text.w3d_dtor_held_801baffc 0x801baffc : { *(.text.w3d_dtor_held_801baffc) }
  .text.w3d_dtor_held_801bb244 0x801bb244 : { *(.text.w3d_dtor_held_801bb244) }
  .text.w3d_dtor_held_801bb48c 0x801bb48c : { *(.text.w3d_dtor_held_801bb48c) }
  .text.w3d_dtor_held_801bb6dc 0x801bb6dc : { *(.text.w3d_dtor_held_801bb6dc) }
  .text.w3d_dtor_held_801bb938 0x801bb938 : { *(.text.w3d_dtor_held_801bb938) }
  .text.w3d_dtor_801bbb70 0x801bbb70 : { *(.text.w3d_dtor_801bbb70) }
  .text.w3d_dtor_held_801bbd14 0x801bbd14 : { *(.text.w3d_dtor_held_801bbd14) }
  .text.w3d_dtor_held_801bbf64 0x801bbf64 : { *(.text.w3d_dtor_held_801bbf64) }
  .text.w3d_dtor_801bc3e0 0x801bc3e0 : { *(.text.w3d_dtor_801bc3e0) }
  .text.w3d_dtor_801bc57c 0x801bc57c : { *(.text.w3d_dtor_801bc57c) }
  .text.w3d_dtor_801bc79c 0x801bc79c : { *(.text.w3d_dtor_801bc79c) }
  .text.w3d_dtor_801bc9b4 0x801bc9b4 : { *(.text.w3d_dtor_801bc9b4) }
  .text.w3d_dtor_801bcba0 0x801bcba0 : { *(.text.w3d_dtor_801bcba0) }
  .text.w3d_dtor_801bce24 0x801bce24 : { *(.text.w3d_dtor_801bce24) }
  .text.w3d_dtor_801bd050 0x801bd050 : { *(.text.w3d_dtor_801bd050) }
  .text.w3d_ctor_801bd218 0x801bd218 : { *(.text.w3d_ctor_801bd218) }
  .text.w3d_dtor_801bd254 0x801bd254 : { *(.text.w3d_dtor_801bd254) }
  .text.w3d_dtor_801bd3c8 0x801bd3c8 : { *(.text.w3d_dtor_801bd3c8) }
  .text.w3d_dtor_801bd560 0x801bd560 : { *(.text.w3d_dtor_801bd560) }
  .text.w3d_dtor_held_801bd72c 0x801bd72c : { *(.text.w3d_dtor_held_801bd72c) }
  .text.w3d_dtor_held_801bd9bc 0x801bd9bc : { *(.text.w3d_dtor_held_801bd9bc) }
  .text.w3d_dtor_held_801bdc04 0x801bdc04 : { *(.text.w3d_dtor_held_801bdc04) }
  .text.w3d_ctor_801bddf0 0x801bddf0 : { *(.text.w3d_ctor_801bddf0) }
  .text.w3d_dtor_801bde2c 0x801bde2c : { *(.text.w3d_dtor_801bde2c) }
  .text.w3d_ctor_801bdfe4 0x801bdfe4 : { *(.text.w3d_ctor_801bdfe4) }
  .text.w3d_dtor_801be020 0x801be020 : { *(.text.w3d_dtor_801be020) }
  .text.w3d_dtor_held_801be1a0 0x801be1a0 : { *(.text.w3d_dtor_held_801be1a0) }
  .text.w3d_dtor_held_801be36c 0x801be36c : { *(.text.w3d_dtor_held_801be36c) }
  .text.w3d_dtor_held_801be530 0x801be530 : { *(.text.w3d_dtor_held_801be530) }
  .text.w3d_dtor_801be850 0x801be850 : { *(.text.w3d_dtor_801be850) }
  .text.w3d_ctor_801bf038 0x801bf038 : { *(.text.w3d_ctor_801bf038) }
  .text.w3d_dtor_801bf074 0x801bf074 : { *(.text.w3d_dtor_801bf074) }
  .text.w3d_dtor_held_801bf1e4 0x801bf1e4 : { *(.text.w3d_dtor_held_801bf1e4) }
  .text.w3d_ctor_801bf34c 0x801bf34c : { *(.text.w3d_ctor_801bf34c) }
  .text.w3d_dtor_801bf388 0x801bf388 : { *(.text.w3d_dtor_801bf388) }
  .text.w3d_dtor_801bf50c 0x801bf50c : { *(.text.w3d_dtor_801bf50c) }
  .text.w3d_dtor_801bf7a4 0x801bf7a4 : { *(.text.w3d_dtor_801bf7a4) }
  .text.w3d_dtor_801bfab0 0x801bfab0 : { *(.text.w3d_dtor_801bfab0) }
  .text.w3d_dtor_801bfca4 0x801bfca4 : { *(.text.w3d_dtor_801bfca4) }
  .text.w3d_dtor_801bfec0 0x801bfec0 : { *(.text.w3d_dtor_801bfec0) }
  .text.w3d_dtor_801c009c 0x801c009c : { *(.text.w3d_dtor_801c009c) }
  .text.w3d_dtor_801c0254 0x801c0254 : { *(.text.w3d_dtor_801c0254) }
  .text.w3d_dtor_held_801c0488 0x801c0488 : { *(.text.w3d_dtor_held_801c0488) }
  .text.w3d_ctor_801c14d0 0x801c14d0 : { *(.text.w3d_ctor_801c14d0) }
  /DISCARD/ : { *(.text*) *(.rodata*) *(.data*) *(.bss*) *(.sdata*) *(.sbss*) *(.comment) }
}
