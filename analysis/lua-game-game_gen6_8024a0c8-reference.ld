/* Generated reference-only placements. All bodies are source-built. */
OUTPUT_FORMAT("elf32-powerpc")
OUTPUT_ARCH(powerpc)
ENTRY(w3d_setf_8024a0c8)
_SDA_BASE_ = 0x804b2540;
_SDA2_BASE_ = 0x804c2540;
SECTIONS {
  .text.w3d_setf_8024a0c8 0x8024a0c8 : { *(.text.w3d_setf_8024a0c8) }
  .text.w3d_getf_8024a0d0 0x8024a0d0 : { *(.text.w3d_getf_8024a0d0) }
  .text.w3d_setf_8024a0d8 0x8024a0d8 : { *(.text.w3d_setf_8024a0d8) }
  .text.w3d_getf_8024a0e0 0x8024a0e0 : { *(.text.w3d_getf_8024a0e0) }
  .text.w3d_copy12_8024a128 0x8024a128 : { *(.text.w3d_copy12_8024a128) }
  .text.w3d_member_8024a148 0x8024a148 : { *(.text.w3d_member_8024a148) }
  .text.w3d_copy12_8024a150 0x8024a150 : { *(.text.w3d_copy12_8024a150) }
  .text.w3d_member_8024a170 0x8024a170 : { *(.text.w3d_member_8024a170) }
  .text.w3d_setf_8024a1b8 0x8024a1b8 : { *(.text.w3d_setf_8024a1b8) }
  .text.w3d_getf_8024a1c0 0x8024a1c0 : { *(.text.w3d_getf_8024a1c0) }
  .text.w3d_setf_8024a1c8 0x8024a1c8 : { *(.text.w3d_setf_8024a1c8) }
  .text.w3d_getf_8024a1d0 0x8024a1d0 : { *(.text.w3d_getf_8024a1d0) }
  .text.w3d_copy12_8024a1d8 0x8024a1d8 : { *(.text.w3d_copy12_8024a1d8) }
  .text.w3d_member_8024a1f8 0x8024a1f8 : { *(.text.w3d_member_8024a1f8) }
  .text.w3d_setf_8024a200 0x8024a200 : { *(.text.w3d_setf_8024a200) }
  .text.w3d_getf_8024a208 0x8024a208 : { *(.text.w3d_getf_8024a208) }
  .text.w3d_setf_8024a230 0x8024a230 : { *(.text.w3d_setf_8024a230) }
  .text.w3d_getf_8024a238 0x8024a238 : { *(.text.w3d_getf_8024a238) }
  .text.w3d_setf_8024a240 0x8024a240 : { *(.text.w3d_setf_8024a240) }
  .text.w3d_getf_8024a248 0x8024a248 : { *(.text.w3d_getf_8024a248) }
  .text.w3d_setf_8024a290 0x8024a290 : { *(.text.w3d_setf_8024a290) }
  .text.w3d_getf_8024a298 0x8024a298 : { *(.text.w3d_getf_8024a298) }
  .text.w3d_setf_8024a310 0x8024a310 : { *(.text.w3d_setf_8024a310) }
  .text.w3d_getf_8024a318 0x8024a318 : { *(.text.w3d_getf_8024a318) }
  .text.w3d_copy12_8024a348 0x8024a348 : { *(.text.w3d_copy12_8024a348) }
  .text.w3d_member_8024a368 0x8024a368 : { *(.text.w3d_member_8024a368) }
  .text.w3d_copy12_8024a370 0x8024a370 : { *(.text.w3d_copy12_8024a370) }
  .text.w3d_member_8024a390 0x8024a390 : { *(.text.w3d_member_8024a390) }
  .text.w3d_copy12_8024a398 0x8024a398 : { *(.text.w3d_copy12_8024a398) }
  .text.w3d_member_8024a3b8 0x8024a3b8 : { *(.text.w3d_member_8024a3b8) }
  .text.w3d_copy12_8024a3c0 0x8024a3c0 : { *(.text.w3d_copy12_8024a3c0) }
  .text.w3d_member_8024a3e0 0x8024a3e0 : { *(.text.w3d_member_8024a3e0) }
  .text.w3d_member_8024a3fc 0x8024a3fc : { *(.text.w3d_member_8024a3fc) }
  .text.w3d_setf_8024a414 0x8024a414 : { *(.text.w3d_setf_8024a414) }
  .text.w3d_getf_8024a41c 0x8024a41c : { *(.text.w3d_getf_8024a41c) }
  .text.w3d_member_8024a438 0x8024a438 : { *(.text.w3d_member_8024a438) }
  .text.w3d_member_8024a454 0x8024a454 : { *(.text.w3d_member_8024a454) }
  .text.w3d_member_8024a480 0x8024a480 : { *(.text.w3d_member_8024a480) }
  .text.w3d_setf_8024a488 0x8024a488 : { *(.text.w3d_setf_8024a488) }
  .text.w3d_getf_8024a490 0x8024a490 : { *(.text.w3d_getf_8024a490) }
  .text.w3d_setf_8024a4a8 0x8024a4a8 : { *(.text.w3d_setf_8024a4a8) }
  .text.w3d_getf_8024a4b0 0x8024a4b0 : { *(.text.w3d_getf_8024a4b0) }
  .text.w3d_setf_8024a4b8 0x8024a4b8 : { *(.text.w3d_setf_8024a4b8) }
  .text.w3d_getf_8024a4c0 0x8024a4c0 : { *(.text.w3d_getf_8024a4c0) }
  .text.w3d_setf_8024a4c8 0x8024a4c8 : { *(.text.w3d_setf_8024a4c8) }
  .text.w3d_getf_8024a4d0 0x8024a4d0 : { *(.text.w3d_getf_8024a4d0) }
  .text.w3d_setf_8024a4d8 0x8024a4d8 : { *(.text.w3d_setf_8024a4d8) }
  .text.w3d_getf_8024a4e0 0x8024a4e0 : { *(.text.w3d_getf_8024a4e0) }
  .text.w3d_setf_8024a4e8 0x8024a4e8 : { *(.text.w3d_setf_8024a4e8) }
  .text.w3d_getf_8024a4f0 0x8024a4f0 : { *(.text.w3d_getf_8024a4f0) }
  .text.w3d_copy12_8024a4f8 0x8024a4f8 : { *(.text.w3d_copy12_8024a4f8) }
  .text.w3d_member_8024a518 0x8024a518 : { *(.text.w3d_member_8024a518) }
  .text.w3d_copy12_8024a520 0x8024a520 : { *(.text.w3d_copy12_8024a520) }
  .text.w3d_member_8024a540 0x8024a540 : { *(.text.w3d_member_8024a540) }
  .text.w3d_setf_8024a578 0x8024a578 : { *(.text.w3d_setf_8024a578) }
  .text.w3d_getf_8024a580 0x8024a580 : { *(.text.w3d_getf_8024a580) }
  .text.w3d_setf_8024a588 0x8024a588 : { *(.text.w3d_setf_8024a588) }
  .text.w3d_getf_8024a590 0x8024a590 : { *(.text.w3d_getf_8024a590) }
  .text.w3d_copy12_8024a598 0x8024a598 : { *(.text.w3d_copy12_8024a598) }
  .text.w3d_member_8024a5b8 0x8024a5b8 : { *(.text.w3d_member_8024a5b8) }
  .text.w3d_setf_8024a5c0 0x8024a5c0 : { *(.text.w3d_setf_8024a5c0) }
  .text.w3d_getf_8024a5c8 0x8024a5c8 : { *(.text.w3d_getf_8024a5c8) }
  .text.w3d_setf_8024a5f0 0x8024a5f0 : { *(.text.w3d_setf_8024a5f0) }
  .text.w3d_getf_8024a5f8 0x8024a5f8 : { *(.text.w3d_getf_8024a5f8) }
  .text.w3d_setf_8024a600 0x8024a600 : { *(.text.w3d_setf_8024a600) }
  .text.w3d_getf_8024a608 0x8024a608 : { *(.text.w3d_getf_8024a608) }
  .text.w3d_setf_8024a630 0x8024a630 : { *(.text.w3d_setf_8024a630) }
  .text.w3d_getf_8024a638 0x8024a638 : { *(.text.w3d_getf_8024a638) }
  .text.w3d_setf_8024a640 0x8024a640 : { *(.text.w3d_setf_8024a640) }
  .text.w3d_getf_8024a648 0x8024a648 : { *(.text.w3d_getf_8024a648) }
  .text.w3d_setf_8024a650 0x8024a650 : { *(.text.w3d_setf_8024a650) }
  .text.w3d_getf_8024a658 0x8024a658 : { *(.text.w3d_getf_8024a658) }
  .text.w3d_setf_8024a660 0x8024a660 : { *(.text.w3d_setf_8024a660) }
  .text.w3d_getf_8024a668 0x8024a668 : { *(.text.w3d_getf_8024a668) }
  .text.w3d_setf_8024a670 0x8024a670 : { *(.text.w3d_setf_8024a670) }
  .text.w3d_getf_8024a678 0x8024a678 : { *(.text.w3d_getf_8024a678) }
  .text.w3d_setf_8024a680 0x8024a680 : { *(.text.w3d_setf_8024a680) }
  .text.w3d_getf_8024a688 0x8024a688 : { *(.text.w3d_getf_8024a688) }
  .text.w3d_setf_8024a690 0x8024a690 : { *(.text.w3d_setf_8024a690) }
  .text.w3d_getf_8024a698 0x8024a698 : { *(.text.w3d_getf_8024a698) }
  /DISCARD/ : { *(.text*) *(.rodata*) *(.data*) *(.bss*) *(.sdata*) *(.sbss*) *(.comment) }
}
