/* Generated reference-only placements. All bodies are source-built. */
OUTPUT_FORMAT("elf32-powerpc")
OUTPUT_ARCH(powerpc)
ENTRY(w3d_cc17a_ease_level_8002159c)
_SDA_BASE_ = 0x804b2540;
_SDA2_BASE_ = 0x804c2540;
cast_803426b4 = 0x803426b4;
cast_80342a74 = 0x80342a74;
destroy_80178474 = 0x80178474;
epsilon_8036c040 = 0x8036c040;
factor_8036c03c = 0x8036c03c;
handle_800fc710 = 0x800fc710;
index_800fc6dc = 0x800fc6dc;
integer_80178c48 = 0x80178c48;
value_80178df0 = 0x80178df0;
SECTIONS {
  .text.w3d_cc17a_ease_level_8002159c 0x8002159c : { *(.text.w3d_cc17a_ease_level_8002159c) }
  /DISCARD/ : { *(.text*) *(.rodata*) *(.data*) *(.bss*) *(.sdata*) *(.sbss*) *(.comment) }
}
