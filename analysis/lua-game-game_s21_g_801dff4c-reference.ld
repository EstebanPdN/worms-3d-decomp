/* Generated reference-only placements. All bodies are source-built. */
OUTPUT_FORMAT("elf32-powerpc")
OUTPUT_ARCH(powerpc)
ENTRY(w3d_s21_flush_slots_801dff4c)
_SDA_BASE_ = 0x804b2540;
_SDA2_BASE_ = 0x804c2540;
fn_801e4e6c = 0x801e4e6c;
fn_801e507c = 0x801e507c;
SECTIONS {
  .text.w3d_s21_flush_slots_801dff4c 0x801dff4c : { *(.text.w3d_s21_flush_slots_801dff4c) }
  /DISCARD/ : { *(.text*) *(.rodata*) *(.data*) *(.bss*) *(.sdata*) *(.sbss*) *(.comment) }
}
