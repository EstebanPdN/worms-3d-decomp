/* Generated reference-only placements. All bodies are source-built. */
OUTPUT_FORMAT("elf32-powerpc")
OUTPUT_ARCH(powerpc)
ENTRY(w3d_d19e_reset_named_object_8024dc24)
_SDA_BASE_ = 0x804b2540;
_SDA2_BASE_ = 0x804c2540;
fn_801e8d9c = 0x801e8d9c;
fn_801ed24c = 0x801ed24c;
fn_801f0210 = 0x801f0210;
key_803c511c = 0x803c511c;
key_803c5150 = 0x803c5150;
key_803c5174 = 0x803c5174;
key_803c51a4 = 0x803c51a4;
key_803c51d4 = 0x803c51d4;
key_803c51f8 = 0x803c51f8;
value_803c521c = 0x803c521c;
w3d_empty_string_804b06a0 = 0x804b06a0;
w3d_string_base_finish = 0x8020c5c4;
w3d_string_base_init = 0x8020c5c0;
w3d_string_header = 0x80341884;
w3d_string_release = 0x80341588;
w3d_string_release_header = 0x8020bb2c;
SECTIONS {
  .text.w3d_d19e_reset_named_object_8024dc24 0x8024dc24 : { *(.text.w3d_d19e_reset_named_object_8024dc24) }
  /DISCARD/ : { *(.text*) *(.rodata*) *(.data*) *(.bss*) *(.sdata*) *(.sbss*) *(.comment) }
}
