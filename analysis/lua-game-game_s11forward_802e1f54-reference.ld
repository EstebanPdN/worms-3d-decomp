/* Generated reference-only placements. All bodies are source-built. */
OUTPUT_FORMAT("elf32-powerpc")
OUTPUT_ARCH(powerpc)
ENTRY(w3d_auto_802e1f54)
_SDA_BASE_ = 0x804b2540;
_SDA2_BASE_ = 0x804c2540;
fn_802E1B8C = 0x802e1b8c;
fn_802E1D7C = 0x802e1d7c;
SECTIONS {
  .text.w3d_auto_802e1f54 0x802e1f54 : { *(.text.w3d_auto_802e1f54) }
  /DISCARD/ : { *(.text*) *(.rodata*) *(.data*) *(.bss*) *(.sdata*) *(.sbss*) *(.comment) }
}
