/* Generated reference-only placements. All bodies are source-built. */
OUTPUT_FORMAT("elf32-powerpc")
OUTPUT_ARCH(powerpc)
ENTRY(w3d_cx8c_node_construct_8034baf8)
_SDA_BASE_ = 0x804b2540;
_SDA2_BASE_ = 0x804c2540;
cx8c_node_init_8020fc60 = 0x8020fc60;
cx8c_vtable_80411ad8 = 0x80411ad8;
cx8c_vtable_80419598 = 0x80419598;
SECTIONS {
  .text.w3d_cx8c_node_construct_8034baf8 0x8034baf8 : { *(.text.w3d_cx8c_node_construct_8034baf8) }
  /DISCARD/ : { *(.text*) *(.rodata*) *(.data*) *(.bss*) *(.sdata*) *(.sbss*) *(.comment) }
}
