/* Generated reference-only placements. All bodies are source-built. */
OUTPUT_FORMAT("elf32-powerpc")
OUTPUT_ARCH(powerpc)
ENTRY(k4a_object_apply_vector_800dfe20)
_SDA_BASE_ = 0x804b2540;
_SDA2_BASE_ = 0x804c2540;
FUN_801a3eb0 = 0x801a3eb0;
w3d_auto_800dfdf4 = 0x800dfdf4;
w3d_f32_80389ce8 = 0x80389ce8;
SECTIONS {
  .text.k4a_object_apply_vector_800dfe20 0x800dfe20 : { *(.text.k4a_object_apply_vector_800dfe20) }
  /DISCARD/ : { *(.text*) *(.rodata*) *(.data*) *(.bss*) *(.sdata*) *(.sbss*) *(.comment) }
}
