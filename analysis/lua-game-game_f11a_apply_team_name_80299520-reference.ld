/* Generated reference-only placements. All bodies are source-built. */
OUTPUT_FORMAT("elf32-powerpc")
OUTPUT_ARCH(powerpc)
ENTRY(w3d_f11a_apply_team_name_80299520)
_SDA_BASE_ = 0x804b2540;
_SDA2_BASE_ = 0x804c2540;
fn_800fc1f0 = 0x800fc1f0;
fn_800fc43c = 0x800fc43c;
fn_8020c5c0 = 0x8020c5c0;
fn_8020c5c4 = 0x8020c5c4;
fn_802997fc = 0x802997fc;
fn_80299b48 = 0x80299b48;
fn_80341588 = 0x80341588;
fn_80341884 = 0x80341884;
key_803d0a54 = 0x803d0a54;
key_803d0b88 = 0x803d0b88;
SECTIONS {
  .text.w3d_f11a_apply_team_name_80299520 0x80299520 : { *(.text.w3d_f11a_apply_team_name_80299520) }
  /DISCARD/ : { *(.text*) *(.rodata*) *(.data*) *(.bss*) *(.sdata*) *(.sbss*) *(.comment) }
}
