/* Generated reference-only placements. All bodies are source-built. */
OUTPUT_FORMAT("elf32-powerpc")
OUTPUT_ARCH(powerpc)
ENTRY(w3d_static_init_8000a1d8)
_SDA_BASE_ = 0x804b2540;
_SDA2_BASE_ = 0x804c2540;
w3d_fn_8000a174 = 0x8000a174;
w3d_fn_800122b4 = 0x800122b4;
w3d_fn_80015bac = 0x80015bac;
w3d_fn_80017d8c = 0x80017d8c;
w3d_fn_8001a6d0 = 0x8001a6d0;
w3d_fn_8001c674 = 0x8001c674;
w3d_fn_800202d8 = 0x800202d8;
w3d_fn_800212ec = 0x800212ec;
w3d_fn_80022028 = 0x80022028;
w3d_fn_80022a0c = 0x80022a0c;
w3d_fn_80023144 = 0x80023144;
w3d_fn_80024ae8 = 0x80024ae8;
w3d_fn_80024f94 = 0x80024f94;
w3d_fn_80025610 = 0x80025610;
w3d_fn_80025b38 = 0x80025b38;
w3d_fn_800267fc = 0x800267fc;
w3d_fn_8002740c = 0x8002740c;
w3d_fn_80027fcc = 0x80027fcc;
w3d_fn_80029068 = 0x80029068;
w3d_fn_80029364 = 0x80029364;
w3d_fn_8002a208 = 0x8002a208;
w3d_fn_8002a724 = 0x8002a724;
w3d_fn_8002b124 = 0x8002b124;
w3d_fn_8002b678 = 0x8002b678;
w3d_fn_8002c1dc = 0x8002c1dc;
w3d_fn_8002d698 = 0x8002d698;
w3d_fn_8002dbb8 = 0x8002dbb8;
w3d_fn_8002e6ec = 0x8002e6ec;
w3d_fn_8002f7e8 = 0x8002f7e8;
w3d_fn_80030714 = 0x80030714;
w3d_fn_80035bf8 = 0x80035bf8;
w3d_fn_80037204 = 0x80037204;
w3d_fn_800377c4 = 0x800377c4;
w3d_fn_800386bc = 0x800386bc;
w3d_fn_8003a0e8 = 0x8003a0e8;
w3d_fn_8003a2bc = 0x8003a2bc;
w3d_fn_8003a774 = 0x8003a774;
w3d_fn_8003b7f8 = 0x8003b7f8;
w3d_fn_8003d108 = 0x8003d108;
w3d_fn_8003dc04 = 0x8003dc04;
w3d_fn_8003f028 = 0x8003f028;
w3d_fn_80041b00 = 0x80041b00;
w3d_fn_800481cc = 0x800481cc;
w3d_fn_800494ec = 0x800494ec;
w3d_fn_8004d5ac = 0x8004d5ac;
w3d_fn_8004d800 = 0x8004d800;
w3d_fn_8004d908 = 0x8004d908;
w3d_fn_8004d980 = 0x8004d980;
w3d_fn_8004e690 = 0x8004e690;
w3d_fn_8004edc0 = 0x8004edc0;
w3d_fn_8004ef24 = 0x8004ef24;
w3d_fn_8004f844 = 0x8004f844;
w3d_fn_8005135c = 0x8005135c;
w3d_fn_80051aec = 0x80051aec;
w3d_fn_80052048 = 0x80052048;
w3d_fn_800523e4 = 0x800523e4;
w3d_fn_80061234 = 0x80061234;
w3d_fn_800616a8 = 0x800616a8;
w3d_fn_80061d78 = 0x80061d78;
w3d_fn_80062a44 = 0x80062a44;
w3d_fn_800634d0 = 0x800634d0;
w3d_fn_80064ec0 = 0x80064ec0;
w3d_fn_80066588 = 0x80066588;
w3d_fn_80066904 = 0x80066904;
w3d_fn_80066d20 = 0x80066d20;
w3d_fn_80067894 = 0x80067894;
w3d_fn_80067e84 = 0x80067e84;
w3d_fn_80068330 = 0x80068330;
w3d_fn_800698f0 = 0x800698f0;
w3d_fn_8006f17c = 0x8006f17c;
w3d_fn_8006ff34 = 0x8006ff34;
w3d_fn_80070780 = 0x80070780;
w3d_fn_80072260 = 0x80072260;
w3d_fn_80072ca4 = 0x80072ca4;
w3d_fn_800731a4 = 0x800731a4;
w3d_fn_800789c8 = 0x800789c8;
w3d_fn_8007bacc = 0x8007bacc;
w3d_fn_8007e910 = 0x8007e910;
w3d_fn_8007ea44 = 0x8007ea44;
w3d_fn_8007eacc = 0x8007eacc;
SECTIONS {
  .text.w3d_static_init_8000a1d8 0x8000a1d8 : { *(.text.w3d_static_init_8000a1d8) }
  .text.w3d_static_init_800151fc 0x800151fc : { *(.text.w3d_static_init_800151fc) }
  .text.w3d_static_init_80015c40 0x80015c40 : { *(.text.w3d_static_init_80015c40) }
  .text.w3d_static_init_80017ee0 0x80017ee0 : { *(.text.w3d_static_init_80017ee0) }
  .text.w3d_static_init_8001a72c 0x8001a72c : { *(.text.w3d_static_init_8001a72c) }
  .text.w3d_static_init_8001c6f4 0x8001c6f4 : { *(.text.w3d_static_init_8001c6f4) }
  .text.w3d_static_init_800203f8 0x800203f8 : { *(.text.w3d_static_init_800203f8) }
  .text.w3d_static_init_8002143c 0x8002143c : { *(.text.w3d_static_init_8002143c) }
  .text.w3d_static_init_8002210c 0x8002210c : { *(.text.w3d_static_init_8002210c) }
  .text.w3d_static_init_80022a9c 0x80022a9c : { *(.text.w3d_static_init_80022a9c) }
  .text.w3d_static_init_80023260 0x80023260 : { *(.text.w3d_static_init_80023260) }
  .text.w3d_static_init_80024bb8 0x80024bb8 : { *(.text.w3d_static_init_80024bb8) }
  .text.w3d_static_init_80025014 0x80025014 : { *(.text.w3d_static_init_80025014) }
  .text.w3d_static_init_800256e0 0x800256e0 : { *(.text.w3d_static_init_800256e0) }
  .text.w3d_static_init_80025bb8 0x80025bb8 : { *(.text.w3d_static_init_80025bb8) }
  .text.w3d_static_init_800268ac 0x800268ac : { *(.text.w3d_static_init_800268ac) }
  .text.w3d_static_init_8002750c 0x8002750c : { *(.text.w3d_static_init_8002750c) }
  .text.w3d_static_init_800280fc 0x800280fc : { *(.text.w3d_static_init_800280fc) }
  .text.w3d_static_init_80029108 0x80029108 : { *(.text.w3d_static_init_80029108) }
  .text.w3d_static_init_800293c4 0x800293c4 : { *(.text.w3d_static_init_800293c4) }
  .text.w3d_static_init_8002a298 0x8002a298 : { *(.text.w3d_static_init_8002a298) }
  .text.w3d_static_init_8002a7c4 0x8002a7c4 : { *(.text.w3d_static_init_8002a7c4) }
  .text.w3d_static_init_8002b204 0x8002b204 : { *(.text.w3d_static_init_8002b204) }
  .text.w3d_static_init_8002b6d8 0x8002b6d8 : { *(.text.w3d_static_init_8002b6d8) }
  .text.w3d_static_init_8002c2cc 0x8002c2cc : { *(.text.w3d_static_init_8002c2cc) }
  .text.w3d_static_init_8002d6fc 0x8002d6fc : { *(.text.w3d_static_init_8002d6fc) }
  .text.w3d_static_init_8002dc18 0x8002dc18 : { *(.text.w3d_static_init_8002dc18) }
  .text.w3d_static_init_8002e79c 0x8002e79c : { *(.text.w3d_static_init_8002e79c) }
  .text.w3d_static_init_8002f888 0x8002f888 : { *(.text.w3d_static_init_8002f888) }
  .text.w3d_static_init_80030794 0x80030794 : { *(.text.w3d_static_init_80030794) }
  .text.w3d_static_init_800361cc 0x800361cc : { *(.text.w3d_static_init_800361cc) }
  .text.w3d_static_init_80037284 0x80037284 : { *(.text.w3d_static_init_80037284) }
  .text.w3d_static_init_80037838 0x80037838 : { *(.text.w3d_static_init_80037838) }
  .text.w3d_static_init_8003873c 0x8003873c : { *(.text.w3d_static_init_8003873c) }
  .text.w3d_static_init_8003a238 0x8003a238 : { *(.text.w3d_static_init_8003a238) }
  .text.w3d_static_init_8003a340 0x8003a340 : { *(.text.w3d_static_init_8003a340) }
  .text.w3d_static_init_8003a7d4 0x8003a7d4 : { *(.text.w3d_static_init_8003a7d4) }
  .text.w3d_static_init_8003b8b0 0x8003b8b0 : { *(.text.w3d_static_init_8003b8b0) }
  .text.w3d_static_init_8003d22c 0x8003d22c : { *(.text.w3d_static_init_8003d22c) }
  .text.w3d_static_init_8003dc90 0x8003dc90 : { *(.text.w3d_static_init_8003dc90) }
  .text.w3d_static_init_8003f0f0 0x8003f0f0 : { *(.text.w3d_static_init_8003f0f0) }
  .text.w3d_static_init_80041bd8 0x80041bd8 : { *(.text.w3d_static_init_80041bd8) }
  .text.w3d_static_init_80048460 0x80048460 : { *(.text.w3d_static_init_80048460) }
  .text.w3d_static_init_800495cc 0x800495cc : { *(.text.w3d_static_init_800495cc) }
  .text.w3d_static_init_8004d7d4 0x8004d7d4 : { *(.text.w3d_static_init_8004d7d4) }
  .text.w3d_static_init_8004d844 0x8004d844 : { *(.text.w3d_static_init_8004d844) }
  .text.w3d_static_init_8004d94c 0x8004d94c : { *(.text.w3d_static_init_8004d94c) }
  .text.w3d_static_init_8004d9c4 0x8004d9c4 : { *(.text.w3d_static_init_8004d9c4) }
  .text.w3d_static_init_8004e798 0x8004e798 : { *(.text.w3d_static_init_8004e798) }
  .text.w3d_static_init_8004ee20 0x8004ee20 : { *(.text.w3d_static_init_8004ee20) }
  .text.w3d_static_init_8004ef68 0x8004ef68 : { *(.text.w3d_static_init_8004ef68) }
  .text.w3d_static_init_8004f8a4 0x8004f8a4 : { *(.text.w3d_static_init_8004f8a4) }
  .text.w3d_static_init_800513bc 0x800513bc : { *(.text.w3d_static_init_800513bc) }
  .text.w3d_static_init_80051b4c 0x80051b4c : { *(.text.w3d_static_init_80051b4c) }
  .text.w3d_static_init_800520c8 0x800520c8 : { *(.text.w3d_static_init_800520c8) }
  .text.w3d_static_init_800524a8 0x800524a8 : { *(.text.w3d_static_init_800524a8) }
  .text.w3d_static_init_80061294 0x80061294 : { *(.text.w3d_static_init_80061294) }
  .text.w3d_static_init_80061718 0x80061718 : { *(.text.w3d_static_init_80061718) }
  .text.w3d_static_init_80061e18 0x80061e18 : { *(.text.w3d_static_init_80061e18) }
  .text.w3d_static_init_80062ad4 0x80062ad4 : { *(.text.w3d_static_init_80062ad4) }
  .text.w3d_static_init_80063590 0x80063590 : { *(.text.w3d_static_init_80063590) }
  .text.w3d_static_init_80064f20 0x80064f20 : { *(.text.w3d_static_init_80064f20) }
  .text.w3d_static_init_80066688 0x80066688 : { *(.text.w3d_static_init_80066688) }
  .text.w3d_static_init_80066948 0x80066948 : { *(.text.w3d_static_init_80066948) }
  .text.w3d_static_init_80066d80 0x80066d80 : { *(.text.w3d_static_init_80066d80) }
  .text.w3d_static_init_8006794c 0x8006794c : { *(.text.w3d_static_init_8006794c) }
  .text.w3d_static_init_80067ee8 0x80067ee8 : { *(.text.w3d_static_init_80067ee8) }
  .text.w3d_static_init_800683d0 0x800683d0 : { *(.text.w3d_static_init_800683d0) }
  .text.w3d_static_init_800699e0 0x800699e0 : { *(.text.w3d_static_init_800699e0) }
  .text.w3d_static_init_8006f5b0 0x8006f5b0 : { *(.text.w3d_static_init_8006f5b0) }
  .text.w3d_static_init_8006ff98 0x8006ff98 : { *(.text.w3d_static_init_8006ff98) }
  .text.w3d_static_init_800707f0 0x800707f0 : { *(.text.w3d_static_init_800707f0) }
  .text.w3d_static_init_80072434 0x80072434 : { *(.text.w3d_static_init_80072434) }
  .text.w3d_static_init_80072cf8 0x80072cf8 : { *(.text.w3d_static_init_80072cf8) }
  .text.w3d_static_init_80073264 0x80073264 : { *(.text.w3d_static_init_80073264) }
  .text.w3d_static_init_80078d8c 0x80078d8c : { *(.text.w3d_static_init_80078d8c) }
  .text.w3d_static_init_8007bb28 0x8007bb28 : { *(.text.w3d_static_init_8007bb28) }
  .text.w3d_static_init_8007e96c 0x8007e96c : { *(.text.w3d_static_init_8007e96c) }
  .text.w3d_static_init_8007eaa0 0x8007eaa0 : { *(.text.w3d_static_init_8007eaa0) }
  .text.w3d_static_init_8007eb28 0x8007eb28 : { *(.text.w3d_static_init_8007eb28) }
  /DISCARD/ : { *(.text*) *(.rodata*) *(.data*) *(.bss*) *(.sdata*) *(.sbss*) *(.comment) }
}
