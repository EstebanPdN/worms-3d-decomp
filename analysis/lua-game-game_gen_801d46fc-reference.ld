/* Generated reference-only placements. All bodies are source-built. */
OUTPUT_FORMAT("elf32-powerpc")
OUTPUT_ARCH(powerpc)
ENTRY(w3d_registry_release_801d46fc)
_SDA_BASE_ = 0x804b2540;
_SDA2_BASE_ = 0x804c2540;
w3d_fn_801d464c = 0x801d464c;
w3d_fn_801d4804 = 0x801d4804;
w3d_fn_801d5058 = 0x801d5058;
w3d_fn_801d50a4 = 0x801d50a4;
w3d_fn_801d544c = 0x801d544c;
w3d_fn_801d54a4 = 0x801d54a4;
w3d_fn_801d5dc0 = 0x801d5dc0;
w3d_fn_801d5e1c = 0x801d5e1c;
w3d_fn_801d9a74 = 0x801d9a74;
w3d_fn_801d9acc = 0x801d9acc;
w3d_fn_801db144 = 0x801db144;
w3d_fn_801db2a4 = 0x801db2a4;
w3d_fn_801dddf8 = 0x801dddf8;
w3d_fn_801dde90 = 0x801dde90;
w3d_fn_801de81c = 0x801de81c;
w3d_fn_801de8d4 = 0x801de8d4;
w3d_global_8036545c = 0x8036545c;
w3d_global_803654a8 = 0x803654a8;
w3d_global_803654f4 = 0x803654f4;
w3d_global_80365540 = 0x80365540;
w3d_global_8036558c = 0x8036558c;
w3d_global_803655bc = 0x803655bc;
w3d_global_803655ec = 0x803655ec;
w3d_global_8036561c = 0x8036561c;
w3d_global_803af134 = 0x803af134;
w3d_global_803af1f0 = 0x803af1f0;
w3d_global_803af310 = 0x803af310;
w3d_global_803af84c = 0x803af84c;
w3d_global_803afe14 = 0x803afe14;
w3d_global_803b0284 = 0x803b0284;
w3d_global_803b02e4 = 0x803b02e4;
w3d_global_803b0310 = 0x803b0310;
w3d_heap_allocate_entry_a = 0x801fe1d8;
w3d_owner_list_remove = 0x8020fd2c;
w3d_registry_list_8036545c = 0x8036545c;
w3d_registry_list_803654a8 = 0x803654a8;
w3d_registry_list_803654f4 = 0x803654f4;
w3d_registry_list_80365540 = 0x80365540;
w3d_registry_list_8036558c = 0x8036558c;
w3d_registry_list_803655bc = 0x803655bc;
w3d_registry_list_8036561c = 0x8036561c;
w3d_state_register = 0x8020fd04;
SECTIONS {
  .text.w3d_registry_release_801d46fc 0x801d46fc : { *(.text.w3d_registry_release_801d46fc) }
  .text.w3d_registry_retain_801d4758 0x801d4758 : { *(.text.w3d_registry_retain_801d4758) }
  .text.w3d_address_801d4e80 0x801d4e80 : { *(.text.w3d_address_801d4e80) }
  .text.w3d_registry_unlink_801d4e8c 0x801d4e8c : { *(.text.w3d_registry_unlink_801d4e8c) }
  .text.w3d_registry_create_801d4ed0 0x801d4ed0 : { *(.text.w3d_registry_create_801d4ed0) }
  .text.w3d_get_801d4f88 0x801d4f88 : { *(.text.w3d_get_801d4f88) }
  .text.w3d_address_801d4f90 0x801d4f90 : { *(.text.w3d_address_801d4f90) }
  .text.w3d_registry_release_801d4f9c 0x801d4f9c : { *(.text.w3d_registry_release_801d4f9c) }
  .text.w3d_registry_retain_801d4ff8 0x801d4ff8 : { *(.text.w3d_registry_retain_801d4ff8) }
  .text.w3d_constant_801d51c0 0x801d51c0 : { *(.text.w3d_constant_801d51c0) }
  .text.w3d_constant_801d51c8 0x801d51c8 : { *(.text.w3d_constant_801d51c8) }
  .text.w3d_address_801d5274 0x801d5274 : { *(.text.w3d_address_801d5274) }
  .text.w3d_registry_unlink_801d5280 0x801d5280 : { *(.text.w3d_registry_unlink_801d5280) }
  .text.w3d_registry_create_801d52c4 0x801d52c4 : { *(.text.w3d_registry_create_801d52c4) }
  .text.w3d_get_801d537c 0x801d537c : { *(.text.w3d_get_801d537c) }
  .text.w3d_address_801d5384 0x801d5384 : { *(.text.w3d_address_801d5384) }
  .text.w3d_registry_release_801d5390 0x801d5390 : { *(.text.w3d_registry_release_801d5390) }
  .text.w3d_registry_retain_801d53ec 0x801d53ec : { *(.text.w3d_registry_retain_801d53ec) }
  .text.w3d_constant_801d55e8 0x801d55e8 : { *(.text.w3d_constant_801d55e8) }
  .text.w3d_constant_801d55f0 0x801d55f0 : { *(.text.w3d_constant_801d55f0) }
  .text.w3d_get_801d5660 0x801d5660 : { *(.text.w3d_get_801d5660) }
  .text.w3d_get_801d5674 0x801d5674 : { *(.text.w3d_get_801d5674) }
  .text.w3d_address_801d5be8 0x801d5be8 : { *(.text.w3d_address_801d5be8) }
  .text.w3d_registry_unlink_801d5bf4 0x801d5bf4 : { *(.text.w3d_registry_unlink_801d5bf4) }
  .text.w3d_registry_create_801d5c38 0x801d5c38 : { *(.text.w3d_registry_create_801d5c38) }
  .text.w3d_get_801d5cf0 0x801d5cf0 : { *(.text.w3d_get_801d5cf0) }
  .text.w3d_address_801d5cf8 0x801d5cf8 : { *(.text.w3d_address_801d5cf8) }
  .text.w3d_registry_release_801d5d04 0x801d5d04 : { *(.text.w3d_registry_release_801d5d04) }
  .text.w3d_registry_retain_801d5d60 0x801d5d60 : { *(.text.w3d_registry_retain_801d5d60) }
  .text.w3d_constant_801d5f78 0x801d5f78 : { *(.text.w3d_constant_801d5f78) }
  .text.w3d_get_801d5fe8 0x801d5fe8 : { *(.text.w3d_get_801d5fe8) }
  .text.w3d_get_801d5ff0 0x801d5ff0 : { *(.text.w3d_get_801d5ff0) }
  .text.w3d_get_801d5ff8 0x801d5ff8 : { *(.text.w3d_get_801d5ff8) }
  .text.w3d_constant_801d6548 0x801d6548 : { *(.text.w3d_constant_801d6548) }
  .text.w3d_constant_801d65e0 0x801d65e0 : { *(.text.w3d_constant_801d65e0) }
  .text.w3d_address_801d989c 0x801d989c : { *(.text.w3d_address_801d989c) }
  .text.w3d_registry_unlink_801d98a8 0x801d98a8 : { *(.text.w3d_registry_unlink_801d98a8) }
  .text.w3d_registry_create_801d98ec 0x801d98ec : { *(.text.w3d_registry_create_801d98ec) }
  .text.w3d_get_801d99a4 0x801d99a4 : { *(.text.w3d_get_801d99a4) }
  .text.w3d_address_801d99ac 0x801d99ac : { *(.text.w3d_address_801d99ac) }
  .text.w3d_registry_release_801d99b8 0x801d99b8 : { *(.text.w3d_registry_release_801d99b8) }
  .text.w3d_registry_retain_801d9a14 0x801d9a14 : { *(.text.w3d_registry_retain_801d9a14) }
  .text.w3d_constant_801d9c10 0x801d9c10 : { *(.text.w3d_constant_801d9c10) }
  .text.w3d_constant_801d9c18 0x801d9c18 : { *(.text.w3d_constant_801d9c18) }
  .text.w3d_get_801d9c88 0x801d9c88 : { *(.text.w3d_get_801d9c88) }
  .text.w3d_get_801d9c9c 0x801d9c9c : { *(.text.w3d_get_801d9c9c) }
  .text.w3d_address_801dadc0 0x801dadc0 : { *(.text.w3d_address_801dadc0) }
  .text.w3d_registry_unlink_801dadcc 0x801dadcc : { *(.text.w3d_registry_unlink_801dadcc) }
  .text.w3d_registry_create_801dae10 0x801dae10 : { *(.text.w3d_registry_create_801dae10) }
  .text.w3d_address_801dae70 0x801dae70 : { *(.text.w3d_address_801dae70) }
  .text.w3d_registry_release_801dae7c 0x801dae7c : { *(.text.w3d_registry_release_801dae7c) }
  .text.w3d_registry_retain_801daed8 0x801daed8 : { *(.text.w3d_registry_retain_801daed8) }
  .text.w3d_constant_801dbad4 0x801dbad4 : { *(.text.w3d_constant_801dbad4) }
  .text.w3d_address_801ddc80 0x801ddc80 : { *(.text.w3d_address_801ddc80) }
  .text.w3d_registry_unlink_801ddc8c 0x801ddc8c : { *(.text.w3d_registry_unlink_801ddc8c) }
  .text.w3d_registry_create_801ddcd0 0x801ddcd0 : { *(.text.w3d_registry_create_801ddcd0) }
  .text.w3d_address_801ddd30 0x801ddd30 : { *(.text.w3d_address_801ddd30) }
  .text.w3d_registry_release_801ddd3c 0x801ddd3c : { *(.text.w3d_registry_release_801ddd3c) }
  .text.w3d_registry_retain_801ddd98 0x801ddd98 : { *(.text.w3d_registry_retain_801ddd98) }
  .text.w3d_get_801de134 0x801de134 : { *(.text.w3d_get_801de134) }
  .text.w3d_address_801de4b4 0x801de4b4 : { *(.text.w3d_address_801de4b4) }
  .text.w3d_address_801de4c0 0x801de4c0 : { *(.text.w3d_address_801de4c0) }
  .text.w3d_constant_801de4cc 0x801de4cc : { *(.text.w3d_constant_801de4cc) }
  .text.w3d_constant_801de4d4 0x801de4d4 : { *(.text.w3d_constant_801de4d4) }
  .text.w3d_constant_801de5ac 0x801de5ac : { *(.text.w3d_constant_801de5ac) }
  .text.w3d_constant_801de5b4 0x801de5b4 : { *(.text.w3d_constant_801de5b4) }
  .text.w3d_constant_801de5bc 0x801de5bc : { *(.text.w3d_constant_801de5bc) }
  .text.w3d_constant_801de5c4 0x801de5c4 : { *(.text.w3d_constant_801de5c4) }
  .text.w3d_constant_801de5cc 0x801de5cc : { *(.text.w3d_constant_801de5cc) }
  .text.w3d_constant_801de5d4 0x801de5d4 : { *(.text.w3d_constant_801de5d4) }
  .text.w3d_constant_801de5dc 0x801de5dc : { *(.text.w3d_constant_801de5dc) }
  .text.w3d_constant_801de5e4 0x801de5e4 : { *(.text.w3d_constant_801de5e4) }
  .text.w3d_constant_801de5ec 0x801de5ec : { *(.text.w3d_constant_801de5ec) }
  .text.w3d_constant_801de5f4 0x801de5f4 : { *(.text.w3d_constant_801de5f4) }
  .text.w3d_address_801de6a4 0x801de6a4 : { *(.text.w3d_address_801de6a4) }
  .text.w3d_registry_unlink_801de6b0 0x801de6b0 : { *(.text.w3d_registry_unlink_801de6b0) }
  .text.w3d_registry_create_801de6f4 0x801de6f4 : { *(.text.w3d_registry_create_801de6f4) }
  .text.w3d_address_801de754 0x801de754 : { *(.text.w3d_address_801de754) }
  .text.w3d_registry_release_801de760 0x801de760 : { *(.text.w3d_registry_release_801de760) }
  .text.w3d_registry_retain_801de7bc 0x801de7bc : { *(.text.w3d_registry_retain_801de7bc) }
  /DISCARD/ : { *(.text*) *(.rodata*) *(.data*) *(.bss*) *(.sdata*) *(.sbss*) *(.comment) }
}
