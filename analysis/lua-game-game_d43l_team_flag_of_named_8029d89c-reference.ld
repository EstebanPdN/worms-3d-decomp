/* Generated reference-only placements. All bodies are source-built. */
OUTPUT_FORMAT("elf32-powerpc")
OUTPUT_ARCH(powerpc)
ENTRY(d43l_team_flag_of_named_8029d89c)
_SDA_BASE_ = 0x804b2540;
_SDA2_BASE_ = 0x804c2540;
__4Name = 0x803426b8;
fn_800fc1b0 = 0x800fc1b0;
fn_800fc2b0 = 0x800fc2b0;
fn_801797b4 = 0x801797b4;
fn_8020bd38 = 0x8020bd38;
fn_8020c5c4 = 0x8020c5c4;
fn_80341584 = 0x80341584;
fn_80341588 = 0x80341588;
s_803d097c = 0x803d097c;
s_803d09ec = 0x803d09ec;
strcmp = 0x802ef234;
SECTIONS {
  .text.d43l_team_flag_of_named_8029d89c 0x8029d89c : { *(.text.d43l_team_flag_of_named_8029d89c) }
  /DISCARD/ : { *(.text*) *(.rodata*) *(.data*) *(.bss*) *(.sdata*) *(.sbss*) *(.comment) }
}
