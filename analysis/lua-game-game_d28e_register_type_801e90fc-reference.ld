/* Generated reference-only placements. All bodies are source-built. */
OUTPUT_FORMAT("elf32-powerpc")
OUTPUT_ARCH(powerpc)
ENTRY(w3d_d28e_register_type_801e90fc)
_SDA_BASE_ = 0x804b2540;
_SDA2_BASE_ = 0x804c2540;
alloc_80212fd4 = 0x80212fd4;
fn_801e925c = 0x801e925c;
free_802134fc = 0x802134fc;
lbl_8045e080 = 0x8045e080;
memcpy_802eee50 = 0x802eee50;
w3d_find_80356884 = 0x80356884;
SECTIONS {
  .text.w3d_d28e_register_type_801e90fc 0x801e90fc : { *(.text.w3d_d28e_register_type_801e90fc) }
  /DISCARD/ : { *(.text*) *(.rodata*) *(.data*) *(.bss*) *(.sdata*) *(.sbss*) *(.comment) }
}
