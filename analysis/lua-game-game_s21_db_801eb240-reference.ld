/* Generated reference-only placements. All bodies are source-built. */
OUTPUT_FORMAT("elf32-powerpc")
OUTPUT_ARCH(powerpc)
ENTRY(w3d_s21_apply_unless_two_801eb240)
_SDA_BASE_ = 0x804b2540;
_SDA2_BASE_ = 0x804c2540;
fn_801fff94 = 0x801fff94;
SECTIONS {
  .text.w3d_s21_apply_unless_two_801eb240 0x801eb240 : { *(.text.w3d_s21_apply_unless_two_801eb240) }
  /DISCARD/ : { *(.text*) *(.rodata*) *(.data*) *(.bss*) *(.sdata*) *(.sbss*) *(.comment) }
}
