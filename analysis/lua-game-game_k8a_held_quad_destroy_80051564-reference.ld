/* Generated reference-only placements. All bodies are source-built. */
OUTPUT_FORMAT("elf32-powerpc")
OUTPUT_ARCH(powerpc)
ENTRY(w3d_k8a_held_quad_destroy_80051564)
_SDA_BASE_ = 0x804b2540;
_SDA2_BASE_ = 0x804c2540;
w3d_base_destroy_8015ff2c = 0x8015ff2c;
w3d_vtable_8040eb20 = 0x8040eb20;
SECTIONS {
  .text.w3d_k8a_held_quad_destroy_80051564 0x80051564 : { *(.text.w3d_k8a_held_quad_destroy_80051564) }
  /DISCARD/ : { *(.text*) *(.rodata*) *(.data*) *(.bss*) *(.sdata*) *(.sbss*) *(.comment) }
}
