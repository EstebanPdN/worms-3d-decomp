/* Generated reference-only placements. All bodies are source-built. */
OUTPUT_FORMAT("elf32-powerpc")
OUTPUT_ARCH(powerpc)
ENTRY(w3d_d32k_list_box_layout_8026ed00)
_SDA_BASE_ = 0x804b2540;
_SDA2_BASE_ = 0x804c2540;
__12Str_803426b8 = 0x803426b8;
__12Str_803426b8PCc = 0x8020bb54;
fn_8015adf4 = 0x8015adf4;
fn_80173f88 = 0x80173f88;
fn_80178df0 = 0x80178df0;
fn_801fe1d8 = 0x801fe1d8;
fn_8020bd38 = 0x8020bd38;
fn_8020c5c0 = 0x8020c5c0;
fn_8020c5c4 = 0x8020c5c4;
fn_8025dffc = 0x8025dffc;
fn_8025e128 = 0x8025e128;
fn_8025ee60 = 0x8025ee60;
fn_8025ee94 = 0x8025ee94;
fn_8025f064 = 0x8025f064;
fn_80263608__FG12Str_803426b8i = 0x80263608;
fn_80263bb8 = 0x80263bb8;
fn_80263c24 = 0x80263c24;
fn_80263c90 = 0x80263c90;
fn_8027014c = 0x8027014c;
fn_8027035c = 0x8027035c;
fn_80293460 = 0x80293460;
fn_8029358c = 0x8029358c;
fn_80294398 = 0x80294398;
fn_802943cc = 0x802943cc;
fn_8029459c = 0x8029459c;
fn_80341588 = 0x80341588;
fn_80341884 = 0x80341884;
fn_8034357c = 0x8034357c;
lbl_803cbe94 = 0x803cbe94;
lbl_803cbea8 = 0x803cbea8;
lbl_803cbebc = 0x803cbebc;
lbl_803cbecc = 0x803cbecc;
lbl_803cbee4 = 0x803cbee4;
lbl_8045e788 = 0x8045e788;
SECTIONS {
  .text.w3d_d32k_list_box_layout_8026ed00 0x8026ed00 : { *(.text.w3d_d32k_list_box_layout_8026ed00) }
  .rodata 0x803cbef8 : { *(.rodata) }
  /DISCARD/ : { *(.text*) *(.rodata*) *(.data*) *(.bss*) *(.sdata*) *(.sbss*) *(.comment) }
}
