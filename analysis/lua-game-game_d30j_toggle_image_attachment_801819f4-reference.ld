/* Generated reference-only placements. All bodies are source-built. */
OUTPUT_FORMAT("elf32-powerpc")
OUTPUT_ARCH(powerpc)
ENTRY(d30j_toggle_image_attachment_801819f4)
_SDA_BASE_ = 0x804b2540;
_SDA2_BASE_ = 0x804c2540;
fn_801ef380 = 0x801ef380;
lbl_80362844 = 0x80362844;
lbl_8040e0d8 = 0x8040e0d8;
lbl_80414518 = 0x80414518;
w3d_empty_80341348 = 0x80341348;
w3d_k5b_iface_array_field_append_801ef174 = 0x801ef174;
w3d_s10_service_forward_8020b680 = 0x8020b680;
SECTIONS {
  .text.d30j_toggle_image_attachment_801819f4 0x801819f4 : { *(.text.d30j_toggle_image_attachment_801819f4) }
  /DISCARD/ : { *(.text*) *(.rodata*) *(.data*) *(.bss*) *(.sdata*) *(.sbss*) *(.comment) }
}
