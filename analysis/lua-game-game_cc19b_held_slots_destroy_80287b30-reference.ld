/* Generated reference-only placements. All bodies are source-built. */
OUTPUT_FORMAT("elf32-powerpc")
OUTPUT_ARCH(powerpc)
ENTRY(w3d_cc19b_held_slots_destroy_80287b30)
_SDA_BASE_ = 0x804b2540;
_SDA2_BASE_ = 0x804c2540;
w3d_base_destroy_8015ff2c = 0x8015ff2c;
w3d_vtable_8041c010 = 0x8041c010;
SECTIONS {
  .text.w3d_cc19b_held_slots_destroy_80287b30 0x80287b30 : { *(.text.w3d_cc19b_held_slots_destroy_80287b30) }
  /DISCARD/ : { *(.text*) *(.rodata*) *(.data*) *(.bss*) *(.sdata*) *(.sbss*) *(.comment) }
}
