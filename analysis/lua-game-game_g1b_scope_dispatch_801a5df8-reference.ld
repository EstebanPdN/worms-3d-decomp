/* Generated reference-only placements. All bodies are source-built. */
OUTPUT_FORMAT("elf32-powerpc")
OUTPUT_ARCH(powerpc)
ENTRY(g1b_scope_dispatch_801a5df8)
_SDA_BASE_ = 0x804b2540;
_SDA2_BASE_ = 0x804c2540;
fn_801a572c = 0x801a572c;
value_8045e62c = 0x8045e62c;
SECTIONS {
  .text.g1b_scope_dispatch_801a5df8 0x801a5df8 : { *(.text.g1b_scope_dispatch_801a5df8) }
  /DISCARD/ : { *(.text*) *(.rodata*) *(.data*) *(.bss*) *(.sdata*) *(.sbss*) *(.comment) }
}
