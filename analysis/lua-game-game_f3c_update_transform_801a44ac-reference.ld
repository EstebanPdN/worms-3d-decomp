/* Generated reference-only placements. All bodies are source-built. */
OUTPUT_FORMAT("elf32-powerpc")
OUTPUT_ARCH(powerpc)
ENTRY(f3c_update_transform_801a44ac)
_SDA_BASE_ = 0x804b2540;
_SDA2_BASE_ = 0x804c2540;
fn_801a3eb0 = 0x801a3eb0;
fn_801f606c = 0x801f606c;
fn_801f6448 = 0x801f6448;
lbl_80363938 = 0x80363938;
SECTIONS {
  .text.f3c_update_transform_801a44ac 0x801a44ac : { *(.text.f3c_update_transform_801a44ac) }
  /DISCARD/ : { *(.text*) *(.rodata*) *(.data*) *(.bss*) *(.sdata*) *(.sbss*) *(.comment) }
}
