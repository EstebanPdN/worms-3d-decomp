/* Generated reference-only placements. All bodies are source-built. */
OUTPUT_FORMAT("elf32-powerpc")
OUTPUT_ARCH(powerpc)
ENTRY(d27l_keyboard_set_mode_802c38cc)
_SDA_BASE_ = 0x804b2540;
_SDA2_BASE_ = 0x804c2540;
__3StrPCc = 0x8020bb54;
empty_803d86a4 = 0x803d86a4;
fn_800fc2b0 = 0x800fc2b0;
fn_8018b360 = 0x8018b360;
fn_8020bb2c = 0x8020bb2c;
fn_8020c5c4 = 0x8020c5c4;
fn_802c6924 = 0x802c6924;
fn_802c7a0c = 0x802c7a0c;
fn_802c8174 = 0x802c8174;
fn_80341588 = 0x80341588;
lower_803d8678 = 0x803d8678;
number_803d8684 = 0x803d8684;
s_803d860c = 0x803d860c;
strchr = 0x802ef198;
symbol_803d868c = 0x803d868c;
symbol_803d8698 = 0x803d8698;
upper_803d866c = 0x803d866c;
SECTIONS {
  .text.d27l_keyboard_set_mode_802c38cc 0x802c38cc : { *(.text.d27l_keyboard_set_mode_802c38cc) }
  /DISCARD/ : { *(.text*) *(.rodata*) *(.data*) *(.bss*) *(.sdata*) *(.sbss*) *(.comment) }
}
