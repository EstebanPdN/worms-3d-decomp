/* Generated reference-only placements. All bodies are source-built. */
OUTPUT_FORMAT("elf32-powerpc")
OUTPUT_ARCH(powerpc)
ENTRY(d27f_load_team_store_80297b8c)
_SDA_BASE_ = 0x804b2540;
_SDA2_BASE_ = 0x804c2540;
_._19Descriptor_80178474 = 0x80178474;
__15String_803426b8 = 0x803426b8;
__15String_803426b8PCc = 0x8020bb54;
lbl_803d0940 = 0x803d0940;
lbl_803d0a0c = 0x803d0a0c;
lbl_803d0a20 = 0x803d0a20;
lbl_803d0a2c = 0x803d0a2c;
lbl_803d0a3c = 0x803d0a3c;
lbl_803d0a48 = 0x803d0a48;
lbl_803d0a54 = 0x803d0a54;
lbl_803d0a60 = 0x803d0a60;
lbl_803d0a6c = 0x803d0a6c;
strchr = 0x802ef198;
w3d_auto_800fc230 = 0x800fc230;
w3d_auto_800fc2b0 = 0x800fc2b0;
w3d_auto_80179598 = 0x80179598;
w3d_constructor_lookup_name = 0x800fc1b0;
w3d_empty_80341584 = 0x80341584;
w3d_k5b_array_ref_lock_801ef048 = 0x801ef048;
w3d_string_assign = 0x8020bd38;
w3d_string_base_finish = 0x8020c5c4;
w3d_string_format = 0x8020c510;
w3d_string_release = 0x80341588;
w3d_string_release_header = 0x8020bb2c;
SECTIONS {
  .text.d27f_load_team_store_80297b8c 0x80297b8c : { *(.text.d27f_load_team_store_80297b8c) }
  /DISCARD/ : { *(.text*) *(.rodata*) *(.data*) *(.bss*) *(.sdata*) *(.sbss*) *(.comment) }
}
