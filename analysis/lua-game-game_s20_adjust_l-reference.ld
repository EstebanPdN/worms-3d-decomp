/* Generated reference-only placements. All bodies are source-built. */
OUTPUT_FORMAT("elf32-powerpc")
OUTPUT_ARCH(powerpc)
ENTRY(w3d_s20_dispatch_with_guard_801aace0)
_SDA_BASE_ = 0x804b2540;
_SDA2_BASE_ = 0x804c2540;
fn_801a9b10 = 0x801a9b10;
fn_801a9c9c = 0x801a9c9c;
SECTIONS {
  .text.w3d_s20_dispatch_with_guard_801aace0 0x801aace0 : { *(.text.w3d_s20_dispatch_with_guard_801aace0) }
  /DISCARD/ : { *(.text*) *(.rodata*) *(.data*) *(.bss*) *(.sdata*) *(.sbss*) *(.comment) }
}
