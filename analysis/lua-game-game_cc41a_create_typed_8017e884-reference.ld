/* Generated reference-only placements. All bodies are source-built. */
OUTPUT_FORMAT("elf32-powerpc")
OUTPUT_ARCH(powerpc)
ENTRY(cc41a_create_typed_8017e884)
_SDA_BASE_ = 0x804b2540;
_SDA2_BASE_ = 0x804c2540;
cc41a_resultType_80363f64 = 0x80363f64;
SECTIONS {
  .text.cc41a_create_typed_8017e884 0x8017e884 : { *(.text.cc41a_create_typed_8017e884) }
  /DISCARD/ : { *(.text*) *(.rodata*) *(.data*) *(.bss*) *(.sdata*) *(.sbss*) *(.comment) }
}
