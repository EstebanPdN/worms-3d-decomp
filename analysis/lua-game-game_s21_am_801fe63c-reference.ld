/* Generated reference-only placements. All bodies are source-built. */
OUTPUT_FORMAT("elf32-powerpc")
OUTPUT_ARCH(powerpc)
ENTRY(w3d_s21_bool_to_text_801fe63c)
_SDA_BASE_ = 0x804b2540;
_SDA2_BASE_ = 0x804c2540;
fn_8020bd38 = 0x8020bd38;
lbl_803b298c = 0x803b298c;
lbl_803b2994 = 0x803b2994;
SECTIONS {
  .text.w3d_s21_bool_to_text_801fe63c 0x801fe63c : { *(.text.w3d_s21_bool_to_text_801fe63c) }
  /DISCARD/ : { *(.text*) *(.rodata*) *(.data*) *(.bss*) *(.sdata*) *(.sbss*) *(.comment) }
}
