/* Generated reference-only placements. All bodies are source-built. */
OUTPUT_FORMAT("elf32-powerpc")
OUTPUT_ARCH(powerpc)
ENTRY(w3d_d24e_register_colour_properties_801cb6a4)
_SDA_BASE_ = 0x804b2540;
_SDA2_BASE_ = 0x804c2540;
fn_801e8d9c = 0x801e8d9c;
fn_801ec52c = 0x801ec52c;
fn_801ece2c = 0x801ece2c;
fn_801f0b70 = 0x801f0b70;
lbl_803add84 = 0x803add84;
lbl_803addb0 = 0x803addb0;
lbl_803adde0 = 0x803adde0;
lbl_803ade10 = 0x803ade10;
lbl_803ade44 = 0x803ade44;
lbl_803ade7c = 0x803ade7c;
lbl_803adeb4 = 0x803adeb4;
lbl_803adeec = 0x803adeec;
lbl_803adf1c = 0x803adf1c;
lbl_803adf44 = 0x803adf44;
lbl_803adf48 = 0x803adf48;
lbl_803adf4c = 0x803adf4c;
lbl_803adf50 = 0x803adf50;
SECTIONS {
  .text.w3d_d24e_register_colour_properties_801cb6a4 0x801cb6a4 : { *(.text.w3d_d24e_register_colour_properties_801cb6a4) }
  /DISCARD/ : { *(.text*) *(.rodata*) *(.data*) *(.bss*) *(.sdata*) *(.sbss*) *(.comment) }
}
