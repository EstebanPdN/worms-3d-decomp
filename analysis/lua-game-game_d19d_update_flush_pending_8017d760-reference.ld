/* Generated reference-only placements. All bodies are source-built. */
OUTPUT_FORMAT("elf32-powerpc")
OUTPUT_ARCH(powerpc)
ENTRY(d19d_update_flush_pending_8017d760)
_SDA_BASE_ = 0x804b2540;
_SDA2_BASE_ = 0x804c2540;
fn_8017e49c = 0x8017e49c;
fn_8019831c = 0x8019831c;
fn_803439d8 = 0x803439d8;
SECTIONS {
  .text.d19d_update_flush_pending_8017d760 0x8017d760 : { *(.text.d19d_update_flush_pending_8017d760) }
  /DISCARD/ : { *(.text*) *(.rodata*) *(.data*) *(.bss*) *(.sdata*) *(.sbss*) *(.comment) }
}
