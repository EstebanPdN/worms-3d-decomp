/* Generated reference-only placements. All bodies are source-built. */
OUTPUT_FORMAT("elf32-powerpc")
OUTPUT_ARCH(powerpc)
ENTRY(w3d_k4b_channel_pair_construct_801a7274)
_SDA_BASE_ = 0x804b2540;
_SDA2_BASE_ = 0x804c2540;
fn_801e81c8 = 0x801e81c8;
fn_803534b0 = 0x803534b0;
lbl_80413bf8 = 0x80413bf8;
lbl_80413c38 = 0x80413c38;
SECTIONS {
  .text.w3d_k4b_channel_pair_construct_801a7274 0x801a7274 : { *(.text.w3d_k4b_channel_pair_construct_801a7274) }
  /DISCARD/ : { *(.text*) *(.rodata*) *(.data*) *(.bss*) *(.sdata*) *(.sbss*) *(.comment) }
}
