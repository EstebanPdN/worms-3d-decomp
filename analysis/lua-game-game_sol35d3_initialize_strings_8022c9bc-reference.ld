/* Generated reference-only placements. All bodies are source-built. */
OUTPUT_FORMAT("elf32-powerpc")
OUTPUT_ARCH(powerpc)
ENTRY(w3d_sol35d3_initialize_strings_8022c9bc)
_SDA_BASE_ = 0x804b2540;
_SDA2_BASE_ = 0x804c2540;
fn_801e8d9c = 0x801e8d9c;
fn_801eb674 = 0x801eb674;
fn_801ed24c = 0x801ed24c;
fn_8020bb2c = 0x8020bb2c;
fn_8020c5c0 = 0x8020c5c0;
fn_8020c5c4 = 0x8020c5c4;
fn_80341588 = 0x80341588;
fn_80341884 = 0x80341884;
lbl_803ba668 = 0x803ba668;
lbl_803ba698 = 0x803ba698;
lbl_803ba6bc = 0x803ba6bc;
lbl_803ba6f0 = 0x803ba6f0;
lbl_804b06a0 = 0x804b06a0;
SECTIONS {
  .text.w3d_sol35d3_initialize_strings_8022c9bc 0x8022c9bc : { *(.text.w3d_sol35d3_initialize_strings_8022c9bc) }
  /DISCARD/ : { *(.text*) *(.rodata*) *(.data*) *(.bss*) *(.sdata*) *(.sbss*) *(.comment) }
}
