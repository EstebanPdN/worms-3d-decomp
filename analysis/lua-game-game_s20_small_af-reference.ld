/* Generated reference-only placements. All bodies are source-built. */
OUTPUT_FORMAT("elf32-powerpc")
OUTPUT_ARCH(powerpc)
ENTRY(w3d_s20_describe_fields_80190538)
_SDA_BASE_ = 0x804b2540;
_SDA2_BASE_ = 0x804c2540;
lbl_803a8200 = 0x803a8200;
lbl_803a820c = 0x803a820c;
SECTIONS {
  .text.w3d_s20_describe_fields_80190538 0x80190538 : { *(.text.w3d_s20_describe_fields_80190538) }
  /DISCARD/ : { *(.text*) *(.rodata*) *(.data*) *(.bss*) *(.sdata*) *(.sbss*) *(.comment) }
}
