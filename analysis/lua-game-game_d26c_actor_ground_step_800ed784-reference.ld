/* Generated reference-only placements. All bodies are source-built. */
OUTPUT_FORMAT("elf32-powerpc")
OUTPUT_ARCH(powerpc)
ENTRY(d26c_actor_ground_step_800ed784)
_SDA_BASE_ = 0x804b2540;
_SDA2_BASE_ = 0x804c2540;
fall_800eaf14 = 0x800eaf14;
find_800ea748 = 0x800ea748;
SECTIONS {
  .text.d26c_actor_ground_step_800ed784 0x800ed784 : { *(.text.d26c_actor_ground_step_800ed784) }
  /DISCARD/ : { *(.text*) *(.rodata*) *(.data*) *(.bss*) *(.sdata*) *(.sbss*) *(.comment) }
}
