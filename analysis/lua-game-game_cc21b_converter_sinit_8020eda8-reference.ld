/* Generated reference-only placements. All bodies are source-built. */
OUTPUT_FORMAT("elf32-powerpc")
OUTPUT_ARCH(powerpc)
ENTRY(w3d_cc21b_converter_sinit_8020eda8)
_SDA_BASE_ = 0x804b2540;
_SDA2_BASE_ = 0x804c2540;
cc21b_descriptor_80463360 = 0x80463360;
cc21b_descriptor_ctor_8020fbd0 = 0x8020fbd0;
cc21b_factory_8020de48 = 0x8020de48;
cc21b_forward_8020ea2c = 0x8020ea2c;
cc21b_insert_80200af8 = 0x80200af8;
cc21b_name_803b32f8 = 0x803b32f8;
cc21b_name_803ea280 = 0x803ea280;
cc21b_registration_80463390 = 0x80463390;
cc21b_reverse_8020ed40 = 0x8020ed40;
cc21b_table_80463308 = 0x80463308;
cc21b_vtable_80411ad8 = 0x80411ad8;
cc21b_vtable_80419598 = 0x80419598;
SECTIONS {
  .text.w3d_cc21b_converter_sinit_8020eda8 0x8020eda8 : { *(.text.w3d_cc21b_converter_sinit_8020eda8) }
  /DISCARD/ : { *(.text*) *(.rodata*) *(.data*) *(.bss*) *(.sdata*) *(.sbss*) *(.comment) }
}
