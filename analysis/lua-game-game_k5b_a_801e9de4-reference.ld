/* Generated reference-only placements. All bodies are source-built. */
OUTPUT_FORMAT("elf32-powerpc")
OUTPUT_ARCH(powerpc)
ENTRY(w3d_k5b_class_find_member_kind_801e9de4)
_SDA_BASE_ = 0x804b2540;
_SDA2_BASE_ = 0x804c2540;
lbl_80365788 = 0x80365788;
SECTIONS {
  .text.w3d_k5b_class_find_member_kind_801e9de4 0x801e9de4 : { *(.text.w3d_k5b_class_find_member_kind_801e9de4) }
  /DISCARD/ : { *(.text*) *(.rodata*) *(.data*) *(.bss*) *(.sdata*) *(.sbss*) *(.comment) }
}
