/* Generated reference-only placements. All bodies are source-built. */
OUTPUT_FORMAT("elf32-powerpc")
OUTPUT_ARCH(powerpc)
ENTRY(w3d_member_801c81c0)
_SDA_BASE_ = 0x804b2540;
_SDA2_BASE_ = 0x804c2540;
SECTIONS {
  .text.w3d_member_801c81c0 0x801c81c0 : { *(.text.w3d_member_801c81c0) }
  .text.w3d_member_801c8210 0x801c8210 : { *(.text.w3d_member_801c8210) }
  .text.w3d_member_801c8470 0x801c8470 : { *(.text.w3d_member_801c8470) }
  .text.w3d_member_801c84b8 0x801c84b8 : { *(.text.w3d_member_801c84b8) }
  .text.w3d_member_801c84f0 0x801c84f0 : { *(.text.w3d_member_801c84f0) }
  .text.w3d_member_801c8528 0x801c8528 : { *(.text.w3d_member_801c8528) }
  .text.w3d_member_801c8560 0x801c8560 : { *(.text.w3d_member_801c8560) }
  .text.w3d_member_801c85b8 0x801c85b8 : { *(.text.w3d_member_801c85b8) }
  .text.w3d_member_801c85f0 0x801c85f0 : { *(.text.w3d_member_801c85f0) }
  .text.w3d_member_801c8628 0x801c8628 : { *(.text.w3d_member_801c8628) }
  .text.w3d_member_801c8660 0x801c8660 : { *(.text.w3d_member_801c8660) }
  .text.w3d_setf_801c8678 0x801c8678 : { *(.text.w3d_setf_801c8678) }
  .text.w3d_getf_801c8680 0x801c8680 : { *(.text.w3d_getf_801c8680) }
  .text.w3d_copy12_801c8698 0x801c8698 : { *(.text.w3d_copy12_801c8698) }
  .text.w3d_member_801c86b8 0x801c86b8 : { *(.text.w3d_member_801c86b8) }
  .text.w3d_member_801c872c 0x801c872c : { *(.text.w3d_member_801c872c) }
  .text.w3d_member_801c8898 0x801c8898 : { *(.text.w3d_member_801c8898) }
  .text.w3d_member_801c890c 0x801c890c : { *(.text.w3d_member_801c890c) }
  .text.w3d_setf_801c8990 0x801c8990 : { *(.text.w3d_setf_801c8990) }
  .text.w3d_getf_801c8998 0x801c8998 : { *(.text.w3d_getf_801c8998) }
  .text.w3d_setf_801c89a0 0x801c89a0 : { *(.text.w3d_setf_801c89a0) }
  .text.w3d_getf_801c89a8 0x801c89a8 : { *(.text.w3d_getf_801c89a8) }
  .text.w3d_setf_801c89b0 0x801c89b0 : { *(.text.w3d_setf_801c89b0) }
  .text.w3d_getf_801c89b8 0x801c89b8 : { *(.text.w3d_getf_801c89b8) }
  .text.w3d_member_801c89d4 0x801c89d4 : { *(.text.w3d_member_801c89d4) }
  .text.w3d_copy12_801c89fc 0x801c89fc : { *(.text.w3d_copy12_801c89fc) }
  .text.w3d_member_801c8a1c 0x801c8a1c : { *(.text.w3d_member_801c8a1c) }
  .text.w3d_copy12_801c8a24 0x801c8a24 : { *(.text.w3d_copy12_801c8a24) }
  .text.w3d_member_801c8a44 0x801c8a44 : { *(.text.w3d_member_801c8a44) }
  .text.w3d_copy12_801c8a4c 0x801c8a4c : { *(.text.w3d_copy12_801c8a4c) }
  .text.w3d_member_801c8a6c 0x801c8a6c : { *(.text.w3d_member_801c8a6c) }
  .text.w3d_member_801c8ae0 0x801c8ae0 : { *(.text.w3d_member_801c8ae0) }
  .text.w3d_copy12_801c8ae8 0x801c8ae8 : { *(.text.w3d_copy12_801c8ae8) }
  .text.w3d_member_801c8b08 0x801c8b08 : { *(.text.w3d_member_801c8b08) }
  .text.w3d_copy12_801c8b10 0x801c8b10 : { *(.text.w3d_copy12_801c8b10) }
  .text.w3d_member_801c8b30 0x801c8b30 : { *(.text.w3d_member_801c8b30) }
  .text.w3d_setf_801c8b38 0x801c8b38 : { *(.text.w3d_setf_801c8b38) }
  .text.w3d_getf_801c8b40 0x801c8b40 : { *(.text.w3d_getf_801c8b40) }
  .text.w3d_setf_801c8b48 0x801c8b48 : { *(.text.w3d_setf_801c8b48) }
  .text.w3d_getf_801c8b50 0x801c8b50 : { *(.text.w3d_getf_801c8b50) }
  .text.w3d_setf_801c8b58 0x801c8b58 : { *(.text.w3d_setf_801c8b58) }
  .text.w3d_getf_801c8b60 0x801c8b60 : { *(.text.w3d_getf_801c8b60) }
  .text.w3d_setf_801c8b68 0x801c8b68 : { *(.text.w3d_setf_801c8b68) }
  .text.w3d_getf_801c8b70 0x801c8b70 : { *(.text.w3d_getf_801c8b70) }
  .text.w3d_copy12_801c8b78 0x801c8b78 : { *(.text.w3d_copy12_801c8b78) }
  .text.w3d_member_801c8b98 0x801c8b98 : { *(.text.w3d_member_801c8b98) }
  .text.w3d_setf_801c8ba0 0x801c8ba0 : { *(.text.w3d_setf_801c8ba0) }
  .text.w3d_getf_801c8ba8 0x801c8ba8 : { *(.text.w3d_getf_801c8ba8) }
  .text.w3d_setf_801c8bb0 0x801c8bb0 : { *(.text.w3d_setf_801c8bb0) }
  .text.w3d_getf_801c8bb8 0x801c8bb8 : { *(.text.w3d_getf_801c8bb8) }
  .text.w3d_setf_801c8bc0 0x801c8bc0 : { *(.text.w3d_setf_801c8bc0) }
  .text.w3d_getf_801c8bc8 0x801c8bc8 : { *(.text.w3d_getf_801c8bc8) }
  .text.w3d_setf_801c8bd0 0x801c8bd0 : { *(.text.w3d_setf_801c8bd0) }
  .text.w3d_getf_801c8bd8 0x801c8bd8 : { *(.text.w3d_getf_801c8bd8) }
  .text.w3d_setf_801c8be0 0x801c8be0 : { *(.text.w3d_setf_801c8be0) }
  .text.w3d_getf_801c8be8 0x801c8be8 : { *(.text.w3d_getf_801c8be8) }
  .text.w3d_member_801c8c5c 0x801c8c5c : { *(.text.w3d_member_801c8c5c) }
  .text.w3d_copy12_801c8d50 0x801c8d50 : { *(.text.w3d_copy12_801c8d50) }
  .text.w3d_member_801c8d70 0x801c8d70 : { *(.text.w3d_member_801c8d70) }
  .text.w3d_copy12_801c8d78 0x801c8d78 : { *(.text.w3d_copy12_801c8d78) }
  .text.w3d_member_801c8d98 0x801c8d98 : { *(.text.w3d_member_801c8d98) }
  .text.w3d_member_801c8e28 0x801c8e28 : { *(.text.w3d_member_801c8e28) }
  .text.w3d_setf_801c8e9c 0x801c8e9c : { *(.text.w3d_setf_801c8e9c) }
  .text.w3d_getf_801c8ea4 0x801c8ea4 : { *(.text.w3d_getf_801c8ea4) }
  .text.w3d_setf_801c8eac 0x801c8eac : { *(.text.w3d_setf_801c8eac) }
  .text.w3d_getf_801c8eb4 0x801c8eb4 : { *(.text.w3d_getf_801c8eb4) }
  .text.w3d_setf_801c8ebc 0x801c8ebc : { *(.text.w3d_setf_801c8ebc) }
  .text.w3d_getf_801c8ec4 0x801c8ec4 : { *(.text.w3d_getf_801c8ec4) }
  .text.w3d_copy12_801c8ecc 0x801c8ecc : { *(.text.w3d_copy12_801c8ecc) }
  .text.w3d_member_801c8eec 0x801c8eec : { *(.text.w3d_member_801c8eec) }
  .text.w3d_copy12_801c8ef4 0x801c8ef4 : { *(.text.w3d_copy12_801c8ef4) }
  .text.w3d_member_801c8f14 0x801c8f14 : { *(.text.w3d_member_801c8f14) }
  .text.w3d_copy12_801c8f5c 0x801c8f5c : { *(.text.w3d_copy12_801c8f5c) }
  .text.w3d_member_801c8f7c 0x801c8f7c : { *(.text.w3d_member_801c8f7c) }
  .text.w3d_copy12_801c8f84 0x801c8f84 : { *(.text.w3d_copy12_801c8f84) }
  .text.w3d_member_801c8fa4 0x801c8fa4 : { *(.text.w3d_member_801c8fa4) }
  .text.w3d_member_801d0850 0x801d0850 : { *(.text.w3d_member_801d0850) }
  .text.w3d_setf_801d0bbc 0x801d0bbc : { *(.text.w3d_setf_801d0bbc) }
  .text.w3d_getf_801d0bc4 0x801d0bc4 : { *(.text.w3d_getf_801d0bc4) }
  .text.w3d_setf_801d0bcc 0x801d0bcc : { *(.text.w3d_setf_801d0bcc) }
  /DISCARD/ : { *(.text*) *(.rodata*) *(.data*) *(.bss*) *(.sdata*) *(.sbss*) *(.comment) }
}
