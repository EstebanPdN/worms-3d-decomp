/* Generated reference-only placements. All bodies are source-built. */
OUTPUT_FORMAT("elf32-powerpc")
OUTPUT_ARCH(powerpc)
ENTRY(cc39d_apply_records_801dbd34)
_SDA_BASE_ = 0x804b2540;
_SDA2_BASE_ = 0x804c2540;
SECTIONS {
  .text.cc39d_apply_records_801dbd34 0x801dbd34 : { *(.text.cc39d_apply_records_801dbd34) }
  .text.cc39d_apply_records_801dc254 0x801dc254 : { *(.text.cc39d_apply_records_801dc254) }
  /DISCARD/ : { *(.text*) *(.rodata*) *(.data*) *(.bss*) *(.sdata*) *(.sbss*) *(.comment) }
}
