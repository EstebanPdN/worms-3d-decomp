/* Generated reference-only placements. All bodies are source-built. */
OUTPUT_FORMAT("elf32-powerpc")
OUTPUT_ARCH(powerpc)
ENTRY(w3d_auto_80269e34)
_SDA_BASE_ = 0x804b2540;
_SDA2_BASE_ = 0x804c2540;
fn_800FC2B0 = 0x800fc2b0;
fn_8026B3F0 = 0x8026b3f0;
fn_8026C008 = 0x8026c008;
fn_8026C54C = 0x8026c54c;
fn_8026CAC0 = 0x8026cac0;
fn_802EF234 = 0x802ef234;
lbl_803CB80C = 0x803cb80c;
lbl_803CB990 = 0x803cb990;
lbl_803CB9A0 = 0x803cb9a0;
lbl_803CB9B0 = 0x803cb9b0;
lbl_803CB9BC = 0x803cb9bc;
lbl_803CB9CC = 0x803cb9cc;
lbl_803CB9DC = 0x803cb9dc;
SECTIONS {
  .text.w3d_auto_80269e34 0x80269e34 : { *(.text.w3d_auto_80269e34) }
  /DISCARD/ : { *(.text*) *(.rodata*) *(.data*) *(.bss*) *(.sdata*) *(.sbss*) *(.comment) }
}
