/* Generated reference-only placements. All bodies are source-built. */
OUTPUT_FORMAT("elf32-powerpc")
OUTPUT_ARCH(powerpc)
ENTRY(w3d_s21_s64_to_text_801fef98)
_SDA_BASE_ = 0x804b2540;
_SDA2_BASE_ = 0x804c2540;
fn_8020c510 = 0x8020c510;
lbl_803b29c4 = 0x803b29c4;
SECTIONS {
  .text.w3d_s21_s64_to_text_801fef98 0x801fef98 : { *(.text.w3d_s21_s64_to_text_801fef98) }
  /DISCARD/ : { *(.text*) *(.rodata*) *(.data*) *(.bss*) *(.sdata*) *(.sbss*) *(.comment) }
}
