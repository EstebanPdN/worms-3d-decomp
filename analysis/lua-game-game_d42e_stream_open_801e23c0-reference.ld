/* Generated reference-only placements. All bodies are source-built. */
OUTPUT_FORMAT("elf32-powerpc")
OUTPUT_ARCH(powerpc)
ENTRY(w3d_d42e_stream_open_801e23c0)
_SDA_BASE_ = 0x804b2540;
_SDA2_BASE_ = 0x804c2540;
__6String = 0x803426b8;
fn_802f4ef0 = 0x802f4ef0;
lbl_803b05e0 = 0x803b05e0;
lbl_803b05e8 = 0x803b05e8;
w3d_cx11b_string_prefix_assign_8020c048 = 0x8020c048;
w3d_string_append = 0x8020bf2c;
w3d_string_assign = 0x8020bd38;
w3d_string_base_finish = 0x8020c5c4;
w3d_string_release = 0x80341588;
SECTIONS {
  .text.w3d_d42e_stream_open_801e23c0 0x801e23c0 : { *(.text.w3d_d42e_stream_open_801e23c0) }
  /DISCARD/ : { *(.text*) *(.rodata*) *(.data*) *(.bss*) *(.sdata*) *(.sbss*) *(.comment) }
}
