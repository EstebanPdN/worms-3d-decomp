/* Generated reference-only placements. All bodies are source-built. */
OUTPUT_FORMAT("elf32-powerpc")
OUTPUT_ARCH(powerpc)
ENTRY(_._9F16bOwner)
_SDA_BASE_ = 0x804b2540;
_SDA2_BASE_ = 0x804c2540;
_._20F16bPrimary_8015ff2c = 0x8015ff2c;
fn_802afc40 = 0x802afc40;
vt_8041bb30 = 0x8041bb30;
vt_8041bb80 = 0x8041bb80;
SECTIONS {
  .text._._9F16bOwner 0x8025f24c : { *(.text._._9F16bOwner) }
  /DISCARD/ : { *(.text*) *(.rodata*) *(.data*) *(.bss*) *(.sdata*) *(.sbss*) *(.comment) }
}
