/* Generated reference-only placements. All bodies are source-built. */
OUTPUT_FORMAT("elf32-powerpc")
OUTPUT_ARCH(powerpc)
ENTRY(w3d_copy_float_property_801ec3fc)
_SDA_BASE_ = 0x804b2540;
_SDA2_BASE_ = 0x804c2540;
SECTIONS {
  .text.w3d_copy_float_property_801ec3fc 0x801ec3fc : { *(.text.w3d_copy_float_property_801ec3fc) }
  .text.w3d_copy_float_property_801ec5b8 0x801ec5b8 : { *(.text.w3d_copy_float_property_801ec5b8) }
  /DISCARD/ : { *(.text*) *(.rodata*) *(.data*) *(.bss*) *(.sdata*) *(.sbss*) *(.comment) }
}
