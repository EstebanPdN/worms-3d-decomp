/* Generated reference-only placements. All bodies are source-built. */
OUTPUT_FORMAT("elf32-powerpc")
OUTPUT_ARCH(powerpc)
ENTRY(w3d_cx16b_audio_mode_801dda84)
_SDA_BASE_ = 0x804b2540;
_SDA2_BASE_ = 0x804c2540;
fn_802fb7ac = 0x802fb7ac;
fn_802ff7b0 = 0x802ff7b0;
fn_80322a5c = 0x80322a5c;
str_803b0214 = 0x803b0214;
str_803b0230 = 0x803b0230;
str_803b0250 = 0x803b0250;
SECTIONS {
  .text.w3d_cx16b_audio_mode_801dda84 0x801dda84 : { *(.text.w3d_cx16b_audio_mode_801dda84) }
  /DISCARD/ : { *(.text*) *(.rodata*) *(.data*) *(.bss*) *(.sdata*) *(.sbss*) *(.comment) }
}
