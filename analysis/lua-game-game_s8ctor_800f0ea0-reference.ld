/* Generated reference-only placements. All bodies are source-built. */
OUTPUT_FORMAT("elf32-powerpc")
OUTPUT_ARCH(powerpc)
ENTRY(__23s8_Constructed_800f0ea0)
_SDA_BASE_ = 0x804b2540;
_SDA2_BASE_ = 0x804c2540;
fn_80161014 = 0x80161014;
w3d_vtable_80410328 = 0x80410328;
SECTIONS {
  .text.__23s8_Constructed_800f0ea0 0x800f0ea0 : { *(.text.__23s8_Constructed_800f0ea0) }
  /DISCARD/ : { *(.text*) *(.rodata*) *(.data*) *(.bss*) *(.sdata*) *(.sbss*) *(.comment) }
}
