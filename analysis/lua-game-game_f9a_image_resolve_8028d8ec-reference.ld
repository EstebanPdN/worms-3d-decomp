/* Generated reference-only placements. All bodies are source-built. */
OUTPUT_FORMAT("elf32-powerpc")
OUTPUT_ARCH(powerpc)
ENTRY(w3d_f9a_image_resolve_8028d8ec)
_SDA_BASE_ = 0x804b2540;
_SDA2_BASE_ = 0x804c2540;
empty_803cffb8 = 0x803cffb8;
fn_800fc1b0 = 0x800fc1b0;
fn_800fd62c = 0x800fd62c;
fn_80179170 = 0x80179170;
fn_8020bb2c = 0x8020bb2c;
fn_8020bd38 = 0x8020bd38;
fn_8020c5c4 = 0x8020c5c4;
fn_8028daa8 = 0x8028daa8;
fn_8028dc30 = 0x8028dc30;
fn_80341588 = 0x80341588;
fn_80343744 = 0x80343744;
SECTIONS {
  .text.w3d_f9a_image_resolve_8028d8ec 0x8028d8ec : { *(.text.w3d_f9a_image_resolve_8028d8ec) }
  /DISCARD/ : { *(.text*) *(.rodata*) *(.data*) *(.bss*) *(.sdata*) *(.sbss*) *(.comment) }
}
