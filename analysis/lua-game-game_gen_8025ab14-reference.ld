/* Generated reference-only placements. All bodies are source-built. */
OUTPUT_FORMAT("elf32-powerpc")
OUTPUT_ARCH(powerpc)
ENTRY(w3d_set_8025ab14)
_SDA_BASE_ = 0x804b2540;
_SDA2_BASE_ = 0x804c2540;
SECTIONS {
  .text.w3d_set_8025ab14 0x8025ab14 : { *(.text.w3d_set_8025ab14) }
  .text.w3d_set_8025ab28 0x8025ab28 : { *(.text.w3d_set_8025ab28) }
  .text.w3d_set_8025ab3c 0x8025ab3c : { *(.text.w3d_set_8025ab3c) }
  .text.w3d_set_8025ab50 0x8025ab50 : { *(.text.w3d_set_8025ab50) }
  .text.w3d_set_8025ab64 0x8025ab64 : { *(.text.w3d_set_8025ab64) }
  .text.w3d_set_8025ab78 0x8025ab78 : { *(.text.w3d_set_8025ab78) }
  .text.w3d_set_8025ab8c 0x8025ab8c : { *(.text.w3d_set_8025ab8c) }
  .text.w3d_set_8025aba0 0x8025aba0 : { *(.text.w3d_set_8025aba0) }
  .text.w3d_set_8025abb4 0x8025abb4 : { *(.text.w3d_set_8025abb4) }
  .text.w3d_set_8025abc8 0x8025abc8 : { *(.text.w3d_set_8025abc8) }
  .text.w3d_set_8025abdc 0x8025abdc : { *(.text.w3d_set_8025abdc) }
  .text.w3d_set_8025abf0 0x8025abf0 : { *(.text.w3d_set_8025abf0) }
  .text.w3d_set_8025ac04 0x8025ac04 : { *(.text.w3d_set_8025ac04) }
  .text.w3d_set_8025ac18 0x8025ac18 : { *(.text.w3d_set_8025ac18) }
  .text.w3d_set_8025ac2c 0x8025ac2c : { *(.text.w3d_set_8025ac2c) }
  .text.w3d_set_8025ac40 0x8025ac40 : { *(.text.w3d_set_8025ac40) }
  .text.w3d_set_8025ac54 0x8025ac54 : { *(.text.w3d_set_8025ac54) }
  .text.w3d_set_8025ac68 0x8025ac68 : { *(.text.w3d_set_8025ac68) }
  .text.w3d_get_8025ac70 0x8025ac70 : { *(.text.w3d_get_8025ac70) }
  .text.w3d_set_8025ac78 0x8025ac78 : { *(.text.w3d_set_8025ac78) }
  .text.w3d_get_8025ac80 0x8025ac80 : { *(.text.w3d_get_8025ac80) }
  .text.w3d_set_8025ac88 0x8025ac88 : { *(.text.w3d_set_8025ac88) }
  .text.w3d_get_8025ac90 0x8025ac90 : { *(.text.w3d_get_8025ac90) }
  .text.w3d_set_8025ac98 0x8025ac98 : { *(.text.w3d_set_8025ac98) }
  .text.w3d_get_8025aca0 0x8025aca0 : { *(.text.w3d_get_8025aca0) }
  .text.w3d_set_8025aca8 0x8025aca8 : { *(.text.w3d_set_8025aca8) }
  .text.w3d_get_8025acb0 0x8025acb0 : { *(.text.w3d_get_8025acb0) }
  .text.w3d_set_8025acb8 0x8025acb8 : { *(.text.w3d_set_8025acb8) }
  .text.w3d_get_8025acc0 0x8025acc0 : { *(.text.w3d_get_8025acc0) }
  .text.w3d_set_8025acc8 0x8025acc8 : { *(.text.w3d_set_8025acc8) }
  .text.w3d_get_8025acd0 0x8025acd0 : { *(.text.w3d_get_8025acd0) }
  .text.w3d_set_8025acd8 0x8025acd8 : { *(.text.w3d_set_8025acd8) }
  .text.w3d_get_8025ace0 0x8025ace0 : { *(.text.w3d_get_8025ace0) }
  .text.w3d_set_8025ace8 0x8025ace8 : { *(.text.w3d_set_8025ace8) }
  .text.w3d_get_8025acf0 0x8025acf0 : { *(.text.w3d_get_8025acf0) }
  .text.w3d_set_8025acf8 0x8025acf8 : { *(.text.w3d_set_8025acf8) }
  .text.w3d_get_8025ad00 0x8025ad00 : { *(.text.w3d_get_8025ad00) }
  .text.w3d_set_8025ad08 0x8025ad08 : { *(.text.w3d_set_8025ad08) }
  .text.w3d_get_8025ad10 0x8025ad10 : { *(.text.w3d_get_8025ad10) }
  .text.w3d_set_8025ad18 0x8025ad18 : { *(.text.w3d_set_8025ad18) }
  .text.w3d_get_8025ad20 0x8025ad20 : { *(.text.w3d_get_8025ad20) }
  .text.w3d_set_8025ad28 0x8025ad28 : { *(.text.w3d_set_8025ad28) }
  .text.w3d_get_8025ad30 0x8025ad30 : { *(.text.w3d_get_8025ad30) }
  .text.w3d_set_8025ad38 0x8025ad38 : { *(.text.w3d_set_8025ad38) }
  .text.w3d_get_8025ad40 0x8025ad40 : { *(.text.w3d_get_8025ad40) }
  .text.w3d_set_8025ad48 0x8025ad48 : { *(.text.w3d_set_8025ad48) }
  .text.w3d_get_8025ad50 0x8025ad50 : { *(.text.w3d_get_8025ad50) }
  .text.w3d_set_8025ad58 0x8025ad58 : { *(.text.w3d_set_8025ad58) }
  .text.w3d_get_8025ad60 0x8025ad60 : { *(.text.w3d_get_8025ad60) }
  .text.w3d_set_8025ad68 0x8025ad68 : { *(.text.w3d_set_8025ad68) }
  .text.w3d_get_8025ad70 0x8025ad70 : { *(.text.w3d_get_8025ad70) }
  .text.w3d_set_8025ad78 0x8025ad78 : { *(.text.w3d_set_8025ad78) }
  .text.w3d_get_8025ad80 0x8025ad80 : { *(.text.w3d_get_8025ad80) }
  .text.w3d_set_8025ad88 0x8025ad88 : { *(.text.w3d_set_8025ad88) }
  .text.w3d_get_8025ad90 0x8025ad90 : { *(.text.w3d_get_8025ad90) }
  .text.w3d_set_8025ad98 0x8025ad98 : { *(.text.w3d_set_8025ad98) }
  .text.w3d_get_8025ada0 0x8025ada0 : { *(.text.w3d_get_8025ada0) }
  .text.w3d_set_8025ada8 0x8025ada8 : { *(.text.w3d_set_8025ada8) }
  .text.w3d_get_8025adb0 0x8025adb0 : { *(.text.w3d_get_8025adb0) }
  .text.w3d_set_8025adb8 0x8025adb8 : { *(.text.w3d_set_8025adb8) }
  .text.w3d_get_8025adc0 0x8025adc0 : { *(.text.w3d_get_8025adc0) }
  .text.w3d_set_8025adc8 0x8025adc8 : { *(.text.w3d_set_8025adc8) }
  .text.w3d_get_8025add0 0x8025add0 : { *(.text.w3d_get_8025add0) }
  .text.w3d_set_8025add8 0x8025add8 : { *(.text.w3d_set_8025add8) }
  .text.w3d_get_8025ade0 0x8025ade0 : { *(.text.w3d_get_8025ade0) }
  .text.w3d_set_8025ade8 0x8025ade8 : { *(.text.w3d_set_8025ade8) }
  .text.w3d_get_8025adf0 0x8025adf0 : { *(.text.w3d_get_8025adf0) }
  .text.w3d_set_8025adf8 0x8025adf8 : { *(.text.w3d_set_8025adf8) }
  .text.w3d_get_8025ae00 0x8025ae00 : { *(.text.w3d_get_8025ae00) }
  .text.w3d_set_8025ae08 0x8025ae08 : { *(.text.w3d_set_8025ae08) }
  .text.w3d_get_8025ae10 0x8025ae10 : { *(.text.w3d_get_8025ae10) }
  .text.w3d_set_8025ae18 0x8025ae18 : { *(.text.w3d_set_8025ae18) }
  .text.w3d_get_8025ae20 0x8025ae20 : { *(.text.w3d_get_8025ae20) }
  .text.w3d_set_8025ae28 0x8025ae28 : { *(.text.w3d_set_8025ae28) }
  .text.w3d_get_8025ae30 0x8025ae30 : { *(.text.w3d_get_8025ae30) }
  .text.w3d_set_8025ae38 0x8025ae38 : { *(.text.w3d_set_8025ae38) }
  .text.w3d_get_8025ae40 0x8025ae40 : { *(.text.w3d_get_8025ae40) }
  .text.w3d_set_8025ae48 0x8025ae48 : { *(.text.w3d_set_8025ae48) }
  .text.w3d_get_8025ae50 0x8025ae50 : { *(.text.w3d_get_8025ae50) }
  .text.w3d_set_8025ae58 0x8025ae58 : { *(.text.w3d_set_8025ae58) }
  /DISCARD/ : { *(.text*) *(.rodata*) *(.data*) *(.bss*) *(.sdata*) *(.sbss*) *(.comment) }
}
