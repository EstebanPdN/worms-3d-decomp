/* Generated reference-only placements. All bodies are source-built. */
OUTPUT_FORMAT("elf32-powerpc")
OUTPUT_ARCH(powerpc)
ENTRY(insert_unique__Q24_STLt8_Rb_tree5ZUiZQ24_STLt4pair2ZCUiZPvZQ24_STLt10_Select1st1ZQ24_STLt4pair2ZCUiZPvZQ24_STLt4less1ZUiZQ24_STLt9allocator1ZQ24_STLt4pair2ZCUiZPvGQ24_STLt17_Rb_tree_iterator2ZQ24_STLt4pair2ZCUiZPvZQ24_STLt16_Nonconst_traits1ZQ24_STLt4pair2ZCUiZPvRCQ24_STLt4pair2ZCUiZPv)
_SDA_BASE_ = 0x804b2540;
_SDA2_BASE_ = 0x804c2540;
_M_insert__Q24_STLt8_Rb_tree5ZUiZQ24_STLt4pair2ZCUiZPvZQ24_STLt10_Select1st1ZQ24_STLt4pair2ZCUiZPvZQ24_STLt4less1ZUiZQ24_STLt9allocator1ZQ24_STLt4pair2ZCUiZPvPQ24_STL18_Rb_tree_node_baseT1RCQ24_STLt4pair2ZCUiZPvT1 = 0x8035cc74;
SECTIONS {
  .text.insert_unique__Q24_STLt8_Rb_tree5ZUiZQ24_STLt4pair2ZCUiZPvZQ24_STLt10_Select1st1ZQ24_STLt4pair2ZCUiZPvZQ24_STLt4less1ZUiZQ24_STLt9allocator1ZQ24_STLt4pair2ZCUiZPvGQ24_STLt17_Rb_tree_iterator2ZQ24_STLt4pair2ZCUiZPvZQ24_STLt16_Nonconst_traits1ZQ24_STLt4pair2ZCUiZPvRCQ24_STLt4pair2ZCUiZPv 0x8035ced0 : { *(.text.insert_unique__Q24_STLt8_Rb_tree5ZUiZQ24_STLt4pair2ZCUiZPvZQ24_STLt10_Select1st1ZQ24_STLt4pair2ZCUiZPvZQ24_STLt4less1ZUiZQ24_STLt9allocator1ZQ24_STLt4pair2ZCUiZPvGQ24_STLt17_Rb_tree_iterator2ZQ24_STLt4pair2ZCUiZPvZQ24_STLt16_Nonconst_traits1ZQ24_STLt4pair2ZCUiZPvRCQ24_STLt4pair2ZCUiZPv) }
  /DISCARD/ : { *(.text*) *(.rodata*) *(.data*) *(.bss*) *(.sdata*) *(.sbss*) *(.comment) }
}
