/* Generated reference-only placements. All bodies are source-built. */
OUTPUT_FORMAT("elf32-powerpc")
OUTPUT_ARCH(powerpc)
ENTRY(w3d_d40n_reset_state_lists_8019ce60)
_SDA_BASE_ = 0x804b2540;
_SDA2_BASE_ = 0x804c2540;
_S_oom_malloc__Q24_STLt14__malloc_alloc1i0Ui = 0x803413d8;
fn_801f2678 = 0x801f2678;
fn_801f2698 = 0x801f2698;
fn_801f2758 = 0x801f2758;
free = 0x802134fc;
malloc = 0x80212fd4;
memmove = 0x802eeef4;
memset = 0x802eefe0;
SECTIONS {
  .text.w3d_d40n_reset_state_lists_8019ce60 0x8019ce60 : { *(.text.w3d_d40n_reset_state_lists_8019ce60) }
  /DISCARD/ : { *(.text*) *(.rodata*) *(.data*) *(.bss*) *(.sdata*) *(.sbss*) *(.comment) }
}
