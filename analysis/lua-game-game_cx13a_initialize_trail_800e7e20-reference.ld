/* Generated reference-only placements. All bodies are source-built. */
OUTPUT_FORMAT("elf32-powerpc")
OUTPUT_ARCH(powerpc)
ENTRY(w3d_cx13a_initialize_trail_800e7e20)
_SDA_BASE_ = 0x804b2540;
_SDA2_BASE_ = 0x804c2540;
base_8015fef0 = 0x8015fef0;
vtable_804101b0 = 0x804101b0;
SECTIONS {
  .text.w3d_cx13a_initialize_trail_800e7e20 0x800e7e20 : { *(.text.w3d_cx13a_initialize_trail_800e7e20) }
  /DISCARD/ : { *(.text*) *(.rodata*) *(.data*) *(.bss*) *(.sdata*) *(.sbss*) *(.comment) }
}
