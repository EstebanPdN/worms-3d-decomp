/* Generated reference-only placements. All bodies are source-built. */
OUTPUT_FORMAT("elf32-powerpc")
OUTPUT_ARCH(powerpc)
ENTRY(w3d_s21_hold_tick_801e4f38)
_SDA_BASE_ = 0x804b2540;
_SDA2_BASE_ = 0x804c2540;
fn_801df1ac = 0x801df1ac;
fn_80322838 = 0x80322838;
SECTIONS {
  .text.w3d_s21_hold_tick_801e4f38 0x801e4f38 : { *(.text.w3d_s21_hold_tick_801e4f38) }
  /DISCARD/ : { *(.text*) *(.rodata*) *(.data*) *(.bss*) *(.sdata*) *(.sbss*) *(.comment) }
}
