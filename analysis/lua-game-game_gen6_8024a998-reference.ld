/* Generated reference-only placements. All bodies are source-built. */
OUTPUT_FORMAT("elf32-powerpc")
OUTPUT_ARCH(powerpc)
ENTRY(w3d_getf_8024a998)
_SDA_BASE_ = 0x804b2540;
_SDA2_BASE_ = 0x804c2540;
SECTIONS {
  .text.w3d_getf_8024a998 0x8024a998 : { *(.text.w3d_getf_8024a998) }
  .text.w3d_setf_8024a9b0 0x8024a9b0 : { *(.text.w3d_setf_8024a9b0) }
  .text.w3d_getf_8024a9b8 0x8024a9b8 : { *(.text.w3d_getf_8024a9b8) }
  .text.w3d_setf_8024a9c0 0x8024a9c0 : { *(.text.w3d_setf_8024a9c0) }
  .text.w3d_getf_8024a9c8 0x8024a9c8 : { *(.text.w3d_getf_8024a9c8) }
  .text.w3d_setf_8024a9f0 0x8024a9f0 : { *(.text.w3d_setf_8024a9f0) }
  .text.w3d_getf_8024a9f8 0x8024a9f8 : { *(.text.w3d_getf_8024a9f8) }
  .text.w3d_setf_8024aa00 0x8024aa00 : { *(.text.w3d_setf_8024aa00) }
  .text.w3d_getf_8024aa08 0x8024aa08 : { *(.text.w3d_getf_8024aa08) }
  .text.w3d_setf_8024aa10 0x8024aa10 : { *(.text.w3d_setf_8024aa10) }
  .text.w3d_getf_8024aa18 0x8024aa18 : { *(.text.w3d_getf_8024aa18) }
  .text.w3d_setf_8024aa20 0x8024aa20 : { *(.text.w3d_setf_8024aa20) }
  .text.w3d_getf_8024aa28 0x8024aa28 : { *(.text.w3d_getf_8024aa28) }
  .text.w3d_setf_8024aa30 0x8024aa30 : { *(.text.w3d_setf_8024aa30) }
  .text.w3d_getf_8024aa38 0x8024aa38 : { *(.text.w3d_getf_8024aa38) }
  .text.w3d_member_8024aaa8 0x8024aaa8 : { *(.text.w3d_member_8024aaa8) }
  .text.w3d_member_8024ab18 0x8024ab18 : { *(.text.w3d_member_8024ab18) }
  .text.w3d_setf_8024ab20 0x8024ab20 : { *(.text.w3d_setf_8024ab20) }
  .text.w3d_getf_8024ab28 0x8024ab28 : { *(.text.w3d_getf_8024ab28) }
  .text.w3d_setf_8024ab30 0x8024ab30 : { *(.text.w3d_setf_8024ab30) }
  .text.w3d_getf_8024ab38 0x8024ab38 : { *(.text.w3d_getf_8024ab38) }
  .text.w3d_setf_8024ab40 0x8024ab40 : { *(.text.w3d_setf_8024ab40) }
  .text.w3d_getf_8024ab48 0x8024ab48 : { *(.text.w3d_getf_8024ab48) }
  .text.w3d_setf_8024ab50 0x8024ab50 : { *(.text.w3d_setf_8024ab50) }
  .text.w3d_getf_8024ab58 0x8024ab58 : { *(.text.w3d_getf_8024ab58) }
  .text.w3d_setf_8024ab60 0x8024ab60 : { *(.text.w3d_setf_8024ab60) }
  .text.w3d_getf_8024ab68 0x8024ab68 : { *(.text.w3d_getf_8024ab68) }
  .text.w3d_setf_8024ab70 0x8024ab70 : { *(.text.w3d_setf_8024ab70) }
  .text.w3d_getf_8024ab78 0x8024ab78 : { *(.text.w3d_getf_8024ab78) }
  .text.w3d_setf_8024ab80 0x8024ab80 : { *(.text.w3d_setf_8024ab80) }
  .text.w3d_getf_8024ab88 0x8024ab88 : { *(.text.w3d_getf_8024ab88) }
  .text.w3d_setf_8024ab90 0x8024ab90 : { *(.text.w3d_setf_8024ab90) }
  .text.w3d_getf_8024ab98 0x8024ab98 : { *(.text.w3d_getf_8024ab98) }
  .text.w3d_setf_8024aba0 0x8024aba0 : { *(.text.w3d_setf_8024aba0) }
  .text.w3d_getf_8024aba8 0x8024aba8 : { *(.text.w3d_getf_8024aba8) }
  .text.w3d_setf_8024abb0 0x8024abb0 : { *(.text.w3d_setf_8024abb0) }
  .text.w3d_getf_8024abb8 0x8024abb8 : { *(.text.w3d_getf_8024abb8) }
  .text.w3d_setf_8024abc0 0x8024abc0 : { *(.text.w3d_setf_8024abc0) }
  .text.w3d_getf_8024abc8 0x8024abc8 : { *(.text.w3d_getf_8024abc8) }
  .text.w3d_setf_8024abd0 0x8024abd0 : { *(.text.w3d_setf_8024abd0) }
  .text.w3d_getf_8024abd8 0x8024abd8 : { *(.text.w3d_getf_8024abd8) }
  .text.w3d_setf_8024abe0 0x8024abe0 : { *(.text.w3d_setf_8024abe0) }
  .text.w3d_getf_8024abe8 0x8024abe8 : { *(.text.w3d_getf_8024abe8) }
  .text.w3d_setf_8024abf0 0x8024abf0 : { *(.text.w3d_setf_8024abf0) }
  .text.w3d_getf_8024abf8 0x8024abf8 : { *(.text.w3d_getf_8024abf8) }
  .text.w3d_setf_8024ac00 0x8024ac00 : { *(.text.w3d_setf_8024ac00) }
  .text.w3d_getf_8024ac08 0x8024ac08 : { *(.text.w3d_getf_8024ac08) }
  .text.w3d_setf_8024ac10 0x8024ac10 : { *(.text.w3d_setf_8024ac10) }
  .text.w3d_getf_8024ac18 0x8024ac18 : { *(.text.w3d_getf_8024ac18) }
  .text.w3d_setf_8024ac20 0x8024ac20 : { *(.text.w3d_setf_8024ac20) }
  .text.w3d_getf_8024ac28 0x8024ac28 : { *(.text.w3d_getf_8024ac28) }
  .text.w3d_setf_8024ac30 0x8024ac30 : { *(.text.w3d_setf_8024ac30) }
  .text.w3d_getf_8024ac38 0x8024ac38 : { *(.text.w3d_getf_8024ac38) }
  .text.w3d_setf_8024ac40 0x8024ac40 : { *(.text.w3d_setf_8024ac40) }
  .text.w3d_getf_8024ac48 0x8024ac48 : { *(.text.w3d_getf_8024ac48) }
  .text.w3d_setf_8024ac50 0x8024ac50 : { *(.text.w3d_setf_8024ac50) }
  .text.w3d_getf_8024ac58 0x8024ac58 : { *(.text.w3d_getf_8024ac58) }
  .text.w3d_setf_8024ac60 0x8024ac60 : { *(.text.w3d_setf_8024ac60) }
  .text.w3d_getf_8024ac68 0x8024ac68 : { *(.text.w3d_getf_8024ac68) }
  .text.w3d_setf_8024ac70 0x8024ac70 : { *(.text.w3d_setf_8024ac70) }
  .text.w3d_getf_8024ac78 0x8024ac78 : { *(.text.w3d_getf_8024ac78) }
  .text.w3d_setf_8024ac80 0x8024ac80 : { *(.text.w3d_setf_8024ac80) }
  .text.w3d_getf_8024ac88 0x8024ac88 : { *(.text.w3d_getf_8024ac88) }
  .text.w3d_setf_8024ac90 0x8024ac90 : { *(.text.w3d_setf_8024ac90) }
  .text.w3d_getf_8024ac98 0x8024ac98 : { *(.text.w3d_getf_8024ac98) }
  .text.w3d_setf_8024aca0 0x8024aca0 : { *(.text.w3d_setf_8024aca0) }
  .text.w3d_getf_8024aca8 0x8024aca8 : { *(.text.w3d_getf_8024aca8) }
  .text.w3d_setf_8024acb0 0x8024acb0 : { *(.text.w3d_setf_8024acb0) }
  .text.w3d_getf_8024acb8 0x8024acb8 : { *(.text.w3d_getf_8024acb8) }
  .text.w3d_setf_8024acc0 0x8024acc0 : { *(.text.w3d_setf_8024acc0) }
  .text.w3d_getf_8024acc8 0x8024acc8 : { *(.text.w3d_getf_8024acc8) }
  .text.w3d_setf_8024acd0 0x8024acd0 : { *(.text.w3d_setf_8024acd0) }
  .text.w3d_getf_8024acd8 0x8024acd8 : { *(.text.w3d_getf_8024acd8) }
  .text.w3d_setf_8024ace0 0x8024ace0 : { *(.text.w3d_setf_8024ace0) }
  .text.w3d_getf_8024ace8 0x8024ace8 : { *(.text.w3d_getf_8024ace8) }
  .text.w3d_setf_8024acf0 0x8024acf0 : { *(.text.w3d_setf_8024acf0) }
  .text.w3d_getf_8024acf8 0x8024acf8 : { *(.text.w3d_getf_8024acf8) }
  .text.w3d_setf_8024ad00 0x8024ad00 : { *(.text.w3d_setf_8024ad00) }
  .text.w3d_getf_8024ad08 0x8024ad08 : { *(.text.w3d_getf_8024ad08) }
  .text.w3d_setf_8024ad10 0x8024ad10 : { *(.text.w3d_setf_8024ad10) }
  /DISCARD/ : { *(.text*) *(.rodata*) *(.data*) *(.bss*) *(.sdata*) *(.sbss*) *(.comment) }
}
