/* Generated reference-only placements. All bodies are source-built. */
OUTPUT_FORMAT("elf32-powerpc")
OUTPUT_ARCH(powerpc)
ENTRY(w3d_select_nonempty_property_record_802b6c44)
_SDA_BASE_ = 0x804b2540;
_SDA2_BASE_ = 0x804c2540;
__22F1pRecordText_803426b8 = 0x803426b8;
fn_800fc1b0 = 0x800fc1b0;
fn_80178c48 = 0x80178c48;
fn_80178d1c = 0x80178d1c;
fn_80179170 = 0x80179170;
fn_8020bb2c = 0x8020bb2c;
fn_8020c510 = 0x8020c510;
fn_8020c5c4 = 0x8020c5c4;
fn_802b9ae0 = 0x802b9ae0;
fn_80341588 = 0x80341588;
fn_803426b4 = 0x803426b4;
fn_80342a78 = 0x80342a78;
fn_80343744 = 0x80343744;
format_803d7ff4 = 0x803d7ff4;
SECTIONS {
  .text.w3d_select_nonempty_property_record_802b6c44 0x802b6c44 : { *(.text.w3d_select_nonempty_property_record_802b6c44) }
  .text.w3d_select_property_record_802b6da8 0x802b6da8 : { *(.text.w3d_select_property_record_802b6da8) }
  /DISCARD/ : { *(.text*) *(.rodata*) *(.data*) *(.bss*) *(.sdata*) *(.sbss*) *(.comment) }
}
