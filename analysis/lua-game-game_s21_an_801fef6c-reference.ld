/* Generated reference-only placements. All bodies are source-built. */
OUTPUT_FORMAT("elf32-powerpc")
OUTPUT_ARCH(powerpc)
ENTRY(w3d_s21_u64_to_text_helper_801fef6c)
_SDA_BASE_ = 0x804b2540;
_SDA2_BASE_ = 0x804c2540;
fn_8020db18 = 0x8020db18;
SECTIONS {
  .text.w3d_s21_u64_to_text_helper_801fef6c 0x801fef6c : { *(.text.w3d_s21_u64_to_text_helper_801fef6c) }
  /DISCARD/ : { *(.text*) *(.rodata*) *(.data*) *(.bss*) *(.sdata*) *(.sbss*) *(.comment) }
}
