/* Generated reference-only placements. All bodies are source-built. */
OUTPUT_FORMAT("elf32-powerpc")
OUTPUT_ARCH(powerpc)
ENTRY(w3d_cx12b_movie_play_802e0db8)
_SDA_BASE_ = 0x804b2540;
_SDA2_BASE_ = 0x804c2540;
failure_803db2f0 = 0x803db2f0;
file_803db1f8 = 0x803db1f8;
flag_800c7fe4 = 0x800c7fe4;
monitor_800c8120 = 0x800c8120;
play_803db2e4 = 0x803db2e4;
preload_802e1618 = 0x802e1618;
print_802ebfbc = 0x802ebfbc;
report_802fb82c = 0x802fb82c;
trace_802fb7ac = 0x802fb7ac;
uninitialized_803db2b0 = 0x803db2b0;
SECTIONS {
  .text.w3d_cx12b_movie_play_802e0db8 0x802e0db8 : { *(.text.w3d_cx12b_movie_play_802e0db8) }
  /DISCARD/ : { *(.text*) *(.rodata*) *(.data*) *(.bss*) *(.sdata*) *(.sbss*) *(.comment) }
}
