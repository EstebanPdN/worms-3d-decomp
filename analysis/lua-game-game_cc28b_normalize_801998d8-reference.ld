/* Generated reference-only placements. All bodies are source-built. */
OUTPUT_FORMAT("elf32-powerpc")
OUTPUT_ARCH(powerpc)
ENTRY(w3d_cc28b_normalize_801998d8)
_SDA_BASE_ = 0x804b2540;
_SDA2_BASE_ = 0x804c2540;
lbl_803a86e8 = 0x803a86e8;
lbl_803a86ec = 0x803a86ec;
SECTIONS {
  .text.w3d_cc28b_normalize_801998d8 0x801998d8 : { *(.text.w3d_cc28b_normalize_801998d8) }
  /DISCARD/ : { *(.text*) *(.rodata*) *(.data*) *(.bss*) *(.sdata*) *(.sbss*) *(.comment) }
}
