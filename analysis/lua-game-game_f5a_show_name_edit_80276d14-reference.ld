/* Generated reference-only placements. All bodies are source-built. */
OUTPUT_FORMAT("elf32-powerpc")
OUTPUT_ARCH(powerpc)
ENTRY(w3d_f5a_show_name_edit_80276d14)
_SDA_BASE_ = 0x804b2540;
_SDA2_BASE_ = 0x804c2540;
__13Text_803426b8 = 0x803426b8;
edit_803ce3b0 = 0x803ce3b0;
empty_803cc0d8 = 0x803cc0d8;
fn_8020c5c4 = 0x8020c5c4;
fn_8027a934 = 0x8027a934;
fn_802cbdf8 = 0x802cbdf8;
fn_802cbf2c = 0x802cbf2c;
fn_802cc0ac = 0x802cc0ac;
fn_802cd128 = 0x802cd128;
fn_802cd220 = 0x802cd220;
fn_80341588 = 0x80341588;
line_803cd33c = 0x803cd33c;
new_803ce3d0 = 0x803ce3d0;
old_803ce3c0 = 0x803ce3c0;
SECTIONS {
  .text.w3d_f5a_show_name_edit_80276d14 0x80276d14 : { *(.text.w3d_f5a_show_name_edit_80276d14) }
  /DISCARD/ : { *(.text*) *(.rodata*) *(.data*) *(.bss*) *(.sdata*) *(.sbss*) *(.comment) }
}
