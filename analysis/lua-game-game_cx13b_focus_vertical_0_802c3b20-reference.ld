/* Generated reference-only placements. All bodies are source-built. */
OUTPUT_FORMAT("elf32-powerpc")
OUTPUT_ARCH(powerpc)
ENTRY(w3d_cx13b_focus_vertical_0_802c3b20)
_SDA_BASE_ = 0x804b2540;
_SDA2_BASE_ = 0x804c2540;
dispatch_802c3ff0 = 0x802c3ff0;
map_803d86a8 = 0x803d86a8;
map_803d86d0 = 0x803d86d0;
SECTIONS {
  .text.w3d_cx13b_focus_vertical_0_802c3b20 0x802c3b20 : { *(.text.w3d_cx13b_focus_vertical_0_802c3b20) }
  /DISCARD/ : { *(.text*) *(.rodata*) *(.data*) *(.bss*) *(.sdata*) *(.sbss*) *(.comment) }
}
