/* Generated reference-only placements. All bodies are source-built. */
OUTPUT_FORMAT("elf32-powerpc")
OUTPUT_ARCH(powerpc)
ENTRY(w3d_d21e_register_lump_geometry_properties_8024d0e4)
_SDA_BASE_ = 0x804b2540;
_SDA2_BASE_ = 0x804c2540;
constant_803c4fe0 = 0x803c4fe0;
desc_803c4cac = 0x803c4cac;
desc_803c4ce0 = 0x803c4ce0;
desc_803c4d1c = 0x803c4d1c;
desc_803c4d64 = 0x803c4d64;
desc_803c4d9c = 0x803c4d9c;
desc_803c4dd4 = 0x803c4dd4;
desc_803c4e08 = 0x803c4e08;
desc_803c4e50 = 0x803c4e50;
desc_803c4e84 = 0x803c4e84;
desc_803c4ec0 = 0x803c4ec0;
desc_803c4efc = 0x803c4efc;
desc_803c4f34 = 0x803c4f34;
desc_803c4f70 = 0x803c4f70;
desc_803c4fa8 = 0x803c4fa8;
fn_801e8d9c = 0x801e8d9c;
fn_801eb834 = 0x801eb834;
fn_801ebbb8 = 0x801ebbb8;
fn_801ecc6c = 0x801ecc6c;
fn_801efd98 = 0x801efd98;
fn_801efdfc = 0x801efdfc;
fn_801eff8c = 0x801eff8c;
fn_801f00f0 = 0x801f00f0;
lbl_803c4d40 = 0x803c4d40;
lbl_803c4e30 = 0x803c4e30;
lbl_803c4fcc = 0x803c4fcc;
lbl_803fe4c4 = 0x803fe4c4;
lbl_8045e004 = 0x8045e004;
lbl_8045ed34 = 0x8045ed34;
lbl_8045ed4c = 0x8045ed4c;
memset = 0x802eefe0;
SECTIONS {
  .text.w3d_d21e_register_lump_geometry_properties_8024d0e4 0x8024d0e4 : { *(.text.w3d_d21e_register_lump_geometry_properties_8024d0e4) }
  .bss 0x80464ea0 : { *(.bss) }
  .sbss 0x804b08b4 : { *(.sbss) }
  /DISCARD/ : { *(.text*) *(.rodata*) *(.data*) *(.bss*) *(.sdata*) *(.sbss*) *(.comment) }
}
