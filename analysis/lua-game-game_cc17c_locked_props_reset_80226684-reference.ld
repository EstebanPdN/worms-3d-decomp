/* Generated reference-only placements. All bodies are source-built. */
OUTPUT_FORMAT("elf32-powerpc")
OUTPUT_ARCH(powerpc)
ENTRY(w3d_cc17c_locked_props_reset_80226684)
_SDA_BASE_ = 0x804b2540;
_SDA2_BASE_ = 0x804c2540;
fn_801e8d9c = 0x801e8d9c;
fn_801eb674 = 0x801eb674;
fn_801ece2c = 0x801ece2c;
fn_801ed24c = 0x801ed24c;
fn_8020bb2c = 0x8020bb2c;
fn_8020c5c0 = 0x8020c5c0;
fn_8020c5c4 = 0x8020c5c4;
fn_80341588 = 0x80341588;
fn_80341884 = 0x80341884;
lbl_803b7fec = 0x803b7fec;
lbl_803b8020 = 0x803b8020;
lbl_803b8050 = 0x803b8050;
lbl_804b06a0 = 0x804b06a0;
SECTIONS {
  .text.w3d_cc17c_locked_props_reset_80226684 0x80226684 : { *(.text.w3d_cc17c_locked_props_reset_80226684) }
  /DISCARD/ : { *(.text*) *(.rodata*) *(.data*) *(.bss*) *(.sdata*) *(.sbss*) *(.comment) }
}
