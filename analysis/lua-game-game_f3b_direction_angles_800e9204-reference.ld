/* Generated reference-only placements. All bodies are source-built. */
OUTPUT_FORMAT("elf32-powerpc")
OUTPUT_ARCH(powerpc)
ENTRY(f3b_direction_angles_800e9204)
_SDA_BASE_ = 0x804b2540;
_SDA2_BASE_ = 0x804c2540;
asin_802e7c30 = 0x802e7c30;
halfturn_8038b260 = 0x8038b260;
one_8038b25c = 0x8038b25c;
sqrt_802e82c0 = 0x802e82c0;
zero_8038b258 = 0x8038b258;
SECTIONS {
  .text.f3b_direction_angles_800e9204 0x800e9204 : { *(.text.f3b_direction_angles_800e9204) }
  /DISCARD/ : { *(.text*) *(.rodata*) *(.data*) *(.bss*) *(.sdata*) *(.sbss*) *(.comment) }
}
