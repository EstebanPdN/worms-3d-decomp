/* Generated reference-only placements. All bodies are source-built. */
OUTPUT_FORMAT("elf32-powerpc")
OUTPUT_ARCH(powerpc)
ENTRY(w3d_s20_dispatch_target_then_kind_801a49d8)
_SDA_BASE_ = 0x804b2540;
_SDA2_BASE_ = 0x804c2540;
lbl_80363cf8 = 0x80363cf8;
SECTIONS {
  .text.w3d_s20_dispatch_target_then_kind_801a49d8 0x801a49d8 : { *(.text.w3d_s20_dispatch_target_then_kind_801a49d8) }
  /DISCARD/ : { *(.text*) *(.rodata*) *(.data*) *(.bss*) *(.sdata*) *(.sbss*) *(.comment) }
}
