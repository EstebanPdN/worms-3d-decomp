/* Generated reference-only placements. All bodies are source-built. */
OUTPUT_FORMAT("elf32-powerpc")
OUTPUT_ARCH(powerpc)
ENTRY(w3d_cx15a_approach_level_80064950)
_SDA_BASE_ = 0x804b2540;
_SDA2_BASE_ = 0x804c2540;
epsilon_80379db8 = 0x80379db8;
refresh_800642ac = 0x800642ac;
value_80178df0 = 0x80178df0;
zero_80379dbc = 0x80379dbc;
SECTIONS {
  .text.w3d_cx15a_approach_level_80064950 0x80064950 : { *(.text.w3d_cx15a_approach_level_80064950) }
  /DISCARD/ : { *(.text*) *(.rodata*) *(.data*) *(.bss*) *(.sdata*) *(.sbss*) *(.comment) }
}
