/* Generated reference-only placements. All bodies are source-built. */
OUTPUT_FORMAT("elf32-powerpc")
OUTPUT_ARCH(powerpc)
ENTRY(w3d_cx8b_quaternion_alias_apply_801a56b8)
_SDA_BASE_ = 0x804b2540;
_SDA2_BASE_ = 0x804c2540;
fn_801f506c = 0x801f506c;
SECTIONS {
  .text.w3d_cx8b_quaternion_alias_apply_801a56b8 0x801a56b8 : { *(.text.w3d_cx8b_quaternion_alias_apply_801a56b8) }
  /DISCARD/ : { *(.text*) *(.rodata*) *(.data*) *(.bss*) *(.sdata*) *(.sbss*) *(.comment) }
}
