/* Generated reference-only placements. All bodies are source-built. */
OUTPUT_FORMAT("elf32-powerpc")
OUTPUT_ARCH(powerpc)
ENTRY(h2p_set_named_value_802aa71c)
_SDA_BASE_ = 0x804b2540;
_SDA2_BASE_ = 0x804c2540;
fn_800fc1b0 = 0x800fc1b0;
fn_80178c54 = 0x80178c54;
fn_80178d28 = 0x80178d28;
fn_8020c5c0 = 0x8020c5c0;
fn_8020c5c4 = 0x8020c5c4;
fn_80341588 = 0x80341588;
fn_80341884 = 0x80341884;
fn_803426b4 = 0x803426b4;
fn_80342a78 = 0x80342a78;
SECTIONS {
  .text.h2p_set_named_value_802aa71c 0x802aa71c : { *(.text.h2p_set_named_value_802aa71c) }
  /DISCARD/ : { *(.text*) *(.rodata*) *(.data*) *(.bss*) *(.sdata*) *(.sbss*) *(.comment) }
}
