/* Generated reference-only placements. All bodies are source-built. */
OUTPUT_FORMAT("elf32-powerpc")
OUTPUT_ARCH(powerpc)
ENTRY(w3d_strassign_80231174)
_SDA_BASE_ = 0x804b2540;
_SDA2_BASE_ = 0x804c2540;
w3d_string_release_header = 0x8020bb2c;
SECTIONS {
  .text.w3d_strassign_80231174 0x80231174 : { *(.text.w3d_strassign_80231174) }
  .text.w3d_strassign_802311e4 0x802311e4 : { *(.text.w3d_strassign_802311e4) }
  .text.w3d_strassign_80231254 0x80231254 : { *(.text.w3d_strassign_80231254) }
  .text.w3d_strassign_802312c4 0x802312c4 : { *(.text.w3d_strassign_802312c4) }
  .text.w3d_strassign_80231344 0x80231344 : { *(.text.w3d_strassign_80231344) }
  .text.w3d_strassign_802313b4 0x802313b4 : { *(.text.w3d_strassign_802313b4) }
  .text.w3d_strassign_80231424 0x80231424 : { *(.text.w3d_strassign_80231424) }
  .text.w3d_strassign_80231494 0x80231494 : { *(.text.w3d_strassign_80231494) }
  .text.w3d_strassign_80231504 0x80231504 : { *(.text.w3d_strassign_80231504) }
  .text.w3d_strassign_80231574 0x80231574 : { *(.text.w3d_strassign_80231574) }
  .text.w3d_strassign_80231634 0x80231634 : { *(.text.w3d_strassign_80231634) }
  .text.w3d_strassign_802316a4 0x802316a4 : { *(.text.w3d_strassign_802316a4) }
  .text.w3d_strassign_80231714 0x80231714 : { *(.text.w3d_strassign_80231714) }
  .text.w3d_strassign_80231784 0x80231784 : { *(.text.w3d_strassign_80231784) }
  .text.w3d_strassign_802317f4 0x802317f4 : { *(.text.w3d_strassign_802317f4) }
  .text.w3d_strassign_80231864 0x80231864 : { *(.text.w3d_strassign_80231864) }
  .text.w3d_strassign_80231904 0x80231904 : { *(.text.w3d_strassign_80231904) }
  .text.w3d_strassign_80231974 0x80231974 : { *(.text.w3d_strassign_80231974) }
  .text.w3d_strassign_80231a04 0x80231a04 : { *(.text.w3d_strassign_80231a04) }
  .text.w3d_strassign_80231a74 0x80231a74 : { *(.text.w3d_strassign_80231a74) }
  .text.w3d_strassign_80231ae4 0x80231ae4 : { *(.text.w3d_strassign_80231ae4) }
  .text.w3d_strassign_80231b54 0x80231b54 : { *(.text.w3d_strassign_80231b54) }
  .text.w3d_strassign_80231bc4 0x80231bc4 : { *(.text.w3d_strassign_80231bc4) }
  .text.w3d_strassign_80231c34 0x80231c34 : { *(.text.w3d_strassign_80231c34) }
  .text.w3d_strassign_80231cc4 0x80231cc4 : { *(.text.w3d_strassign_80231cc4) }
  .text.w3d_strassign_80231d84 0x80231d84 : { *(.text.w3d_strassign_80231d84) }
  .text.w3d_strassign_80231e04 0x80231e04 : { *(.text.w3d_strassign_80231e04) }
  .text.w3d_strassign_80231ea4 0x80231ea4 : { *(.text.w3d_strassign_80231ea4) }
  .text.w3d_strassign_8023204c 0x8023204c : { *(.text.w3d_strassign_8023204c) }
  .text.w3d_strassign_802320bc 0x802320bc : { *(.text.w3d_strassign_802320bc) }
  .text.w3d_strassign_8023213c 0x8023213c : { *(.text.w3d_strassign_8023213c) }
  .text.w3d_strassign_8023222c 0x8023222c : { *(.text.w3d_strassign_8023222c) }
  .text.w3d_strassign_8023229c 0x8023229c : { *(.text.w3d_strassign_8023229c) }
  .text.w3d_strassign_8023231c 0x8023231c : { *(.text.w3d_strassign_8023231c) }
  .text.w3d_strassign_8023238c 0x8023238c : { *(.text.w3d_strassign_8023238c) }
  .text.w3d_strassign_802323fc 0x802323fc : { *(.text.w3d_strassign_802323fc) }
  .text.w3d_strassign_8023246c 0x8023246c : { *(.text.w3d_strassign_8023246c) }
  .text.w3d_strassign_802324dc 0x802324dc : { *(.text.w3d_strassign_802324dc) }
  .text.w3d_strassign_8023254c 0x8023254c : { *(.text.w3d_strassign_8023254c) }
  .text.w3d_strassign_802325ec 0x802325ec : { *(.text.w3d_strassign_802325ec) }
  .text.w3d_strassign_8023265c 0x8023265c : { *(.text.w3d_strassign_8023265c) }
  .text.w3d_strassign_802326fc 0x802326fc : { *(.text.w3d_strassign_802326fc) }
  .text.w3d_strassign_8023276c 0x8023276c : { *(.text.w3d_strassign_8023276c) }
  .text.w3d_strassign_802327ec 0x802327ec : { *(.text.w3d_strassign_802327ec) }
  .text.w3d_strassign_8023285c 0x8023285c : { *(.text.w3d_strassign_8023285c) }
  .text.w3d_strassign_802328cc 0x802328cc : { *(.text.w3d_strassign_802328cc) }
  .text.w3d_strassign_8023293c 0x8023293c : { *(.text.w3d_strassign_8023293c) }
  .text.w3d_strassign_802329ac 0x802329ac : { *(.text.w3d_strassign_802329ac) }
  .text.w3d_strassign_80232a1c 0x80232a1c : { *(.text.w3d_strassign_80232a1c) }
  .text.w3d_strassign_80232abc 0x80232abc : { *(.text.w3d_strassign_80232abc) }
  .text.w3d_strassign_80232b2c 0x80232b2c : { *(.text.w3d_strassign_80232b2c) }
  .text.w3d_strassign_80232bcc 0x80232bcc : { *(.text.w3d_strassign_80232bcc) }
  .text.w3d_strassign_80232c3c 0x80232c3c : { *(.text.w3d_strassign_80232c3c) }
  .text.w3d_strassign_80232cbc 0x80232cbc : { *(.text.w3d_strassign_80232cbc) }
  .text.w3d_strassign_80232d2c 0x80232d2c : { *(.text.w3d_strassign_80232d2c) }
  .text.w3d_strassign_80232d9c 0x80232d9c : { *(.text.w3d_strassign_80232d9c) }
  .text.w3d_strassign_80232e0c 0x80232e0c : { *(.text.w3d_strassign_80232e0c) }
  .text.w3d_strassign_80232e7c 0x80232e7c : { *(.text.w3d_strassign_80232e7c) }
  .text.w3d_strassign_80232eec 0x80232eec : { *(.text.w3d_strassign_80232eec) }
  .text.w3d_strassign_80232f8c 0x80232f8c : { *(.text.w3d_strassign_80232f8c) }
  .text.w3d_strassign_80232ffc 0x80232ffc : { *(.text.w3d_strassign_80232ffc) }
  .text.w3d_strassign_8023309c 0x8023309c : { *(.text.w3d_strassign_8023309c) }
  .text.w3d_strassign_8023310c 0x8023310c : { *(.text.w3d_strassign_8023310c) }
  .text.w3d_strassign_8023318c 0x8023318c : { *(.text.w3d_strassign_8023318c) }
  .text.w3d_strassign_802331fc 0x802331fc : { *(.text.w3d_strassign_802331fc) }
  .text.w3d_strassign_8023326c 0x8023326c : { *(.text.w3d_strassign_8023326c) }
  .text.w3d_strassign_802332dc 0x802332dc : { *(.text.w3d_strassign_802332dc) }
  .text.w3d_strassign_8023334c 0x8023334c : { *(.text.w3d_strassign_8023334c) }
  .text.w3d_strassign_802333bc 0x802333bc : { *(.text.w3d_strassign_802333bc) }
  .text.w3d_strassign_8023345c 0x8023345c : { *(.text.w3d_strassign_8023345c) }
  .text.w3d_strassign_802334cc 0x802334cc : { *(.text.w3d_strassign_802334cc) }
  .text.w3d_strassign_8023356c 0x8023356c : { *(.text.w3d_strassign_8023356c) }
  .text.w3d_strassign_802335ec 0x802335ec : { *(.text.w3d_strassign_802335ec) }
  .text.w3d_strassign_8023366c 0x8023366c : { *(.text.w3d_strassign_8023366c) }
  .text.w3d_strassign_8023372c 0x8023372c : { *(.text.w3d_strassign_8023372c) }
  .text.w3d_strassign_802337ac 0x802337ac : { *(.text.w3d_strassign_802337ac) }
  .text.w3d_strassign_80235044 0x80235044 : { *(.text.w3d_strassign_80235044) }
  .text.w3d_strassign_802350b4 0x802350b4 : { *(.text.w3d_strassign_802350b4) }
  .text.w3d_strassign_80235124 0x80235124 : { *(.text.w3d_strassign_80235124) }
  .text.w3d_strassign_80235194 0x80235194 : { *(.text.w3d_strassign_80235194) }
  /DISCARD/ : { *(.text*) *(.rodata*) *(.data*) *(.bss*) *(.sdata*) *(.sbss*) *(.comment) }
}
