/* Generated reference-only placements. All bodies are source-built. */
OUTPUT_FORMAT("elf32-powerpc")
OUTPUT_ARCH(powerpc)
ENTRY(d24d_track_target_8014da00)
_SDA_BASE_ = 0x804b2540;
_SDA2_BASE_ = 0x804c2540;
d24d_apply_motion_800db60c = 0x800db60c;
d24d_class_a_80361860 = 0x80361860;
d24d_class_c_803618f0 = 0x803618f0;
d24d_create_slot_80022e20 = 0x80022e20;
d24d_direction_of__FP12d24d_Tracker = 0x8014c260;
d24d_lookup_80164fc8 = 0x80164fc8;
d24d_offset_towards__FP11d24d_TargetP9d24d_Vec3T1i = 0x800db194;
d24d_owner_matches_8014c488 = 0x8014c488;
d24d_text_803a0e2c = 0x803a0e2c;
d24d_text_803a1670 = 0x803a1670;
SECTIONS {
  .text.d24d_track_target_8014da00 0x8014da00 : { *(.text.d24d_track_target_8014da00) }
  /DISCARD/ : { *(.text*) *(.rodata*) *(.data*) *(.bss*) *(.sdata*) *(.sbss*) *(.comment) }
}
