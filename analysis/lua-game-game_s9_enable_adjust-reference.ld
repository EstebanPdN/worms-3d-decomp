/* Generated reference-only placements. All bodies are source-built. */
OUTPUT_FORMAT("elf32-powerpc")
OUTPUT_ARCH(powerpc)
ENTRY(s9_adjust_enable_8016d428)
_SDA_BASE_ = 0x804b2540;
_SDA2_BASE_ = 0x804c2540;
fn_8016c7d0 = 0x8016c7d0;
SECTIONS {
  .text.s9_adjust_enable_8016d428 0x8016d428 : { *(.text.s9_adjust_enable_8016d428) }
  /DISCARD/ : { *(.text*) *(.rodata*) *(.data*) *(.bss*) *(.sdata*) *(.sbss*) *(.comment) }
}
