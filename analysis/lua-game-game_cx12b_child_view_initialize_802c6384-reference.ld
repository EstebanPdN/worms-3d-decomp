/* Generated reference-only placements. All bodies are source-built. */
OUTPUT_FORMAT("elf32-powerpc")
OUTPUT_ARCH(powerpc)
ENTRY(w3d_cx12b_child_view_initialize_802c6384)
_SDA_BASE_ = 0x804b2540;
_SDA2_BASE_ = 0x804c2540;
setup_802c6434 = 0x802c6434;
setup_802c663c = 0x802c663c;
setup_802c68bc = 0x802c68bc;
SECTIONS {
  .text.w3d_cx12b_child_view_initialize_802c6384 0x802c6384 : { *(.text.w3d_cx12b_child_view_initialize_802c6384) }
  /DISCARD/ : { *(.text*) *(.rodata*) *(.data*) *(.bss*) *(.sdata*) *(.sbss*) *(.comment) }
}
