/* Generated reference-only placements. All bodies are source-built. */
OUTPUT_FORMAT("elf32-powerpc")
OUTPUT_ARCH(powerpc)
ENTRY(w3d_f12c_setup_editor_properties_8026c0d0)
_SDA_BASE_ = 0x804b2540;
_SDA2_BASE_ = 0x804c2540;
__22F12cSetupText_8020bb54PCc = 0x8020bb54;
callback_802699e8 = 0x802699e8;
callback_80269a64 = 0x80269a64;
callback_80269ae0 = 0x80269ae0;
callback_80269b5c = 0x80269b5c;
callback_80269bd8 = 0x80269bd8;
callback_80269c54 = 0x80269c54;
callback_80269cd8 = 0x80269cd8;
callback_80269d54 = 0x80269d54;
callback_80269dd0 = 0x80269dd0;
callback_80269e34 = 0x80269e34;
callback_80269f90 = 0x80269f90;
fn_800fd62c = 0x800fd62c;
fn_8020c5c4 = 0x8020c5c4;
fn_80341588 = 0x80341588;
name_803cb8bc = 0x803cb8bc;
name_803cb8f8 = 0x803cb8f8;
name_803cb908 = 0x803cb908;
name_803cb918 = 0x803cb918;
name_803cb92c = 0x803cb92c;
name_803cb940 = 0x803cb940;
name_803cb950 = 0x803cb950;
name_803cb960 = 0x803cb960;
name_803cb970 = 0x803cb970;
name_803cb980 = 0x803cb980;
name_803cb990 = 0x803cb990;
SECTIONS {
  .text.w3d_f12c_setup_editor_properties_8026c0d0 0x8026c0d0 : { *(.text.w3d_f12c_setup_editor_properties_8026c0d0) }
  /DISCARD/ : { *(.text*) *(.rodata*) *(.data*) *(.bss*) *(.sdata*) *(.sbss*) *(.comment) }
}
