/* Generated reference-only placements. All bodies are source-built. */
OUTPUT_FORMAT("elf32-powerpc")
OUTPUT_ARCH(powerpc)
ENTRY(w3d_ai_clone_plan_80014f8c)
_SDA_BASE_ = 0x804b2540;
_SDA2_BASE_ = 0x804c2540;
fn_80006360 = 0x80006360;
lbl_8036a534 = 0x8036a534;
lbl_8036a538 = 0x8036a538;
lbl_8040cc78 = 0x8040cc78;
lbl_8040ccb0 = 0x8040ccb0;
lbl_8040d7b8 = 0x8040d7b8;
SECTIONS {
  .text.w3d_ai_clone_plan_80014f8c 0x80014f8c : { *(.text.w3d_ai_clone_plan_80014f8c) }
  .text.w3d_ai_clone_plan_800150e0 0x800150e0 : { *(.text.w3d_ai_clone_plan_800150e0) }
  /DISCARD/ : { *(.text*) *(.rodata*) *(.data*) *(.bss*) *(.sdata*) *(.sbss*) *(.comment) }
}
