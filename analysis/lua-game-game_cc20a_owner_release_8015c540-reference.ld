/* Generated reference-only placements. All bodies are source-built. */
OUTPUT_FORMAT("elf32-powerpc")
OUTPUT_ARCH(powerpc)
ENTRY(w3d_cc20a_owner_release_8015c540)
_SDA_BASE_ = 0x804b2540;
_SDA2_BASE_ = 0x804c2540;
fn_8015b630 = 0x8015b630;
lbl_804111c8 = 0x804111c8;
SECTIONS {
  .text.w3d_cc20a_owner_release_8015c540 0x8015c540 : { *(.text.w3d_cc20a_owner_release_8015c540) }
  /DISCARD/ : { *(.text*) *(.rodata*) *(.data*) *(.bss*) *(.sdata*) *(.sbss*) *(.comment) }
}
