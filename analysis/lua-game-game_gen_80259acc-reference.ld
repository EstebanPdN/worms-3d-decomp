/* Generated reference-only placements. All bodies are source-built. */
OUTPUT_FORMAT("elf32-powerpc")
OUTPUT_ARCH(powerpc)
ENTRY(w3d_set_80259acc)
_SDA_BASE_ = 0x804b2540;
_SDA2_BASE_ = 0x804c2540;
SECTIONS {
  .text.w3d_set_80259acc 0x80259acc : { *(.text.w3d_set_80259acc) }
  .text.w3d_get_80259ad4 0x80259ad4 : { *(.text.w3d_get_80259ad4) }
  .text.w3d_set_80259adc 0x80259adc : { *(.text.w3d_set_80259adc) }
  .text.w3d_get_80259ae4 0x80259ae4 : { *(.text.w3d_get_80259ae4) }
  .text.w3d_set_80259aec 0x80259aec : { *(.text.w3d_set_80259aec) }
  .text.w3d_get_80259af4 0x80259af4 : { *(.text.w3d_get_80259af4) }
  .text.w3d_set_80259b1c 0x80259b1c : { *(.text.w3d_set_80259b1c) }
  .text.w3d_get_80259b24 0x80259b24 : { *(.text.w3d_get_80259b24) }
  .text.w3d_set_80259c3c 0x80259c3c : { *(.text.w3d_set_80259c3c) }
  .text.w3d_get_80259c44 0x80259c44 : { *(.text.w3d_get_80259c44) }
  .text.w3d_set_80259f7c 0x80259f7c : { *(.text.w3d_set_80259f7c) }
  .text.w3d_get_80259f84 0x80259f84 : { *(.text.w3d_get_80259f84) }
  .text.w3d_set_80259f8c 0x80259f8c : { *(.text.w3d_set_80259f8c) }
  .text.w3d_get_80259f94 0x80259f94 : { *(.text.w3d_get_80259f94) }
  .text.w3d_set_80259f9c 0x80259f9c : { *(.text.w3d_set_80259f9c) }
  .text.w3d_get_80259fa4 0x80259fa4 : { *(.text.w3d_get_80259fa4) }
  .text.w3d_set_80259fac 0x80259fac : { *(.text.w3d_set_80259fac) }
  .text.w3d_get_80259fb4 0x80259fb4 : { *(.text.w3d_get_80259fb4) }
  .text.w3d_set_80259fbc 0x80259fbc : { *(.text.w3d_set_80259fbc) }
  .text.w3d_get_80259fc4 0x80259fc4 : { *(.text.w3d_get_80259fc4) }
  .text.w3d_set_80259fcc 0x80259fcc : { *(.text.w3d_set_80259fcc) }
  .text.w3d_get_80259fd4 0x80259fd4 : { *(.text.w3d_get_80259fd4) }
  .text.w3d_set_80259fdc 0x80259fdc : { *(.text.w3d_set_80259fdc) }
  .text.w3d_get_80259fe4 0x80259fe4 : { *(.text.w3d_get_80259fe4) }
  .text.w3d_set_80259fec 0x80259fec : { *(.text.w3d_set_80259fec) }
  .text.w3d_get_80259ff4 0x80259ff4 : { *(.text.w3d_get_80259ff4) }
  .text.w3d_set_80259ffc 0x80259ffc : { *(.text.w3d_set_80259ffc) }
  .text.w3d_get_8025a004 0x8025a004 : { *(.text.w3d_get_8025a004) }
  .text.w3d_set_8025a00c 0x8025a00c : { *(.text.w3d_set_8025a00c) }
  .text.w3d_get_8025a014 0x8025a014 : { *(.text.w3d_get_8025a014) }
  .text.w3d_set_8025a01c 0x8025a01c : { *(.text.w3d_set_8025a01c) }
  .text.w3d_get_8025a024 0x8025a024 : { *(.text.w3d_get_8025a024) }
  .text.w3d_set_8025a02c 0x8025a02c : { *(.text.w3d_set_8025a02c) }
  .text.w3d_get_8025a034 0x8025a034 : { *(.text.w3d_get_8025a034) }
  .text.w3d_set_8025a03c 0x8025a03c : { *(.text.w3d_set_8025a03c) }
  .text.w3d_get_8025a044 0x8025a044 : { *(.text.w3d_get_8025a044) }
  .text.w3d_set_8025a56c 0x8025a56c : { *(.text.w3d_set_8025a56c) }
  .text.w3d_get_8025a574 0x8025a574 : { *(.text.w3d_get_8025a574) }
  .text.w3d_set_8025a57c 0x8025a57c : { *(.text.w3d_set_8025a57c) }
  .text.w3d_get_8025a584 0x8025a584 : { *(.text.w3d_get_8025a584) }
  .text.w3d_set_8025a58c 0x8025a58c : { *(.text.w3d_set_8025a58c) }
  .text.w3d_get_8025a594 0x8025a594 : { *(.text.w3d_get_8025a594) }
  .text.w3d_set_8025a59c 0x8025a59c : { *(.text.w3d_set_8025a59c) }
  .text.w3d_get_8025a5a4 0x8025a5a4 : { *(.text.w3d_get_8025a5a4) }
  .text.w3d_set_8025a5ac 0x8025a5ac : { *(.text.w3d_set_8025a5ac) }
  .text.w3d_get_8025a5b4 0x8025a5b4 : { *(.text.w3d_get_8025a5b4) }
  .text.w3d_set_8025a86c 0x8025a86c : { *(.text.w3d_set_8025a86c) }
  .text.w3d_set_8025a880 0x8025a880 : { *(.text.w3d_set_8025a880) }
  .text.w3d_set_8025a894 0x8025a894 : { *(.text.w3d_set_8025a894) }
  .text.w3d_set_8025a8a8 0x8025a8a8 : { *(.text.w3d_set_8025a8a8) }
  .text.w3d_set_8025a8bc 0x8025a8bc : { *(.text.w3d_set_8025a8bc) }
  .text.w3d_set_8025a8d0 0x8025a8d0 : { *(.text.w3d_set_8025a8d0) }
  .text.w3d_set_8025a8e4 0x8025a8e4 : { *(.text.w3d_set_8025a8e4) }
  .text.w3d_set_8025a8f8 0x8025a8f8 : { *(.text.w3d_set_8025a8f8) }
  .text.w3d_set_8025a90c 0x8025a90c : { *(.text.w3d_set_8025a90c) }
  .text.w3d_set_8025a920 0x8025a920 : { *(.text.w3d_set_8025a920) }
  .text.w3d_set_8025a934 0x8025a934 : { *(.text.w3d_set_8025a934) }
  .text.w3d_set_8025a948 0x8025a948 : { *(.text.w3d_set_8025a948) }
  .text.w3d_set_8025a95c 0x8025a95c : { *(.text.w3d_set_8025a95c) }
  .text.w3d_set_8025a970 0x8025a970 : { *(.text.w3d_set_8025a970) }
  .text.w3d_set_8025a984 0x8025a984 : { *(.text.w3d_set_8025a984) }
  .text.w3d_set_8025a998 0x8025a998 : { *(.text.w3d_set_8025a998) }
  .text.w3d_set_8025a9ac 0x8025a9ac : { *(.text.w3d_set_8025a9ac) }
  .text.w3d_set_8025a9c0 0x8025a9c0 : { *(.text.w3d_set_8025a9c0) }
  .text.w3d_set_8025a9d4 0x8025a9d4 : { *(.text.w3d_set_8025a9d4) }
  .text.w3d_set_8025a9e8 0x8025a9e8 : { *(.text.w3d_set_8025a9e8) }
  .text.w3d_set_8025a9fc 0x8025a9fc : { *(.text.w3d_set_8025a9fc) }
  .text.w3d_set_8025aa10 0x8025aa10 : { *(.text.w3d_set_8025aa10) }
  .text.w3d_set_8025aa24 0x8025aa24 : { *(.text.w3d_set_8025aa24) }
  .text.w3d_set_8025aa38 0x8025aa38 : { *(.text.w3d_set_8025aa38) }
  .text.w3d_set_8025aa4c 0x8025aa4c : { *(.text.w3d_set_8025aa4c) }
  .text.w3d_set_8025aa60 0x8025aa60 : { *(.text.w3d_set_8025aa60) }
  .text.w3d_set_8025aa74 0x8025aa74 : { *(.text.w3d_set_8025aa74) }
  .text.w3d_set_8025aa88 0x8025aa88 : { *(.text.w3d_set_8025aa88) }
  .text.w3d_set_8025aa9c 0x8025aa9c : { *(.text.w3d_set_8025aa9c) }
  .text.w3d_set_8025aab0 0x8025aab0 : { *(.text.w3d_set_8025aab0) }
  .text.w3d_set_8025aac4 0x8025aac4 : { *(.text.w3d_set_8025aac4) }
  .text.w3d_set_8025aad8 0x8025aad8 : { *(.text.w3d_set_8025aad8) }
  .text.w3d_set_8025aaec 0x8025aaec : { *(.text.w3d_set_8025aaec) }
  .text.w3d_set_8025ab00 0x8025ab00 : { *(.text.w3d_set_8025ab00) }
  /DISCARD/ : { *(.text*) *(.rodata*) *(.data*) *(.bss*) *(.sdata*) *(.sbss*) *(.comment) }
}
