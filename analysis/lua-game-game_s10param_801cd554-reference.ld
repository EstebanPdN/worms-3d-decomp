/* Generated reference-only placements. All bodies are source-built. */
OUTPUT_FORMAT("elf32-powerpc")
OUTPUT_ARCH(powerpc)
ENTRY(w3d_s10_init_two_properties_801cd554)
_SDA_BASE_ = 0x804b2540;
_SDA2_BASE_ = 0x804c2540;
fn_801e8d9c = 0x801e8d9c;
fn_801ece2c = 0x801ece2c;
lbl_803ae768 = 0x803ae768;
lbl_803ae79c = 0x803ae79c;
SECTIONS {
  .text.w3d_s10_init_two_properties_801cd554 0x801cd554 : { *(.text.w3d_s10_init_two_properties_801cd554) }
  /DISCARD/ : { *(.text*) *(.rodata*) *(.data*) *(.bss*) *(.sdata*) *(.sbss*) *(.comment) }
}
