/* Generated reference-only placements. All bodies are source-built. */
OUTPUT_FORMAT("elf32-powerpc")
OUTPUT_ARCH(powerpc)
ENTRY(w3d_d41k_frame_box_parts_8026a16c)
_SDA_BASE_ = 0x804b2540;
_SDA2_BASE_ = 0x804c2540;
__12Str_803426b8 = 0x803426b8;
__12Str_803426b8PCc = 0x8020bb54;
fn_800fc1b0 = 0x800fc1b0;
fn_8015adf4 = 0x8015adf4;
fn_80173df0 = 0x80173df0;
fn_80173f88 = 0x80173f88;
fn_80178df0 = 0x80178df0;
fn_80178f54 = 0x80178f54;
fn_8020bd38 = 0x8020bd38;
fn_8020c5c0 = 0x8020c5c0;
fn_8020c5c4 = 0x8020c5c4;
fn_80263608 = 0x80263608;
fn_80263bb8 = 0x80263bb8;
fn_80341588 = 0x80341588;
fn_80341884 = 0x80341884;
fn_80342a74 = 0x80342a74;
fn_8034357c = 0x8034357c;
lbl_803cb9ec = 0x803cb9ec;
lbl_803cba00 = 0x803cba00;
lbl_8045e788 = 0x8045e788;
SECTIONS {
  .text.w3d_d41k_frame_box_parts_8026a16c 0x8026a16c : { *(.text.w3d_d41k_frame_box_parts_8026a16c) }
  .rodata 0x803cba14 : { *(.rodata) }
  /DISCARD/ : { *(.text*) *(.rodata*) *(.data*) *(.bss*) *(.sdata*) *(.sbss*) *(.comment) }
}
