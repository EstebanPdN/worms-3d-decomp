/* Generated reference-only placements. All bodies are source-built. */
OUTPUT_FORMAT("elf32-powerpc")
OUTPUT_ARCH(powerpc)
ENTRY(w3d_cx8c_pair_owner_8034ae84)
_SDA_BASE_ = 0x804b2540;
_SDA2_BASE_ = 0x804c2540;
cx8c_allocate_801fe1d8 = 0x801fe1d8;
SECTIONS {
  .text.w3d_cx8c_pair_owner_8034ae84 0x8034ae84 : { *(.text.w3d_cx8c_pair_owner_8034ae84) }
  /DISCARD/ : { *(.text*) *(.rodata*) *(.data*) *(.bss*) *(.sdata*) *(.sbss*) *(.comment) }
}
