/* Generated reference-only placements. All bodies are source-built. */
OUTPUT_FORMAT("elf32-powerpc")
OUTPUT_ARCH(powerpc)
ENTRY(w3d_cx12b_focus_advance_802c3ef0)
_SDA_BASE_ = 0x804b2540;
_SDA2_BASE_ = 0x804c2540;
dispatch_802c3ff0 = 0x802c3ff0;
SECTIONS {
  .text.w3d_cx12b_focus_advance_802c3ef0 0x802c3ef0 : { *(.text.w3d_cx12b_focus_advance_802c3ef0) }
  /DISCARD/ : { *(.text*) *(.rodata*) *(.data*) *(.bss*) *(.sdata*) *(.sbss*) *(.comment) }
}
