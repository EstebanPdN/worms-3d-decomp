/* Generated reference-only placements. All bodies are source-built. */
OUTPUT_FORMAT("elf32-powerpc")
OUTPUT_ARCH(powerpc)
ENTRY(d24f_record_vector_resize_80348a4c)
_SDA_BASE_ = 0x804b2540;
_SDA2_BASE_ = 0x804c2540;
sol35f6a_record32_insert_80347dec = 0x80347dec;
w3d_auto_80210abc = 0x80210abc;
w3d_construct_802109dc = 0x802109dc;
SECTIONS {
  .text.d24f_record_vector_resize_80348a4c 0x80348a4c : { *(.text.d24f_record_vector_resize_80348a4c) }
  /DISCARD/ : { *(.text*) *(.rodata*) *(.data*) *(.bss*) *(.sdata*) *(.sbss*) *(.comment) }
}
