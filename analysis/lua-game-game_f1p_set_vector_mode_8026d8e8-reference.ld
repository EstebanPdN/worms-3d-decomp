/* Generated reference-only placements. All bodies are source-built. */
OUTPUT_FORMAT("elf32-powerpc")
OUTPUT_ARCH(powerpc)
ENTRY(w3d_set_vector_mode_8026d8e8)
_SDA_BASE_ = 0x804b2540;
_SDA2_BASE_ = 0x804c2540;
fn_8026d524 = 0x8026d524;
fn_8026dbe8 = 0x8026dbe8;
value_803cbd74 = 0x803cbd74;
value_803cbd78 = 0x803cbd78;
SECTIONS {
  .text.w3d_set_vector_mode_8026d8e8 0x8026d8e8 : { *(.text.w3d_set_vector_mode_8026d8e8) }
  /DISCARD/ : { *(.text*) *(.rodata*) *(.data*) *(.bss*) *(.sdata*) *(.sbss*) *(.comment) }
}
