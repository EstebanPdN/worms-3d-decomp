/* Generated reference-only placements. All bodies are source-built. */
OUTPUT_FORMAT("elf32-powerpc")
OUTPUT_ARCH(powerpc)
ENTRY(k4a_camera_free_construct_80072460)
_SDA_BASE_ = 0x804b2540;
_SDA2_BASE_ = 0x804c2540;
FUN_8015a0d4 = 0x8015a0d4;
w3d_constructor_lookup_name = 0x800fc1b0;
w3d_constructor_native_cast = 0x80342a78;
w3d_f32_8037ccc4 = 0x8037ccc4;
w3d_str_8037ccac = 0x8037ccac;
w3d_vtable_8040f0a8 = 0x8040f0a8;
SECTIONS {
  .text.k4a_camera_free_construct_80072460 0x80072460 : { *(.text.k4a_camera_free_construct_80072460) }
  /DISCARD/ : { *(.text*) *(.rodata*) *(.data*) *(.bss*) *(.sdata*) *(.sbss*) *(.comment) }
}
