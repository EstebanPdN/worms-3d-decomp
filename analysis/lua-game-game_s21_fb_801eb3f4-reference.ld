/* Generated reference-only placements. All bodies are source-built. */
OUTPUT_FORMAT("elf32-powerpc")
OUTPUT_ARCH(powerpc)
ENTRY(w3d_s21_read_element_801eb3f4)
_SDA_BASE_ = 0x804b2540;
_SDA2_BASE_ = 0x804c2540;
__7S21Text = 0x803426b8;
fn_801fff60__FP9S21Target = 0x801fff60;
fn_8020c5c4__FP7S21Text = 0x8020c5c4;
fn_8020d82c__FiP7S21Text = 0x8020d82c;
fn_8020dbf8__FiPCc = 0x8020dbf8;
fn_80341588__FP7S21Text = 0x80341588;
lbl_803b0c58 = 0x803b0c58;
SECTIONS {
  .text.w3d_s21_read_element_801eb3f4 0x801eb3f4 : { *(.text.w3d_s21_read_element_801eb3f4) }
  /DISCARD/ : { *(.text*) *(.rodata*) *(.data*) *(.bss*) *(.sdata*) *(.sbss*) *(.comment) }
}
