/* Generated reference-only placements. All bodies are source-built. */
OUTPUT_FORMAT("elf32-powerpc")
OUTPUT_ARCH(powerpc)
ENTRY(w3d_d29e_open_stream_801f7dc4)
_SDA_BASE_ = 0x804b2540;
_SDA2_BASE_ = 0x804c2540;
_._6Tagged = 0x8020803c;
__6Tagged = 0x80207fec;
lbl_80365808 = 0x80365808;
refill__6TaggedPvi = 0x802080a0;
w3d_cx14b_stream_interface_attach_801f8754 = 0x801f8754;
w3d_r24b_invoke_ready_callback_8020fcb4 = 0x8020fcb4;
w3d_registry_retain_80207f8c = 0x80207f8c;
SECTIONS {
  .text.w3d_d29e_open_stream_801f7dc4 0x801f7dc4 : { *(.text.w3d_d29e_open_stream_801f7dc4) }
  /DISCARD/ : { *(.text*) *(.rodata*) *(.data*) *(.bss*) *(.sdata*) *(.sbss*) *(.comment) }
}
