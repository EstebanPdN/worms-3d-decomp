/* Generated reference-only placements. All bodies are source-built. */
OUTPUT_FORMAT("elf32-powerpc")
OUTPUT_ARCH(powerpc)
ENTRY(cc44a_apply_blend_8016a650)
_SDA_BASE_ = 0x804b2540;
_SDA2_BASE_ = 0x804c2540;
cc44a_alpha_compare_8030b3dc = 0x8030b3dc;
cc44a_blend_factors_803a5500 = 0x803a5500;
cc44a_depth_location_8030ba98 = 0x8030ba98;
cc44a_set_blend_8030b9b8 = 0x8030b9b8;
SECTIONS {
  .text.cc44a_apply_blend_8016a650 0x8016a650 : { *(.text.cc44a_apply_blend_8016a650) }
  /DISCARD/ : { *(.text*) *(.rodata*) *(.data*) *(.bss*) *(.sdata*) *(.sbss*) *(.comment) }
}
