/* Generated reference-only placements. All bodies are source-built. */
OUTPUT_FORMAT("elf32-powerpc")
OUTPUT_ARCH(powerpc)
ENTRY(w3d_d27k_land_settings_save_8026bdf0)
_SDA_BASE_ = 0x804b2540;
_SDA2_BASE_ = 0x804c2540;
__15String_803426b8 = 0x803426b8;
assign_8020bd38 = 0x8020bd38;
format_8020c510 = 0x8020c510;
read_800fc550 = 0x800fc550;
seed_8026ce4c = 0x8026ce4c;
string_finish_8020c5c4 = 0x8020c5c4;
string_release_80341588 = 0x80341588;
text_803cb80c = 0x803cb80c;
text_803cb8d0 = 0x803cb8d0;
text_803cb8f8 = 0x803cb8f8;
text_803cb908 = 0x803cb908;
text_803cb918 = 0x803cb918;
text_803cb92c = 0x803cb92c;
text_803cb940 = 0x803cb940;
text_803cb950 = 0x803cb950;
text_803cb960 = 0x803cb960;
text_803cb970 = 0x803cb970;
text_803cb990 = 0x803cb990;
text_803cb9a0 = 0x803cb9a0;
text_803cb9b0 = 0x803cb9b0;
text_803cb9bc = 0x803cb9bc;
text_803cb9cc = 0x803cb9cc;
text_803cb9dc = 0x803cb9dc;
write_800fc43c = 0x800fc43c;
SECTIONS {
  .text.w3d_d27k_land_settings_save_8026bdf0 0x8026bdf0 : { *(.text.w3d_d27k_land_settings_save_8026bdf0) }
  /DISCARD/ : { *(.text*) *(.rodata*) *(.data*) *(.bss*) *(.sdata*) *(.sbss*) *(.comment) }
}
