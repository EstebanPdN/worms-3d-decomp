/* Generated reference-only placements. All bodies are source-built. */
OUTPUT_FORMAT("elf32-powerpc")
OUTPUT_ARCH(powerpc)
ENTRY(cc41a_refresh_group_8017d294)
_SDA_BASE_ = 0x804b2540;
_SDA2_BASE_ = 0x804c2540;
cc41a_begin_8020b5c8 = 0x8020b5c8;
cc41a_controlKey_804143e0 = 0x804143e0;
cc41a_dirty_804a8dd8 = 0x804a8dd8;
cc41a_end_8020b5d0 = 0x8020b5d0;
cc41a_service_8020b648 = 0x8020b648;
SECTIONS {
  .text.cc41a_refresh_group_8017d294 0x8017d294 : { *(.text.cc41a_refresh_group_8017d294) }
  /DISCARD/ : { *(.text*) *(.rodata*) *(.data*) *(.bss*) *(.sdata*) *(.sbss*) *(.comment) }
}
