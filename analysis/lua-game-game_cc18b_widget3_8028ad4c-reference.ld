/* Generated reference-only placements. All bodies are source-built. */
OUTPUT_FORMAT("elf32-powerpc")
OUTPUT_ARCH(powerpc)
ENTRY(w3d_cc18b_widget3_construct_8028ad4c)
_SDA_BASE_ = 0x804b2540;
_SDA2_BASE_ = 0x804c2540;
base_8015fef0 = 0x8015fef0;
member_802afb20 = 0x802afb20;
table_8041c090 = 0x8041c090;
table_8041c0e0 = 0x8041c0e0;
SECTIONS {
  .text.w3d_cc18b_widget3_construct_8028ad4c 0x8028ad4c : { *(.text.w3d_cc18b_widget3_construct_8028ad4c) }
  /DISCARD/ : { *(.text*) *(.rodata*) *(.data*) *(.bss*) *(.sdata*) *(.sbss*) *(.comment) }
}
