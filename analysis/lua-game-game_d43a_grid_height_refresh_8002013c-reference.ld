/* Generated reference-only placements. All bodies are source-built. */
OUTPUT_FORMAT("elf32-powerpc")
OUTPUT_ARCH(powerpc)
ENTRY(w3d_d43a_grid_height_refresh_8002013c)
_SDA_BASE_ = 0x804b2540;
_SDA2_BASE_ = 0x804c2540;
w3d_empty_80342a74 = 0x80342a74;
w3d_value_80178df0 = 0x80178df0;
SECTIONS {
  .text.w3d_d43a_grid_height_refresh_8002013c 0x8002013c : { *(.text.w3d_d43a_grid_height_refresh_8002013c) }
  /DISCARD/ : { *(.text*) *(.rodata*) *(.data*) *(.bss*) *(.sdata*) *(.sbss*) *(.comment) }
}
