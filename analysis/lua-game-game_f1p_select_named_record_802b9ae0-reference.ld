/* Generated reference-only placements. All bodies are source-built. */
OUTPUT_FORMAT("elf32-powerpc")
OUTPUT_ARCH(powerpc)
ENTRY(w3d_select_named_record_802b9ae0)
_SDA_BASE_ = 0x804b2540;
_SDA2_BASE_ = 0x804c2540;
fn_801797b4 = 0x801797b4;
fn_802b83ac = 0x802b83ac;
fn_802b8be0 = 0x802b8be0;
fn_802bc8b4 = 0x802bc8b4;
fn_802ef234 = 0x802ef234;
fn_80341584 = 0x80341584;
SECTIONS {
  .text.w3d_select_named_record_802b9ae0 0x802b9ae0 : { *(.text.w3d_select_named_record_802b9ae0) }
  /DISCARD/ : { *(.text*) *(.rodata*) *(.data*) *(.bss*) *(.sdata*) *(.sbss*) *(.comment) }
}
