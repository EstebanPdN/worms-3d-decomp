/* Generated reference-only placements. All bodies are source-built. */
OUTPUT_FORMAT("elf32-powerpc")
OUTPUT_ARCH(powerpc)
ENTRY(g2b_write_schema_801ea18c)
_SDA_BASE_ = 0x804b2540;
_SDA2_BASE_ = 0x804c2540;
fn_801eb0b0 = 0x801eb0b0;
key_803b0a24 = 0x803b0a24;
key_803b0a28 = 0x803b0a28;
key_803b0a38 = 0x803b0a38;
key_803b0a44 = 0x803b0a44;
sentinel_80365788 = 0x80365788;
tag_803b0a1c = 0x803b0a1c;
SECTIONS {
  .text.g2b_write_schema_801ea18c 0x801ea18c : { *(.text.g2b_write_schema_801ea18c) }
  /DISCARD/ : { *(.text*) *(.rodata*) *(.data*) *(.bss*) *(.sdata*) *(.sbss*) *(.comment) }
}
