/* Generated reference-only placements. All bodies are source-built. */
OUTPUT_FORMAT("elf32-powerpc")
OUTPUT_ARCH(powerpc)
ENTRY(w3d_empty_80100744)
_SDA_BASE_ = 0x804b2540;
_SDA2_BASE_ = 0x804c2540;
w3d_fn_8010430c = 0x8010430c;
w3d_fn_80104350 = 0x80104350;
w3d_fn_80104768 = 0x80104768;
w3d_fn_80104984 = 0x80104984;
w3d_fn_80106c88 = 0x80106c88;
w3d_fn_80108368 = 0x80108368;
w3d_fn_801083ac = 0x801083ac;
w3d_fn_8010912c = 0x8010912c;
w3d_fn_801091a4 = 0x801091a4;
w3d_fn_8010a740 = 0x8010a740;
w3d_fn_8010a784 = 0x8010a784;
w3d_fn_8010dadc = 0x8010dadc;
w3d_fn_8010db24 = 0x8010db24;
w3d_fn_8010df80 = 0x8010df80;
w3d_fn_8010dfc8 = 0x8010dfc8;
w3d_fn_8010e6d0 = 0x8010e6d0;
w3d_fn_8010e75c = 0x8010e75c;
w3d_fn_801192ec = 0x801192ec;
w3d_fn_801193bc = 0x801193bc;
w3d_fn_80119e10 = 0x80119e10;
w3d_fn_80119e50 = 0x80119e50;
w3d_global_803610b0 = 0x803610b0;
w3d_global_803610e0 = 0x803610e0;
w3d_global_80361110 = 0x80361110;
w3d_global_80361140 = 0x80361140;
w3d_global_80361170 = 0x80361170;
w3d_global_803611a0 = 0x803611a0;
w3d_global_803611d0 = 0x803611d0;
w3d_global_80361200 = 0x80361200;
w3d_global_80361230 = 0x80361230;
w3d_global_80361260 = 0x80361260;
w3d_global_80361290 = 0x80361290;
w3d_global_803612c0 = 0x803612c0;
w3d_global_803612f0 = 0x803612f0;
w3d_heap_allocate_entry_a = 0x801fe1d8;
w3d_owner_list_remove = 0x8020fd2c;
w3d_registry_list_803610b0 = 0x803610b0;
w3d_registry_list_803610e0 = 0x803610e0;
w3d_registry_list_80361110 = 0x80361110;
w3d_registry_list_80361140 = 0x80361140;
w3d_registry_list_80361170 = 0x80361170;
w3d_registry_list_803611a0 = 0x803611a0;
w3d_registry_list_803611d0 = 0x803611d0;
w3d_registry_list_80361200 = 0x80361200;
w3d_registry_list_80361230 = 0x80361230;
w3d_registry_list_80361260 = 0x80361260;
w3d_registry_list_80361290 = 0x80361290;
w3d_registry_list_803612c0 = 0x803612c0;
w3d_state_register = 0x8020fd04;
SECTIONS {
  .text.w3d_empty_80100744 0x80100744 : { *(.text.w3d_empty_80100744) }
  .text.w3d_get_80102734 0x80102734 : { *(.text.w3d_get_80102734) }
  .text.w3d_address_801041e8 0x801041e8 : { *(.text.w3d_address_801041e8) }
  .text.w3d_registry_unlink_801041f4 0x801041f4 : { *(.text.w3d_registry_unlink_801041f4) }
  .text.w3d_registry_create_80104238 0x80104238 : { *(.text.w3d_registry_create_80104238) }
  .text.w3d_registry_release_80104298 0x80104298 : { *(.text.w3d_registry_release_80104298) }
  .text.w3d_registry_retain_801042f4 0x801042f4 : { *(.text.w3d_registry_retain_801042f4) }
  .text.w3d_constant_80104408 0x80104408 : { *(.text.w3d_constant_80104408) }
  .text.w3d_empty_80104444 0x80104444 : { *(.text.w3d_empty_80104444) }
  .text.w3d_address_80104644 0x80104644 : { *(.text.w3d_address_80104644) }
  .text.w3d_registry_unlink_80104650 0x80104650 : { *(.text.w3d_registry_unlink_80104650) }
  .text.w3d_registry_create_80104694 0x80104694 : { *(.text.w3d_registry_create_80104694) }
  .text.w3d_registry_release_801046f4 0x801046f4 : { *(.text.w3d_registry_release_801046f4) }
  .text.w3d_registry_retain_80104750 0x80104750 : { *(.text.w3d_registry_retain_80104750) }
  .text.w3d_empty_80105ac4 0x80105ac4 : { *(.text.w3d_empty_80105ac4) }
  .text.w3d_address_80106aac 0x80106aac : { *(.text.w3d_address_80106aac) }
  .text.w3d_registry_unlink_80106ab8 0x80106ab8 : { *(.text.w3d_registry_unlink_80106ab8) }
  .text.w3d_registry_release_80106b5c 0x80106b5c : { *(.text.w3d_registry_release_80106b5c) }
  .text.w3d_registry_retain_80106bb8 0x80106bb8 : { *(.text.w3d_registry_retain_80106bb8) }
  .text.w3d_empty_801081ac 0x801081ac : { *(.text.w3d_empty_801081ac) }
  .text.w3d_address_80108244 0x80108244 : { *(.text.w3d_address_80108244) }
  .text.w3d_registry_unlink_80108250 0x80108250 : { *(.text.w3d_registry_unlink_80108250) }
  .text.w3d_registry_create_80108294 0x80108294 : { *(.text.w3d_registry_create_80108294) }
  .text.w3d_registry_release_801082f4 0x801082f4 : { *(.text.w3d_registry_release_801082f4) }
  .text.w3d_registry_retain_80108350 0x80108350 : { *(.text.w3d_registry_retain_80108350) }
  .text.w3d_constant_801084ac 0x801084ac : { *(.text.w3d_constant_801084ac) }
  .text.w3d_address_80109008 0x80109008 : { *(.text.w3d_address_80109008) }
  .text.w3d_registry_unlink_80109014 0x80109014 : { *(.text.w3d_registry_unlink_80109014) }
  .text.w3d_registry_create_80109058 0x80109058 : { *(.text.w3d_registry_create_80109058) }
  .text.w3d_registry_release_801090b8 0x801090b8 : { *(.text.w3d_registry_release_801090b8) }
  .text.w3d_registry_retain_80109114 0x80109114 : { *(.text.w3d_registry_retain_80109114) }
  .text.w3d_constant_8010a0e8 0x8010a0e8 : { *(.text.w3d_constant_8010a0e8) }
  .text.w3d_empty_8010a4ac 0x8010a4ac : { *(.text.w3d_empty_8010a4ac) }
  .text.w3d_address_8010a61c 0x8010a61c : { *(.text.w3d_address_8010a61c) }
  .text.w3d_registry_unlink_8010a628 0x8010a628 : { *(.text.w3d_registry_unlink_8010a628) }
  .text.w3d_registry_create_8010a66c 0x8010a66c : { *(.text.w3d_registry_create_8010a66c) }
  .text.w3d_registry_release_8010a6cc 0x8010a6cc : { *(.text.w3d_registry_release_8010a6cc) }
  .text.w3d_registry_retain_8010a728 0x8010a728 : { *(.text.w3d_registry_retain_8010a728) }
  .text.w3d_constant_8010a848 0x8010a848 : { *(.text.w3d_constant_8010a848) }
  .text.w3d_empty_8010a850 0x8010a850 : { *(.text.w3d_empty_8010a850) }
  .text.w3d_get_8010a8fc 0x8010a8fc : { *(.text.w3d_get_8010a8fc) }
  .text.w3d_empty_8010ad20 0x8010ad20 : { *(.text.w3d_empty_8010ad20) }
  .text.w3d_address_8010d9b8 0x8010d9b8 : { *(.text.w3d_address_8010d9b8) }
  .text.w3d_registry_unlink_8010d9c4 0x8010d9c4 : { *(.text.w3d_registry_unlink_8010d9c4) }
  .text.w3d_registry_create_8010da08 0x8010da08 : { *(.text.w3d_registry_create_8010da08) }
  .text.w3d_registry_release_8010da68 0x8010da68 : { *(.text.w3d_registry_release_8010da68) }
  .text.w3d_registry_retain_8010dac4 0x8010dac4 : { *(.text.w3d_registry_retain_8010dac4) }
  .text.w3d_empty_8010dd40 0x8010dd40 : { *(.text.w3d_empty_8010dd40) }
  .text.w3d_address_8010de5c 0x8010de5c : { *(.text.w3d_address_8010de5c) }
  .text.w3d_registry_unlink_8010de68 0x8010de68 : { *(.text.w3d_registry_unlink_8010de68) }
  .text.w3d_registry_create_8010deac 0x8010deac : { *(.text.w3d_registry_create_8010deac) }
  .text.w3d_registry_release_8010df0c 0x8010df0c : { *(.text.w3d_registry_release_8010df0c) }
  .text.w3d_registry_retain_8010df68 0x8010df68 : { *(.text.w3d_registry_retain_8010df68) }
  .text.w3d_empty_8010e294 0x8010e294 : { *(.text.w3d_empty_8010e294) }
  .text.w3d_address_8010e574 0x8010e574 : { *(.text.w3d_address_8010e574) }
  .text.w3d_registry_unlink_8010e580 0x8010e580 : { *(.text.w3d_registry_unlink_8010e580) }
  .text.w3d_registry_create_8010e5c4 0x8010e5c4 : { *(.text.w3d_registry_create_8010e5c4) }
  .text.w3d_registry_release_8010e624 0x8010e624 : { *(.text.w3d_registry_release_8010e624) }
  .text.w3d_registry_retain_8010e680 0x8010e680 : { *(.text.w3d_registry_retain_8010e680) }
  .text.w3d_constant_8010ee0c 0x8010ee0c : { *(.text.w3d_constant_8010ee0c) }
  .text.w3d_empty_8010f7cc 0x8010f7cc : { *(.text.w3d_empty_8010f7cc) }
  .text.w3d_address_80118ba0 0x80118ba0 : { *(.text.w3d_address_80118ba0) }
  .text.w3d_registry_unlink_80118bac 0x80118bac : { *(.text.w3d_registry_unlink_80118bac) }
  .text.w3d_registry_retain_80118cec 0x80118cec : { *(.text.w3d_registry_retain_80118cec) }
  .text.w3d_get_801190d0 0x801190d0 : { *(.text.w3d_get_801190d0) }
  .text.w3d_address_801191c8 0x801191c8 : { *(.text.w3d_address_801191c8) }
  .text.w3d_registry_unlink_801191d4 0x801191d4 : { *(.text.w3d_registry_unlink_801191d4) }
  .text.w3d_registry_create_80119218 0x80119218 : { *(.text.w3d_registry_create_80119218) }
  .text.w3d_registry_release_80119278 0x80119278 : { *(.text.w3d_registry_release_80119278) }
  .text.w3d_registry_retain_801192d4 0x801192d4 : { *(.text.w3d_registry_retain_801192d4) }
  .text.w3d_constant_80119588 0x80119588 : { *(.text.w3d_constant_80119588) }
  .text.w3d_address_80119cec 0x80119cec : { *(.text.w3d_address_80119cec) }
  .text.w3d_registry_unlink_80119cf8 0x80119cf8 : { *(.text.w3d_registry_unlink_80119cf8) }
  .text.w3d_registry_create_80119d3c 0x80119d3c : { *(.text.w3d_registry_create_80119d3c) }
  .text.w3d_registry_release_80119d9c 0x80119d9c : { *(.text.w3d_registry_release_80119d9c) }
  .text.w3d_registry_retain_80119df8 0x80119df8 : { *(.text.w3d_registry_retain_80119df8) }
  .text.w3d_constant_80119f0c 0x80119f0c : { *(.text.w3d_constant_80119f0c) }
  .text.w3d_empty_80119f14 0x80119f14 : { *(.text.w3d_empty_80119f14) }
  .text.w3d_empty_80119f18 0x80119f18 : { *(.text.w3d_empty_80119f18) }
  .text.w3d_address_80119fa8 0x80119fa8 : { *(.text.w3d_address_80119fa8) }
  /DISCARD/ : { *(.text*) *(.rodata*) *(.data*) *(.bss*) *(.sdata*) *(.sbss*) *(.comment) }
}
