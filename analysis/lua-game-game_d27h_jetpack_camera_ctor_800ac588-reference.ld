/* Generated reference-only placements. All bodies are source-built. */
OUTPUT_FORMAT("elf32-powerpc")
OUTPUT_ARCH(powerpc)
ENTRY(d27h_jetpack_camera_ctor_800ac588)
_SDA_BASE_ = 0x804b2540;
_SDA2_BASE_ = 0x804c2540;
base_8015a0d4 = 0x8015a0d4;
cast_80342a74 = 0x80342a74;
n_80381e38 = 0x80381e38;
n_80381e58 = 0x80381e58;
n_80381e78 = 0x80381e78;
n_80381e98 = 0x80381e98;
n_80381eb8 = 0x80381eb8;
n_80381ed8 = 0x80381ed8;
n_80381ef8 = 0x80381ef8;
n_80381f18 = 0x80381f18;
n_80381f38 = 0x80381f38;
n_80381f58 = 0x80381f58;
n_80381f78 = 0x80381f78;
n_80381f94 = 0x80381f94;
n_80381fb4 = 0x80381fb4;
n_80381fd4 = 0x80381fd4;
read_setting_800fc1b0 = 0x800fc1b0;
vtable_8040f6c0 = 0x8040f6c0;
SECTIONS {
  .text.d27h_jetpack_camera_ctor_800ac588 0x800ac588 : { *(.text.d27h_jetpack_camera_ctor_800ac588) }
  /DISCARD/ : { *(.text*) *(.rodata*) *(.data*) *(.bss*) *(.sdata*) *(.sbss*) *(.comment) }
}
