/* Generated reference-only placements. All bodies are source-built. */
OUTPUT_FORMAT("elf32-powerpc")
OUTPUT_ARCH(powerpc)
ENTRY(w3d_s21_destroy_801e4c48)
_SDA_BASE_ = 0x804b2540;
_SDA2_BASE_ = 0x804c2540;
fn_801e4de8 = 0x801e4de8;
fn_801fe1f8 = 0x801fe1f8;
lbl_80416f38 = 0x80416f38;
SECTIONS {
  .text.w3d_s21_destroy_801e4c48 0x801e4c48 : { *(.text.w3d_s21_destroy_801e4c48) }
  /DISCARD/ : { *(.text*) *(.rodata*) *(.data*) *(.bss*) *(.sdata*) *(.sbss*) *(.comment) }
}
