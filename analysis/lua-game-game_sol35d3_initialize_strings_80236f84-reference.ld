/* Generated reference-only placements. All bodies are source-built. */
OUTPUT_FORMAT("elf32-powerpc")
OUTPUT_ARCH(powerpc)
ENTRY(w3d_sol35d3_initialize_strings_80236f84)
_SDA_BASE_ = 0x804b2540;
_SDA2_BASE_ = 0x804c2540;
fn_801e8d9c = 0x801e8d9c;
fn_801ebf38 = 0x801ebf38;
fn_801ec0f8 = 0x801ec0f8;
fn_801ece2c = 0x801ece2c;
fn_801ed24c = 0x801ed24c;
fn_8020bb2c = 0x8020bb2c;
fn_8020c5c0 = 0x8020c5c0;
fn_8020c5c4 = 0x8020c5c4;
fn_80341588 = 0x80341588;
fn_80341884 = 0x80341884;
lbl_803baec4 = 0x803baec4;
lbl_803baef4 = 0x803baef4;
lbl_803baf1c = 0x803baf1c;
lbl_803baf44 = 0x803baf44;
lbl_803baf78 = 0x803baf78;
lbl_803bafac = 0x803bafac;
lbl_803bafe0 = 0x803bafe0;
lbl_803bb014 = 0x803bb014;
lbl_804b06a0 = 0x804b06a0;
SECTIONS {
  .text.w3d_sol35d3_initialize_strings_80236f84 0x80236f84 : { *(.text.w3d_sol35d3_initialize_strings_80236f84) }
  /DISCARD/ : { *(.text*) *(.rodata*) *(.data*) *(.bss*) *(.sdata*) *(.sbss*) *(.comment) }
}
