/* Generated reference-only placements. All bodies are source-built. */
OUTPUT_FORMAT("elf32-powerpc")
OUTPUT_ARCH(powerpc)
ENTRY(__thunk_28_run_800e2344__8Cc17pTC0PvN21)
_SDA_BASE_ = 0x804b2540;
_SDA2_BASE_ = 0x804c2540;
run_800e21b8__8Cc17pTC1PvT1 = 0x800e21b8;
run_800e2344__8Cc17pTC0PvN21 = 0x800e2344;
run_800e2368__8Cc17pTC2PvT1 = 0x800e2368;
run_800e275c__8Cc17pTC3 = 0x800e275c;
run_800e4414__8Cc17pTC5PvT1 = 0x800e4414;
run_800e45ac__8Cc17pTC4PvN21 = 0x800e45ac;
run_800e45d0__8Cc17pTC6PvT1 = 0x800e45d0;
run_800e4f08__8Cc17pTC7 = 0x800e4f08;
SECTIONS {
  .gnu.linkonce.t.__thunk_28_run_800e2344__8Cc17pTC0PvN21 0x80344d84 : { *(.gnu.linkonce.t.__thunk_28_run_800e2344__8Cc17pTC0PvN21) }
  .gnu.linkonce.t.__thunk_28_run_800e21b8__8Cc17pTC1PvT1 0x80344d8c : { *(.gnu.linkonce.t.__thunk_28_run_800e21b8__8Cc17pTC1PvT1) }
  .gnu.linkonce.t.__thunk_28_run_800e2368__8Cc17pTC2PvT1 0x80344d94 : { *(.gnu.linkonce.t.__thunk_28_run_800e2368__8Cc17pTC2PvT1) }
  .gnu.linkonce.t.__thunk_28_run_800e275c__8Cc17pTC3 0x80344d9c : { *(.gnu.linkonce.t.__thunk_28_run_800e275c__8Cc17pTC3) }
  .gnu.linkonce.t.__thunk_28_run_800e45ac__8Cc17pTC4PvN21 0x80344da4 : { *(.gnu.linkonce.t.__thunk_28_run_800e45ac__8Cc17pTC4PvN21) }
  .gnu.linkonce.t.__thunk_28_run_800e4414__8Cc17pTC5PvT1 0x80344dac : { *(.gnu.linkonce.t.__thunk_28_run_800e4414__8Cc17pTC5PvT1) }
  .gnu.linkonce.t.__thunk_28_run_800e45d0__8Cc17pTC6PvT1 0x80344db4 : { *(.gnu.linkonce.t.__thunk_28_run_800e45d0__8Cc17pTC6PvT1) }
  .gnu.linkonce.t.__thunk_28_run_800e4f08__8Cc17pTC7 0x80344dbc : { *(.gnu.linkonce.t.__thunk_28_run_800e4f08__8Cc17pTC7) }
  /DISCARD/ : { *(.text*) *(.rodata*) *(.data*) *(.bss*) *(.sdata*) *(.sbss*) *(.comment) }
}
