/* Generated reference-only placements. All bodies are source-built. */
OUTPUT_FORMAT("elf32-powerpc")
OUTPUT_ARCH(powerpc)
ENTRY(cc38a_script_find_80102a34)
_SDA_BASE_ = 0x804b2540;
_SDA2_BASE_ = 0x804c2540;
cc38a_compare_802ef234 = 0x802ef234;
cc38a_finish_8020c5c4 = 0x8020c5c4;
cc38a_name_800ffcdc = 0x800ffcdc;
cc38a_release_80341588 = 0x80341588;
SECTIONS {
  .text.cc38a_script_find_80102a34 0x80102a34 : { *(.text.cc38a_script_find_80102a34) }
  /DISCARD/ : { *(.text*) *(.rodata*) *(.data*) *(.bss*) *(.sdata*) *(.sbss*) *(.comment) }
}
