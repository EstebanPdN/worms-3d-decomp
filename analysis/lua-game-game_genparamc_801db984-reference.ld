/* Generated reference-only placements. All bodies are source-built. */
OUTPUT_FORMAT("elf32-powerpc")
OUTPUT_ARCH(powerpc)
ENTRY(w3d_update_typed_children_801db984)
_SDA_BASE_ = 0x804b2540;
_SDA2_BASE_ = 0x804c2540;
SECTIONS {
  .text.w3d_update_typed_children_801db984 0x801db984 : { *(.text.w3d_update_typed_children_801db984) }
  .text.w3d_update_typed_children_801dbadc 0x801dbadc : { *(.text.w3d_update_typed_children_801dbadc) }
  /DISCARD/ : { *(.text*) *(.rodata*) *(.data*) *(.bss*) *(.sdata*) *(.sbss*) *(.comment) }
}
