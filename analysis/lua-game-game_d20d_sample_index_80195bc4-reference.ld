/* Generated reference-only placements. All bodies are source-built. */
OUTPUT_FORMAT("elf32-powerpc")
OUTPUT_ARCH(powerpc)
ENTRY(d20d_sample_index_80195bc4)
_SDA_BASE_ = 0x804b2540;
_SDA2_BASE_ = 0x804c2540;
cc40b_apply_channels_80195fb0 = 0x80195fb0;
fn_80196038 = 0x80196038;
fn_801979fc = 0x801979fc;
w3d_f32_803a8480 = 0x803a8480;
w3d_f32_803a8484 = 0x803a8484;
SECTIONS {
  .text.d20d_sample_index_80195bc4 0x80195bc4 : { *(.text.d20d_sample_index_80195bc4) }
  /DISCARD/ : { *(.text*) *(.rodata*) *(.data*) *(.bss*) *(.sdata*) *(.sbss*) *(.comment) }
}
