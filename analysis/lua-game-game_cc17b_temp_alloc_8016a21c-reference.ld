/* Generated reference-only placements. All bodies are source-built. */
OUTPUT_FORMAT("elf32-powerpc")
OUTPUT_ARCH(powerpc)
ENTRY(w3d_cc17b_temp_alloc_8016a21c)
_SDA_BASE_ = 0x804b2540;
_SDA2_BASE_ = 0x804c2540;
fn_801fcb64 = 0x801fcb64;
message_803a50c4 = 0x803a50c4;
SECTIONS {
  .text.w3d_cc17b_temp_alloc_8016a21c 0x8016a21c : { *(.text.w3d_cc17b_temp_alloc_8016a21c) }
  /DISCARD/ : { *(.text*) *(.rodata*) *(.data*) *(.bss*) *(.sdata*) *(.sbss*) *(.comment) }
}
