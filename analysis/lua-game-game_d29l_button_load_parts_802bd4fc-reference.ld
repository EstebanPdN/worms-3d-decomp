/* Generated reference-only placements. All bodies are source-built. */
OUTPUT_FORMAT("elf32-powerpc")
OUTPUT_ARCH(powerpc)
ENTRY(d29l_button_load_parts_802bd4fc)
_SDA_BASE_ = 0x804b2540;
_SDA2_BASE_ = 0x804c2540;
__3Str = 0x803426b8;
box_803d838c = 0x803d838c;
fn_8015adf4 = 0x8015adf4;
fn_80173f88 = 0x80173f88;
fn_8020bd38 = 0x8020bd38;
fn_8020c5c0 = 0x8020c5c0;
fn_8020c5c4 = 0x8020c5c4;
fn_80263608 = 0x80263608;
fn_802bd354 = 0x802bd354;
fn_802bd8cc = 0x802bd8cc;
fn_80341588 = 0x80341588;
fn_80341884 = 0x80341884;
fn_8034357c = 0x8034357c;
SECTIONS {
  .text.d29l_button_load_parts_802bd4fc 0x802bd4fc : { *(.text.d29l_button_load_parts_802bd4fc) }
  /DISCARD/ : { *(.text*) *(.rodata*) *(.data*) *(.bss*) *(.sdata*) *(.sbss*) *(.comment) }
}
