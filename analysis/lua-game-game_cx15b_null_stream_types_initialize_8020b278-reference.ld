/* Generated reference-only placements. All bodies are source-built. */
OUTPUT_FORMAT("elf32-powerpc")
OUTPUT_ARCH(powerpc)
ENTRY(w3d_cx15b_null_stream_types_initialize_8020b278)
_SDA_BASE_ = 0x804b2540;
_SDA2_BASE_ = 0x804c2540;
construct_8020fbd0 = 0x8020fbd0;
factory_8020af30 = 0x8020af30;
name_803ea248 = 0x803ea248;
name_803ea264 = 0x803ea264;
type_803659b8 = 0x803659b8;
type_803659e8 = 0x803659e8;
SECTIONS {
  .text.w3d_cx15b_null_stream_types_initialize_8020b278 0x8020b278 : { *(.text.w3d_cx15b_null_stream_types_initialize_8020b278) }
  /DISCARD/ : { *(.text*) *(.rodata*) *(.data*) *(.bss*) *(.sdata*) *(.sbss*) *(.comment) }
}
