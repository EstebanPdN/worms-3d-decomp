/* Generated reference-only placements. All bodies are source-built. */
OUTPUT_FORMAT("elf32-powerpc")
OUTPUT_ARCH(powerpc)
ENTRY(d25i_weapon_list_fill_8010fd08)
_SDA_BASE_ = 0x804b2540;
_SDA2_BASE_ = 0x804c2540;
_._19Descriptor_80178474 = 0x80178474;
array_lock_801ef048 = 0x801ef048;
as_table_80341584 = 0x80341584;
class_80419e68 = 0x80419e68;
create_8020b680 = 0x8020b680;
definition_801797b4 = 0x801797b4;
list_append_801ef174 = 0x801ef174;
list_begin_801ef380 = 0x801ef380;
next_setting_800fc69c = 0x800fc69c;
read_key_800fc2b0 = 0x800fc2b0;
string_assign_8020bd38 = 0x8020bd38;
string_release_8020bb2c = 0x8020bb2c;
table_get_80179598 = 0x80179598;
type_803667a8 = 0x803667a8;
SECTIONS {
  .text.d25i_weapon_list_fill_8010fd08 0x8010fd08 : { *(.text.d25i_weapon_list_fill_8010fd08) }
  /DISCARD/ : { *(.text*) *(.rodata*) *(.data*) *(.bss*) *(.sdata*) *(.sbss*) *(.comment) }
}
