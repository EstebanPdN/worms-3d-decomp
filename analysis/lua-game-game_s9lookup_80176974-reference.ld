/* Generated reference-only placements. All bodies are source-built. */
OUTPUT_FORMAT("elf32-powerpc")
OUTPUT_ARCH(powerpc)
ENTRY(s9_lookup_slot_80176974)
_SDA_BASE_ = 0x804b2540;
_SDA2_BASE_ = 0x804c2540;
fn_80177eb0 = 0x80177eb0;
fn_80178c48 = 0x80178c48;
fn_80178d1c = 0x80178d1c;
fn_8017941c = 0x8017941c;
fn_801797b4 = 0x801797b4;
fn_80341584 = 0x80341584;
fn_803426b4 = 0x803426b4;
fn_80342a78 = 0x80342a78;
fn_80343858 = 0x80343858;
SECTIONS {
  .text.s9_lookup_slot_80176974 0x80176974 : { *(.text.s9_lookup_slot_80176974) }
  .text.s9_lookup_slot_801769dc 0x801769dc : { *(.text.s9_lookup_slot_801769dc) }
  .text.s9_lookup_slot_80176b98 0x80176b98 : { *(.text.s9_lookup_slot_80176b98) }
  .text.s9_lookup_slot_80176c00 0x80176c00 : { *(.text.s9_lookup_slot_80176c00) }
  /DISCARD/ : { *(.text*) *(.rodata*) *(.data*) *(.bss*) *(.sdata*) *(.sbss*) *(.comment) }
}
