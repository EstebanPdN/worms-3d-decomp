/* Generated reference-only placements. All bodies are source-built. */
OUTPUT_FORMAT("elf32-powerpc")
OUTPUT_ARCH(powerpc)
ENTRY(w3d_setf_8024a6a0)
_SDA_BASE_ = 0x804b2540;
_SDA2_BASE_ = 0x804c2540;
SECTIONS {
  .text.w3d_setf_8024a6a0 0x8024a6a0 : { *(.text.w3d_setf_8024a6a0) }
  .text.w3d_getf_8024a6a8 0x8024a6a8 : { *(.text.w3d_getf_8024a6a8) }
  .text.w3d_setf_8024a6b0 0x8024a6b0 : { *(.text.w3d_setf_8024a6b0) }
  .text.w3d_getf_8024a6b8 0x8024a6b8 : { *(.text.w3d_getf_8024a6b8) }
  .text.w3d_setf_8024a6c0 0x8024a6c0 : { *(.text.w3d_setf_8024a6c0) }
  .text.w3d_getf_8024a6c8 0x8024a6c8 : { *(.text.w3d_getf_8024a6c8) }
  .text.w3d_setf_8024a6d0 0x8024a6d0 : { *(.text.w3d_setf_8024a6d0) }
  .text.w3d_getf_8024a6d8 0x8024a6d8 : { *(.text.w3d_getf_8024a6d8) }
  .text.w3d_setf_8024a6e0 0x8024a6e0 : { *(.text.w3d_setf_8024a6e0) }
  .text.w3d_getf_8024a6e8 0x8024a6e8 : { *(.text.w3d_getf_8024a6e8) }
  .text.w3d_setf_8024a6f0 0x8024a6f0 : { *(.text.w3d_setf_8024a6f0) }
  .text.w3d_getf_8024a6f8 0x8024a6f8 : { *(.text.w3d_getf_8024a6f8) }
  .text.w3d_setf_8024a700 0x8024a700 : { *(.text.w3d_setf_8024a700) }
  .text.w3d_getf_8024a708 0x8024a708 : { *(.text.w3d_getf_8024a708) }
  .text.w3d_setf_8024a710 0x8024a710 : { *(.text.w3d_setf_8024a710) }
  .text.w3d_getf_8024a718 0x8024a718 : { *(.text.w3d_getf_8024a718) }
  .text.w3d_setf_8024a720 0x8024a720 : { *(.text.w3d_setf_8024a720) }
  .text.w3d_getf_8024a728 0x8024a728 : { *(.text.w3d_getf_8024a728) }
  .text.w3d_setf_8024a730 0x8024a730 : { *(.text.w3d_setf_8024a730) }
  .text.w3d_getf_8024a738 0x8024a738 : { *(.text.w3d_getf_8024a738) }
  .text.w3d_setf_8024a740 0x8024a740 : { *(.text.w3d_setf_8024a740) }
  .text.w3d_getf_8024a748 0x8024a748 : { *(.text.w3d_getf_8024a748) }
  .text.w3d_setf_8024a750 0x8024a750 : { *(.text.w3d_setf_8024a750) }
  .text.w3d_getf_8024a758 0x8024a758 : { *(.text.w3d_getf_8024a758) }
  .text.w3d_setf_8024a760 0x8024a760 : { *(.text.w3d_setf_8024a760) }
  .text.w3d_getf_8024a768 0x8024a768 : { *(.text.w3d_getf_8024a768) }
  .text.w3d_setf_8024a770 0x8024a770 : { *(.text.w3d_setf_8024a770) }
  .text.w3d_getf_8024a778 0x8024a778 : { *(.text.w3d_getf_8024a778) }
  .text.w3d_setf_8024a780 0x8024a780 : { *(.text.w3d_setf_8024a780) }
  .text.w3d_getf_8024a788 0x8024a788 : { *(.text.w3d_getf_8024a788) }
  .text.w3d_setf_8024a790 0x8024a790 : { *(.text.w3d_setf_8024a790) }
  .text.w3d_getf_8024a798 0x8024a798 : { *(.text.w3d_getf_8024a798) }
  .text.w3d_setf_8024a7a0 0x8024a7a0 : { *(.text.w3d_setf_8024a7a0) }
  .text.w3d_getf_8024a7a8 0x8024a7a8 : { *(.text.w3d_getf_8024a7a8) }
  .text.w3d_setf_8024a7b0 0x8024a7b0 : { *(.text.w3d_setf_8024a7b0) }
  .text.w3d_getf_8024a7b8 0x8024a7b8 : { *(.text.w3d_getf_8024a7b8) }
  .text.w3d_setf_8024a7c0 0x8024a7c0 : { *(.text.w3d_setf_8024a7c0) }
  .text.w3d_getf_8024a7c8 0x8024a7c8 : { *(.text.w3d_getf_8024a7c8) }
  .text.w3d_setf_8024a7d0 0x8024a7d0 : { *(.text.w3d_setf_8024a7d0) }
  .text.w3d_getf_8024a7d8 0x8024a7d8 : { *(.text.w3d_getf_8024a7d8) }
  .text.w3d_setf_8024a7e0 0x8024a7e0 : { *(.text.w3d_setf_8024a7e0) }
  .text.w3d_getf_8024a7e8 0x8024a7e8 : { *(.text.w3d_getf_8024a7e8) }
  .text.w3d_setf_8024a7f0 0x8024a7f0 : { *(.text.w3d_setf_8024a7f0) }
  .text.w3d_getf_8024a7f8 0x8024a7f8 : { *(.text.w3d_getf_8024a7f8) }
  .text.w3d_setf_8024a800 0x8024a800 : { *(.text.w3d_setf_8024a800) }
  .text.w3d_getf_8024a808 0x8024a808 : { *(.text.w3d_getf_8024a808) }
  .text.w3d_setf_8024a810 0x8024a810 : { *(.text.w3d_setf_8024a810) }
  .text.w3d_getf_8024a818 0x8024a818 : { *(.text.w3d_getf_8024a818) }
  .text.w3d_setf_8024a820 0x8024a820 : { *(.text.w3d_setf_8024a820) }
  .text.w3d_getf_8024a828 0x8024a828 : { *(.text.w3d_getf_8024a828) }
  .text.w3d_setf_8024a830 0x8024a830 : { *(.text.w3d_setf_8024a830) }
  .text.w3d_getf_8024a838 0x8024a838 : { *(.text.w3d_getf_8024a838) }
  .text.w3d_setf_8024a840 0x8024a840 : { *(.text.w3d_setf_8024a840) }
  .text.w3d_getf_8024a848 0x8024a848 : { *(.text.w3d_getf_8024a848) }
  .text.w3d_setf_8024a850 0x8024a850 : { *(.text.w3d_setf_8024a850) }
  .text.w3d_getf_8024a858 0x8024a858 : { *(.text.w3d_getf_8024a858) }
  .text.w3d_setf_8024a860 0x8024a860 : { *(.text.w3d_setf_8024a860) }
  .text.w3d_getf_8024a868 0x8024a868 : { *(.text.w3d_getf_8024a868) }
  .text.w3d_setf_8024a870 0x8024a870 : { *(.text.w3d_setf_8024a870) }
  .text.w3d_getf_8024a878 0x8024a878 : { *(.text.w3d_getf_8024a878) }
  .text.w3d_setf_8024a880 0x8024a880 : { *(.text.w3d_setf_8024a880) }
  .text.w3d_getf_8024a888 0x8024a888 : { *(.text.w3d_getf_8024a888) }
  .text.w3d_setf_8024a890 0x8024a890 : { *(.text.w3d_setf_8024a890) }
  .text.w3d_getf_8024a898 0x8024a898 : { *(.text.w3d_getf_8024a898) }
  .text.w3d_setf_8024a8b0 0x8024a8b0 : { *(.text.w3d_setf_8024a8b0) }
  .text.w3d_getf_8024a8b8 0x8024a8b8 : { *(.text.w3d_getf_8024a8b8) }
  .text.w3d_setf_8024a8c0 0x8024a8c0 : { *(.text.w3d_setf_8024a8c0) }
  .text.w3d_getf_8024a8c8 0x8024a8c8 : { *(.text.w3d_getf_8024a8c8) }
  .text.w3d_setf_8024a8d0 0x8024a8d0 : { *(.text.w3d_setf_8024a8d0) }
  .text.w3d_getf_8024a8d8 0x8024a8d8 : { *(.text.w3d_getf_8024a8d8) }
  .text.w3d_setf_8024a8e0 0x8024a8e0 : { *(.text.w3d_setf_8024a8e0) }
  .text.w3d_getf_8024a8e8 0x8024a8e8 : { *(.text.w3d_getf_8024a8e8) }
  .text.w3d_setf_8024a8f0 0x8024a8f0 : { *(.text.w3d_setf_8024a8f0) }
  .text.w3d_getf_8024a8f8 0x8024a8f8 : { *(.text.w3d_getf_8024a8f8) }
  .text.w3d_setf_8024a900 0x8024a900 : { *(.text.w3d_setf_8024a900) }
  .text.w3d_getf_8024a908 0x8024a908 : { *(.text.w3d_getf_8024a908) }
  .text.w3d_member_8024a978 0x8024a978 : { *(.text.w3d_member_8024a978) }
  .text.w3d_setf_8024a980 0x8024a980 : { *(.text.w3d_setf_8024a980) }
  .text.w3d_getf_8024a988 0x8024a988 : { *(.text.w3d_getf_8024a988) }
  .text.w3d_setf_8024a990 0x8024a990 : { *(.text.w3d_setf_8024a990) }
  /DISCARD/ : { *(.text*) *(.rodata*) *(.data*) *(.bss*) *(.sdata*) *(.sbss*) *(.comment) }
}
