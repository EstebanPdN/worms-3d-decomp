/* Generated reference-only placements. All bodies are source-built. */
OUTPUT_FORMAT("elf32-powerpc")
OUTPUT_ARCH(powerpc)
ENTRY(d30j_solve_attachment_matrix_80181e3c)
_SDA_BASE_ = 0x804b2540;
_SDA2_BASE_ = 0x804c2540;
fn_801ef380 = 0x801ef380;
lbl_804140d0 = 0x804140d0;
lbl_80414a40 = 0x80414a40;
lbl_804163f8 = 0x804163f8;
lbl_804164c0 = 0x804164c0;
w3d_k5b_iface_array_field_append_801ef174 = 0x801ef174;
w3d_s10_service_forward_8020b680 = 0x8020b680;
SECTIONS {
  .text.d30j_solve_attachment_matrix_80181e3c 0x80181e3c : { *(.text.d30j_solve_attachment_matrix_80181e3c) }
  /DISCARD/ : { *(.text*) *(.rodata*) *(.data*) *(.bss*) *(.sdata*) *(.sbss*) *(.comment) }
}
