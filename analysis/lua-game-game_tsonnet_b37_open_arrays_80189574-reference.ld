/* Generated reference-only placements. All bodies are source-built. */
OUTPUT_FORMAT("elf32-powerpc")
OUTPUT_ARCH(powerpc)
ENTRY(tsonnet_b37_open_80189574)
_SDA_BASE_ = 0x804b2540;
_SDA2_BASE_ = 0x804c2540;
fn_801ef048 = 0x801ef048;
SECTIONS {
  .text.tsonnet_b37_open_80189574 0x80189574 : { *(.text.tsonnet_b37_open_80189574) }
  .text.tsonnet_b37_open_8018963c 0x8018963c : { *(.text.tsonnet_b37_open_8018963c) }
  .text.tsonnet_b37_open_80189760 0x80189760 : { *(.text.tsonnet_b37_open_80189760) }
  /DISCARD/ : { *(.text*) *(.rodata*) *(.data*) *(.bss*) *(.sdata*) *(.sbss*) *(.comment) }
}
