/* Generated reference-only placements. All bodies are source-built. */
OUTPUT_FORMAT("elf32-powerpc")
OUTPUT_ARCH(powerpc)
ENTRY(w3d_s20_apply_record_8016c240)
_SDA_BASE_ = 0x804b2540;
_SDA2_BASE_ = 0x804c2540;
fn_8016c014 = 0x8016c014;
fn_8016c1f4 = 0x8016c1f4;
fn_801a2bf4 = 0x801a2bf4;
fn_801d0858 = 0x801d0858;
fn_803080a4 = 0x803080a4;
fn_8030ae60 = 0x8030ae60;
fn_8030ae84 = 0x8030ae84;
fn_8030b648 = 0x8030b648;
SECTIONS {
  .text.w3d_s20_apply_record_8016c240 0x8016c240 : { *(.text.w3d_s20_apply_record_8016c240) }
  /DISCARD/ : { *(.text*) *(.rodata*) *(.data*) *(.bss*) *(.sdata*) *(.sbss*) *(.comment) }
}
