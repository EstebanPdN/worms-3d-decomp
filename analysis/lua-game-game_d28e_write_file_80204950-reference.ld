/* Generated reference-only placements. All bodies are source-built. */
OUTPUT_FORMAT("elf32-powerpc")
OUTPUT_ARCH(powerpc)
ENTRY(w3d_d28e_write_file_80204950)
_SDA_BASE_ = 0x804b2540;
_SDA2_BASE_ = 0x804c2540;
alloc_80212fd4 = 0x80212fd4;
f7c_guids_80204f08 = 0x80204f08;
f7c_header_80204c18 = 0x80204c18;
f7c_types_80204d88 = 0x80204d88;
fn_80204850 = 0x80204850;
fn_80204ffc = 0x80204ffc;
fn_80205258 = 0x80205258;
fn_80205654 = 0x80205654;
free_802134fc = 0x802134fc;
memcpy_802eee50 = 0x802eee50;
w3d_auto_801ffea8 = 0x801ffea8;
w3d_auto_80205648 = 0x80205648;
w3d_rb_increment_80351ef8 = 0x80351ef8;
SECTIONS {
  .text.w3d_d28e_write_file_80204950 0x80204950 : { *(.text.w3d_d28e_write_file_80204950) }
  /DISCARD/ : { *(.text*) *(.rodata*) *(.data*) *(.bss*) *(.sdata*) *(.sbss*) *(.comment) }
}
