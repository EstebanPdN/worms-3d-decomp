/* Generated reference-only placements. All bodies are source-built. */
OUTPUT_FORMAT("elf32-powerpc")
OUTPUT_ARCH(powerpc)
ENTRY(w3d_set_80249a4c)
_SDA_BASE_ = 0x804b2540;
_SDA2_BASE_ = 0x804c2540;
SECTIONS {
  .text.w3d_set_80249a4c 0x80249a4c : { *(.text.w3d_set_80249a4c) }
  .text.w3d_get_80249a54 0x80249a54 : { *(.text.w3d_get_80249a54) }
  .text.w3d_set_80249a5c 0x80249a5c : { *(.text.w3d_set_80249a5c) }
  .text.w3d_get_80249a64 0x80249a64 : { *(.text.w3d_get_80249a64) }
  .text.w3d_set_80249a6c 0x80249a6c : { *(.text.w3d_set_80249a6c) }
  .text.w3d_get_80249a74 0x80249a74 : { *(.text.w3d_get_80249a74) }
  .text.w3d_set_80249a7c 0x80249a7c : { *(.text.w3d_set_80249a7c) }
  .text.w3d_get_80249a84 0x80249a84 : { *(.text.w3d_get_80249a84) }
  .text.w3d_set_80249a8c 0x80249a8c : { *(.text.w3d_set_80249a8c) }
  .text.w3d_get_80249a94 0x80249a94 : { *(.text.w3d_get_80249a94) }
  .text.w3d_set_80249a9c 0x80249a9c : { *(.text.w3d_set_80249a9c) }
  .text.w3d_get_80249aa4 0x80249aa4 : { *(.text.w3d_get_80249aa4) }
  .text.w3d_set_80249aac 0x80249aac : { *(.text.w3d_set_80249aac) }
  .text.w3d_get_80249ab4 0x80249ab4 : { *(.text.w3d_get_80249ab4) }
  .text.w3d_set_80249abc 0x80249abc : { *(.text.w3d_set_80249abc) }
  .text.w3d_get_80249ac4 0x80249ac4 : { *(.text.w3d_get_80249ac4) }
  .text.w3d_set_80249acc 0x80249acc : { *(.text.w3d_set_80249acc) }
  .text.w3d_get_80249ad4 0x80249ad4 : { *(.text.w3d_get_80249ad4) }
  .text.w3d_set_80249adc 0x80249adc : { *(.text.w3d_set_80249adc) }
  .text.w3d_get_80249ae4 0x80249ae4 : { *(.text.w3d_get_80249ae4) }
  .text.w3d_set_80249aec 0x80249aec : { *(.text.w3d_set_80249aec) }
  .text.w3d_get_80249af4 0x80249af4 : { *(.text.w3d_get_80249af4) }
  .text.w3d_set_80249afc 0x80249afc : { *(.text.w3d_set_80249afc) }
  .text.w3d_get_80249b04 0x80249b04 : { *(.text.w3d_get_80249b04) }
  .text.w3d_set_80249b7c 0x80249b7c : { *(.text.w3d_set_80249b7c) }
  .text.w3d_get_80249b84 0x80249b84 : { *(.text.w3d_get_80249b84) }
  .text.w3d_set_80249b8c 0x80249b8c : { *(.text.w3d_set_80249b8c) }
  .text.w3d_get_80249b94 0x80249b94 : { *(.text.w3d_get_80249b94) }
  .text.w3d_set_80249b9c 0x80249b9c : { *(.text.w3d_set_80249b9c) }
  .text.w3d_get_80249ba4 0x80249ba4 : { *(.text.w3d_get_80249ba4) }
  .text.w3d_set_80249c1c 0x80249c1c : { *(.text.w3d_set_80249c1c) }
  .text.w3d_get_80249c24 0x80249c24 : { *(.text.w3d_get_80249c24) }
  .text.w3d_set_80249d5c 0x80249d5c : { *(.text.w3d_set_80249d5c) }
  .text.w3d_get_80249d64 0x80249d64 : { *(.text.w3d_get_80249d64) }
  .text.w3d_set_80249d6c 0x80249d6c : { *(.text.w3d_set_80249d6c) }
  .text.w3d_get_80249d74 0x80249d74 : { *(.text.w3d_get_80249d74) }
  .text.w3d_set_80249d7c 0x80249d7c : { *(.text.w3d_set_80249d7c) }
  .text.w3d_get_80249d84 0x80249d84 : { *(.text.w3d_get_80249d84) }
  .text.w3d_set_80249d8c 0x80249d8c : { *(.text.w3d_set_80249d8c) }
  .text.w3d_get_80249d94 0x80249d94 : { *(.text.w3d_get_80249d94) }
  .text.w3d_set_80249d9c 0x80249d9c : { *(.text.w3d_set_80249d9c) }
  .text.w3d_get_80249da4 0x80249da4 : { *(.text.w3d_get_80249da4) }
  .text.w3d_set_80249dac 0x80249dac : { *(.text.w3d_set_80249dac) }
  .text.w3d_get_80249db4 0x80249db4 : { *(.text.w3d_get_80249db4) }
  .text.w3d_set_80249dbc 0x80249dbc : { *(.text.w3d_set_80249dbc) }
  .text.w3d_get_80249dc4 0x80249dc4 : { *(.text.w3d_get_80249dc4) }
  .text.w3d_set_80249dcc 0x80249dcc : { *(.text.w3d_set_80249dcc) }
  .text.w3d_get_80249dd4 0x80249dd4 : { *(.text.w3d_get_80249dd4) }
  .text.w3d_set_80249ddc 0x80249ddc : { *(.text.w3d_set_80249ddc) }
  .text.w3d_get_80249de4 0x80249de4 : { *(.text.w3d_get_80249de4) }
  .text.w3d_set_80249f1c 0x80249f1c : { *(.text.w3d_set_80249f1c) }
  .text.w3d_get_80249f24 0x80249f24 : { *(.text.w3d_get_80249f24) }
  .text.w3d_set_80249f9c 0x80249f9c : { *(.text.w3d_set_80249f9c) }
  .text.w3d_get_80249fa4 0x80249fa4 : { *(.text.w3d_get_80249fa4) }
  .text.w3d_set_80249fac 0x80249fac : { *(.text.w3d_set_80249fac) }
  .text.w3d_get_80249fb4 0x80249fb4 : { *(.text.w3d_get_80249fb4) }
  .text.w3d_set_80249fd8 0x80249fd8 : { *(.text.w3d_set_80249fd8) }
  .text.w3d_get_80249fe0 0x80249fe0 : { *(.text.w3d_get_80249fe0) }
  .text.w3d_set_8024a098 0x8024a098 : { *(.text.w3d_set_8024a098) }
  .text.w3d_get_8024a0a0 0x8024a0a0 : { *(.text.w3d_get_8024a0a0) }
  .text.w3d_set_8024a0b8 0x8024a0b8 : { *(.text.w3d_set_8024a0b8) }
  .text.w3d_get_8024a0c0 0x8024a0c0 : { *(.text.w3d_get_8024a0c0) }
  .text.w3d_set_8024a0e8 0x8024a0e8 : { *(.text.w3d_set_8024a0e8) }
  .text.w3d_get_8024a0f0 0x8024a0f0 : { *(.text.w3d_get_8024a0f0) }
  .text.w3d_set_8024a0f8 0x8024a0f8 : { *(.text.w3d_set_8024a0f8) }
  .text.w3d_get_8024a100 0x8024a100 : { *(.text.w3d_get_8024a100) }
  .text.w3d_set_8024a108 0x8024a108 : { *(.text.w3d_set_8024a108) }
  .text.w3d_get_8024a110 0x8024a110 : { *(.text.w3d_get_8024a110) }
  .text.w3d_set_8024a118 0x8024a118 : { *(.text.w3d_set_8024a118) }
  .text.w3d_get_8024a120 0x8024a120 : { *(.text.w3d_get_8024a120) }
  .text.w3d_set_8024a178 0x8024a178 : { *(.text.w3d_set_8024a178) }
  .text.w3d_get_8024a180 0x8024a180 : { *(.text.w3d_get_8024a180) }
  .text.w3d_set_8024a188 0x8024a188 : { *(.text.w3d_set_8024a188) }
  .text.w3d_get_8024a190 0x8024a190 : { *(.text.w3d_get_8024a190) }
  .text.w3d_set_8024a198 0x8024a198 : { *(.text.w3d_set_8024a198) }
  .text.w3d_get_8024a1a0 0x8024a1a0 : { *(.text.w3d_get_8024a1a0) }
  .text.w3d_set_8024a1a8 0x8024a1a8 : { *(.text.w3d_set_8024a1a8) }
  .text.w3d_get_8024a1b0 0x8024a1b0 : { *(.text.w3d_get_8024a1b0) }
  .text.w3d_set_8024a210 0x8024a210 : { *(.text.w3d_set_8024a210) }
  .text.w3d_get_8024a218 0x8024a218 : { *(.text.w3d_get_8024a218) }
  /DISCARD/ : { *(.text*) *(.rodata*) *(.data*) *(.bss*) *(.sdata*) *(.sbss*) *(.comment) }
}
