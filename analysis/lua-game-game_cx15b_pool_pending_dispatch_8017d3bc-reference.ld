/* Generated reference-only placements. All bodies are source-built. */
OUTPUT_FORMAT("elf32-powerpc")
OUTPUT_ARCH(powerpc)
ENTRY(w3d_cx15b_pool_pending_dispatch_8017d3bc)
_SDA_BASE_ = 0x804b2540;
_SDA2_BASE_ = 0x804c2540;
enabled_804a8dd8 = 0x804a8dd8;
owned_804a89d8 = 0x804a89d8;
pending_804a8bd8 = 0x804a8bd8;
SECTIONS {
  .text.w3d_cx15b_pool_pending_dispatch_8017d3bc 0x8017d3bc : { *(.text.w3d_cx15b_pool_pending_dispatch_8017d3bc) }
  /DISCARD/ : { *(.text*) *(.rodata*) *(.data*) *(.bss*) *(.sdata*) *(.sbss*) *(.comment) }
}
