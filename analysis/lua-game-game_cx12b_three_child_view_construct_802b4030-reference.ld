/* Generated reference-only placements. All bodies are source-built. */
OUTPUT_FORMAT("elf32-powerpc")
OUTPUT_ARCH(powerpc)
ENTRY(w3d_cx12b_three_child_view_construct_802b4030)
_SDA_BASE_ = 0x804b2540;
_SDA2_BASE_ = 0x804c2540;
base_8015fef0 = 0x8015fef0;
member_802afb20 = 0x802afb20;
table_8041c6b0 = 0x8041c6b0;
table_8041c700 = 0x8041c700;
SECTIONS {
  .text.w3d_cx12b_three_child_view_construct_802b4030 0x802b4030 : { *(.text.w3d_cx12b_three_child_view_construct_802b4030) }
  /DISCARD/ : { *(.text*) *(.rodata*) *(.data*) *(.bss*) *(.sdata*) *(.sbss*) *(.comment) }
}
