/* Generated reference-only placements. All bodies are source-built. */
OUTPUT_FORMAT("elf32-powerpc")
OUTPUT_ARCH(powerpc)
ENTRY(w3d_s21_open_child_resource_80218608)
_SDA_BASE_ = 0x804b2540;
_SDA2_BASE_ = 0x804c2540;
fn_801fe1d8__Fi = 0x801fe1d8;
fn_8020bd38__FP7S21PathPCc = 0x8020bd38;
fn_8020bf2c__FP7S21PathPCc = 0x8020bf2c;
fn_8020c5c0__FP7S21Path = 0x8020c5c0;
fn_8020c5c4__FP7S21Path = 0x8020c5c4;
fn_80218194__FP7S21Path = 0x80218194;
fn_80218300__FPv = 0x80218300;
fn_80218774__FP9S21StreamP20S21ResourceDirectoryP7S21Path = 0x80218774;
fn_80341588__FP7S21Path = 0x80341588;
fn_80341884__FP7S21Path = 0x80341884;
lbl_803b387c = 0x803b387c;
SECTIONS {
  .text.w3d_s21_open_child_resource_80218608 0x80218608 : { *(.text.w3d_s21_open_child_resource_80218608) }
  /DISCARD/ : { *(.text*) *(.rodata*) *(.data*) *(.bss*) *(.sdata*) *(.sbss*) *(.comment) }
}
