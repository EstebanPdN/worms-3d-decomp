/* Generated reference-only placements. All bodies are source-built. */
OUTPUT_FORMAT("elf32-powerpc")
OUTPUT_ARCH(powerpc)
ENTRY(s19_lookup_slot_8008c454)
_SDA_BASE_ = 0x804b2540;
_SDA2_BASE_ = 0x804c2540;
w3d_s20_lookup_handle_object_80164fc8 = 0x80164fc8;
SECTIONS {
  .text.s19_lookup_slot_8008c454 0x8008c454 : { *(.text.s19_lookup_slot_8008c454) }
  .text.s19_lookup_slot_8008c548 0x8008c548 : { *(.text.s19_lookup_slot_8008c548) }
  /DISCARD/ : { *(.text*) *(.rodata*) *(.data*) *(.bss*) *(.sdata*) *(.sbss*) *(.comment) }
}
