/* Generated reference-only placements. All bodies are source-built. */
OUTPUT_FORMAT("elf32-powerpc")
OUTPUT_ARCH(powerpc)
ENTRY(f9b_choose_crate_8008a76c)
_SDA_BASE_ = 0x804b2540;
_SDA2_BASE_ = 0x804c2540;
contents_8037da74 = 0x8037da74;
random_80162ba8 = 0x80162ba8;
set_800fc550 = 0x800fc550;
total_8008da54 = 0x8008da54;
weapons_803eb63c = 0x803eb63c;
weights_80431db8 = 0x80431db8;
SECTIONS {
  .text.f9b_choose_crate_8008a76c 0x8008a76c : { *(.text.f9b_choose_crate_8008a76c) }
  /DISCARD/ : { *(.text*) *(.rodata*) *(.data*) *(.bss*) *(.sdata*) *(.sbss*) *(.comment) }
}
