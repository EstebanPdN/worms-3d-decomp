/* Generated reference-only placements. All bodies are source-built. */
OUTPUT_FORMAT("elf32-powerpc")
OUTPUT_ARCH(powerpc)
ENTRY(d24j_load_buffer_8019805c)
_SDA_BASE_ = 0x804b2540;
_SDA2_BASE_ = 0x804c2540;
fn_801981d0 = 0x801981d0;
fn_801981f8 = 0x801981f8;
fn_8020f3b0 = 0x8020f3b0;
fn_8020f618 = 0x8020f618;
fn_802fb7ac = 0x802fb7ac;
fn_80343810 = 0x80343810;
fn_80343944 = 0x80343944;
text_803a854c = 0x803a854c;
SECTIONS {
  .text.d24j_load_buffer_8019805c 0x8019805c : { *(.text.d24j_load_buffer_8019805c) }
  /DISCARD/ : { *(.text*) *(.rodata*) *(.data*) *(.bss*) *(.sdata*) *(.sbss*) *(.comment) }
}
