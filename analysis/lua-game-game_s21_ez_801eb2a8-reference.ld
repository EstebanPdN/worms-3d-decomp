/* Generated reference-only placements. All bodies are source-built. */
OUTPUT_FORMAT("elf32-powerpc")
OUTPUT_ARCH(powerpc)
ENTRY(w3d_s21_find_entry_801eb2a8)
_SDA_BASE_ = 0x804b2540;
_SDA2_BASE_ = 0x804c2540;
fn_801eb29c = 0x801eb29c;
fn_802ef234 = 0x802ef234;
SECTIONS {
  .text.w3d_s21_find_entry_801eb2a8 0x801eb2a8 : { *(.text.w3d_s21_find_entry_801eb2a8) }
  /DISCARD/ : { *(.text*) *(.rodata*) *(.data*) *(.bss*) *(.sdata*) *(.sbss*) *(.comment) }
}
