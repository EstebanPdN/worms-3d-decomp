/* Generated reference-only placements. All bodies are source-built. */
OUTPUT_FORMAT("elf32-powerpc")
OUTPUT_ARCH(powerpc)
ENTRY(d25f_vector_component_edit_80279dc0)
_SDA_BASE_ = 0x804b2540;
_SDA2_BASE_ = 0x804c2540;
atof = 0x802ed878;
fn_802cc0ac = 0x802cc0ac;
w3d_auto_8027a98c = 0x8027a98c;
w3d_cx7b_script_flag_set_8027a934 = 0x8027a934;
w3d_s21_append_position_802cd26c = 0x802cd26c;
w3d_s21_sink_write_indexed_802cbdf8 = 0x802cbdf8;
w3d_s21_vector_get_801e9db8 = 0x801e9db8;
w3d_str_803ce688 = 0x803ce688;
w3d_string_base_finish = 0x8020c5c4;
w3d_string_default = 0x803426b8;
w3d_string_release = 0x80341588;
SECTIONS {
  .text.d25f_vector_component_edit_80279dc0 0x80279dc0 : { *(.text.d25f_vector_component_edit_80279dc0) }
  /DISCARD/ : { *(.text*) *(.rodata*) *(.data*) *(.bss*) *(.sdata*) *(.sbss*) *(.comment) }
}
