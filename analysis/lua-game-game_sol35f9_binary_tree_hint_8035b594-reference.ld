/* Generated reference-only placements. All bodies are source-built. */
OUTPUT_FORMAT("elf32-powerpc")
OUTPUT_ARCH(powerpc)
ENTRY(sol35f9_binary_tree_hint_8035b594)
_SDA_BASE_ = 0x804b2540;
_SDA2_BASE_ = 0x804c2540;
sol35f9_binary_hint_8035b594_insert_8035b32c = 0x8035b32c;
sol35f9_binary_hint_8035b594_memcmp_802eedc0 = 0x802eedc0;
sol35f9_binary_hint_8035b594_next_80351ef8 = 0x80351ef8;
sol35f9_binary_hint_8035b594_previous_803526a0 = 0x803526a0;
sol35f9_binary_hint_8035b594_unique_8035b478 = 0x8035b478;
SECTIONS {
  .text.sol35f9_binary_tree_hint_8035b594 0x8035b594 : { *(.text.sol35f9_binary_tree_hint_8035b594) }
  /DISCARD/ : { *(.text*) *(.rodata*) *(.data*) *(.bss*) *(.sdata*) *(.sbss*) *(.comment) }
}
