/* Generated reference-only placements. All bodies are source-built. */
OUTPUT_FORMAT("elf32-powerpc")
OUTPUT_ARCH(powerpc)
ENTRY(d29j_shut_down_pools_8017c26c)
_SDA_BASE_ = 0x804b2540;
_SDA2_BASE_ = 0x804c2540;
fn_801709b0 = 0x801709b0;
fn_80170b18 = 0x80170b18;
fn_801743b4 = 0x801743b4;
fn_80174528 = 0x80174528;
fn_8017f3b8 = 0x8017f3b8;
fn_8017f52c = 0x8017f52c;
fn_80182850 = 0x80182850;
fn_801829c4 = 0x801829c4;
fn_80183d48 = 0x80183d48;
fn_801875e0 = 0x801875e0;
fn_80187754 = 0x80187754;
fn_8018a678 = 0x8018a678;
fn_8018a7ec = 0x8018a7ec;
fn_8020c5c0 = 0x8020c5c0;
fn_8020c5c4 = 0x8020c5c4;
fn_80341588 = 0x80341588;
fn_80341884 = 0x80341884;
SECTIONS {
  .text.d29j_shut_down_pools_8017c26c 0x8017c26c : { *(.text.d29j_shut_down_pools_8017c26c) }
  /DISCARD/ : { *(.text*) *(.rodata*) *(.data*) *(.bss*) *(.sdata*) *(.sbss*) *(.comment) }
}
