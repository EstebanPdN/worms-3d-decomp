/* Generated reference-only placements. All bodies are source-built. */
OUTPUT_FORMAT("elf32-powerpc")
OUTPUT_ARCH(powerpc)
ENTRY(w3d_get_8023080c)
_SDA_BASE_ = 0x804b2540;
_SDA2_BASE_ = 0x804c2540;
SECTIONS {
  .text.w3d_get_8023080c 0x8023080c : { *(.text.w3d_get_8023080c) }
  .text.w3d_set_802309d4 0x802309d4 : { *(.text.w3d_set_802309d4) }
  .text.w3d_get_802309dc 0x802309dc : { *(.text.w3d_get_802309dc) }
  .text.w3d_set_802309e4 0x802309e4 : { *(.text.w3d_set_802309e4) }
  .text.w3d_get_802309ec 0x802309ec : { *(.text.w3d_get_802309ec) }
  .text.w3d_set_802309f4 0x802309f4 : { *(.text.w3d_set_802309f4) }
  .text.w3d_get_802309fc 0x802309fc : { *(.text.w3d_get_802309fc) }
  .text.w3d_set_80230a04 0x80230a04 : { *(.text.w3d_set_80230a04) }
  .text.w3d_get_80230a0c 0x80230a0c : { *(.text.w3d_get_80230a0c) }
  .text.w3d_set_80230a34 0x80230a34 : { *(.text.w3d_set_80230a34) }
  .text.w3d_get_80230a3c 0x80230a3c : { *(.text.w3d_get_80230a3c) }
  .text.w3d_set_80230a44 0x80230a44 : { *(.text.w3d_set_80230a44) }
  .text.w3d_get_80230a4c 0x80230a4c : { *(.text.w3d_get_80230a4c) }
  .text.w3d_set_80230c84 0x80230c84 : { *(.text.w3d_set_80230c84) }
  .text.w3d_get_80230c8c 0x80230c8c : { *(.text.w3d_get_80230c8c) }
  .text.w3d_set_80230c94 0x80230c94 : { *(.text.w3d_set_80230c94) }
  .text.w3d_get_80230c9c 0x80230c9c : { *(.text.w3d_get_80230c9c) }
  .text.w3d_set_80230ca4 0x80230ca4 : { *(.text.w3d_set_80230ca4) }
  .text.w3d_get_80230cac 0x80230cac : { *(.text.w3d_get_80230cac) }
  .text.w3d_set_80230cb4 0x80230cb4 : { *(.text.w3d_set_80230cb4) }
  .text.w3d_get_80230cbc 0x80230cbc : { *(.text.w3d_get_80230cbc) }
  .text.w3d_set_80230de4 0x80230de4 : { *(.text.w3d_set_80230de4) }
  .text.w3d_get_80230dec 0x80230dec : { *(.text.w3d_get_80230dec) }
  .text.w3d_set_80230fc4 0x80230fc4 : { *(.text.w3d_set_80230fc4) }
  .text.w3d_get_80230fcc 0x80230fcc : { *(.text.w3d_get_80230fcc) }
  .text.w3d_set_80231334 0x80231334 : { *(.text.w3d_set_80231334) }
  .text.w3d_get_8023133c 0x8023133c : { *(.text.w3d_get_8023133c) }
  .text.w3d_set_802315e4 0x802315e4 : { *(.text.w3d_set_802315e4) }
  .text.w3d_get_802315ec 0x802315ec : { *(.text.w3d_get_802315ec) }
  .text.w3d_set_802315f4 0x802315f4 : { *(.text.w3d_set_802315f4) }
  .text.w3d_get_802315fc 0x802315fc : { *(.text.w3d_get_802315fc) }
  .text.w3d_set_80231604 0x80231604 : { *(.text.w3d_set_80231604) }
  .text.w3d_get_8023160c 0x8023160c : { *(.text.w3d_get_8023160c) }
  .text.w3d_set_802318d4 0x802318d4 : { *(.text.w3d_set_802318d4) }
  .text.w3d_get_802318dc 0x802318dc : { *(.text.w3d_get_802318dc) }
  .text.w3d_set_802318e4 0x802318e4 : { *(.text.w3d_set_802318e4) }
  .text.w3d_get_802318ec 0x802318ec : { *(.text.w3d_get_802318ec) }
  .text.w3d_set_802318f4 0x802318f4 : { *(.text.w3d_set_802318f4) }
  .text.w3d_get_802318fc 0x802318fc : { *(.text.w3d_get_802318fc) }
  .text.w3d_set_802319e4 0x802319e4 : { *(.text.w3d_set_802319e4) }
  .text.w3d_get_802319ec 0x802319ec : { *(.text.w3d_get_802319ec) }
  .text.w3d_set_802319f4 0x802319f4 : { *(.text.w3d_set_802319f4) }
  .text.w3d_get_802319fc 0x802319fc : { *(.text.w3d_get_802319fc) }
  .text.w3d_set_80231ca4 0x80231ca4 : { *(.text.w3d_set_80231ca4) }
  .text.w3d_get_80231cac 0x80231cac : { *(.text.w3d_get_80231cac) }
  .text.w3d_set_80231cb4 0x80231cb4 : { *(.text.w3d_set_80231cb4) }
  .text.w3d_get_80231cbc 0x80231cbc : { *(.text.w3d_get_80231cbc) }
  .text.w3d_set_80231d54 0x80231d54 : { *(.text.w3d_set_80231d54) }
  .text.w3d_get_80231d5c 0x80231d5c : { *(.text.w3d_get_80231d5c) }
  .text.w3d_set_80231d64 0x80231d64 : { *(.text.w3d_set_80231d64) }
  .text.w3d_get_80231d6c 0x80231d6c : { *(.text.w3d_get_80231d6c) }
  .text.w3d_set_80231d74 0x80231d74 : { *(.text.w3d_set_80231d74) }
  .text.w3d_get_80231d7c 0x80231d7c : { *(.text.w3d_get_80231d7c) }
  .text.w3d_set_80231df4 0x80231df4 : { *(.text.w3d_set_80231df4) }
  .text.w3d_get_80231dfc 0x80231dfc : { *(.text.w3d_get_80231dfc) }
  .text.w3d_set_80231e84 0x80231e84 : { *(.text.w3d_set_80231e84) }
  .text.w3d_get_80231e8c 0x80231e8c : { *(.text.w3d_get_80231e8c) }
  .text.w3d_set_80231e94 0x80231e94 : { *(.text.w3d_set_80231e94) }
  .text.w3d_get_80231e9c 0x80231e9c : { *(.text.w3d_get_80231e9c) }
  .text.w3d_set_80231ffc 0x80231ffc : { *(.text.w3d_set_80231ffc) }
  .text.w3d_get_80232004 0x80232004 : { *(.text.w3d_get_80232004) }
  .text.w3d_set_8023200c 0x8023200c : { *(.text.w3d_set_8023200c) }
  .text.w3d_get_80232014 0x80232014 : { *(.text.w3d_get_80232014) }
  .text.w3d_set_8023201c 0x8023201c : { *(.text.w3d_set_8023201c) }
  .text.w3d_get_80232024 0x80232024 : { *(.text.w3d_get_80232024) }
  .text.w3d_set_8023202c 0x8023202c : { *(.text.w3d_set_8023202c) }
  .text.w3d_get_80232034 0x80232034 : { *(.text.w3d_get_80232034) }
  .text.w3d_set_8023203c 0x8023203c : { *(.text.w3d_set_8023203c) }
  .text.w3d_get_80232044 0x80232044 : { *(.text.w3d_get_80232044) }
  .text.w3d_set_8023212c 0x8023212c : { *(.text.w3d_set_8023212c) }
  .text.w3d_get_80232134 0x80232134 : { *(.text.w3d_get_80232134) }
  .text.w3d_set_802321ac 0x802321ac : { *(.text.w3d_set_802321ac) }
  .text.w3d_get_802321b4 0x802321b4 : { *(.text.w3d_get_802321b4) }
  .text.w3d_set_802321bc 0x802321bc : { *(.text.w3d_set_802321bc) }
  .text.w3d_get_802321c4 0x802321c4 : { *(.text.w3d_get_802321c4) }
  .text.w3d_set_802321cc 0x802321cc : { *(.text.w3d_set_802321cc) }
  .text.w3d_get_802321d4 0x802321d4 : { *(.text.w3d_get_802321d4) }
  .text.w3d_set_802321dc 0x802321dc : { *(.text.w3d_set_802321dc) }
  .text.w3d_get_802321e4 0x802321e4 : { *(.text.w3d_get_802321e4) }
  .text.w3d_set_802321ec 0x802321ec : { *(.text.w3d_set_802321ec) }
  /DISCARD/ : { *(.text*) *(.rodata*) *(.data*) *(.bss*) *(.sdata*) *(.sbss*) *(.comment) }
}
