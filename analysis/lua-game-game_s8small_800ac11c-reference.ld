/* Generated reference-only placements. All bodies are source-built. */
OUTPUT_FORMAT("elf32-powerpc")
OUTPUT_ARCH(powerpc)
ENTRY(s8_set_member_property_800ac11c)
_SDA_BASE_ = 0x804b2540;
_SDA2_BASE_ = 0x804c2540;
fn_80178c54 = 0x80178c54;
fn_803426b4 = 0x803426b4;
SECTIONS {
  .text.s8_set_member_property_800ac11c 0x800ac11c : { *(.text.s8_set_member_property_800ac11c) }
  /DISCARD/ : { *(.text*) *(.rodata*) *(.data*) *(.bss*) *(.sdata*) *(.sbss*) *(.comment) }
}
