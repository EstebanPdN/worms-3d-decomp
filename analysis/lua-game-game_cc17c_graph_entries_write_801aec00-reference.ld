/* Generated reference-only placements. All bodies are source-built. */
OUTPUT_FORMAT("elf32-powerpc")
OUTPUT_ARCH(powerpc)
ENTRY(w3d_cc17c_graph_entries_write_801aec00)
_SDA_BASE_ = 0x804b2540;
_SDA2_BASE_ = 0x804c2540;
lbl_803aa754 = 0x803aa754;
lbl_803aa75c = 0x803aa75c;
lbl_803aa764 = 0x803aa764;
SECTIONS {
  .text.w3d_cc17c_graph_entries_write_801aec00 0x801aec00 : { *(.text.w3d_cc17c_graph_entries_write_801aec00) }
  /DISCARD/ : { *(.text*) *(.rodata*) *(.data*) *(.bss*) *(.sdata*) *(.sbss*) *(.comment) }
}
