/* Generated reference-only placements. All bodies are source-built. */
OUTPUT_FORMAT("elf32-powerpc")
OUTPUT_ARCH(powerpc)
ENTRY(d28l_keyboard_press_selected_802c40b4)
_SDA_BASE_ = 0x804b2540;
_SDA2_BASE_ = 0x804c2540;
__3Str = 0x803426b8;
fn_800fc1b0 = 0x800fc1b0;
fn_801790bc = 0x801790bc;
fn_8020c510 = 0x8020c510;
fn_8020c5c4 = 0x8020c5c4;
fn_8020c5cc = 0x8020c5cc;
fn_8020c6a4 = 0x8020c6a4;
fn_8020c7e8 = 0x8020c7e8;
fn_802b1258 = 0x802b1258;
fn_802c4080 = 0x802c4080;
fn_802c43ec = 0x802c43ec;
fn_802c4744 = 0x802c4744;
fn_802c4998 = 0x802c4998;
fn_802c4a7c = 0x802c4a7c;
fn_802c4e7c = 0x802c4e7c;
fn_802c6954 = 0x802c6954;
fn_802c814c = 0x802c814c;
fn_802c8158 = 0x802c8158;
fn_80341588 = 0x80341588;
fn_80343744 = 0x80343744;
s_803d8728 = 0x803d8728;
s_803d8730 = 0x803d8730;
s_803d873c = 0x803d873c;
s_803d8744 = 0x803d8744;
s_803d874c = 0x803d874c;
SECTIONS {
  .text.d28l_keyboard_press_selected_802c40b4 0x802c40b4 : { *(.text.d28l_keyboard_press_selected_802c40b4) }
  /DISCARD/ : { *(.text*) *(.rodata*) *(.data*) *(.bss*) *(.sdata*) *(.sbss*) *(.comment) }
}
