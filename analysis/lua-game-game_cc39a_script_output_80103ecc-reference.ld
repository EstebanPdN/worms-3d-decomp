/* Generated reference-only placements. All bodies are source-built. */
OUTPUT_FORMAT("elf32-powerpc")
OUTPUT_ARCH(powerpc)
ENTRY(cc39a_script_output_80103ecc)
_SDA_BASE_ = 0x804b2540;
_SDA2_BASE_ = 0x804c2540;
cc39a_append_8020bf2c = 0x8020bf2c;
cc39a_empty_804b06a0 = 0x804b06a0;
cc39a_error_80399508 = 0x80399508;
cc39a_format_802ec254 = 0x802ec254;
cc39a_format_80399480 = 0x80399480;
cc39a_free_8020bb2c = 0x8020bb2c;
cc39a_number_802cda9c = 0x802cda9c;
cc39a_output_801022e8 = 0x801022e8;
cc39a_report_801022ec = 0x801022ec;
cc39a_settop_802cd808 = 0x802cd808;
cc39a_string_802cdaf4 = 0x802cdaf4;
cc39a_text_802cdd04 = 0x802cdd04;
cc39a_top_802cd7f4 = 0x802cd7f4;
cc39a_value_802cdc5c = 0x802cdc5c;
SECTIONS {
  .text.cc39a_script_output_80103ecc 0x80103ecc : { *(.text.cc39a_script_output_80103ecc) }
  /DISCARD/ : { *(.text*) *(.rodata*) *(.data*) *(.bss*) *(.sdata*) *(.sbss*) *(.comment) }
}
