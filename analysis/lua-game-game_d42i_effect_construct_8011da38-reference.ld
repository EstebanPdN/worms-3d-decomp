/* Generated reference-only placements. All bodies are source-built. */
OUTPUT_FORMAT("elf32-powerpc")
OUTPUT_ARCH(powerpc)
ENTRY(d42i_effect_construct_8011da38)
_SDA_BASE_ = 0x804b2540;
_SDA2_BASE_ = 0x804c2540;
base_8015fef0 = 0x8015fef0;
vt_80410ab0 = 0x80410ab0;
SECTIONS {
  .text.d42i_effect_construct_8011da38 0x8011da38 : { *(.text.d42i_effect_construct_8011da38) }
  /DISCARD/ : { *(.text*) *(.rodata*) *(.data*) *(.bss*) *(.sdata*) *(.sbss*) *(.comment) }
}
