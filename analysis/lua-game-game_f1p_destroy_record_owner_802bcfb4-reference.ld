/* Generated reference-only placements. All bodies are source-built. */
OUTPUT_FORMAT("elf32-powerpc")
OUTPUT_ARCH(powerpc)
ENTRY(_._14F1pRecordOwner)
_SDA_BASE_ = 0x804b2540;
_SDA2_BASE_ = 0x804c2540;
__builtin_delete = 0x801fe1f8;
fn_802134fc = 0x802134fc;
fn_802bf658 = 0x802bf658;
SECTIONS {
  .text._._14F1pRecordOwner 0x802bcfb4 : { *(.text._._14F1pRecordOwner) }
  /DISCARD/ : { *(.text*) *(.rodata*) *(.data*) *(.bss*) *(.sdata*) *(.sbss*) *(.comment) }
}
