/* Generated reference-only placements. All bodies are source-built. */
OUTPUT_FORMAT("elf32-powerpc")
OUTPUT_ARCH(powerpc)
ENTRY(w3d_auto_80255418)
_SDA_BASE_ = 0x804b2540;
_SDA2_BASE_ = 0x804c2540;
fn_801E8D9C = 0x801e8d9c;
fn_801EB674 = 0x801eb674;
fn_801EBF38 = 0x801ebf38;
fn_801EC52C = 0x801ec52c;
lbl_803C7DA0 = 0x803c7da0;
lbl_803C7DD8 = 0x803c7dd8;
lbl_803C7E10 = 0x803c7e10;
lbl_803C7E48 = 0x803c7e48;
lbl_803C7E80 = 0x803c7e80;
lbl_803C7EBC = 0x803c7ebc;
lbl_803C7EF0 = 0x803c7ef0;
lbl_803C7F38 = 0x803c7f38;
lbl_803C7F80 = 0x803c7f80;
lbl_803C7FC4 = 0x803c7fc4;
lbl_803C8008 = 0x803c8008;
SECTIONS {
  .text.w3d_auto_80255418 0x80255418 : { *(.text.w3d_auto_80255418) }
  /DISCARD/ : { *(.text*) *(.rodata*) *(.data*) *(.bss*) *(.sdata*) *(.sbss*) *(.comment) }
}
