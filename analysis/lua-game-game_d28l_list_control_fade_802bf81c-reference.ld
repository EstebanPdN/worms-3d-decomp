/* Generated reference-only placements. All bodies are source-built. */
OUTPUT_FORMAT("elf32-powerpc")
OUTPUT_ARCH(powerpc)
ENTRY(d28l_list_control_fade_802bf81c)
_SDA_BASE_ = 0x804b2540;
_SDA2_BASE_ = 0x804c2540;
fn_80173df0 = 0x80173df0;
fn_8018d35c = 0x8018d35c;
fn_8018d434 = 0x8018d434;
fn_802bf798 = 0x802bf798;
fn_802bfa40 = 0x802bfa40;
fn_8034357c = 0x8034357c;
fn_80343580 = 0x80343580;
SECTIONS {
  .text.d28l_list_control_fade_802bf81c 0x802bf81c : { *(.text.d28l_list_control_fade_802bf81c) }
  .rodata 0x803d840c : { *(.rodata) }
  /DISCARD/ : { *(.text*) *(.rodata*) *(.data*) *(.bss*) *(.sdata*) *(.sbss*) *(.comment) }
}
