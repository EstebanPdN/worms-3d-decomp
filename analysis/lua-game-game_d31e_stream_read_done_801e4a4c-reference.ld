/* Generated reference-only placements. All bodies are source-built. */
OUTPUT_FORMAT("elf32-powerpc")
OUTPUT_ARCH(powerpc)
ENTRY(w3d_d31e_stream_read_done_801e4a4c)
_SDA_BASE_ = 0x804b2540;
_SDA2_BASE_ = 0x804c2540;
fn_802f5320 = 0x802f5320;
fn_802f7694 = 0x802f7694;
fn_803238fc = 0x803238fc;
fn_80326210 = 0x80326210;
g_slots = 0x8045d930;
w3d_cx14b_sound_voice_start_801e4994 = 0x801e4994;
SECTIONS {
  .text.w3d_d31e_stream_read_done_801e4a4c 0x801e4a4c : { *(.text.w3d_d31e_stream_read_done_801e4a4c) }
  /DISCARD/ : { *(.text*) *(.rodata*) *(.data*) *(.bss*) *(.sdata*) *(.sbss*) *(.comment) }
}
