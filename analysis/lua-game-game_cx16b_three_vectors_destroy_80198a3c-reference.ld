/* Generated reference-only placements. All bodies are source-built. */
OUTPUT_FORMAT("elf32-powerpc")
OUTPUT_ARCH(powerpc)
ENTRY(w3d_cx16b_three_vectors_destroy_80198a3c)
_SDA_BASE_ = 0x804b2540;
_SDA2_BASE_ = 0x804c2540;
fn_801907d0 = 0x801907d0;
fn_80199c70 = 0x80199c70;
fn_801fe1f8 = 0x801fe1f8;
fn_80210990 = 0x80210990;
lbl_80413428 = 0x80413428;
lbl_80413470 = 0x80413470;
SECTIONS {
  .text.w3d_cx16b_three_vectors_destroy_80198a3c 0x80198a3c : { *(.text.w3d_cx16b_three_vectors_destroy_80198a3c) }
  /DISCARD/ : { *(.text*) *(.rodata*) *(.data*) *(.bss*) *(.sdata*) *(.sbss*) *(.comment) }
}
