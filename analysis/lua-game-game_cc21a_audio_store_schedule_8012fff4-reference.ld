/* Generated reference-only placements. All bodies are source-built. */
OUTPUT_FORMAT("elf32-powerpc")
OUTPUT_ARCH(powerpc)
ENTRY(cc21a_audio_store_schedule_8012fff4)
_SDA_BASE_ = 0x804b2540;
_SDA2_BASE_ = 0x804c2540;
cc21a_fn_8015fef0 = 0x8015fef0;
cc21a_lbl_8039dfe4 = 0x8039dfe4;
cc21a_lbl_8039dfe8 = 0x8039dfe8;
cc21a_lbl_80410e40 = 0x80410e40;
SECTIONS {
  .text.cc21a_audio_store_schedule_8012fff4 0x8012fff4 : { *(.text.cc21a_audio_store_schedule_8012fff4) }
  /DISCARD/ : { *(.text*) *(.rodata*) *(.data*) *(.bss*) *(.sdata*) *(.sbss*) *(.comment) }
}
