/* Generated reference-only placements. All bodies are source-built. */
OUTPUT_FORMAT("elf32-powerpc")
OUTPUT_ARCH(powerpc)
ENTRY(w3d_s21_static_identity_quat_801f79d4)
_SDA_BASE_ = 0x804b2540;
_SDA2_BASE_ = 0x804c2540;
fn_80359cd8 = 0x80359cd8;
lbl_803b1814 = 0x803b1814;
lbl_803b1818 = 0x803b1818;
lbl_8045e778 = 0x8045e778;
SECTIONS {
  .text.w3d_s21_static_identity_quat_801f79d4 0x801f79d4 : { *(.text.w3d_s21_static_identity_quat_801f79d4) }
  /DISCARD/ : { *(.text*) *(.rodata*) *(.data*) *(.bss*) *(.sdata*) *(.sbss*) *(.comment) }
}
