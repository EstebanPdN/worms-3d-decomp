/* Generated reference-only placements. All bodies are source-built. */
OUTPUT_FORMAT("elf32-powerpc")
OUTPUT_ARCH(powerpc)
ENTRY(_M_fill_insert__Q24_STLt6vector2Z8D42xMaskZt15ModuleAllocator1Z8D42xMaskP8D42xMaskUiRC8D42xMask)
_SDA_BASE_ = 0x804b2540;
_SDA2_BASE_ = 0x804c2540;
_M_fill_insert__Q24_STLt6vector2ZiZt15ModuleAllocator1ZiPiUiRCi = 0x80350a78;
__as__8D42xMaskRC8D42xMask = 0x80350ca8;
w3d_auto_801907a8 = 0x801907a8;
w3d_auto_801907d0 = 0x801907d0;
SECTIONS {
  .text._M_fill_insert__Q24_STLt6vector2Z8D42xMaskZt15ModuleAllocator1Z8D42xMaskP8D42xMaskUiRC8D42xMask 0x80350dd8 : { *(.text._M_fill_insert__Q24_STLt6vector2Z8D42xMaskZt15ModuleAllocator1Z8D42xMaskP8D42xMaskUiRC8D42xMask) }
  /DISCARD/ : { *(.text*) *(.rodata*) *(.data*) *(.bss*) *(.sdata*) *(.sbss*) *(.comment) }
}
