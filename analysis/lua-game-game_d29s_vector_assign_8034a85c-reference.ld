/* Generated reference-only placements. All bodies are source-built. */
OUTPUT_FORMAT("elf32-powerpc")
OUTPUT_ARCH(powerpc)
ENTRY(__as__Q24_STLt6vector2Z20D29sRecord8_8034a85cZQ24_STLt9allocator1Z20D29sRecord8_8034a85cRCQ24_STLt6vector2Z20D29sRecord8_8034a85cZQ24_STLt9allocator1Z20D29sRecord8_8034a85c)
_SDA_BASE_ = 0x804b2540;
_SDA2_BASE_ = 0x804c2540;
_S_oom_malloc__Q24_STLt14__malloc_alloc1i0Ui = 0x803413d8;
free = 0x802134fc;
malloc = 0x80212fd4;
SECTIONS {
  .text.__as__Q24_STLt6vector2Z20D29sRecord8_8034a85cZQ24_STLt9allocator1Z20D29sRecord8_8034a85cRCQ24_STLt6vector2Z20D29sRecord8_8034a85cZQ24_STLt9allocator1Z20D29sRecord8_8034a85c 0x8034a85c : { *(.text.__as__Q24_STLt6vector2Z20D29sRecord8_8034a85cZQ24_STLt9allocator1Z20D29sRecord8_8034a85cRCQ24_STLt6vector2Z20D29sRecord8_8034a85cZQ24_STLt9allocator1Z20D29sRecord8_8034a85c) }
  /DISCARD/ : { *(.text*) *(.rodata*) *(.data*) *(.bss*) *(.sdata*) *(.sbss*) *(.comment) }
}
