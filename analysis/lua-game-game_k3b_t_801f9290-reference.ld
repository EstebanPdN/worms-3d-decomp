/* Generated reference-only placements. All bodies are source-built. */
OUTPUT_FORMAT("elf32-powerpc")
OUTPUT_ARCH(powerpc)
ENTRY(w3d_k3b_tagged_construct_801f9290)
_SDA_BASE_ = 0x804b2540;
_SDA2_BASE_ = 0x804c2540;
w3d_vtable_80418190 = 0x80418190;
w3d_vtable_804181c0 = 0x804181c0;
SECTIONS {
  .text.w3d_k3b_tagged_construct_801f9290 0x801f9290 : { *(.text.w3d_k3b_tagged_construct_801f9290) }
  /DISCARD/ : { *(.text*) *(.rodata*) *(.data*) *(.bss*) *(.sdata*) *(.sbss*) *(.comment) }
}
