/* Generated reference-only placements. All bodies are source-built. */
OUTPUT_FORMAT("elf32-powerpc")
OUTPUT_ARCH(powerpc)
ENTRY(w3d_s21_submit_801fa52c)
_SDA_BASE_ = 0x804b2540;
_SDA2_BASE_ = 0x804c2540;
fn_801f99d8 = 0x801f99d8;
fn_801fac44 = 0x801fac44;
SECTIONS {
  .text.w3d_s21_submit_801fa52c 0x801fa52c : { *(.text.w3d_s21_submit_801fa52c) }
  /DISCARD/ : { *(.text*) *(.rodata*) *(.data*) *(.bss*) *(.sdata*) *(.sbss*) *(.comment) }
}
