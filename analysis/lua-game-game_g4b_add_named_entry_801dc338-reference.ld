/* Generated reference-only placements. All bodies are source-built. */
OUTPUT_FORMAT("elf32-powerpc")
OUTPUT_ARCH(powerpc)
ENTRY(g4b_add_named_entry_801dc338)
_SDA_BASE_ = 0x804b2540;
_SDA2_BASE_ = 0x804c2540;
fn_801de10c = 0x801de10c;
fn_801de134 = 0x801de134;
fn_801de13c = 0x801de13c;
fn_801de2dc = 0x801de2dc;
fn_80210d54 = 0x80210d54;
fn_802ef234 = 0x802ef234;
SECTIONS {
  .text.g4b_add_named_entry_801dc338 0x801dc338 : { *(.text.g4b_add_named_entry_801dc338) }
  /DISCARD/ : { *(.text*) *(.rodata*) *(.data*) *(.bss*) *(.sdata*) *(.sbss*) *(.comment) }
}
