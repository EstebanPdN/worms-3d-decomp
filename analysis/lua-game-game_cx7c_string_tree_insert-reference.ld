/* Generated reference-only placements. All bodies are source-built. */
OUTPUT_FORMAT("elf32-powerpc")
OUTPUT_ARCH(powerpc)
ENTRY(w3d_cx7c_string_tree_insert_8035a464)
_SDA_BASE_ = 0x804b2540;
_SDA2_BASE_ = 0x804c2540;
cx7c_allocate_80212fd4 = 0x80212fd4;
cx7c_allocation_fallback_803413d8 = 0x803413d8;
cx7c_rebalance_80352404 = 0x80352404;
cx7c_strcmp_802ef234 = 0x802ef234;
cx7c_string_base_init_8020c5c0 = 0x8020c5c0;
cx7c_string_header_80341884 = 0x80341884;
SECTIONS {
  .text.w3d_cx7c_string_tree_insert_8035a464 0x8035a464 : { *(.text.w3d_cx7c_string_tree_insert_8035a464) }
  /DISCARD/ : { *(.text*) *(.rodata*) *(.data*) *(.bss*) *(.sdata*) *(.sbss*) *(.comment) }
}
