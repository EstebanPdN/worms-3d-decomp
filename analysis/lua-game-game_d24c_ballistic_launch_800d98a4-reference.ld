/* Generated reference-only placements. All bodies are source-built. */
OUTPUT_FORMAT("elf32-powerpc")
OUTPUT_ARCH(powerpc)
ENTRY(d24c_ballistic_launch_800d98a4)
_SDA_BASE_ = 0x804b2540;
_SDA2_BASE_ = 0x804c2540;
basis_800d9b70 = 0x800d9b70;
fn_800d8938 = 0x800d8938;
identity_80341584 = 0x80341584;
origin_8045e788 = 0x8045e788;
set_pending_800ecec0 = 0x800ecec0;
settings_801797b4 = 0x801797b4;
solve_800d99e0 = 0x800d99e0;
SECTIONS {
  .text.d24c_ballistic_launch_800d98a4 0x800d98a4 : { *(.text.d24c_ballistic_launch_800d98a4) }
  /DISCARD/ : { *(.text*) *(.rodata*) *(.data*) *(.bss*) *(.sdata*) *(.sbss*) *(.comment) }
}
