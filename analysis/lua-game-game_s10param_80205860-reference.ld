/* Generated reference-only placements. All bodies are source-built. */
OUTPUT_FORMAT("elf32-powerpc")
OUTPUT_ARCH(powerpc)
ENTRY(w3d_s10_registry_remove_80205860)
_SDA_BASE_ = 0x804b2540;
_SDA2_BASE_ = 0x804c2540;
fn_8020596c = 0x8020596c;
fn_8020fd2c = 0x8020fd2c;
lbl_8045edf4 = 0x8045edf4;
SECTIONS {
  .text.w3d_s10_registry_remove_80205860 0x80205860 : { *(.text.w3d_s10_registry_remove_80205860) }
  /DISCARD/ : { *(.text*) *(.rodata*) *(.data*) *(.bss*) *(.sdata*) *(.sbss*) *(.comment) }
}
