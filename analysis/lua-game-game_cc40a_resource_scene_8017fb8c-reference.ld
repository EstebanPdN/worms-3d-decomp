/* Generated reference-only placements. All bodies are source-built. */
OUTPUT_FORMAT("elf32-powerpc")
OUTPUT_ARCH(powerpc)
ENTRY(cc40a_resource_scene_8017fb8c)
_SDA_BASE_ = 0x804b2540;
_SDA2_BASE_ = 0x804c2540;
cc40a_queryKey_8040e158 = 0x8040e158;
cc40a_sceneType_80362158 = 0x80362158;
SECTIONS {
  .text.cc40a_resource_scene_8017fb8c 0x8017fb8c : { *(.text.cc40a_resource_scene_8017fb8c) }
  /DISCARD/ : { *(.text*) *(.rodata*) *(.data*) *(.bss*) *(.sdata*) *(.sbss*) *(.comment) }
}
