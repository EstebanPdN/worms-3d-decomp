/* Generated reference-only placements. All bodies are source-built. */
OUTPUT_FORMAT("elf32-powerpc")
OUTPUT_ARCH(powerpc)
ENTRY(d30l_title_line_802a3784)
_SDA_BASE_ = 0x804b2540;
_SDA2_BASE_ = 0x804c2540;
__3StrPCc = 0x8020bb54;
fn_8015adf4 = 0x8015adf4;
fn_8015ae3c = 0x8015ae3c;
fn_80171ee0 = 0x80171ee0;
fn_80171f90 = 0x80171f90;
fn_80171fa0 = 0x80171fa0;
fn_80171ff8 = 0x80171ff8;
fn_80173f88 = 0x80173f88;
fn_8020c5c4 = 0x8020c5c4;
fn_80341588 = 0x80341588;
fn_8034357c = 0x8034357c;
fn_80343808 = 0x80343808;
memset = 0x802eefe0;
SECTIONS {
  .text.d30l_title_line_802a3784 0x802a3784 : { *(.text.d30l_title_line_802a3784) }
  .rodata 0x803d2e3c : { *(.rodata) }
  /DISCARD/ : { *(.text*) *(.rodata*) *(.data*) *(.bss*) *(.sdata*) *(.sbss*) *(.comment) }
}
