/* Generated reference-only placements. All bodies are source-built. */
OUTPUT_FORMAT("elf32-powerpc")
OUTPUT_ARCH(powerpc)
ENTRY(d31c_hud_setup_v2_800fefe8)
_SDA_BASE_ = 0x804b2540;
_SDA2_BASE_ = 0x804c2540;
as_mesh_8034380c = 0x8034380c;
cast_80342a74 = 0x80342a74;
cast_80342a78 = 0x80342a78;
cast_80342fa4 = 0x80342fa4;
flags_80189704 = 0x80189704;
load_8015adf4 = 0x8015adf4;
mesh_alloc_8018920c = 0x8018920c;
mesh_set_80189450 = 0x80189450;
read_setting_800fc1b0 = 0x800fc1b0;
read_vec_800fc2f0 = 0x800fc2f0;
s0_8039828c = 0x8039828c;
s10_80398360 = 0x80398360;
s11_80398370 = 0x80398370;
s1_80398298 = 0x80398298;
s2_803982b0 = 0x803982b0;
s3_803982c4 = 0x803982c4;
s4_803982dc = 0x803982dc;
s5_803982f4 = 0x803982f4;
s6_8039830c = 0x8039830c;
s7_80398328 = 0x80398328;
s8_80398340 = 0x80398340;
s9_80398354 = 0x80398354;
sizes_8018963c = 0x8018963c;
string_finish_8020c5c4 = 0x8020c5c4;
string_from_text_8020bb54 = 0x8020bb54;
string_release_80341588 = 0x80341588;
vec_80178ec4 = 0x80178ec4;
SECTIONS {
  .text.d31c_hud_setup_v2_800fefe8 0x800fefe8 : { *(.text.d31c_hud_setup_v2_800fefe8) }
  /DISCARD/ : { *(.text*) *(.rodata*) *(.data*) *(.bss*) *(.sdata*) *(.sbss*) *(.comment) }
}
