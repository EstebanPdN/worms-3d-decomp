/* Generated reference-only placements. All bodies are source-built. */
OUTPUT_FORMAT("elf32-powerpc")
OUTPUT_ARCH(powerpc)
ENTRY(w3d_s21_find_item_class_801e8f64)
_SDA_BASE_ = 0x804b2540;
_SDA2_BASE_ = 0x804c2540;
fn_801fff3c = 0x801fff3c;
fn_802eedc0 = 0x802eedc0;
lbl_8045e080 = 0x8045e080;
SECTIONS {
  .text.w3d_s21_find_item_class_801e8f64 0x801e8f64 : { *(.text.w3d_s21_find_item_class_801e8f64) }
  /DISCARD/ : { *(.text*) *(.rodata*) *(.data*) *(.bss*) *(.sdata*) *(.sbss*) *(.comment) }
}
