/* Generated reference-only placements. All bodies are source-built. */
OUTPUT_FORMAT("elf32-powerpc")
OUTPUT_ARCH(powerpc)
ENTRY(w3d_f3a_comment_8028ebe0)
_SDA_BASE_ = 0x804b2540;
_SDA2_BASE_ = 0x804c2540;
__13Text_8020bb54PCc = 0x8020bb54;
fn_800c467c = 0x800c467c;
fn_800fc2b0 = 0x800fc2b0;
fn_8020c5c4 = 0x8020c5c4;
fn_80341588 = 0x80341588;
fn_8035f16c = 0x8035f16c;
name_803d004c = 0x803d004c;
SECTIONS {
  .text.w3d_f3a_comment_8028ebe0 0x8028ebe0 : { *(.text.w3d_f3a_comment_8028ebe0) }
  /DISCARD/ : { *(.text*) *(.rodata*) *(.data*) *(.bss*) *(.sdata*) *(.sbss*) *(.comment) }
}
