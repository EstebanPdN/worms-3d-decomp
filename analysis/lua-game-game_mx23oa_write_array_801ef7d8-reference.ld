/* Generated reference-only placements. All bodies are source-built. */
OUTPUT_FORMAT("elf32-powerpc")
OUTPUT_ARCH(powerpc)
ENTRY(mx23oa_write_array_801ef7d8)
_SDA_BASE_ = 0x804b2540;
_SDA2_BASE_ = 0x804c2540;
__19Mx23oaText_803426b8 = 0x803426b8;
fn_801ffea8 = 0x801ffea8;
fn_801fff60 = 0x801fff60;
fn_80200050 = 0x80200050;
fn_8020c5c4 = 0x8020c5c4;
fn_8020d980 = 0x8020d980;
fn_8020dbf8 = 0x8020dbf8;
fn_80341588 = 0x80341588;
lbl_803b0d4c = 0x803b0d4c;
lbl_803b0d54 = 0x803b0d54;
lbl_803b0d58 = 0x803b0d58;
lbl_803b0d60 = 0x803b0d60;
lbl_803b0d64 = 0x803b0d64;
SECTIONS {
  .text.mx23oa_write_array_801ef7d8 0x801ef7d8 : { *(.text.mx23oa_write_array_801ef7d8) }
  /DISCARD/ : { *(.text*) *(.rodata*) *(.data*) *(.bss*) *(.sdata*) *(.sbss*) *(.comment) }
}
