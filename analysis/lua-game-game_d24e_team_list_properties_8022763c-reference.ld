/* Generated reference-only placements. All bodies are source-built. */
OUTPUT_FORMAT("elf32-powerpc")
OUTPUT_ARCH(powerpc)
ENTRY(w3d_d24e_register_team_list_properties_8022763c)
_SDA_BASE_ = 0x804b2540;
_SDA2_BASE_ = 0x804c2540;
__15String_8020bb54PCc = 0x8020bb54;
d20e_release_header_8020bb2c = 0x8020bb2c;
d20e_string_finish_8020c5c4 = 0x8020c5c4;
d20e_string_release_80341588 = 0x80341588;
desc_803b81b4 = 0x803b81b4;
desc_803b81fc = 0x803b81fc;
desc_803b822c = 0x803b822c;
desc_803b825c = 0x803b825c;
desc_803b828c = 0x803b828c;
desc_803b82bc = 0x803b82bc;
desc_803b82ec = 0x803b82ec;
desc_803b8318 = 0x803b8318;
desc_803b8344 = 0x803b8344;
desc_803b8374 = 0x803b8374;
fn_801e8d9c = 0x801e8d9c;
fn_801eb674 = 0x801eb674;
fn_801ebf38 = 0x801ebf38;
fn_801ec0f8 = 0x801ec0f8;
fn_801ed24c = 0x801ed24c;
fn_801eff8c = 0x801eff8c;
fn_801efff0 = 0x801efff0;
lbl_803b81d8 = 0x803b81d8;
lbl_803b81e0 = 0x803b81e0;
lbl_804007e4 = 0x804007e4;
lbl_8045e004 = 0x8045e004;
lbl_8045ed94 = 0x8045ed94;
lit_803b8198 = 0x803b8198;
lit_803b819c = 0x803b819c;
lit_803b81a4 = 0x803b81a4;
lit_803b81a8 = 0x803b81a8;
memset = 0x802eefe0;
SECTIONS {
  .text.w3d_d24e_register_team_list_properties_8022763c 0x8022763c : { *(.text.w3d_d24e_register_team_list_properties_8022763c) }
  .bss 0x80464acc : { *(.bss) }
  .sbss 0x804b07f4 : { *(.sbss) }
  /DISCARD/ : { *(.text*) *(.rodata*) *(.data*) *(.bss*) *(.sdata*) *(.sbss*) *(.comment) }
}
