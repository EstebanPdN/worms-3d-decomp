/* Generated reference-only placements. All bodies are source-built. */
OUTPUT_FORMAT("elf32-powerpc")
OUTPUT_ARCH(powerpc)
ENTRY(w3d_d42k_button_build_802663dc_802663dc)
_SDA_BASE_ = 0x804b2540;
_SDA2_BASE_ = 0x804c2540;
__12Str_803426b8 = 0x803426b8;
__12Str_803426b8PCc = 0x8020bb54;
fn_8015adf4 = 0x8015adf4;
fn_8015ae3c = 0x8015ae3c;
fn_80171ee0 = 0x80171ee0;
fn_80171f90 = 0x80171f90;
fn_80171fa0 = 0x80171fa0;
fn_80171ff8 = 0x80171ff8;
fn_80173df0 = 0x80173df0;
fn_80173f88 = 0x80173f88;
fn_8020bb2c = 0x8020bb2c;
fn_8020bd38 = 0x8020bd38;
fn_8020c510 = 0x8020c510;
fn_8020c5c4 = 0x8020c5c4;
fn_8026857c = 0x8026857c;
fn_802b1510 = 0x802b1510;
fn_80341588 = 0x80341588;
fn_8034357c = 0x8034357c;
fn_80343808 = 0x80343808;
lbl_803cb52c = 0x803cb52c;
lbl_803cb5cc = 0x803cb5cc;
lbl_803cb610 = 0x803cb610;
lbl_803cb634 = 0x803cb634;
lbl_803cb640 = 0x803cb640;
lbl_803cb648 = 0x803cb648;
lbl_803cb650 = 0x803cb650;
lbl_803cb658 = 0x803cb658;
lbl_803cb660 = 0x803cb660;
lbl_803cb664 = 0x803cb664;
memset = 0x802eefe0;
SECTIONS {
  .text.w3d_d42k_button_build_802663dc_802663dc 0x802663dc : { *(.text.w3d_d42k_button_build_802663dc_802663dc) }
  .rodata 0x803cb698 : { *(.rodata) }
  /DISCARD/ : { *(.text*) *(.rodata*) *(.data*) *(.bss*) *(.sdata*) *(.sbss*) *(.comment) }
}
