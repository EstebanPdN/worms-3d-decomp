/* Generated reference-only placements. All bodies are source-built. */
OUTPUT_FORMAT("elf32-powerpc")
OUTPUT_ARCH(powerpc)
ENTRY(w3d_binding_create_801f0210)
_SDA_BASE_ = 0x804b2540;
_SDA2_BASE_ = 0x804c2540;
__23W3dBindingBase_801eb058 = 0x801eb058;
__nw__19W3dBinding_80417a90Ui = 0x801fe1d8;
__nw__19W3dBinding_80417be0Ui = 0x801fe1d8;
__nw__19W3dBinding_80417ca0Ui = 0x801fe1d8;
fn_801e8bc4 = 0x801e8bc4;
fn_801eb0a8 = 0x801eb0a8;
w3d_vtable_80417a90 = 0x80417a90;
w3d_vtable_80417be0 = 0x80417be0;
w3d_vtable_80417ca0 = 0x80417ca0;
SECTIONS {
  .text.w3d_binding_create_801f0210 0x801f0210 : { *(.text.w3d_binding_create_801f0210) }
  .text.w3d_binding_create_801f0504 0x801f0504 : { *(.text.w3d_binding_create_801f0504) }
  .text.w3d_binding_create_801f0a50 0x801f0a50 : { *(.text.w3d_binding_create_801f0a50) }
  /DISCARD/ : { *(.text*) *(.rodata*) *(.data*) *(.bss*) *(.sdata*) *(.sbss*) *(.comment) }
}
