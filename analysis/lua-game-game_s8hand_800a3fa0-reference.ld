/* Generated reference-only placements. All bodies are source-built. */
OUTPUT_FORMAT("elf32-powerpc")
OUTPUT_ARCH(powerpc)
ENTRY(s8_show_flags_800a3fa0)
_SDA_BASE_ = 0x804b2540;
_SDA2_BASE_ = 0x804c2540;
fn_800fc230 = 0x800fc230;
fn_800fc43c = 0x800fc43c;
lbl_80380d24 = 0x80380d24;
lbl_80380d34 = 0x80380d34;
SECTIONS {
  .text.s8_show_flags_800a3fa0 0x800a3fa0 : { *(.text.s8_show_flags_800a3fa0) }
  /DISCARD/ : { *(.text*) *(.rodata*) *(.data*) *(.bss*) *(.sdata*) *(.sbss*) *(.comment) }
}
