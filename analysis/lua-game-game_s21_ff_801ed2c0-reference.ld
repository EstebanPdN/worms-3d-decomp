/* Generated reference-only placements. All bodies are source-built. */
OUTPUT_FORMAT("elf32-powerpc")
OUTPUT_ARCH(powerpc)
ENTRY(w3d_s21_equal_strings_801ed2c0)
_SDA_BASE_ = 0x804b2540;
_SDA2_BASE_ = 0x804c2540;
fn_802ef234__FPCcT0 = 0x802ef234;
SECTIONS {
  .text.w3d_s21_equal_strings_801ed2c0 0x801ed2c0 : { *(.text.w3d_s21_equal_strings_801ed2c0) }
  /DISCARD/ : { *(.text*) *(.rodata*) *(.data*) *(.bss*) *(.sdata*) *(.sbss*) *(.comment) }
}
