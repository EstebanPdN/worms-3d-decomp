/* Generated reference-only placements. All bodies are source-built. */
OUTPUT_FORMAT("elf32-powerpc")
OUTPUT_ARCH(powerpc)
ENTRY(d26f_edit_page_a_80273dc4)
_SDA_BASE_ = 0x804b2540;
_SDA2_BASE_ = 0x804c2540;
__17D26fText_803426b8 = 0x803426b8;
lbl_803cc0d8 = 0x803cc0d8;
lbl_803cc864 = 0x803cc864;
lbl_803cc86c = 0x803cc86c;
lbl_803cc8b4 = 0x803cc8b4;
lbl_803ccfb4 = 0x803ccfb4;
lbl_803ccfd4 = 0x803ccfd4;
lbl_803cd074 = 0x803cd074;
lbl_803cd08c = 0x803cd08c;
lbl_803cd0a4 = 0x803cd0a4;
lbl_803cd0c4 = 0x803cd0c4;
lbl_803cd0e4 = 0x803cd0e4;
lbl_803cd104 = 0x803cd104;
lbl_803cd124 = 0x803cd124;
lbl_803cd144 = 0x803cd144;
lbl_803cd164 = 0x803cd164;
w3d_auto_802cbf2c = 0x802cbf2c;
w3d_auto_802cd128 = 0x802cd128;
w3d_cc32b_append_lines_v2_802cc0ac = 0x802cc0ac;
w3d_cx7b_script_flag_set_8027a934 = 0x8027a934;
w3d_dtor_node_8020d36c = 0x8020d36c;
w3d_registry_retain_8020d2b8 = 0x8020d2b8;
w3d_s21_append_position_802cd26c = 0x802cd26c;
w3d_s21_repeat_request_802cd220 = 0x802cd220;
w3d_s21_sink_write_indexed_802cbdf8 = 0x802cbdf8;
w3d_s21_vector_get_801e9db8 = 0x801e9db8;
w3d_string_base_finish = 0x8020c5c4;
w3d_string_release = 0x80341588;
w3d_tagged_construct_8020d318 = 0x8020d318;
SECTIONS {
  .text.d26f_edit_page_a_80273dc4 0x80273dc4 : { *(.text.d26f_edit_page_a_80273dc4) }
  /DISCARD/ : { *(.text*) *(.rodata*) *(.data*) *(.bss*) *(.sdata*) *(.sbss*) *(.comment) }
}
