/* Generated reference-only placements. All bodies are source-built. */
OUTPUT_FORMAT("elf32-powerpc")
OUTPUT_ARCH(powerpc)
ENTRY(_._12F16bOwner492)
_SDA_BASE_ = 0x804b2540;
_SDA2_BASE_ = 0x804c2540;
__dl__12F16bOwner492Pv = 0x801fe1f8;
fn_801907d0 = 0x801907d0;
fn_80197ce4 = 0x80197ce4;
fn_80197f98 = 0x80197f98;
fn_80198710 = 0x80198710;
fn_8020c5c4 = 0x8020c5c4;
fn_80210990 = 0x80210990;
fn_80341588 = 0x80341588;
fn_803439d8 = 0x803439d8;
vt_804132e0 = 0x804132e0;
vt_80413338 = 0x80413338;
SECTIONS {
  .text._._12F16bOwner492 0x801908bc : { *(.text._._12F16bOwner492) }
  /DISCARD/ : { *(.text*) *(.rodata*) *(.data*) *(.bss*) *(.sdata*) *(.sbss*) *(.comment) }
}
