/* Generated reference-only placements. All bodies are source-built. */
OUTPUT_FORMAT("elf32-powerpc")
OUTPUT_ARCH(powerpc)
ENTRY(w3d_d31e_setup_stream_chain_801db478)
_SDA_BASE_ = 0x804b2540;
_SDA2_BASE_ = 0x804c2540;
k_80416cb8 = 0x80416cb8;
k_80416e78 = 0x80416e78;
w3d_cx11b_compact_vector_grow_80210d54 = 0x80210d54;
w3d_s10_service_forward_8020b680 = 0x8020b680;
w3d_stream_player_set_output_801e344c = 0x801e344c;
SECTIONS {
  .text.w3d_d31e_setup_stream_chain_801db478 0x801db478 : { *(.text.w3d_d31e_setup_stream_chain_801db478) }
  /DISCARD/ : { *(.text*) *(.rodata*) *(.data*) *(.bss*) *(.sdata*) *(.sbss*) *(.comment) }
}
