/* Generated reference-only placements. All bodies are source-built. */
OUTPUT_FORMAT("elf32-powerpc")
OUTPUT_ARCH(powerpc)
ENTRY(w3d_d21e_register_widget_properties_8021f3b4)
_SDA_BASE_ = 0x804b2540;
_SDA2_BASE_ = 0x804c2540;
constant_803b61e0 = 0x803b61e0;
constant_803b61e4 = 0x803b61e4;
d20e_empty_804b06a0 = 0x804b06a0;
d20e_release_header_8020bb2c = 0x8020bb2c;
d20e_string_finish_8020c5c4 = 0x8020c5c4;
d20e_string_header_80341884 = 0x80341884;
d20e_string_init_8020c5c0 = 0x8020c5c0;
d20e_string_release_80341588 = 0x80341588;
desc_803b5de4 = 0x803b5de4;
desc_803b5e18 = 0x803b5e18;
desc_803b5e4c = 0x803b5e4c;
desc_803b5e78 = 0x803b5e78;
desc_803b5eb0 = 0x803b5eb0;
desc_803b5ee8 = 0x803b5ee8;
desc_803b5f24 = 0x803b5f24;
desc_803b5f5c = 0x803b5f5c;
desc_803b5f8c = 0x803b5f8c;
desc_803b5fbc = 0x803b5fbc;
desc_803b5fec = 0x803b5fec;
desc_803b6018 = 0x803b6018;
desc_803b6048 = 0x803b6048;
desc_803b6078 = 0x803b6078;
desc_803b60b0 = 0x803b60b0;
desc_803b60e8 = 0x803b60e8;
desc_803b611c = 0x803b611c;
desc_803b6150 = 0x803b6150;
desc_803b6188 = 0x803b6188;
desc_803b61bc = 0x803b61bc;
fn_801e8d9c = 0x801e8d9c;
fn_801ebf38 = 0x801ebf38;
fn_801ec52c = 0x801ec52c;
fn_801ed24c = 0x801ed24c;
fn_801f0210 = 0x801f0210;
SECTIONS {
  .text.w3d_d21e_register_widget_properties_8021f3b4 0x8021f3b4 : { *(.text.w3d_d21e_register_widget_properties_8021f3b4) }
  /DISCARD/ : { *(.text*) *(.rodata*) *(.data*) *(.bss*) *(.sdata*) *(.sbss*) *(.comment) }
}
