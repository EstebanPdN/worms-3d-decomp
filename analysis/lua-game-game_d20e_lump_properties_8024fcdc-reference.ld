/* Generated reference-only placements. All bodies are source-built. */
OUTPUT_FORMAT("elf32-powerpc")
OUTPUT_ARCH(powerpc)
ENTRY(w3d_d20e_register_lump_properties_8024fcdc)
_SDA_BASE_ = 0x804b2540;
_SDA2_BASE_ = 0x804c2540;
fn_801e8d9c = 0x801e8d9c;
fn_801eb674 = 0x801eb674;
fn_801ebd78 = 0x801ebd78;
fn_801ec0f8 = 0x801ec0f8;
fn_801ec52c = 0x801ec52c;
fn_801ecc6c = 0x801ecc6c;
fn_801ece2c = 0x801ece2c;
fn_801eff8c = 0x801eff8c;
fn_801f0210 = 0x801f0210;
k_803c578c = 0x803c578c;
k_803c57bc = 0x803c57bc;
k_803c57f4 = 0x803c57f4;
k_803c5828 = 0x803c5828;
k_803c5858 = 0x803c5858;
k_803c588c = 0x803c588c;
k_803c58c0 = 0x803c58c0;
k_803c58f4 = 0x803c58f4;
k_803c5928 = 0x803c5928;
k_803c5950 = 0x803c5950;
k_803c5984 = 0x803c5984;
lbl_803c5770 = 0x803c5770;
lbl_803c577c = 0x803c577c;
lbl_8040106c = 0x8040106c;
lbl_80401078 = 0x80401078;
lbl_8045e004 = 0x8045e004;
memset = 0x802eefe0;
value_803c59ac = 0x803c59ac;
SECTIONS {
  .text.w3d_d20e_register_lump_properties_8024fcdc 0x8024fcdc : { *(.text.w3d_d20e_register_lump_properties_8024fcdc) }
  .bss 0x80464ff4 : { *(.bss) }
  .sbss 0x804b08f8 : { *(.sbss) }
  /DISCARD/ : { *(.text*) *(.rodata*) *(.data*) *(.bss*) *(.sdata*) *(.sbss*) *(.comment) }
}
