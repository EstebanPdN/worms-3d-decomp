/* Generated reference-only placements. All bodies are source-built. */
OUTPUT_FORMAT("elf32-powerpc")
OUTPUT_ARCH(powerpc)
ENTRY(d24j_named_float_8017fc90)
_SDA_BASE_ = 0x804b2540;
_SDA2_BASE_ = 0x804c2540;
fn_8017ffbc = 0x8017ffbc;
fn_801fcb64 = 0x801fcb64;
iid_8040e0a8 = 0x8040e0a8;
strcmp = 0x802ef234;
text_803a779c = 0x803a779c;
SECTIONS {
  .text.d24j_named_float_8017fc90 0x8017fc90 : { *(.text.d24j_named_float_8017fc90) }
  /DISCARD/ : { *(.text*) *(.rodata*) *(.data*) *(.bss*) *(.sdata*) *(.sbss*) *(.comment) }
}
