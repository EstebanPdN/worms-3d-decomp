/* Generated reference-only placements. All bodies are source-built. */
OUTPUT_FORMAT("elf32-powerpc")
OUTPUT_ARCH(powerpc)
ENTRY(w3d_d24a_commentary_weapon_800446f4)
_SDA_BASE_ = 0x804b2540;
_SDA2_BASE_ = 0x804c2540;
__6String = 0x803426b8;
w3d_identity_803426b4 = 0x803426b4;
w3d_interrupt_80044638 = 0x80044638;
w3d_object_int_80178c48 = 0x80178c48;
w3d_player_800fc6dc = 0x800fc6dc;
w3d_string_80374f2c = 0x80374f2c;
w3d_string_80374f3c = 0x80374f3c;
w3d_string_80374f48 = 0x80374f48;
w3d_string_80374f54 = 0x80374f54;
w3d_string_80374f60 = 0x80374f60;
w3d_string_80374f6c = 0x80374f6c;
w3d_string_80374f74 = 0x80374f74;
w3d_string_finish_8020c5c4 = 0x8020c5c4;
w3d_string_format_8020c510 = 0x8020c510;
w3d_string_header_80341884 = 0x80341884;
w3d_string_init_8020c5c0 = 0x8020c5c0;
w3d_string_property_800fc2b0 = 0x800fc2b0;
w3d_string_release_80341588 = 0x80341588;
w3d_type_80368328 = 0x80368328;
w3d_weapon_lookup_800fc330 = 0x800fc330;
w3d_weapons_803eb63c = 0x803eb63c;
SECTIONS {
  .text.w3d_d24a_commentary_weapon_800446f4 0x800446f4 : { *(.text.w3d_d24a_commentary_weapon_800446f4) }
  /DISCARD/ : { *(.text*) *(.rodata*) *(.data*) *(.bss*) *(.sdata*) *(.sbss*) *(.comment) }
}
