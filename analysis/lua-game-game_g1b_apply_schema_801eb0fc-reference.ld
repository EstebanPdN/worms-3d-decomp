/* Generated reference-only placements. All bodies are source-built. */
OUTPUT_FORMAT("elf32-powerpc")
OUTPUT_ARCH(powerpc)
ENTRY(g1b_apply_schema_801eb0fc)
_SDA_BASE_ = 0x804b2540;
_SDA2_BASE_ = 0x804c2540;
fn_801e9de4 = 0x801e9de4;
fn_801eb2a8 = 0x801eb2a8;
fn_80200200 = 0x80200200;
fn_802ed89c = 0x802ed89c;
key_803b0c38 = 0x803b0c38;
key_803b0c40 = 0x803b0c40;
key_803b0c4c = 0x803b0c4c;
SECTIONS {
  .text.g1b_apply_schema_801eb0fc 0x801eb0fc : { *(.text.g1b_apply_schema_801eb0fc) }
  /DISCARD/ : { *(.text*) *(.rodata*) *(.data*) *(.bss*) *(.sdata*) *(.sbss*) *(.comment) }
}
