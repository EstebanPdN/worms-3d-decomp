/* Generated reference-only placements. All bodies are source-built. */
OUTPUT_FORMAT("elf32-powerpc")
OUTPUT_ARCH(powerpc)
ENTRY(w3d_cx7c_list_owner_construct_8035d5b4)
_SDA_BASE_ = 0x804b2540;
_SDA2_BASE_ = 0x804c2540;
cx7c_allocate_80212fd4 = 0x80212fd4;
cx7c_allocation_fallback_803413d8 = 0x803413d8;
cx7c_base_vtable_80419648 = 0x80419648;
cx7c_derived_vtable_80419628 = 0x80419628;
SECTIONS {
  .text.w3d_cx7c_list_owner_construct_8035d5b4 0x8035d5b4 : { *(.text.w3d_cx7c_list_owner_construct_8035d5b4) }
  /DISCARD/ : { *(.text*) *(.rodata*) *(.data*) *(.bss*) *(.sdata*) *(.sbss*) *(.comment) }
}
