/* Generated reference-only placements. All bodies are source-built. */
OUTPUT_FORMAT("elf32-powerpc")
OUTPUT_ARCH(powerpc)
ENTRY(g1b_parse_enum_801ffa68)
_SDA_BASE_ = 0x804b2540;
_SDA2_BASE_ = 0x804c2540;
fn_802ed89c = 0x802ed89c;
fn_802ef234 = 0x802ef234;
fn_802ef9c0 = 0x802ef9c0;
SECTIONS {
  .text.g1b_parse_enum_801ffa68 0x801ffa68 : { *(.text.g1b_parse_enum_801ffa68) }
  /DISCARD/ : { *(.text*) *(.rodata*) *(.data*) *(.bss*) *(.sdata*) *(.sbss*) *(.comment) }
}
