/* Generated reference-only placements. All bodies are source-built. */
OUTPUT_FORMAT("elf32-powerpc")
OUTPUT_ARCH(powerpc)
ENTRY(w3d_cx9c_actor_array_80344930)
_SDA_BASE_ = 0x804b2540;
_SDA2_BASE_ = 0x804c2540;
__19Cx9cRecord_800dc634 = 0x800dc634;
cx9c_array_allocate_800dc5bc = 0x800dc5bc;
SECTIONS {
  .text.w3d_cx9c_actor_array_80344930 0x80344930 : { *(.text.w3d_cx9c_actor_array_80344930) }
  /DISCARD/ : { *(.text*) *(.rodata*) *(.data*) *(.bss*) *(.sdata*) *(.sbss*) *(.comment) }
}
