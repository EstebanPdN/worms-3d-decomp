/* Generated reference-only placements. All bodies are source-built. */
OUTPUT_FORMAT("elf32-powerpc")
OUTPUT_ARCH(powerpc)
ENTRY(s8_apply_item_80102968)
_SDA_BASE_ = 0x804b2540;
_SDA2_BASE_ = 0x804c2540;
fn_800ffb58 = 0x800ffb58;
fn_800ffca4 = 0x800ffca4;
SECTIONS {
  .text.s8_apply_item_80102968 0x80102968 : { *(.text.s8_apply_item_80102968) }
  /DISCARD/ : { *(.text*) *(.rodata*) *(.data*) *(.bss*) *(.sdata*) *(.sbss*) *(.comment) }
}
