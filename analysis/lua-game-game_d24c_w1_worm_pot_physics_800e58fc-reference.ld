/* Generated reference-only placements. All bodies are source-built. */
OUTPUT_FORMAT("elf32-powerpc")
OUTPUT_ARCH(powerpc)
ENTRY(d24c_w1_worm_pot_physics_800e58fc)
_SDA_BASE_ = 0x804b2540;
_SDA2_BASE_ = 0x804c2540;
as_pot_801797b4 = 0x801797b4;
bounce2_8038a560 = 0x8038a560;
bounce_8038a52c = 0x8038a52c;
identity_80341584 = 0x80341584;
one_8038a59c = 0x8038a59c;
pot_8038a558 = 0x8038a558;
read_800fc1b0 = 0x800fc1b0;
read_float_800fc270 = 0x800fc270;
slide2_8038a580 = 0x8038a580;
slide_8038a544 = 0x8038a544;
write_float_800fc4c8 = 0x800fc4c8;
SECTIONS {
  .text.d24c_w1_worm_pot_physics_800e58fc 0x800e58fc : { *(.text.d24c_w1_worm_pot_physics_800e58fc) }
  /DISCARD/ : { *(.text*) *(.rodata*) *(.data*) *(.bss*) *(.sdata*) *(.sbss*) *(.comment) }
}
