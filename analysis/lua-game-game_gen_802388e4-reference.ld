/* Generated reference-only placements. All bodies are source-built. */
OUTPUT_FORMAT("elf32-powerpc")
OUTPUT_ARCH(powerpc)
ENTRY(w3d_set_802388e4)
_SDA_BASE_ = 0x804b2540;
_SDA2_BASE_ = 0x804c2540;
w3d_global_80366c58 = 0x80366c58;
w3d_global_80366ca8 = 0x80366ca8;
w3d_global_80366cf8 = 0x80366cf8;
w3d_global_80366d48 = 0x80366d48;
w3d_global_80366d98 = 0x80366d98;
w3d_global_80366de8 = 0x80366de8;
w3d_global_80366e38 = 0x80366e38;
w3d_global_80366e88 = 0x80366e88;
w3d_global_80366ed8 = 0x80366ed8;
w3d_global_80366f28 = 0x80366f28;
w3d_global_80366f78 = 0x80366f78;
w3d_global_80366fc8 = 0x80366fc8;
w3d_global_80367018 = 0x80367018;
w3d_global_80367068 = 0x80367068;
w3d_global_803670b8 = 0x803670b8;
w3d_global_80367108 = 0x80367108;
w3d_global_80367158 = 0x80367158;
w3d_global_803671a8 = 0x803671a8;
w3d_global_803671f8 = 0x803671f8;
w3d_global_80367248 = 0x80367248;
w3d_global_80367298 = 0x80367298;
w3d_global_803672e8 = 0x803672e8;
w3d_global_80367338 = 0x80367338;
w3d_global_80367388 = 0x80367388;
w3d_global_803673d8 = 0x803673d8;
w3d_global_80367428 = 0x80367428;
w3d_global_80367478 = 0x80367478;
w3d_global_803674c8 = 0x803674c8;
w3d_global_80367518 = 0x80367518;
w3d_owner_list_remove = 0x8020fd2c;
w3d_registry_list_80366c58 = 0x80366c58;
w3d_registry_list_80366ca8 = 0x80366ca8;
w3d_registry_list_80366cf8 = 0x80366cf8;
w3d_registry_list_80366d48 = 0x80366d48;
w3d_registry_list_80366d98 = 0x80366d98;
w3d_registry_list_80366de8 = 0x80366de8;
w3d_registry_list_80366e38 = 0x80366e38;
w3d_registry_list_80366e88 = 0x80366e88;
w3d_registry_list_80366ed8 = 0x80366ed8;
w3d_registry_list_80366f28 = 0x80366f28;
w3d_registry_list_80366f78 = 0x80366f78;
w3d_registry_list_80366fc8 = 0x80366fc8;
w3d_registry_list_80367018 = 0x80367018;
w3d_registry_list_80367068 = 0x80367068;
w3d_registry_list_803670b8 = 0x803670b8;
w3d_registry_list_80367108 = 0x80367108;
w3d_registry_list_80367158 = 0x80367158;
w3d_registry_list_803671a8 = 0x803671a8;
w3d_registry_list_803671f8 = 0x803671f8;
w3d_registry_list_80367248 = 0x80367248;
w3d_registry_list_80367298 = 0x80367298;
w3d_registry_list_803672e8 = 0x803672e8;
w3d_registry_list_80367338 = 0x80367338;
w3d_registry_list_80367388 = 0x80367388;
w3d_registry_list_803673d8 = 0x803673d8;
w3d_registry_list_80367428 = 0x80367428;
w3d_registry_list_80367478 = 0x80367478;
w3d_registry_list_803674c8 = 0x803674c8;
w3d_registry_list_80367518 = 0x80367518;
SECTIONS {
  .text.w3d_set_802388e4 0x802388e4 : { *(.text.w3d_set_802388e4) }
  .text.w3d_get_802388ec 0x802388ec : { *(.text.w3d_get_802388ec) }
  .text.w3d_set_802388f4 0x802388f4 : { *(.text.w3d_set_802388f4) }
  .text.w3d_get_802388fc 0x802388fc : { *(.text.w3d_get_802388fc) }
  .text.w3d_set_80238974 0x80238974 : { *(.text.w3d_set_80238974) }
  .text.w3d_get_8023897c 0x8023897c : { *(.text.w3d_get_8023897c) }
  .text.w3d_set_80238984 0x80238984 : { *(.text.w3d_set_80238984) }
  .text.w3d_get_8023898c 0x8023898c : { *(.text.w3d_get_8023898c) }
  .text.w3d_set_80238994 0x80238994 : { *(.text.w3d_set_80238994) }
  .text.w3d_get_8023899c 0x8023899c : { *(.text.w3d_get_8023899c) }
  .text.w3d_set_802389a4 0x802389a4 : { *(.text.w3d_set_802389a4) }
  .text.w3d_get_802389ac 0x802389ac : { *(.text.w3d_get_802389ac) }
  .text.w3d_set_80238a94 0x80238a94 : { *(.text.w3d_set_80238a94) }
  .text.w3d_get_80238a9c 0x80238a9c : { *(.text.w3d_get_80238a9c) }
  .text.w3d_set_80238aa4 0x80238aa4 : { *(.text.w3d_set_80238aa4) }
  .text.w3d_get_80238aac 0x80238aac : { *(.text.w3d_get_80238aac) }
  .text.w3d_set_80238ab4 0x80238ab4 : { *(.text.w3d_set_80238ab4) }
  .text.w3d_get_80238abc 0x80238abc : { *(.text.w3d_get_80238abc) }
  .text.w3d_set_80238ac4 0x80238ac4 : { *(.text.w3d_set_80238ac4) }
  .text.w3d_get_80238acc 0x80238acc : { *(.text.w3d_get_80238acc) }
  .text.w3d_set_80238ad4 0x80238ad4 : { *(.text.w3d_set_80238ad4) }
  .text.w3d_get_80238adc 0x80238adc : { *(.text.w3d_get_80238adc) }
  .text.w3d_address_80238cd0 0x80238cd0 : { *(.text.w3d_address_80238cd0) }
  .text.w3d_registry_unlink_80238d44 0x80238d44 : { *(.text.w3d_registry_unlink_80238d44) }
  .text.w3d_address_80238e5c 0x80238e5c : { *(.text.w3d_address_80238e5c) }
  .text.w3d_registry_unlink_80238ed0 0x80238ed0 : { *(.text.w3d_registry_unlink_80238ed0) }
  .text.w3d_address_8023914c 0x8023914c : { *(.text.w3d_address_8023914c) }
  .text.w3d_registry_unlink_802391c0 0x802391c0 : { *(.text.w3d_registry_unlink_802391c0) }
  .text.w3d_address_80239394 0x80239394 : { *(.text.w3d_address_80239394) }
  .text.w3d_registry_unlink_80239408 0x80239408 : { *(.text.w3d_registry_unlink_80239408) }
  .text.w3d_address_80239520 0x80239520 : { *(.text.w3d_address_80239520) }
  .text.w3d_registry_unlink_80239594 0x80239594 : { *(.text.w3d_registry_unlink_80239594) }
  .text.w3d_address_80239688 0x80239688 : { *(.text.w3d_address_80239688) }
  .text.w3d_registry_unlink_802396fc 0x802396fc : { *(.text.w3d_registry_unlink_802396fc) }
  .text.w3d_address_80239814 0x80239814 : { *(.text.w3d_address_80239814) }
  .text.w3d_registry_unlink_80239888 0x80239888 : { *(.text.w3d_registry_unlink_80239888) }
  .text.w3d_address_802399a0 0x802399a0 : { *(.text.w3d_address_802399a0) }
  .text.w3d_registry_unlink_80239a14 0x80239a14 : { *(.text.w3d_registry_unlink_80239a14) }
  .text.w3d_address_80239b40 0x80239b40 : { *(.text.w3d_address_80239b40) }
  .text.w3d_registry_unlink_80239bb4 0x80239bb4 : { *(.text.w3d_registry_unlink_80239bb4) }
  .text.w3d_address_80239ca8 0x80239ca8 : { *(.text.w3d_address_80239ca8) }
  .text.w3d_registry_unlink_80239d1c 0x80239d1c : { *(.text.w3d_registry_unlink_80239d1c) }
  .text.w3d_address_80239f30 0x80239f30 : { *(.text.w3d_address_80239f30) }
  .text.w3d_registry_unlink_80239fa4 0x80239fa4 : { *(.text.w3d_registry_unlink_80239fa4) }
  .text.w3d_address_8023a098 0x8023a098 : { *(.text.w3d_address_8023a098) }
  .text.w3d_registry_unlink_8023a10c 0x8023a10c : { *(.text.w3d_registry_unlink_8023a10c) }
  .text.w3d_address_8023a224 0x8023a224 : { *(.text.w3d_address_8023a224) }
  .text.w3d_registry_unlink_8023a298 0x8023a298 : { *(.text.w3d_registry_unlink_8023a298) }
  .text.w3d_address_8023a3b0 0x8023a3b0 : { *(.text.w3d_address_8023a3b0) }
  .text.w3d_registry_unlink_8023a424 0x8023a424 : { *(.text.w3d_registry_unlink_8023a424) }
  .text.w3d_address_8023a614 0x8023a614 : { *(.text.w3d_address_8023a614) }
  .text.w3d_registry_unlink_8023a688 0x8023a688 : { *(.text.w3d_registry_unlink_8023a688) }
  .text.w3d_address_8023a7a0 0x8023a7a0 : { *(.text.w3d_address_8023a7a0) }
  .text.w3d_registry_unlink_8023a814 0x8023a814 : { *(.text.w3d_registry_unlink_8023a814) }
  .text.w3d_address_8023ab50 0x8023ab50 : { *(.text.w3d_address_8023ab50) }
  .text.w3d_registry_unlink_8023abc4 0x8023abc4 : { *(.text.w3d_registry_unlink_8023abc4) }
  .text.w3d_address_8023ae98 0x8023ae98 : { *(.text.w3d_address_8023ae98) }
  .text.w3d_registry_unlink_8023af0c 0x8023af0c : { *(.text.w3d_registry_unlink_8023af0c) }
  .text.w3d_address_8023b290 0x8023b290 : { *(.text.w3d_address_8023b290) }
  .text.w3d_registry_unlink_8023b304 0x8023b304 : { *(.text.w3d_registry_unlink_8023b304) }
  .text.w3d_address_8023b4e4 0x8023b4e4 : { *(.text.w3d_address_8023b4e4) }
  .text.w3d_registry_unlink_8023b558 0x8023b558 : { *(.text.w3d_registry_unlink_8023b558) }
  .text.w3d_address_8023b680 0x8023b680 : { *(.text.w3d_address_8023b680) }
  .text.w3d_registry_unlink_8023b6f4 0x8023b6f4 : { *(.text.w3d_registry_unlink_8023b6f4) }
  .text.w3d_address_8023b9a4 0x8023b9a4 : { *(.text.w3d_address_8023b9a4) }
  .text.w3d_registry_unlink_8023ba18 0x8023ba18 : { *(.text.w3d_registry_unlink_8023ba18) }
  .text.w3d_address_8023bbf4 0x8023bbf4 : { *(.text.w3d_address_8023bbf4) }
  .text.w3d_registry_unlink_8023bc68 0x8023bc68 : { *(.text.w3d_registry_unlink_8023bc68) }
  .text.w3d_address_8023be44 0x8023be44 : { *(.text.w3d_address_8023be44) }
  .text.w3d_registry_unlink_8023beb8 0x8023beb8 : { *(.text.w3d_registry_unlink_8023beb8) }
  .text.w3d_address_8023c168 0x8023c168 : { *(.text.w3d_address_8023c168) }
  .text.w3d_registry_unlink_8023c1dc 0x8023c1dc : { *(.text.w3d_registry_unlink_8023c1dc) }
  .text.w3d_address_8023c3b8 0x8023c3b8 : { *(.text.w3d_address_8023c3b8) }
  .text.w3d_registry_unlink_8023c42c 0x8023c42c : { *(.text.w3d_registry_unlink_8023c42c) }
  .text.w3d_address_8023c6dc 0x8023c6dc : { *(.text.w3d_address_8023c6dc) }
  .text.w3d_registry_unlink_8023c750 0x8023c750 : { *(.text.w3d_registry_unlink_8023c750) }
  .text.w3d_address_8023c844 0x8023c844 : { *(.text.w3d_address_8023c844) }
  .text.w3d_registry_unlink_8023c8b8 0x8023c8b8 : { *(.text.w3d_registry_unlink_8023c8b8) }
  .text.w3d_address_8023c9f0 0x8023c9f0 : { *(.text.w3d_address_8023c9f0) }
  .text.w3d_registry_unlink_8023ca64 0x8023ca64 : { *(.text.w3d_registry_unlink_8023ca64) }
  /DISCARD/ : { *(.text*) *(.rodata*) *(.data*) *(.bss*) *(.sdata*) *(.sbss*) *(.comment) }
}
