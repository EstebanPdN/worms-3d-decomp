/* Generated reference-only placements. All bodies are source-built. */
OUTPUT_FORMAT("elf32-powerpc")
OUTPUT_ARCH(powerpc)
ENTRY(s11_named_handle_802ae4d8)
_SDA_BASE_ = 0x804b2540;
_SDA2_BASE_ = 0x804c2540;
fn_8015ADF4 = 0x8015adf4;
fn_8020BB54 = 0x8020bb54;
fn_8020C5C4 = 0x8020c5c4;
fn_80341588 = 0x80341588;
fn_8034BF4C = 0x8034bf4c;
SECTIONS {
  .text.s11_named_handle_802ae4d8 0x802ae4d8 : { *(.text.s11_named_handle_802ae4d8) }
  /DISCARD/ : { *(.text*) *(.rodata*) *(.data*) *(.bss*) *(.sdata*) *(.sbss*) *(.comment) }
}
