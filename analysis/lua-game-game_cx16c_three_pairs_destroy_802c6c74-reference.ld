/* Generated reference-only placements. All bodies are source-built. */
OUTPUT_FORMAT("elf32-powerpc")
OUTPUT_ARCH(powerpc)
ENTRY(w3d_cx16c_three_pairs_destroy_802c6c74)
_SDA_BASE_ = 0x804b2540;
_SDA2_BASE_ = 0x804c2540;
cx16c_base_destroy_8015ff2c = 0x8015ff2c;
cx16c_table_8041c960 = 0x8041c960;
cx16c_text_finish_8020c5c4 = 0x8020c5c4;
cx16c_text_release_80341588 = 0x80341588;
SECTIONS {
  .text.w3d_cx16c_three_pairs_destroy_802c6c74 0x802c6c74 : { *(.text.w3d_cx16c_three_pairs_destroy_802c6c74) }
  /DISCARD/ : { *(.text*) *(.rodata*) *(.data*) *(.bss*) *(.sdata*) *(.sbss*) *(.comment) }
}
