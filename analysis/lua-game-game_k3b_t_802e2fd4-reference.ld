/* Generated reference-only placements. All bodies are source-built. */
OUTPUT_FORMAT("elf32-powerpc")
OUTPUT_ARCH(powerpc)
ENTRY(w3d_k3b_tagged_construct_802e2fd4)
_SDA_BASE_ = 0x804b2540;
_SDA2_BASE_ = 0x804c2540;
w3d_vtable_8041cb18 = 0x8041cb18;
w3d_vtable_8041cb40 = 0x8041cb40;
SECTIONS {
  .text.w3d_k3b_tagged_construct_802e2fd4 0x802e2fd4 : { *(.text.w3d_k3b_tagged_construct_802e2fd4) }
  /DISCARD/ : { *(.text*) *(.rodata*) *(.data*) *(.bss*) *(.sdata*) *(.sbss*) *(.comment) }
}
