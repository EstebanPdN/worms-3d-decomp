/* Generated reference-only placements. All bodies are source-built. */
OUTPUT_FORMAT("elf32-powerpc")
OUTPUT_ARCH(powerpc)
ENTRY(w3d_k5b_key_binding_set_8017d488)
_SDA_BASE_ = 0x804b2540;
_SDA2_BASE_ = 0x804c2540;
lbl_804a89d8 = 0x804a89d8;
lbl_804a8bd8 = 0x804a8bd8;
lbl_804a8dd8 = 0x804a8dd8;
SECTIONS {
  .text.w3d_k5b_key_binding_set_8017d488 0x8017d488 : { *(.text.w3d_k5b_key_binding_set_8017d488) }
  /DISCARD/ : { *(.text*) *(.rodata*) *(.data*) *(.bss*) *(.sdata*) *(.sbss*) *(.comment) }
}
