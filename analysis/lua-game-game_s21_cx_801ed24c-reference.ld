/* Generated reference-only placements. All bodies are source-built. */
OUTPUT_FORMAT("elf32-powerpc")
OUTPUT_ARCH(powerpc)
ENTRY(w3d_s21_create_entry_801ed24c)
_SDA_BASE_ = 0x804b2540;
_SDA2_BASE_ = 0x804c2540;
fn_801e8bc4 = 0x801e8bc4;
fn_801eb0a8 = 0x801eb0a8;
fn_801ed16c = 0x801ed16c;
fn_801fe1d8 = 0x801fe1d8;
SECTIONS {
  .text.w3d_s21_create_entry_801ed24c 0x801ed24c : { *(.text.w3d_s21_create_entry_801ed24c) }
  /DISCARD/ : { *(.text*) *(.rodata*) *(.data*) *(.bss*) *(.sdata*) *(.sbss*) *(.comment) }
}
