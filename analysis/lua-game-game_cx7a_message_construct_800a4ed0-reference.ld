/* Generated reference-only placements. All bodies are source-built. */
OUTPUT_FORMAT("elf32-powerpc")
OUTPUT_ARCH(powerpc)
ENTRY(w3d_cx7a_message_construct_800a4ed0)
_SDA_BASE_ = 0x804b2540;
_SDA2_BASE_ = 0x804c2540;
set_800a4f44 = 0x800a4f44;
set_800a4f54 = 0x800a4f54;
set_800a4f64 = 0x800a4f64;
set_800a4f74 = 0x800a4f74;
vtable_8040db38 = 0x8040db38;
SECTIONS {
  .text.w3d_cx7a_message_construct_800a4ed0 0x800a4ed0 : { *(.text.w3d_cx7a_message_construct_800a4ed0) }
  /DISCARD/ : { *(.text*) *(.rodata*) *(.data*) *(.bss*) *(.sdata*) *(.sbss*) *(.comment) }
}
