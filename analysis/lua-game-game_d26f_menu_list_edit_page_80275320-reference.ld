/* Generated reference-only placements. All bodies are source-built. */
OUTPUT_FORMAT("elf32-powerpc")
OUTPUT_ARCH(powerpc)
ENTRY(d26f_menu_list_edit_page_80275320)
_SDA_BASE_ = 0x804b2540;
_SDA2_BASE_ = 0x804c2540;
__17D26fText_803426b8 = 0x803426b8;
lbl_803cc0d8 = 0x803cc0d8;
lbl_803cc7a4 = 0x803cc7a4;
lbl_803cc864 = 0x803cc864;
lbl_803cc86c = 0x803cc86c;
lbl_803cc8b4 = 0x803cc8b4;
lbl_803ccbb8 = 0x803ccbb8;
lbl_803ccf30 = 0x803ccf30;
lbl_803cd22c = 0x803cd22c;
lbl_803cd24c = 0x803cd24c;
lbl_803cd26c = 0x803cd26c;
lbl_803cd7e4 = 0x803cd7e4;
lbl_803cd7f8 = 0x803cd7f8;
lbl_803cd818 = 0x803cd818;
lbl_803cd838 = 0x803cd838;
lbl_803cd858 = 0x803cd858;
lbl_803cd878 = 0x803cd878;
lbl_803cd898 = 0x803cd898;
lbl_803cd8b8 = 0x803cd8b8;
lbl_803cd8d8 = 0x803cd8d8;
lbl_803cd8f8 = 0x803cd8f8;
lbl_803cd918 = 0x803cd918;
lbl_803cd938 = 0x803cd938;
lbl_804b06a0 = 0x804b06a0;
w3d_auto_8020d4b8 = 0x8020d4b8;
w3d_auto_802cbf2c = 0x802cbf2c;
w3d_auto_802cbf68 = 0x802cbf68;
w3d_auto_802cbfa4 = 0x802cbfa4;
w3d_auto_802cd07c = 0x802cd07c;
w3d_auto_802cd128 = 0x802cd128;
w3d_cc32b_append_lines_v2_802cc0ac = 0x802cc0ac;
w3d_cx7b_script_flag_set_8027a934 = 0x8027a934;
w3d_dtor_node_8020d36c = 0x8020d36c;
w3d_r25b_sink_write_v3_802cbe9c = 0x802cbe9c;
w3d_registry_retain_8020d2b8 = 0x8020d2b8;
w3d_s21_append_position_802cd26c = 0x802cd26c;
w3d_s21_repeat_request_802cd220 = 0x802cd220;
w3d_s21_sink_write_indexed_802cbdf8 = 0x802cbdf8;
w3d_s21_vector_get_801e9db8 = 0x801e9db8;
w3d_string_base_finish = 0x8020c5c4;
w3d_string_format = 0x8020c510;
w3d_string_release = 0x80341588;
w3d_string_release_header = 0x8020bb2c;
w3d_tagged_construct_8020d318 = 0x8020d318;
SECTIONS {
  .text.d26f_menu_list_edit_page_80275320 0x80275320 : { *(.text.d26f_menu_list_edit_page_80275320) }
  /DISCARD/ : { *(.text*) *(.rodata*) *(.data*) *(.bss*) *(.sdata*) *(.sbss*) *(.comment) }
}
