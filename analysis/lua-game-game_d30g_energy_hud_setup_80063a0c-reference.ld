/* Generated reference-only placements. All bodies are source-built. */
OUTPUT_FORMAT("elf32-powerpc")
OUTPUT_ARCH(powerpc)
ENTRY(w3d_d30g_energy_hud_setup_80063a0c)
_SDA_BASE_ = 0x804b2540;
_SDA2_BASE_ = 0x804c2540;
__6StringPCc = 0x8020bb54;
float_cast_80342a74 = 0x80342a74;
font_cast_80343580 = 0x80343580;
font_flags_8018d324 = 0x8018d324;
layout_80064a80 = 0x80064a80;
lookup_800fc1b0 = 0x800fc1b0;
one_80379d2c = 0x80379d2c;
read_float_80178df0 = 0x80178df0;
read_vector_80178ec4 = 0x80178ec4;
s_80379bfc = 0x80379bfc;
s_80379c14 = 0x80379c14;
s_80379c2c = 0x80379c2c;
s_80379c44 = 0x80379c44;
s_80379c58 = 0x80379c58;
s_80379c70 = 0x80379c70;
s_80379c88 = 0x80379c88;
s_80379ca0 = 0x80379ca0;
s_80379cb8 = 0x80379cb8;
s_80379cd0 = 0x80379cd0;
s_80379ce8 = 0x80379ce8;
s_80379d00 = 0x80379d00;
s_80379d10 = 0x80379d10;
s_80379d24 = 0x80379d24;
set_name_8015adf4 = 0x8015adf4;
string_finish_8020c5c4 = 0x8020c5c4;
string_release_80341588 = 0x80341588;
update_80064198 = 0x80064198;
update_800642ac = 0x800642ac;
vector_cast_80342fa4 = 0x80342fa4;
SECTIONS {
  .text.w3d_d30g_energy_hud_setup_80063a0c 0x80063a0c : { *(.text.w3d_d30g_energy_hud_setup_80063a0c) }
  /DISCARD/ : { *(.text*) *(.rodata*) *(.data*) *(.bss*) *(.sdata*) *(.sbss*) *(.comment) }
}
