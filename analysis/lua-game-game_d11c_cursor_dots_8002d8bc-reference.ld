/* Generated reference-only placements. All bodies are source-built. */
OUTPUT_FORMAT("elf32-powerpc")
OUTPUT_ARCH(powerpc)
ENTRY(d11c_cursor_dots_8002d8bc)
_SDA_BASE_ = 0x804b2540;
_SDA2_BASE_ = 0x804c2540;
__20d11c_String_8020bb54PCc = 0x8020bb54;
d11c_aimer_80372ac4 = 0x80372ac4;
d11c_bitmap_80372aac = 0x80372aac;
d11c_cast_8034357c = 0x8034357c;
d11c_cursor_setup_8004e0dc = 0x8004e0dc;
d11c_dot_80372afc = 0x80372afc;
d11c_dot_nulls_803f3c68 = 0x803f3c68;
d11c_error_80372aec = 0x80372aec;
d11c_handle_set_name_8015adf4 = 0x8015adf4;
d11c_intro_80372ad0 = 0x80372ad0;
d11c_loop_80372ae0 = 0x80372ae0;
d11c_mesh_80372a94 = 0x80372a94;
d11c_string_base_finish_8020c5c4 = 0x8020c5c4;
d11c_string_release_80341588 = 0x80341588;
SECTIONS {
  .text.d11c_cursor_dots_8002d8bc 0x8002d8bc : { *(.text.d11c_cursor_dots_8002d8bc) }
  /DISCARD/ : { *(.text*) *(.rodata*) *(.data*) *(.bss*) *(.sdata*) *(.sbss*) *(.comment) }
}
