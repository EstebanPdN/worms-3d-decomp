/* Generated reference-only placements. All bodies are source-built. */
OUTPUT_FORMAT("elf32-powerpc")
OUTPUT_ARCH(powerpc)
ENTRY(w3d_k6b_value_node_clone_801f15e0)
_SDA_BASE_ = 0x804b2540;
_SDA2_BASE_ = 0x804c2540;
lbl_804179a0 = 0x804179a0;
w3d_auto_801eb058 = 0x801eb058;
w3d_heap_allocate_entry_a = 0x801fe1d8;
w3d_s12_append_value_801e8bc4 = 0x801e8bc4;
w3d_set_801eb0a8 = 0x801eb0a8;
SECTIONS {
  .text.w3d_k6b_value_node_clone_801f15e0 0x801f15e0 : { *(.text.w3d_k6b_value_node_clone_801f15e0) }
  /DISCARD/ : { *(.text*) *(.rodata*) *(.data*) *(.bss*) *(.sdata*) *(.sbss*) *(.comment) }
}
