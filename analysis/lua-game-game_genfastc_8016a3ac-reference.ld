/* Generated reference-only placements. All bodies are source-built. */
OUTPUT_FORMAT("elf32-powerpc")
OUTPUT_ARCH(powerpc)
ENTRY(w3d_apply_alpha_test_8016a3ac)
_SDA_BASE_ = 0x804b2540;
_SDA2_BASE_ = 0x804c2540;
fn_80178f54 = 0x80178f54;
fn_802a0d44 = 0x802a0d44;
fn_802b16c4 = 0x802b16c4;
fn_8030b3dc = 0x8030b3dc;
fn_8030ba98 = 0x8030ba98;
lbl_803a552c = 0x803a552c;
SECTIONS {
  .text.w3d_apply_alpha_test_8016a3ac 0x8016a3ac : { *(.text.w3d_apply_alpha_test_8016a3ac) }
  .text.w3d_set_blend_mode_802a0cc0 0x802a0cc0 : { *(.text.w3d_set_blend_mode_802a0cc0) }
  /DISCARD/ : { *(.text*) *(.rodata*) *(.data*) *(.bss*) *(.sdata*) *(.sbss*) *(.comment) }
}
