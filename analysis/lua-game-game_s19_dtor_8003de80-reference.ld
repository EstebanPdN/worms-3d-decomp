/* Generated reference-only placements. All bodies are source-built. */
OUTPUT_FORMAT("elf32-powerpc")
OUTPUT_ARCH(powerpc)
ENTRY(s19_actor_destroy_8003de80)
_SDA_BASE_ = 0x804b2540;
_SDA2_BASE_ = 0x804c2540;
lbl_8040e8b8 = 0x8040e8b8;
w3d_actor_base_destroy = 0x80161050;
w3d_actor_handle_member_destroy = 0x80126230;
SECTIONS {
  .text.s19_actor_destroy_8003de80 0x8003de80 : { *(.text.s19_actor_destroy_8003de80) }
  /DISCARD/ : { *(.text*) *(.rodata*) *(.data*) *(.bss*) *(.sdata*) *(.sbss*) *(.comment) }
}
