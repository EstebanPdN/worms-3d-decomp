/* Generated reference-only placements. All bodies are source-built. */
OUTPUT_FORMAT("elf32-powerpc")
OUTPUT_ARCH(powerpc)
ENTRY(k5a_alliance_member_count_8008ac48)
_SDA_BASE_ = 0x804b2540;
_SDA2_BASE_ = 0x804c2540;
s8_handle_800fc82c = 0x800fc82c;
s8_handle_800fc948 = 0x800fc948;
w3d_s20_destroy_owned_80178474 = 0x80178474;
SECTIONS {
  .text.k5a_alliance_member_count_8008ac48 0x8008ac48 : { *(.text.k5a_alliance_member_count_8008ac48) }
  /DISCARD/ : { *(.text*) *(.rodata*) *(.data*) *(.bss*) *(.sdata*) *(.sbss*) *(.comment) }
}
