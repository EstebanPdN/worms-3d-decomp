/* Generated reference-only placements. All bodies are source-built. */
OUTPUT_FORMAT("elf32-powerpc")
OUTPUT_ARCH(powerpc)
ENTRY(k4a_speaker_pick_line_8013f0cc)
_SDA_BASE_ = 0x804b2540;
_SDA2_BASE_ = 0x804c2540;
FUN_8013bd0c = 0x8013bd0c;
fn_80162C20 = 0x80162c20;
w3d_str_8039f87c = 0x8039f87c;
w3d_str_8039f880 = 0x8039f880;
SECTIONS {
  .text.k4a_speaker_pick_line_8013f0cc 0x8013f0cc : { *(.text.k4a_speaker_pick_line_8013f0cc) }
  /DISCARD/ : { *(.text*) *(.rodata*) *(.data*) *(.bss*) *(.sdata*) *(.sbss*) *(.comment) }
}
