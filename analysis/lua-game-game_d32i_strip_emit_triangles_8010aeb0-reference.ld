/* Generated reference-only placements. All bodies are source-built. */
OUTPUT_FORMAT("elf32-powerpc")
OUTPUT_ARCH(powerpc)
ENTRY(d32i_strip_emit_triangles_8010aeb0)
_SDA_BASE_ = 0x804b2540;
_SDA2_BASE_ = 0x804c2540;
emit_8010ad24 = 0x8010ad24;
high_8010ae30 = 0x8010ae30;
low_8010adb0 = 0x8010adb0;
SECTIONS {
  .text.d32i_strip_emit_triangles_8010aeb0 0x8010aeb0 : { *(.text.d32i_strip_emit_triangles_8010aeb0) }
  /DISCARD/ : { *(.text*) *(.rodata*) *(.data*) *(.bss*) *(.sdata*) *(.sbss*) *(.comment) }
}
