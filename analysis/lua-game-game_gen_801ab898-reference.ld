/* Generated reference-only placements. All bodies are source-built. */
OUTPUT_FORMAT("elf32-powerpc")
OUTPUT_ARCH(powerpc)
ENTRY(w3d_get_801ab898)
_SDA_BASE_ = 0x804b2540;
_SDA2_BASE_ = 0x804c2540;
w3d_fn_801ac19c = 0x801ac19c;
w3d_fn_801ac2a4 = 0x801ac2a4;
w3d_fn_801ac79c = 0x801ac79c;
w3d_fn_801ac860 = 0x801ac860;
w3d_fn_801ae3d8 = 0x801ae3d8;
w3d_fn_801ae440 = 0x801ae440;
w3d_fn_801aeac0 = 0x801aeac0;
w3d_fn_801aeb28 = 0x801aeb28;
w3d_fn_801b0d38 = 0x801b0d38;
w3d_fn_801b10b8 = 0x801b10b8;
w3d_fn_801b17bc = 0x801b17bc;
w3d_fn_801b1838 = 0x801b1838;
w3d_fn_801b229c = 0x801b229c;
w3d_fn_801b230c = 0x801b230c;
w3d_fn_801b2a6c = 0x801b2a6c;
w3d_fn_801b2dac = 0x801b2dac;
w3d_fn_801b440c = 0x801b440c;
w3d_fn_801b4460 = 0x801b4460;
w3d_global_803624dc = 0x803624dc;
w3d_global_80362528 = 0x80362528;
w3d_global_80362574 = 0x80362574;
w3d_global_803625c0 = 0x803625c0;
w3d_global_803625f0 = 0x803625f0;
w3d_global_8036263c = 0x8036263c;
w3d_global_80362688 = 0x80362688;
w3d_global_803626d4 = 0x803626d4;
w3d_global_80362704 = 0x80362704;
w3d_global_80362754 = 0x80362754;
w3d_global_803aa468 = 0x803aa468;
w3d_global_803aa510 = 0x803aa510;
w3d_global_803aa660 = 0x803aa660;
w3d_global_803aa724 = 0x803aa724;
w3d_global_803aa7e8 = 0x803aa7e8;
w3d_global_803aa8a0 = 0x803aa8a0;
w3d_global_803aa990 = 0x803aa990;
w3d_global_803aaa48 = 0x803aaa48;
w3d_global_803aab4c = 0x803aab4c;
w3d_global_8045ce60 = 0x8045ce60;
w3d_heap_allocate_entry_a = 0x801fe1d8;
w3d_owner_list_remove = 0x8020fd2c;
w3d_registry_list_803624dc = 0x803624dc;
w3d_registry_list_80362528 = 0x80362528;
w3d_registry_list_80362574 = 0x80362574;
w3d_registry_list_803625c0 = 0x803625c0;
w3d_registry_list_803625f0 = 0x803625f0;
w3d_registry_list_8036263c = 0x8036263c;
w3d_registry_list_80362688 = 0x80362688;
w3d_registry_list_803626d4 = 0x803626d4;
w3d_registry_list_80362704 = 0x80362704;
w3d_registry_list_80362754 = 0x80362754;
w3d_state_register = 0x8020fd04;
SECTIONS {
  .text.w3d_get_801ab898 0x801ab898 : { *(.text.w3d_get_801ab898) }
  .text.w3d_get_801ab8ac 0x801ab8ac : { *(.text.w3d_get_801ab8ac) }
  .text.w3d_get_801ab92c 0x801ab92c : { *(.text.w3d_get_801ab92c) }
  .text.w3d_get_801ab978 0x801ab978 : { *(.text.w3d_get_801ab978) }
  .text.w3d_address_801abfc4 0x801abfc4 : { *(.text.w3d_address_801abfc4) }
  .text.w3d_registry_unlink_801abfd0 0x801abfd0 : { *(.text.w3d_registry_unlink_801abfd0) }
  .text.w3d_registry_create_801ac014 0x801ac014 : { *(.text.w3d_registry_create_801ac014) }
  .text.w3d_get_801ac0cc 0x801ac0cc : { *(.text.w3d_get_801ac0cc) }
  .text.w3d_address_801ac0d4 0x801ac0d4 : { *(.text.w3d_address_801ac0d4) }
  .text.w3d_registry_release_801ac0e0 0x801ac0e0 : { *(.text.w3d_registry_release_801ac0e0) }
  .text.w3d_registry_retain_801ac13c 0x801ac13c : { *(.text.w3d_registry_retain_801ac13c) }
  .text.w3d_address_801ac5c4 0x801ac5c4 : { *(.text.w3d_address_801ac5c4) }
  .text.w3d_registry_unlink_801ac5d0 0x801ac5d0 : { *(.text.w3d_registry_unlink_801ac5d0) }
  .text.w3d_registry_create_801ac614 0x801ac614 : { *(.text.w3d_registry_create_801ac614) }
  .text.w3d_get_801ac6cc 0x801ac6cc : { *(.text.w3d_get_801ac6cc) }
  .text.w3d_address_801ac6d4 0x801ac6d4 : { *(.text.w3d_address_801ac6d4) }
  .text.w3d_registry_release_801ac6e0 0x801ac6e0 : { *(.text.w3d_registry_release_801ac6e0) }
  .text.w3d_registry_retain_801ac73c 0x801ac73c : { *(.text.w3d_registry_retain_801ac73c) }
  .text.w3d_get_801acd50 0x801acd50 : { *(.text.w3d_get_801acd50) }
  .text.w3d_get_801acd64 0x801acd64 : { *(.text.w3d_get_801acd64) }
  .text.w3d_constant_801ad588 0x801ad588 : { *(.text.w3d_constant_801ad588) }
  .text.w3d_address_801ae200 0x801ae200 : { *(.text.w3d_address_801ae200) }
  .text.w3d_registry_unlink_801ae20c 0x801ae20c : { *(.text.w3d_registry_unlink_801ae20c) }
  .text.w3d_registry_create_801ae250 0x801ae250 : { *(.text.w3d_registry_create_801ae250) }
  .text.w3d_get_801ae308 0x801ae308 : { *(.text.w3d_get_801ae308) }
  .text.w3d_address_801ae310 0x801ae310 : { *(.text.w3d_address_801ae310) }
  .text.w3d_registry_release_801ae31c 0x801ae31c : { *(.text.w3d_registry_release_801ae31c) }
  .text.w3d_registry_retain_801ae378 0x801ae378 : { *(.text.w3d_registry_retain_801ae378) }
  .text.w3d_constant_801ae5ac 0x801ae5ac : { *(.text.w3d_constant_801ae5ac) }
  .text.w3d_get_801ae61c 0x801ae61c : { *(.text.w3d_get_801ae61c) }
  .text.w3d_address_801ae948 0x801ae948 : { *(.text.w3d_address_801ae948) }
  .text.w3d_registry_unlink_801ae954 0x801ae954 : { *(.text.w3d_registry_unlink_801ae954) }
  .text.w3d_registry_create_801ae998 0x801ae998 : { *(.text.w3d_registry_create_801ae998) }
  .text.w3d_address_801ae9f8 0x801ae9f8 : { *(.text.w3d_address_801ae9f8) }
  .text.w3d_registry_release_801aea04 0x801aea04 : { *(.text.w3d_registry_release_801aea04) }
  .text.w3d_registry_retain_801aea60 0x801aea60 : { *(.text.w3d_registry_retain_801aea60) }
  .text.w3d_address_801b0b60 0x801b0b60 : { *(.text.w3d_address_801b0b60) }
  .text.w3d_registry_unlink_801b0b6c 0x801b0b6c : { *(.text.w3d_registry_unlink_801b0b6c) }
  .text.w3d_registry_create_801b0bb0 0x801b0bb0 : { *(.text.w3d_registry_create_801b0bb0) }
  .text.w3d_get_801b0c68 0x801b0c68 : { *(.text.w3d_get_801b0c68) }
  .text.w3d_address_801b0c70 0x801b0c70 : { *(.text.w3d_address_801b0c70) }
  .text.w3d_registry_release_801b0c7c 0x801b0c7c : { *(.text.w3d_registry_release_801b0c7c) }
  .text.w3d_registry_retain_801b0cd8 0x801b0cd8 : { *(.text.w3d_registry_retain_801b0cd8) }
  .text.w3d_constant_801b126c 0x801b126c : { *(.text.w3d_constant_801b126c) }
  .text.w3d_constant_801b1274 0x801b1274 : { *(.text.w3d_constant_801b1274) }
  .text.w3d_get_801b12e4 0x801b12e4 : { *(.text.w3d_get_801b12e4) }
  .text.w3d_address_801b15e4 0x801b15e4 : { *(.text.w3d_address_801b15e4) }
  .text.w3d_registry_unlink_801b15f0 0x801b15f0 : { *(.text.w3d_registry_unlink_801b15f0) }
  .text.w3d_registry_create_801b1634 0x801b1634 : { *(.text.w3d_registry_create_801b1634) }
  .text.w3d_get_801b16ec 0x801b16ec : { *(.text.w3d_get_801b16ec) }
  .text.w3d_address_801b16f4 0x801b16f4 : { *(.text.w3d_address_801b16f4) }
  .text.w3d_registry_release_801b1700 0x801b1700 : { *(.text.w3d_registry_release_801b1700) }
  .text.w3d_registry_retain_801b175c 0x801b175c : { *(.text.w3d_registry_retain_801b175c) }
  .text.w3d_get_801b1b9c 0x801b1b9c : { *(.text.w3d_get_801b1b9c) }
  .text.w3d_address_801b20c4 0x801b20c4 : { *(.text.w3d_address_801b20c4) }
  .text.w3d_registry_unlink_801b20d0 0x801b20d0 : { *(.text.w3d_registry_unlink_801b20d0) }
  .text.w3d_registry_create_801b2114 0x801b2114 : { *(.text.w3d_registry_create_801b2114) }
  .text.w3d_get_801b21cc 0x801b21cc : { *(.text.w3d_get_801b21cc) }
  .text.w3d_address_801b21d4 0x801b21d4 : { *(.text.w3d_address_801b21d4) }
  .text.w3d_registry_release_801b21e0 0x801b21e0 : { *(.text.w3d_registry_release_801b21e0) }
  .text.w3d_registry_retain_801b223c 0x801b223c : { *(.text.w3d_registry_retain_801b223c) }
  .text.w3d_constant_801b249c 0x801b249c : { *(.text.w3d_constant_801b249c) }
  .text.w3d_get_801b250c 0x801b250c : { *(.text.w3d_get_801b250c) }
  .text.w3d_get_801b2520 0x801b2520 : { *(.text.w3d_get_801b2520) }
  .text.w3d_get_801b2534 0x801b2534 : { *(.text.w3d_get_801b2534) }
  .text.w3d_get_801b2548 0x801b2548 : { *(.text.w3d_get_801b2548) }
  .text.w3d_address_801b2a60 0x801b2a60 : { *(.text.w3d_address_801b2a60) }
  .text.w3d_address_801b2b84 0x801b2b84 : { *(.text.w3d_address_801b2b84) }
  .text.w3d_registry_release_801b2b90 0x801b2b90 : { *(.text.w3d_registry_release_801b2b90) }
  .text.w3d_registry_retain_801b2bec 0x801b2bec : { *(.text.w3d_registry_retain_801b2bec) }
  .text.w3d_address_801b4294 0x801b4294 : { *(.text.w3d_address_801b4294) }
  .text.w3d_registry_unlink_801b42a0 0x801b42a0 : { *(.text.w3d_registry_unlink_801b42a0) }
  .text.w3d_registry_create_801b42e4 0x801b42e4 : { *(.text.w3d_registry_create_801b42e4) }
  .text.w3d_address_801b4344 0x801b4344 : { *(.text.w3d_address_801b4344) }
  .text.w3d_registry_release_801b4350 0x801b4350 : { *(.text.w3d_registry_release_801b4350) }
  .text.w3d_registry_retain_801b43ac 0x801b43ac : { *(.text.w3d_registry_retain_801b43ac) }
  .text.w3d_address_801b4b14 0x801b4b14 : { *(.text.w3d_address_801b4b14) }
  .text.w3d_registry_unlink_801b4b88 0x801b4b88 : { *(.text.w3d_registry_unlink_801b4b88) }
  .text.w3d_address_801b4ddc 0x801b4ddc : { *(.text.w3d_address_801b4ddc) }
  .text.w3d_registry_unlink_801b4e50 0x801b4e50 : { *(.text.w3d_registry_unlink_801b4e50) }
  /DISCARD/ : { *(.text*) *(.rodata*) *(.data*) *(.bss*) *(.sdata*) *(.sbss*) *(.comment) }
}
