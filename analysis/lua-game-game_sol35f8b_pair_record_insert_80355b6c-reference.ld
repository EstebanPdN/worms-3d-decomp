/* Generated reference-only placements. All bodies are source-built. */
OUTPUT_FORMAT("elf32-powerpc")
OUTPUT_ARCH(powerpc)
ENTRY(sol35f8b_pair_record_insert_80355b6c)
_SDA_BASE_ = 0x804b2540;
_SDA2_BASE_ = 0x804c2540;
sol35f8b_allocate_80212fd4 = 0x80212fd4;
sol35f8b_allocation_fallback_803413d8 = 0x803413d8;
sol35f8b_copy_refs_801f2698 = 0x801f2698;
sol35f8b_rebalance_80352404 = 0x80352404;
SECTIONS {
  .text.sol35f8b_pair_record_insert_80355b6c 0x80355b6c : { *(.text.sol35f8b_pair_record_insert_80355b6c) }
  /DISCARD/ : { *(.text*) *(.rodata*) *(.data*) *(.bss*) *(.sdata*) *(.sbss*) *(.comment) }
}
