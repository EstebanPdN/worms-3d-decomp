/* Generated reference-only placements. All bodies are source-built. */
OUTPUT_FORMAT("elf32-powerpc")
OUTPUT_ARCH(powerpc)
ENTRY(w3d_d18e_reset_srt_801bcbf0)
_SDA_BASE_ = 0x804b2540;
_SDA2_BASE_ = 0x804c2540;
fn_801e8d9c = 0x801e8d9c;
fn_801ece2c = 0x801ece2c;
fn_801f0210 = 0x801f0210;
key_803ab934 = 0x803ab934;
key_803ab960 = 0x803ab960;
key_803ab984 = 0x803ab984;
key_803ab9a8 = 0x803ab9a8;
value_803ab9d0 = 0x803ab9d0;
value_803ab9d4 = 0x803ab9d4;
SECTIONS {
  .text.w3d_d18e_reset_srt_801bcbf0 0x801bcbf0 : { *(.text.w3d_d18e_reset_srt_801bcbf0) }
  /DISCARD/ : { *(.text*) *(.rodata*) *(.data*) *(.bss*) *(.sdata*) *(.sbss*) *(.comment) }
}
