/* Generated reference-only placements. All bodies are source-built. */
OUTPUT_FORMAT("elf32-powerpc")
OUTPUT_ARCH(powerpc)
ENTRY(w3d_d26e_camera_axes_801a0cf4)
_SDA_BASE_ = 0x804b2540;
_SDA2_BASE_ = 0x804c2540;
constant_803a9b38 = 0x803a9b38;
constant_803a9b3c = 0x803a9b3c;
constant_803a9b40 = 0x803a9b40;
fn_802e82c0 = 0x802e82c0;
SECTIONS {
  .text.w3d_d26e_camera_axes_801a0cf4 0x801a0cf4 : { *(.text.w3d_d26e_camera_axes_801a0cf4) }
  /DISCARD/ : { *(.text*) *(.rodata*) *(.data*) *(.bss*) *(.sdata*) *(.sbss*) *(.comment) }
}
