/* Generated reference-only placements. All bodies are source-built. */
OUTPUT_FORMAT("elf32-powerpc")
OUTPUT_ARCH(powerpc)
ENTRY(w3d_s21_widget_set_text_802a1bf4)
_SDA_BASE_ = 0x804b2540;
_SDA2_BASE_ = 0x804c2540;
__7S21Text = 0x803426b8;
assign__7S21TextPCcUi = 0x8020bdf4;
fn_8020c5c4__FP7S21Text = 0x8020c5c4;
fn_8029ec80__FP9S21Widgeti = 0x8029ec80;
fn_802a21ec__FP9S21Widget = 0x802a21ec;
fn_80341588__FP7S21Text = 0x80341588;
lbl_803d1f04 = 0x803d1f04;
set__7S21Texti = 0x8020bd38;
SECTIONS {
  .text.w3d_s21_widget_set_text_802a1bf4 0x802a1bf4 : { *(.text.w3d_s21_widget_set_text_802a1bf4) }
  /DISCARD/ : { *(.text*) *(.rodata*) *(.data*) *(.bss*) *(.sdata*) *(.sbss*) *(.comment) }
}
