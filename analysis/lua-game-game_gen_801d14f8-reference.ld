/* Generated reference-only placements. All bodies are source-built. */
OUTPUT_FORMAT("elf32-powerpc")
OUTPUT_ARCH(powerpc)
ENTRY(w3d_get_801d14f8)
_SDA_BASE_ = 0x804b2540;
_SDA2_BASE_ = 0x804c2540;
w3d_fn_801d1ccc = 0x801d1ccc;
w3d_fn_801d1e70 = 0x801d1e70;
w3d_fn_801d3150 = 0x801d3150;
w3d_fn_801d31d0 = 0x801d31d0;
w3d_fn_801d424c = 0x801d424c;
w3d_fn_801d42a0 = 0x801d42a0;
w3d_fn_801d47b8 = 0x801d47b8;
w3d_global_80365364 = 0x80365364;
w3d_global_80365394 = 0x80365394;
w3d_global_803653e0 = 0x803653e0;
w3d_global_8036542c = 0x8036542c;
w3d_global_803aefa8 = 0x803aefa8;
w3d_global_803aeff8 = 0x803aeff8;
w3d_global_803af08c = 0x803af08c;
w3d_global_803af0fc = 0x803af0fc;
w3d_heap_allocate_entry_a = 0x801fe1d8;
w3d_owner_list_remove = 0x8020fd2c;
w3d_registry_list_80365364 = 0x80365364;
w3d_registry_list_80365394 = 0x80365394;
w3d_registry_list_803653e0 = 0x803653e0;
w3d_registry_list_8036542c = 0x8036542c;
w3d_state_register = 0x8020fd04;
SECTIONS {
  .text.w3d_get_801d14f8 0x801d14f8 : { *(.text.w3d_get_801d14f8) }
  .text.w3d_set_801d1500 0x801d1500 : { *(.text.w3d_set_801d1500) }
  .text.w3d_get_801d1508 0x801d1508 : { *(.text.w3d_get_801d1508) }
  .text.w3d_set_801d1510 0x801d1510 : { *(.text.w3d_set_801d1510) }
  .text.w3d_get_801d1518 0x801d1518 : { *(.text.w3d_get_801d1518) }
  .text.w3d_set_801d1520 0x801d1520 : { *(.text.w3d_set_801d1520) }
  .text.w3d_get_801d1528 0x801d1528 : { *(.text.w3d_get_801d1528) }
  .text.w3d_set_801d1530 0x801d1530 : { *(.text.w3d_set_801d1530) }
  .text.w3d_get_801d1538 0x801d1538 : { *(.text.w3d_get_801d1538) }
  .text.w3d_get_801d15a4 0x801d15a4 : { *(.text.w3d_get_801d15a4) }
  .text.w3d_set_801d15ac 0x801d15ac : { *(.text.w3d_set_801d15ac) }
  .text.w3d_get_801d15b4 0x801d15b4 : { *(.text.w3d_get_801d15b4) }
  .text.w3d_set_801d15bc 0x801d15bc : { *(.text.w3d_set_801d15bc) }
  .text.w3d_get_801d15c4 0x801d15c4 : { *(.text.w3d_get_801d15c4) }
  .text.w3d_set_801d15cc 0x801d15cc : { *(.text.w3d_set_801d15cc) }
  .text.w3d_get_801d15d4 0x801d15d4 : { *(.text.w3d_get_801d15d4) }
  .text.w3d_set_801d15dc 0x801d15dc : { *(.text.w3d_set_801d15dc) }
  .text.w3d_get_801d15e4 0x801d15e4 : { *(.text.w3d_get_801d15e4) }
  .text.w3d_set_801d15ec 0x801d15ec : { *(.text.w3d_set_801d15ec) }
  .text.w3d_get_801d15f4 0x801d15f4 : { *(.text.w3d_get_801d15f4) }
  .text.w3d_set_801d15fc 0x801d15fc : { *(.text.w3d_set_801d15fc) }
  .text.w3d_get_801d1604 0x801d1604 : { *(.text.w3d_get_801d1604) }
  .text.w3d_set_801d161c 0x801d161c : { *(.text.w3d_set_801d161c) }
  .text.w3d_get_801d1624 0x801d1624 : { *(.text.w3d_get_801d1624) }
  .text.w3d_set_801d162c 0x801d162c : { *(.text.w3d_set_801d162c) }
  .text.w3d_get_801d1634 0x801d1634 : { *(.text.w3d_get_801d1634) }
  .text.w3d_set_801d163c 0x801d163c : { *(.text.w3d_set_801d163c) }
  .text.w3d_get_801d1644 0x801d1644 : { *(.text.w3d_get_801d1644) }
  .text.w3d_set_801d164c 0x801d164c : { *(.text.w3d_set_801d164c) }
  .text.w3d_get_801d1654 0x801d1654 : { *(.text.w3d_get_801d1654) }
  .text.w3d_set_801d165c 0x801d165c : { *(.text.w3d_set_801d165c) }
  .text.w3d_get_801d1664 0x801d1664 : { *(.text.w3d_get_801d1664) }
  .text.w3d_set_801d166c 0x801d166c : { *(.text.w3d_set_801d166c) }
  .text.w3d_get_801d1674 0x801d1674 : { *(.text.w3d_get_801d1674) }
  .text.w3d_set_801d167c 0x801d167c : { *(.text.w3d_set_801d167c) }
  .text.w3d_get_801d1684 0x801d1684 : { *(.text.w3d_get_801d1684) }
  .text.w3d_get_801d16f0 0x801d16f0 : { *(.text.w3d_get_801d16f0) }
  .text.w3d_get_801d1848 0x801d1848 : { *(.text.w3d_get_801d1848) }
  .text.w3d_set_801d1850 0x801d1850 : { *(.text.w3d_set_801d1850) }
  .text.w3d_get_801d1858 0x801d1858 : { *(.text.w3d_get_801d1858) }
  .text.w3d_set_801d1890 0x801d1890 : { *(.text.w3d_set_801d1890) }
  .text.w3d_get_801d1898 0x801d1898 : { *(.text.w3d_get_801d1898) }
  .text.w3d_get_801d1904 0x801d1904 : { *(.text.w3d_get_801d1904) }
  .text.w3d_get_801d1970 0x801d1970 : { *(.text.w3d_get_801d1970) }
  .text.w3d_get_801d19dc 0x801d19dc : { *(.text.w3d_get_801d19dc) }
  .text.w3d_get_801d1a48 0x801d1a48 : { *(.text.w3d_get_801d1a48) }
  .text.w3d_get_801d1ab4 0x801d1ab4 : { *(.text.w3d_get_801d1ab4) }
  .text.w3d_get_801d1b20 0x801d1b20 : { *(.text.w3d_get_801d1b20) }
  .text.w3d_address_801d1b54 0x801d1b54 : { *(.text.w3d_address_801d1b54) }
  .text.w3d_registry_unlink_801d1b60 0x801d1b60 : { *(.text.w3d_registry_unlink_801d1b60) }
  .text.w3d_registry_create_801d1ba4 0x801d1ba4 : { *(.text.w3d_registry_create_801d1ba4) }
  .text.w3d_address_801d1c04 0x801d1c04 : { *(.text.w3d_address_801d1c04) }
  .text.w3d_registry_release_801d1c10 0x801d1c10 : { *(.text.w3d_registry_release_801d1c10) }
  .text.w3d_registry_retain_801d1c6c 0x801d1c6c : { *(.text.w3d_registry_retain_801d1c6c) }
  .text.w3d_get_801d201c 0x801d201c : { *(.text.w3d_get_801d201c) }
  .text.w3d_get_801d2180 0x801d2180 : { *(.text.w3d_get_801d2180) }
  .text.w3d_get_801d22e4 0x801d22e4 : { *(.text.w3d_get_801d22e4) }
  .text.w3d_address_801d2f78 0x801d2f78 : { *(.text.w3d_address_801d2f78) }
  .text.w3d_registry_unlink_801d2f84 0x801d2f84 : { *(.text.w3d_registry_unlink_801d2f84) }
  .text.w3d_registry_create_801d2fc8 0x801d2fc8 : { *(.text.w3d_registry_create_801d2fc8) }
  .text.w3d_get_801d3080 0x801d3080 : { *(.text.w3d_get_801d3080) }
  .text.w3d_address_801d3088 0x801d3088 : { *(.text.w3d_address_801d3088) }
  .text.w3d_registry_release_801d3094 0x801d3094 : { *(.text.w3d_registry_release_801d3094) }
  .text.w3d_registry_retain_801d30f0 0x801d30f0 : { *(.text.w3d_registry_retain_801d30f0) }
  .text.w3d_constant_801d33a8 0x801d33a8 : { *(.text.w3d_constant_801d33a8) }
  .text.w3d_get_801d3884 0x801d3884 : { *(.text.w3d_get_801d3884) }
  .text.w3d_address_801d4074 0x801d4074 : { *(.text.w3d_address_801d4074) }
  .text.w3d_registry_unlink_801d4080 0x801d4080 : { *(.text.w3d_registry_unlink_801d4080) }
  .text.w3d_registry_create_801d40c4 0x801d40c4 : { *(.text.w3d_registry_create_801d40c4) }
  .text.w3d_get_801d417c 0x801d417c : { *(.text.w3d_get_801d417c) }
  .text.w3d_address_801d4184 0x801d4184 : { *(.text.w3d_address_801d4184) }
  .text.w3d_registry_release_801d4190 0x801d4190 : { *(.text.w3d_registry_release_801d4190) }
  .text.w3d_registry_retain_801d41ec 0x801d41ec : { *(.text.w3d_registry_retain_801d41ec) }
  .text.w3d_constant_801d43e4 0x801d43e4 : { *(.text.w3d_constant_801d43e4) }
  .text.w3d_constant_801d43ec 0x801d43ec : { *(.text.w3d_constant_801d43ec) }
  .text.w3d_empty_801d4540 0x801d4540 : { *(.text.w3d_empty_801d4540) }
  .text.w3d_address_801d4640 0x801d4640 : { *(.text.w3d_address_801d4640) }
  .text.w3d_registry_unlink_801d464c 0x801d464c : { *(.text.w3d_registry_unlink_801d464c) }
  .text.w3d_registry_create_801d4690 0x801d4690 : { *(.text.w3d_registry_create_801d4690) }
  .text.w3d_address_801d46f0 0x801d46f0 : { *(.text.w3d_address_801d46f0) }
  /DISCARD/ : { *(.text*) *(.rodata*) *(.data*) *(.bss*) *(.sdata*) *(.sbss*) *(.comment) }
}
