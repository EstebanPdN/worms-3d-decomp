/* Generated reference-only placements. All bodies are source-built. */
OUTPUT_FORMAT("elf32-powerpc")
OUTPUT_ARCH(powerpc)
ENTRY(w3d_cc27b_expire_records_80198fc4)
_SDA_BASE_ = 0x804b2540;
_SDA2_BASE_ = 0x804c2540;
fn_8019a30c = 0x8019a30c;
SECTIONS {
  .text.w3d_cc27b_expire_records_80198fc4 0x80198fc4 : { *(.text.w3d_cc27b_expire_records_80198fc4) }
  /DISCARD/ : { *(.text*) *(.rodata*) *(.data*) *(.bss*) *(.sdata*) *(.sbss*) *(.comment) }
}
