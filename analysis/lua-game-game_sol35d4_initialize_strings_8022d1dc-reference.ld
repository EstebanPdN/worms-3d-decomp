/* Generated reference-only placements. All bodies are source-built. */
OUTPUT_FORMAT("elf32-powerpc")
OUTPUT_ARCH(powerpc)
ENTRY(w3d_sol35d4_initialize_strings_8022d1dc)
_SDA_BASE_ = 0x804b2540;
_SDA2_BASE_ = 0x804c2540;
fn_801e8d9c = 0x801e8d9c;
fn_801eb674 = 0x801eb674;
fn_801ebf38 = 0x801ebf38;
fn_801ec52c = 0x801ec52c;
fn_801ece2c = 0x801ece2c;
fn_801ed24c = 0x801ed24c;
fn_8020bb2c = 0x8020bb2c;
fn_8020c5c0 = 0x8020c5c0;
fn_8020c5c4 = 0x8020c5c4;
fn_80341588 = 0x80341588;
fn_80341884 = 0x80341884;
lbl_803ba75c = 0x803ba75c;
lbl_803ba78c = 0x803ba78c;
lbl_803ba7b8 = 0x803ba7b8;
lbl_803ba7e8 = 0x803ba7e8;
lbl_803ba818 = 0x803ba818;
lbl_803ba848 = 0x803ba848;
lbl_803ba878 = 0x803ba878;
lbl_803ba8a8 = 0x803ba8a8;
lbl_803ba8d8 = 0x803ba8d8;
lbl_803ba904 = 0x803ba904;
lbl_803ba934 = 0x803ba934;
lbl_803ba95c = 0x803ba95c;
lbl_803ba98c = 0x803ba98c;
lbl_803ba9cc = 0x803ba9cc;
lbl_803baa0c = 0x803baa0c;
lbl_804b06a0 = 0x804b06a0;
SECTIONS {
  .text.w3d_sol35d4_initialize_strings_8022d1dc 0x8022d1dc : { *(.text.w3d_sol35d4_initialize_strings_8022d1dc) }
  /DISCARD/ : { *(.text*) *(.rodata*) *(.data*) *(.bss*) *(.sdata*) *(.sbss*) *(.comment) }
}
