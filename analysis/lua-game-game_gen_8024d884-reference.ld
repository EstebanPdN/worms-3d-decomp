/* Generated reference-only placements. All bodies are source-built. */
OUTPUT_FORMAT("elf32-powerpc")
OUTPUT_ARCH(powerpc)
ENTRY(w3d_address_8024d884)
_SDA_BASE_ = 0x804b2540;
_SDA2_BASE_ = 0x804c2540;
w3d_fn_8024bbc4 = 0x8024bbc4;
w3d_fn_8024c144 = 0x8024c144;
w3d_fn_8024ccc8 = 0x8024ccc8;
w3d_fn_8024cd58 = 0x8024cd58;
w3d_fn_8024ce7c = 0x8024ce7c;
w3d_fn_8024cfb0 = 0x8024cfb0;
w3d_fn_8024d47c = 0x8024d47c;
w3d_fn_8024d594 = 0x8024d594;
w3d_fn_8024d980 = 0x8024d980;
w3d_fn_8024dba8 = 0x8024dba8;
w3d_fn_8024e108 = 0x8024e108;
w3d_fn_8024ea3c = 0x8024ea3c;
w3d_fn_8024eee4 = 0x8024eee4;
w3d_fn_8024f1e8 = 0x8024f1e8;
w3d_fn_8024f430 = 0x8024f430;
w3d_fn_8024f6ac = 0x8024f6ac;
w3d_fn_8024f940 = 0x8024f940;
w3d_fn_8024fc34 = 0x8024fc34;
w3d_fn_802500ac = 0x802500ac;
w3d_fn_80250308 = 0x80250308;
w3d_global_80367f18 = 0x80367f18;
w3d_global_80367f68 = 0x80367f68;
w3d_global_80367fb8 = 0x80367fb8;
w3d_global_80368008 = 0x80368008;
w3d_global_80368058 = 0x80368058;
w3d_global_803680a8 = 0x803680a8;
w3d_global_803680f8 = 0x803680f8;
w3d_global_80368148 = 0x80368148;
w3d_global_80368198 = 0x80368198;
w3d_global_803681e8 = 0x803681e8;
w3d_global_80368238 = 0x80368238;
w3d_global_80368288 = 0x80368288;
w3d_owner_list_remove = 0x8020fd2c;
w3d_registry_list_80367f18 = 0x80367f18;
w3d_registry_list_80367f68 = 0x80367f68;
w3d_registry_list_80367fb8 = 0x80367fb8;
w3d_registry_list_80368008 = 0x80368008;
w3d_registry_list_80368058 = 0x80368058;
w3d_registry_list_803680a8 = 0x803680a8;
w3d_registry_list_803680f8 = 0x803680f8;
w3d_registry_list_80368148 = 0x80368148;
w3d_registry_list_80368198 = 0x80368198;
w3d_registry_list_803681e8 = 0x803681e8;
w3d_registry_list_80368238 = 0x80368238;
w3d_registry_list_80368288 = 0x80368288;
SECTIONS {
  .text.w3d_address_8024d884 0x8024d884 : { *(.text.w3d_address_8024d884) }
  .text.w3d_registry_unlink_8024d8f8 0x8024d8f8 : { *(.text.w3d_registry_unlink_8024d8f8) }
  .text.w3d_address_8024da10 0x8024da10 : { *(.text.w3d_address_8024da10) }
  .text.w3d_registry_unlink_8024da84 0x8024da84 : { *(.text.w3d_registry_unlink_8024da84) }
  .text.w3d_address_8024de74 0x8024de74 : { *(.text.w3d_address_8024de74) }
  .text.w3d_registry_unlink_8024dee8 0x8024dee8 : { *(.text.w3d_registry_unlink_8024dee8) }
  .text.w3d_address_8024e8c8 0x8024e8c8 : { *(.text.w3d_address_8024e8c8) }
  .text.w3d_registry_unlink_8024e93c 0x8024e93c : { *(.text.w3d_registry_unlink_8024e93c) }
  .text.w3d_address_8024eda0 0x8024eda0 : { *(.text.w3d_address_8024eda0) }
  .text.w3d_registry_unlink_8024ee14 0x8024ee14 : { *(.text.w3d_registry_unlink_8024ee14) }
  .text.w3d_address_8024f0bc 0x8024f0bc : { *(.text.w3d_address_8024f0bc) }
  .text.w3d_registry_unlink_8024f130 0x8024f130 : { *(.text.w3d_registry_unlink_8024f130) }
  .text.w3d_address_8024f31c 0x8024f31c : { *(.text.w3d_address_8024f31c) }
  .text.w3d_registry_unlink_8024f390 0x8024f390 : { *(.text.w3d_registry_unlink_8024f390) }
  .text.w3d_address_8024f578 0x8024f578 : { *(.text.w3d_address_8024f578) }
  .text.w3d_registry_unlink_8024f5ec 0x8024f5ec : { *(.text.w3d_registry_unlink_8024f5ec) }
  .text.w3d_address_8024f80c 0x8024f80c : { *(.text.w3d_address_8024f80c) }
  .text.w3d_registry_unlink_8024f880 0x8024f880 : { *(.text.w3d_registry_unlink_8024f880) }
  .text.w3d_address_8024faa0 0x8024faa0 : { *(.text.w3d_address_8024faa0) }
  .text.w3d_registry_unlink_8024fb14 0x8024fb14 : { *(.text.w3d_registry_unlink_8024fb14) }
  .text.w3d_address_8024ff98 0x8024ff98 : { *(.text.w3d_address_8024ff98) }
  .text.w3d_registry_unlink_8025000c 0x8025000c : { *(.text.w3d_registry_unlink_8025000c) }
  .text.w3d_address_802501f4 0x802501f4 : { *(.text.w3d_address_802501f4) }
  .text.w3d_registry_unlink_80250268 0x80250268 : { *(.text.w3d_registry_unlink_80250268) }
  .text.w3d_registry_release_80250750 0x80250750 : { *(.text.w3d_registry_release_80250750) }
  .text.w3d_registry_release_802507ac 0x802507ac : { *(.text.w3d_registry_release_802507ac) }
  .text.w3d_registry_release_80250808 0x80250808 : { *(.text.w3d_registry_release_80250808) }
  .text.w3d_registry_release_80250864 0x80250864 : { *(.text.w3d_registry_release_80250864) }
  .text.w3d_registry_release_802508c0 0x802508c0 : { *(.text.w3d_registry_release_802508c0) }
  .text.w3d_registry_release_8025091c 0x8025091c : { *(.text.w3d_registry_release_8025091c) }
  .text.w3d_registry_release_80250978 0x80250978 : { *(.text.w3d_registry_release_80250978) }
  .text.w3d_registry_release_802509d4 0x802509d4 : { *(.text.w3d_registry_release_802509d4) }
  .text.w3d_registry_release_80250a30 0x80250a30 : { *(.text.w3d_registry_release_80250a30) }
  .text.w3d_registry_release_80250a8c 0x80250a8c : { *(.text.w3d_registry_release_80250a8c) }
  .text.w3d_registry_release_80250ae8 0x80250ae8 : { *(.text.w3d_registry_release_80250ae8) }
  .text.w3d_registry_release_80250b44 0x80250b44 : { *(.text.w3d_registry_release_80250b44) }
  .text.w3d_registry_release_80250ba0 0x80250ba0 : { *(.text.w3d_registry_release_80250ba0) }
  .text.w3d_registry_release_80250bfc 0x80250bfc : { *(.text.w3d_registry_release_80250bfc) }
  .text.w3d_registry_release_80250c58 0x80250c58 : { *(.text.w3d_registry_release_80250c58) }
  .text.w3d_registry_release_80250cb4 0x80250cb4 : { *(.text.w3d_registry_release_80250cb4) }
  .text.w3d_set_80251130 0x80251130 : { *(.text.w3d_set_80251130) }
  .text.w3d_get_80251138 0x80251138 : { *(.text.w3d_get_80251138) }
  .text.w3d_set_80251140 0x80251140 : { *(.text.w3d_set_80251140) }
  .text.w3d_get_80251148 0x80251148 : { *(.text.w3d_get_80251148) }
  .text.w3d_set_80251150 0x80251150 : { *(.text.w3d_set_80251150) }
  .text.w3d_get_80251158 0x80251158 : { *(.text.w3d_get_80251158) }
  .text.w3d_set_80251160 0x80251160 : { *(.text.w3d_set_80251160) }
  .text.w3d_get_80251168 0x80251168 : { *(.text.w3d_get_80251168) }
  .text.w3d_set_80251170 0x80251170 : { *(.text.w3d_set_80251170) }
  .text.w3d_get_80251178 0x80251178 : { *(.text.w3d_get_80251178) }
  .text.w3d_set_80251180 0x80251180 : { *(.text.w3d_set_80251180) }
  .text.w3d_get_80251188 0x80251188 : { *(.text.w3d_get_80251188) }
  .text.w3d_set_80251190 0x80251190 : { *(.text.w3d_set_80251190) }
  .text.w3d_get_80251198 0x80251198 : { *(.text.w3d_get_80251198) }
  .text.w3d_set_802511a0 0x802511a0 : { *(.text.w3d_set_802511a0) }
  .text.w3d_get_802511a8 0x802511a8 : { *(.text.w3d_get_802511a8) }
  .text.w3d_set_802511b0 0x802511b0 : { *(.text.w3d_set_802511b0) }
  .text.w3d_get_802511b8 0x802511b8 : { *(.text.w3d_get_802511b8) }
  .text.w3d_set_802511c0 0x802511c0 : { *(.text.w3d_set_802511c0) }
  .text.w3d_get_802511c8 0x802511c8 : { *(.text.w3d_get_802511c8) }
  .text.w3d_set_802511d0 0x802511d0 : { *(.text.w3d_set_802511d0) }
  .text.w3d_get_802511d8 0x802511d8 : { *(.text.w3d_get_802511d8) }
  .text.w3d_set_802511e0 0x802511e0 : { *(.text.w3d_set_802511e0) }
  .text.w3d_get_802511e8 0x802511e8 : { *(.text.w3d_get_802511e8) }
  .text.w3d_set_80251204 0x80251204 : { *(.text.w3d_set_80251204) }
  .text.w3d_get_8025120c 0x8025120c : { *(.text.w3d_get_8025120c) }
  .text.w3d_set_80251214 0x80251214 : { *(.text.w3d_set_80251214) }
  .text.w3d_get_8025121c 0x8025121c : { *(.text.w3d_get_8025121c) }
  .text.w3d_set_80251224 0x80251224 : { *(.text.w3d_set_80251224) }
  .text.w3d_get_8025122c 0x8025122c : { *(.text.w3d_get_8025122c) }
  .text.w3d_get_80251298 0x80251298 : { *(.text.w3d_get_80251298) }
  .text.w3d_get_80251304 0x80251304 : { *(.text.w3d_get_80251304) }
  .text.w3d_get_80251370 0x80251370 : { *(.text.w3d_get_80251370) }
  .text.w3d_set_80251378 0x80251378 : { *(.text.w3d_set_80251378) }
  .text.w3d_get_80251380 0x80251380 : { *(.text.w3d_get_80251380) }
  .text.w3d_set_80251388 0x80251388 : { *(.text.w3d_set_80251388) }
  .text.w3d_get_80251390 0x80251390 : { *(.text.w3d_get_80251390) }
  .text.w3d_set_80251398 0x80251398 : { *(.text.w3d_set_80251398) }
  .text.w3d_get_802513a0 0x802513a0 : { *(.text.w3d_get_802513a0) }
  .text.w3d_set_802513a8 0x802513a8 : { *(.text.w3d_set_802513a8) }
  /DISCARD/ : { *(.text*) *(.rodata*) *(.data*) *(.bss*) *(.sdata*) *(.sbss*) *(.comment) }
}
