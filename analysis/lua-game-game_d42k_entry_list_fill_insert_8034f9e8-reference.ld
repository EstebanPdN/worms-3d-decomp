/* Generated reference-only placements. All bodies are source-built. */
OUTPUT_FORMAT("elf32-powerpc")
OUTPUT_ARCH(powerpc)
ENTRY(_M_fill_insert__Q24_STLt6vector2Z9D42kEntryZt15ModuleAllocator1Z9D42kEntryP9D42kEntryUiRC9D42kEntry)
_SDA_BASE_ = 0x804b2540;
_SDA2_BASE_ = 0x804c2540;
__as__Q24_STLt6vector2Z20D29sRecord4_8034f81cZt15ModuleAllocator1Z20D29sRecord4_8034f81cRCQ24_STLt6vector2Z20D29sRecord4_8034f81cZt15ModuleAllocator1Z20D29sRecord4_8034f81c = 0x8034f81c;
w3d_auto_801907a8 = 0x801907a8;
w3d_auto_801907d0 = 0x801907d0;
SECTIONS {
  .text._M_fill_insert__Q24_STLt6vector2Z9D42kEntryZt15ModuleAllocator1Z9D42kEntryP9D42kEntryUiRC9D42kEntry 0x8034f9e8 : { *(.text._M_fill_insert__Q24_STLt6vector2Z9D42kEntryZt15ModuleAllocator1Z9D42kEntryP9D42kEntryUiRC9D42kEntry) }
  /DISCARD/ : { *(.text*) *(.rodata*) *(.data*) *(.bss*) *(.sdata*) *(.sbss*) *(.comment) }
}
