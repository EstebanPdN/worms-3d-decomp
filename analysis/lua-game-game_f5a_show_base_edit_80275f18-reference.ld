/* Generated reference-only placements. All bodies are source-built. */
OUTPUT_FORMAT("elf32-powerpc")
OUTPUT_ARCH(powerpc)
ENTRY(w3d_f5a_show_base_edit_80275f18)
_SDA_BASE_ = 0x804b2540;
_SDA2_BASE_ = 0x804c2540;
__13Text_803426b8 = 0x803426b8;
empty_803cc0d8 = 0x803cc0d8;
fn_8020c5c4 = 0x8020c5c4;
fn_8027a934 = 0x8027a934;
fn_802cbdf8 = 0x802cbdf8;
fn_802cbf2c = 0x802cbf2c;
fn_802cbfa4 = 0x802cbfa4;
fn_802cbfe0 = 0x802cbfe0;
fn_802cc0ac = 0x802cc0ac;
fn_802cd128 = 0x802cd128;
fn_802cd220 = 0x802cd220;
fn_802cd26c = 0x802cd26c;
fn_80341588 = 0x80341588;
help_803cdd8c = 0x803cdd8c;
help_803cdddc = 0x803cdddc;
label_803cdc08 = 0x803cdc08;
label_803cdc28 = 0x803cdc28;
label_803cdc50 = 0x803cdc50;
label_803cdc70 = 0x803cdc70;
label_803cdc90 = 0x803cdc90;
label_803cdcb0 = 0x803cdcb0;
label_803cdcd0 = 0x803cdcd0;
label_803cdcf0 = 0x803cdcf0;
label_803cdd10 = 0x803cdd10;
label_803cdd30 = 0x803cdd30;
label_803cdd50 = 0x803cdd50;
label_803cdd70 = 0x803cdd70;
line_803ccc40 = 0x803ccc40;
title_803cdbec = 0x803cdbec;
SECTIONS {
  .text.w3d_f5a_show_base_edit_80275f18 0x80275f18 : { *(.text.w3d_f5a_show_base_edit_80275f18) }
  /DISCARD/ : { *(.text*) *(.rodata*) *(.data*) *(.bss*) *(.sdata*) *(.sbss*) *(.comment) }
}
