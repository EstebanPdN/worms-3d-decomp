/* Generated reference-only placements. All bodies are source-built. */
OUTPUT_FORMAT("elf32-powerpc")
OUTPUT_ARCH(powerpc)
ENTRY(w3d_s21_create_typed_801f0e4c)
_SDA_BASE_ = 0x804b2540;
_SDA2_BASE_ = 0x804c2540;
fn_801e8bc4 = 0x801e8bc4;
fn_801eb058 = 0x801eb058;
fn_801eb0a8 = 0x801eb0a8;
fn_801fe1d8 = 0x801fe1d8;
fn_80343740 = 0x80343740;
lbl_804178b0 = 0x804178b0;
SECTIONS {
  .text.w3d_s21_create_typed_801f0e4c 0x801f0e4c : { *(.text.w3d_s21_create_typed_801f0e4c) }
  /DISCARD/ : { *(.text*) *(.rodata*) *(.data*) *(.bss*) *(.sdata*) *(.sbss*) *(.comment) }
}
