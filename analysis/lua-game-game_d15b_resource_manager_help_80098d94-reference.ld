/* Generated reference-only placements. All bodies are source-built. */
OUTPUT_FORMAT("elf32-powerpc")
OUTPUT_ARCH(powerpc)
ENTRY(d15b_resource_manager_help_80098d94)
_SDA_BASE_ = 0x804b2540;
_SDA2_BASE_ = 0x804c2540;
__9d15b_Text = 0x803426b8;
strcpy = 0x802ef2fc;
w3d_cc32b_append_lines_v2_802cc0ac = 0x802cc0ac;
w3d_cx12b_endpoint_name_reserve_802cc4f0 = 0x802cc4f0;
w3d_help_line_80435bbc = 0x80435bbc;
w3d_string_base_finish = 0x8020c5c4;
w3d_string_release = 0x80341588;
w3d_text_8037fed8 = 0x8037fed8;
w3d_text_8037fef4 = 0x8037fef4;
w3d_text_8037ff00 = 0x8037ff00;
w3d_text_8037ff04 = 0x8037ff04;
w3d_text_8037ff0c = 0x8037ff0c;
w3d_text_8037ff10 = 0x8037ff10;
w3d_text_8037ff1c = 0x8037ff1c;
w3d_text_8037ff20 = 0x8037ff20;
w3d_text_8037ff28 = 0x8037ff28;
w3d_text_8037ff2c = 0x8037ff2c;
w3d_text_8037ff38 = 0x8037ff38;
w3d_text_8037ff3c = 0x8037ff3c;
w3d_text_8037ff4c = 0x8037ff4c;
w3d_text_8037ff50 = 0x8037ff50;
w3d_text_8037ff5c = 0x8037ff5c;
w3d_text_8037ff60 = 0x8037ff60;
SECTIONS {
  .text.d15b_resource_manager_help_80098d94 0x80098d94 : { *(.text.d15b_resource_manager_help_80098d94) }
  /DISCARD/ : { *(.text*) *(.rodata*) *(.data*) *(.bss*) *(.sdata*) *(.sbss*) *(.comment) }
}
