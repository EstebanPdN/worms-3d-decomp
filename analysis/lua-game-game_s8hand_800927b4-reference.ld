/* Generated reference-only placements. All bodies are source-built. */
OUTPUT_FORMAT("elf32-powerpc")
OUTPUT_ARCH(powerpc)
ENTRY(s8_attach_object_800927b4)
_SDA_BASE_ = 0x804b2540;
_SDA2_BASE_ = 0x804c2540;
fn_80073290 = 0x80073290;
fn_8007BB54 = 0x8007bb54;
fn_8007D0F8 = 0x8007d0f8;
fn_8007E10C = 0x8007e10c;
fn_80087128 = 0x80087128;
fn_800923F8 = 0x800923f8;
fn_8009278C = 0x8009278c;
SECTIONS {
  .text.s8_attach_object_800927b4 0x800927b4 : { *(.text.s8_attach_object_800927b4) }
  /DISCARD/ : { *(.text*) *(.rodata*) *(.data*) *(.bss*) *(.sdata*) *(.sbss*) *(.comment) }
}
