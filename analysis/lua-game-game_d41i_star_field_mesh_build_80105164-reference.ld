/* Generated reference-only placements. All bodies are source-built. */
OUTPUT_FORMAT("elf32-powerpc")
OUTPUT_ARCH(powerpc)
ENTRY(d41i_star_field_mesh_build_80105164)
_SDA_BASE_ = 0x804b2540;
_SDA2_BASE_ = 0x804c2540;
__12Vec_80343740 = 0x80343740;
__15String_8020bb54PCc = 0x8020bb54;
__15String_803426b8 = 0x803426b8;
col_80189760 = 0x80189760;
find_80181e3c = 0x80181e3c;
fmt_8020c510 = 0x8020c510;
idx_80189828 = 0x80189828;
load_8015adf4 = 0x8015adf4;
m_80343584 = 0x80343584;
m_8034380c = 0x8034380c;
pos_80189518 = 0x80189518;
rf_8015ff7c = 0x8015ff7c;
ru_8015ff5c = 0x8015ff5c;
s_80399860 = 0x80399860;
s_80399868 = 0x80399868;
s_80399874 = 0x80399874;
setc_8018920c = 0x8018920c;
siz_8018963c = 0x8018963c;
sqrt_802e82c0 = 0x802e82c0;
str_finish_8020c5c4 = 0x8020c5c4;
str_release_80341588 = 0x80341588;
SECTIONS {
  .text.d41i_star_field_mesh_build_80105164 0x80105164 : { *(.text.d41i_star_field_mesh_build_80105164) }
  .rodata 0x8039987c : { *(.rodata) }
  /DISCARD/ : { *(.text*) *(.rodata*) *(.data*) *(.bss*) *(.sdata*) *(.sbss*) *(.comment) }
}
