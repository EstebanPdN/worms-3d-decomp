/* Generated reference-only placements. All bodies are source-built. */
OUTPUT_FORMAT("elf32-powerpc")
OUTPUT_ARCH(powerpc)
ENTRY(w3d_k5b_iface_array_resize_owned_801ee638)
_SDA_BASE_ = 0x804b2540;
_SDA2_BASE_ = 0x804c2540;
w3d_h1_result_then_finish_801ee410 = 0x801ee410;
SECTIONS {
  .text.w3d_k5b_iface_array_resize_owned_801ee638 0x801ee638 : { *(.text.w3d_k5b_iface_array_resize_owned_801ee638) }
  /DISCARD/ : { *(.text*) *(.rodata*) *(.data*) *(.bss*) *(.sdata*) *(.sbss*) *(.comment) }
}
