/* Generated reference-only placements. All bodies are source-built. */
OUTPUT_FORMAT("elf32-powerpc")
OUTPUT_ARCH(powerpc)
ENTRY(d32l_list_add_icon_802be9e4)
_SDA_BASE_ = 0x804b2540;
_SDA2_BASE_ = 0x804c2540;
_S_oom_malloc__Q24_STLt14__malloc_alloc1i0Ui = 0x803413d8;
__3Str = 0x803426b8;
atol = 0x802ed8c4;
fn_8015adf4 = 0x8015adf4;
fn_80173df0 = 0x80173df0;
fn_80173f88 = 0x80173f88;
fn_80178df0 = 0x80178df0;
fn_8020bb2c = 0x8020bb2c;
fn_8020c0fc = 0x8020c0fc;
fn_8020c3a0 = 0x8020c3a0;
fn_8020c5c4 = 0x8020c5c4;
fn_802bf798 = 0x802bf798;
fn_80341588 = 0x80341588;
fn_8034357c = 0x8034357c;
free = 0x802134fc;
lbl_803d83e4 = 0x803d83e4;
malloc = 0x80212fd4;
strlen = 0x802ef9c0;
strstr = 0x802efd14;
SECTIONS {
  .text.d32l_list_add_icon_802be9e4 0x802be9e4 : { *(.text.d32l_list_add_icon_802be9e4) }
  .rodata 0x803d83e8 : { *(.rodata) }
  /DISCARD/ : { *(.text*) *(.rodata*) *(.data*) *(.bss*) *(.sdata*) *(.sbss*) *(.comment) }
}
