/* Generated reference-only placements. All bodies are source-built. */
OUTPUT_FORMAT("elf32-powerpc")
OUTPUT_ARCH(powerpc)
ENTRY(k4a_camera_mode_construct_800e7278)
_SDA_BASE_ = 0x804b2540;
_SDA2_BASE_ = 0x804c2540;
FUN_8015a0d4 = 0x8015a0d4;
w3d_constructor_lookup_name = 0x800fc1b0;
w3d_constructor_native_cast = 0x80342a78;
w3d_str_8038afdc = 0x8038afdc;
w3d_vtable_80410138 = 0x80410138;
SECTIONS {
  .text.k4a_camera_mode_construct_800e7278 0x800e7278 : { *(.text.k4a_camera_mode_construct_800e7278) }
  /DISCARD/ : { *(.text*) *(.rodata*) *(.data*) *(.bss*) *(.sdata*) *(.sbss*) *(.comment) }
}
