/* Generated reference-only placements. All bodies are source-built. */
OUTPUT_FORMAT("elf32-powerpc")
OUTPUT_ARCH(powerpc)
ENTRY(w3d_cx8a_selection_basis_vector_800b5f2c)
_SDA_BASE_ = 0x804b2540;
_SDA2_BASE_ = 0x804c2540;
selection_direction_8043ade4 = 0x8043ade4;
SECTIONS {
  .text.w3d_cx8a_selection_basis_vector_800b5f2c 0x800b5f2c : { *(.text.w3d_cx8a_selection_basis_vector_800b5f2c) }
  /DISCARD/ : { *(.text*) *(.rodata*) *(.data*) *(.bss*) *(.sdata*) *(.sbss*) *(.comment) }
}
