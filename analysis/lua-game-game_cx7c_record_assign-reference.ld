/* Generated reference-only placements. All bodies are source-built. */
OUTPUT_FORMAT("elf32-powerpc")
OUTPUT_ARCH(powerpc)
ENTRY(w3d_cx7c_record_assign_8035c32c)
_SDA_BASE_ = 0x804b2540;
_SDA2_BASE_ = 0x804c2540;
cx7c_string_header_free_8020bb2c = 0x8020bb2c;
SECTIONS {
  .text.w3d_cx7c_record_assign_8035c32c 0x8035c32c : { *(.text.w3d_cx7c_record_assign_8035c32c) }
  /DISCARD/ : { *(.text*) *(.rodata*) *(.data*) *(.bss*) *(.sdata*) *(.sbss*) *(.comment) }
}
