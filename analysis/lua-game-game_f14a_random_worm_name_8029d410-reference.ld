/* Generated reference-only placements. All bodies are source-built. */
OUTPUT_FORMAT("elf32-powerpc")
OUTPUT_ARCH(powerpc)
ENTRY(w3d_f14a_random_worm_name_8029d410)
_SDA_BASE_ = 0x804b2540;
_SDA2_BASE_ = 0x804c2540;
__21F14aWormText_803426b8 = 0x803426b8;
delimiter_803d0d78 = 0x803d0d78;
fn_800fc2b0 = 0x800fc2b0;
fn_800fc550 = 0x800fc550;
fn_80162c20 = 0x80162c20;
fn_8020bd38 = 0x8020bd38;
fn_8020c3a0 = 0x8020c3a0;
fn_8020c510 = 0x8020c510;
fn_8020c5c4 = 0x8020c5c4;
fn_802ef380 = 0x802ef380;
fn_802ef9c0 = 0x802ef9c0;
fn_80341588 = 0x80341588;
format_803d0a0c = 0x803d0a0c;
key_803d0d64 = 0x803d0d64;
SECTIONS {
  .text.w3d_f14a_random_worm_name_8029d410 0x8029d410 : { *(.text.w3d_f14a_random_worm_name_8029d410) }
  /DISCARD/ : { *(.text*) *(.rodata*) *(.data*) *(.bss*) *(.sdata*) *(.sbss*) *(.comment) }
}
