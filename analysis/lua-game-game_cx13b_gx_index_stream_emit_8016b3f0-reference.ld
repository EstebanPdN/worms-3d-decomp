/* Generated reference-only placements. All bodies are source-built. */
OUTPUT_FORMAT("elf32-powerpc")
OUTPUT_ARCH(powerpc)
ENTRY(w3d_cx13b_gx_index_stream_emit_8016b3f0)
_SDA_BASE_ = 0x804b2540;
_SDA2_BASE_ = 0x804c2540;
begin_803089c8 = 0x803089c8;
fifo_cc008000 = 0xcc008000;
SECTIONS {
  .text.w3d_cx13b_gx_index_stream_emit_8016b3f0 0x8016b3f0 : { *(.text.w3d_cx13b_gx_index_stream_emit_8016b3f0) }
  /DISCARD/ : { *(.text*) *(.rodata*) *(.data*) *(.bss*) *(.sdata*) *(.sbss*) *(.comment) }
}
