/* Generated reference-only placements. All bodies are source-built. */
OUTPUT_FORMAT("elf32-powerpc")
OUTPUT_ARCH(powerpc)
ENTRY(g4a_prepare_services_8015c670)
_SDA_BASE_ = 0x804b2540;
_SDA2_BASE_ = 0x804c2540;
bind_80164514 = 0x80164514;
lookup_8020b680 = 0x8020b680;
prepare_8015b72c = 0x8015b72c;
prepare_8015c994 = 0x8015c994;
prepare_8015ca48 = 0x8015ca48;
root_8020b648 = 0x8020b648;
type_80411698 = 0x80411698;
type_804118f8 = 0x804118f8;
type_80411960 = 0x80411960;
type_80412240 = 0x80412240;
type_804143e0 = 0x804143e0;
type_804168b0 = 0x804168b0;
SECTIONS {
  .text.g4a_prepare_services_8015c670 0x8015c670 : { *(.text.g4a_prepare_services_8015c670) }
  /DISCARD/ : { *(.text*) *(.rodata*) *(.data*) *(.bss*) *(.sdata*) *(.sbss*) *(.comment) }
}
