/* Generated reference-only placements. All bodies are source-built. */
OUTPUT_FORMAT("elf32-powerpc")
OUTPUT_ARCH(powerpc)
ENTRY(d34f_scheme_new_from_current_80291b90)
_SDA_BASE_ = 0x804b2540;
_SDA2_BASE_ = 0x804c2540;
_._19Descriptor_80178474 = 0x80178474;
__15String_803426b8 = 0x803426b8;
__15String_803426b8PCc = 0x8020bb54;
lbl_803d0164 = 0x803d0164;
lbl_803d0174 = 0x803d0174;
lbl_803d02ac = 0x803d02ac;
lbl_803d02b4 = 0x803d02b4;
lbl_803d0588 = 0x803d0588;
lbl_80413b28 = 0x80413b28;
s8_property_write_800fc3b0 = 0x800fc3b0;
strcmp = 0x802ef234;
w3d_auto_800fc2b0 = 0x800fc2b0;
w3d_auto_80179598 = 0x80179598;
w3d_constructor_lookup_name = 0x800fc1b0;
w3d_empty_8029301c = 0x8029301c;
w3d_empty_80341584 = 0x80341584;
w3d_export_scheme_8028fb10 = 0x8028fb10;
w3d_k5b_iface_array_field_801ef174 = 0x801ef174;
w3d_s10_service_forward_8020b680 = 0x8020b680;
w3d_string_assign = 0x8020bd38;
w3d_string_base_finish = 0x8020c5c4;
w3d_string_base_init = 0x8020c5c0;
w3d_string_header = 0x80341884;
w3d_string_release = 0x80341588;
w3d_string_release_header = 0x8020bb2c;
SECTIONS {
  .text.d34f_scheme_new_from_current_80291b90 0x80291b90 : { *(.text.d34f_scheme_new_from_current_80291b90) }
  /DISCARD/ : { *(.text*) *(.rodata*) *(.data*) *(.bss*) *(.sdata*) *(.sbss*) *(.comment) }
}
