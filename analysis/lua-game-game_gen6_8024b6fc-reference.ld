/* Generated reference-only placements. All bodies are source-built. */
OUTPUT_FORMAT("elf32-powerpc")
OUTPUT_ARCH(powerpc)
ENTRY(w3d_setf_8024b6fc)
_SDA_BASE_ = 0x804b2540;
_SDA2_BASE_ = 0x804c2540;
SECTIONS {
  .text.w3d_setf_8024b6fc 0x8024b6fc : { *(.text.w3d_setf_8024b6fc) }
  .text.w3d_getf_8024b704 0x8024b704 : { *(.text.w3d_getf_8024b704) }
  .text.w3d_setf_8024b70c 0x8024b70c : { *(.text.w3d_setf_8024b70c) }
  .text.w3d_getf_8024b714 0x8024b714 : { *(.text.w3d_getf_8024b714) }
  .text.w3d_setf_8024b71c 0x8024b71c : { *(.text.w3d_setf_8024b71c) }
  .text.w3d_getf_8024b724 0x8024b724 : { *(.text.w3d_getf_8024b724) }
  .text.w3d_setf_8024b72c 0x8024b72c : { *(.text.w3d_setf_8024b72c) }
  .text.w3d_getf_8024b734 0x8024b734 : { *(.text.w3d_getf_8024b734) }
  .text.w3d_setf_8024b73c 0x8024b73c : { *(.text.w3d_setf_8024b73c) }
  .text.w3d_getf_8024b744 0x8024b744 : { *(.text.w3d_getf_8024b744) }
  .text.w3d_setf_8024b74c 0x8024b74c : { *(.text.w3d_setf_8024b74c) }
  .text.w3d_getf_8024b754 0x8024b754 : { *(.text.w3d_getf_8024b754) }
  .text.w3d_setf_8024b75c 0x8024b75c : { *(.text.w3d_setf_8024b75c) }
  .text.w3d_getf_8024b764 0x8024b764 : { *(.text.w3d_getf_8024b764) }
  .text.w3d_setf_8024b76c 0x8024b76c : { *(.text.w3d_setf_8024b76c) }
  .text.w3d_getf_8024b774 0x8024b774 : { *(.text.w3d_getf_8024b774) }
  .text.w3d_setf_8024b77c 0x8024b77c : { *(.text.w3d_setf_8024b77c) }
  .text.w3d_getf_8024b784 0x8024b784 : { *(.text.w3d_getf_8024b784) }
  .text.w3d_setf_8024b79c 0x8024b79c : { *(.text.w3d_setf_8024b79c) }
  .text.w3d_getf_8024b7a4 0x8024b7a4 : { *(.text.w3d_getf_8024b7a4) }
  .text.w3d_setf_8024b7ac 0x8024b7ac : { *(.text.w3d_setf_8024b7ac) }
  .text.w3d_getf_8024b7b4 0x8024b7b4 : { *(.text.w3d_getf_8024b7b4) }
  .text.w3d_setf_8024b7bc 0x8024b7bc : { *(.text.w3d_setf_8024b7bc) }
  .text.w3d_getf_8024b7c4 0x8024b7c4 : { *(.text.w3d_getf_8024b7c4) }
  .text.w3d_setf_8024b7cc 0x8024b7cc : { *(.text.w3d_setf_8024b7cc) }
  .text.w3d_getf_8024b7d4 0x8024b7d4 : { *(.text.w3d_getf_8024b7d4) }
  .text.w3d_setf_8024b7dc 0x8024b7dc : { *(.text.w3d_setf_8024b7dc) }
  .text.w3d_getf_8024b7e4 0x8024b7e4 : { *(.text.w3d_getf_8024b7e4) }
  .text.w3d_copy12_8024b7ec 0x8024b7ec : { *(.text.w3d_copy12_8024b7ec) }
  .text.w3d_member_8024b80c 0x8024b80c : { *(.text.w3d_member_8024b80c) }
  .text.w3d_copy12_8024b814 0x8024b814 : { *(.text.w3d_copy12_8024b814) }
  .text.w3d_member_8024b834 0x8024b834 : { *(.text.w3d_member_8024b834) }
  .text.w3d_setf_8024b84c 0x8024b84c : { *(.text.w3d_setf_8024b84c) }
  .text.w3d_getf_8024b854 0x8024b854 : { *(.text.w3d_getf_8024b854) }
  .text.w3d_setf_8024b85c 0x8024b85c : { *(.text.w3d_setf_8024b85c) }
  .text.w3d_getf_8024b864 0x8024b864 : { *(.text.w3d_getf_8024b864) }
  .text.w3d_setf_8024b86c 0x8024b86c : { *(.text.w3d_setf_8024b86c) }
  .text.w3d_getf_8024b874 0x8024b874 : { *(.text.w3d_getf_8024b874) }
  .text.w3d_setf_8024b87c 0x8024b87c : { *(.text.w3d_setf_8024b87c) }
  .text.w3d_getf_8024b884 0x8024b884 : { *(.text.w3d_getf_8024b884) }
  .text.w3d_setf_8024b88c 0x8024b88c : { *(.text.w3d_setf_8024b88c) }
  .text.w3d_getf_8024b894 0x8024b894 : { *(.text.w3d_getf_8024b894) }
  .text.w3d_setf_8024b89c 0x8024b89c : { *(.text.w3d_setf_8024b89c) }
  .text.w3d_getf_8024b8a4 0x8024b8a4 : { *(.text.w3d_getf_8024b8a4) }
  .text.w3d_setf_8024b8ac 0x8024b8ac : { *(.text.w3d_setf_8024b8ac) }
  .text.w3d_getf_8024b8b4 0x8024b8b4 : { *(.text.w3d_getf_8024b8b4) }
  .text.w3d_copy12_80250d10 0x80250d10 : { *(.text.w3d_copy12_80250d10) }
  .text.w3d_member_80250d30 0x80250d30 : { *(.text.w3d_member_80250d30) }
  .text.w3d_copy12_80250d38 0x80250d38 : { *(.text.w3d_copy12_80250d38) }
  .text.w3d_member_80250d58 0x80250d58 : { *(.text.w3d_member_80250d58) }
  .text.w3d_member_80250dac 0x80250dac : { *(.text.w3d_member_80250dac) }
  .text.w3d_member_80250e00 0x80250e00 : { *(.text.w3d_member_80250e00) }
  .text.w3d_copy12_80250e08 0x80250e08 : { *(.text.w3d_copy12_80250e08) }
  .text.w3d_member_80250e28 0x80250e28 : { *(.text.w3d_member_80250e28) }
  .text.w3d_copy12_80250e30 0x80250e30 : { *(.text.w3d_copy12_80250e30) }
  .text.w3d_member_80250e50 0x80250e50 : { *(.text.w3d_member_80250e50) }
  .text.w3d_member_80250ea4 0x80250ea4 : { *(.text.w3d_member_80250ea4) }
  .text.w3d_member_80250ef8 0x80250ef8 : { *(.text.w3d_member_80250ef8) }
  .text.w3d_member_80250f4c 0x80250f4c : { *(.text.w3d_member_80250f4c) }
  .text.w3d_setf_80250f54 0x80250f54 : { *(.text.w3d_setf_80250f54) }
  .text.w3d_getf_80250f5c 0x80250f5c : { *(.text.w3d_getf_80250f5c) }
  .text.w3d_copy12_80250f64 0x80250f64 : { *(.text.w3d_copy12_80250f64) }
  .text.w3d_member_80250f84 0x80250f84 : { *(.text.w3d_member_80250f84) }
  .text.w3d_copy12_80250f8c 0x80250f8c : { *(.text.w3d_copy12_80250f8c) }
  .text.w3d_member_80250fac 0x80250fac : { *(.text.w3d_member_80250fac) }
  .text.w3d_copy12_80250fb4 0x80250fb4 : { *(.text.w3d_copy12_80250fb4) }
  .text.w3d_member_80250fd4 0x80250fd4 : { *(.text.w3d_member_80250fd4) }
  .text.w3d_copy12_80250fdc 0x80250fdc : { *(.text.w3d_copy12_80250fdc) }
  .text.w3d_member_80250ffc 0x80250ffc : { *(.text.w3d_member_80250ffc) }
  .text.w3d_member_80251018 0x80251018 : { *(.text.w3d_member_80251018) }
  .text.w3d_member_80251034 0x80251034 : { *(.text.w3d_member_80251034) }
  .text.w3d_copy12_8025103c 0x8025103c : { *(.text.w3d_copy12_8025103c) }
  .text.w3d_member_8025105c 0x8025105c : { *(.text.w3d_member_8025105c) }
  .text.w3d_setf_80251120 0x80251120 : { *(.text.w3d_setf_80251120) }
  .text.w3d_getf_80251128 0x80251128 : { *(.text.w3d_getf_80251128) }
  .text.w3d_member_802511fc 0x802511fc : { *(.text.w3d_member_802511fc) }
  .text.w3d_member_802514d4 0x802514d4 : { *(.text.w3d_member_802514d4) }
  .text.w3d_member_802514f0 0x802514f0 : { *(.text.w3d_member_802514f0) }
  .text.w3d_member_80251774 0x80251774 : { *(.text.w3d_member_80251774) }
  .text.w3d_member_802517e4 0x802517e4 : { *(.text.w3d_member_802517e4) }
  /DISCARD/ : { *(.text*) *(.rodata*) *(.data*) *(.bss*) *(.sdata*) *(.sbss*) *(.comment) }
}
