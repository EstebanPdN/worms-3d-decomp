/* Generated reference-only placements. All bodies are source-built. */
OUTPUT_FORMAT("elf32-powerpc")
OUTPUT_ARCH(powerpc)
ENTRY(w3d_k4b_xform_node_construct_801ac19c)
_SDA_BASE_ = 0x804b2540;
_SDA2_BASE_ = 0x804c2540;
fn_801e81c8 = 0x801e81c8;
lbl_80411d70 = 0x80411d70;
lbl_80411de0 = 0x80411de0;
lbl_80413fc0 = 0x80413fc0;
lbl_8045e748 = 0x8045e748;
w3d_construct_801f2678 = 0x801f2678;
SECTIONS {
  .text.w3d_k4b_xform_node_construct_801ac19c 0x801ac19c : { *(.text.w3d_k4b_xform_node_construct_801ac19c) }
  .rodata 0x803aa498 : { *(.rodata) }
  /DISCARD/ : { *(.text*) *(.rodata*) *(.data*) *(.bss*) *(.sdata*) *(.sbss*) *(.comment) }
}
