/* Generated reference-only placements. All bodies are source-built. */
OUTPUT_FORMAT("elf32-powerpc")
OUTPUT_ARCH(powerpc)
ENTRY(w3d_cx8c_list_clear_8034ba74)
_SDA_BASE_ = 0x804b2540;
_SDA2_BASE_ = 0x804c2540;
cx8c_deallocate_802134fc = 0x802134fc;
cx8c_member_destroy_80210990 = 0x80210990;
cx8c_vtable_80411ac0 = 0x80411ac0;
SECTIONS {
  .text.w3d_cx8c_list_clear_8034ba74 0x8034ba74 : { *(.text.w3d_cx8c_list_clear_8034ba74) }
  /DISCARD/ : { *(.text*) *(.rodata*) *(.data*) *(.bss*) *(.sdata*) *(.sbss*) *(.comment) }
}
