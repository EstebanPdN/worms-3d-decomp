/* Generated reference-only placements. All bodies are source-built. */
OUTPUT_FORMAT("elf32-powerpc")
OUTPUT_ARCH(powerpc)
ENTRY(w3d_cx7c_binary_tree_insert_8035b32c)
_SDA_BASE_ = 0x804b2540;
_SDA2_BASE_ = 0x804c2540;
cx7c_allocate_80212fd4 = 0x80212fd4;
cx7c_allocation_fallback_803413d8 = 0x803413d8;
cx7c_memcmp_802eedc0 = 0x802eedc0;
cx7c_rebalance_80352404 = 0x80352404;
SECTIONS {
  .text.w3d_cx7c_binary_tree_insert_8035b32c 0x8035b32c : { *(.text.w3d_cx7c_binary_tree_insert_8035b32c) }
  /DISCARD/ : { *(.text*) *(.rodata*) *(.data*) *(.bss*) *(.sdata*) *(.sbss*) *(.comment) }
}
