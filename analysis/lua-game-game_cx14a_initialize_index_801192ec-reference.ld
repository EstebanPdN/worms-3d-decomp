/* Generated reference-only placements. All bodies are source-built. */
OUTPUT_FORMAT("elf32-powerpc")
OUTPUT_ARCH(powerpc)
ENTRY(w3d_cx14a_initialize_index_801192ec)
_SDA_BASE_ = 0x804b2540;
_SDA2_BASE_ = 0x804c2540;
base_80161014 = 0x80161014;
cast_803426b4 = 0x803426b4;
key_8039aacc = 0x8039aacc;
query_800fc1b0 = 0x800fc1b0;
vtable_80410950 = 0x80410950;
SECTIONS {
  .text.w3d_cx14a_initialize_index_801192ec 0x801192ec : { *(.text.w3d_cx14a_initialize_index_801192ec) }
  /DISCARD/ : { *(.text*) *(.rodata*) *(.data*) *(.bss*) *(.sdata*) *(.sbss*) *(.comment) }
}
