/* Generated reference-only placements. All bodies are source-built. */
OUTPUT_FORMAT("elf32-powerpc")
OUTPUT_ARCH(powerpc)
ENTRY(d29c_script_open_container_80102dfc)
_SDA_BASE_ = 0x804b2540;
_SDA2_BASE_ = 0x804c2540;
__15String_8020bb54PCc = 0x8020bb54;
__builtin_new = 0x801fe1d8;
as_80179598 = 0x80179598;
error_801022ec = 0x801022ec;
lookup_800fc1b0 = 0x800fc1b0;
lua_gettop = 0x802cd7f4;
lua_isstring = 0x802cdaf4;
lua_pushlightuserdata = 0x802ce244;
lua_settop = 0x802cd808;
lua_tostring = 0x802cdd04;
ref_80341584 = 0x80341584;
s1_8039904c = 0x8039904c;
s2_80399088 = 0x80399088;
s3_803990b8 = 0x803990b8;
s4_803990e8 = 0x803990e8;
str_finish_8020c5c4 = 0x8020c5c4;
str_release_80341588 = 0x80341588;
SECTIONS {
  .text.d29c_script_open_container_80102dfc 0x80102dfc : { *(.text.d29c_script_open_container_80102dfc) }
  /DISCARD/ : { *(.text*) *(.rodata*) *(.data*) *(.bss*) *(.sdata*) *(.sbss*) *(.comment) }
}
