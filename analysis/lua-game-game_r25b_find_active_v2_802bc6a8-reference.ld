/* Generated reference-only placements. All bodies are source-built. */
OUTPUT_FORMAT("elf32-powerpc")
OUTPUT_ARCH(powerpc)
ENTRY(w3d_r25b_find_active_v2_802bc6a8)
_SDA_BASE_ = 0x804b2540;
_SDA2_BASE_ = 0x804c2540;
r25b_entry_key_802bd2bc__FP15R25bActiveEntry = 0x802bd2bc;
SECTIONS {
  .text.w3d_r25b_find_active_v2_802bc6a8 0x802bc6a8 : { *(.text.w3d_r25b_find_active_v2_802bc6a8) }
  /DISCARD/ : { *(.text*) *(.rodata*) *(.data*) *(.bss*) *(.sdata*) *(.sbss*) *(.comment) }
}
