/* Generated reference-only placements. All bodies are source-built. */
OUTPUT_FORMAT("elf32-powerpc")
OUTPUT_ARCH(powerpc)
ENTRY(w3d_member_8024b1c0)
_SDA_BASE_ = 0x804b2540;
_SDA2_BASE_ = 0x804c2540;
SECTIONS {
  .text.w3d_member_8024b1c0 0x8024b1c0 : { *(.text.w3d_member_8024b1c0) }
  .text.w3d_member_8024b1d4 0x8024b1d4 : { *(.text.w3d_member_8024b1d4) }
  .text.w3d_member_8024b1e8 0x8024b1e8 : { *(.text.w3d_member_8024b1e8) }
  .text.w3d_member_8024b1fc 0x8024b1fc : { *(.text.w3d_member_8024b1fc) }
  .text.w3d_member_8024b210 0x8024b210 : { *(.text.w3d_member_8024b210) }
  .text.w3d_member_8024b224 0x8024b224 : { *(.text.w3d_member_8024b224) }
  .text.w3d_member_8024b238 0x8024b238 : { *(.text.w3d_member_8024b238) }
  .text.w3d_member_8024b24c 0x8024b24c : { *(.text.w3d_member_8024b24c) }
  .text.w3d_member_8024b260 0x8024b260 : { *(.text.w3d_member_8024b260) }
  .text.w3d_member_8024b274 0x8024b274 : { *(.text.w3d_member_8024b274) }
  .text.w3d_member_8024b288 0x8024b288 : { *(.text.w3d_member_8024b288) }
  .text.w3d_member_8024b29c 0x8024b29c : { *(.text.w3d_member_8024b29c) }
  .text.w3d_member_8024b2b0 0x8024b2b0 : { *(.text.w3d_member_8024b2b0) }
  .text.w3d_member_8024b2c4 0x8024b2c4 : { *(.text.w3d_member_8024b2c4) }
  .text.w3d_member_8024b2d8 0x8024b2d8 : { *(.text.w3d_member_8024b2d8) }
  .text.w3d_member_8024b2ec 0x8024b2ec : { *(.text.w3d_member_8024b2ec) }
  .text.w3d_member_8024b300 0x8024b300 : { *(.text.w3d_member_8024b300) }
  .text.w3d_member_8024b314 0x8024b314 : { *(.text.w3d_member_8024b314) }
  .text.w3d_member_8024b328 0x8024b328 : { *(.text.w3d_member_8024b328) }
  .text.w3d_member_8024b33c 0x8024b33c : { *(.text.w3d_member_8024b33c) }
  .text.w3d_member_8024b350 0x8024b350 : { *(.text.w3d_member_8024b350) }
  .text.w3d_member_8024b3c0 0x8024b3c0 : { *(.text.w3d_member_8024b3c0) }
  .text.w3d_member_8024b430 0x8024b430 : { *(.text.w3d_member_8024b430) }
  .text.w3d_member_8024b4a0 0x8024b4a0 : { *(.text.w3d_member_8024b4a0) }
  .text.w3d_member_8024b510 0x8024b510 : { *(.text.w3d_member_8024b510) }
  .text.w3d_member_8024b524 0x8024b524 : { *(.text.w3d_member_8024b524) }
  .text.w3d_setf_8024b52c 0x8024b52c : { *(.text.w3d_setf_8024b52c) }
  .text.w3d_getf_8024b534 0x8024b534 : { *(.text.w3d_getf_8024b534) }
  .text.w3d_setf_8024b53c 0x8024b53c : { *(.text.w3d_setf_8024b53c) }
  .text.w3d_getf_8024b544 0x8024b544 : { *(.text.w3d_getf_8024b544) }
  .text.w3d_setf_8024b54c 0x8024b54c : { *(.text.w3d_setf_8024b54c) }
  .text.w3d_getf_8024b554 0x8024b554 : { *(.text.w3d_getf_8024b554) }
  .text.w3d_setf_8024b55c 0x8024b55c : { *(.text.w3d_setf_8024b55c) }
  .text.w3d_getf_8024b564 0x8024b564 : { *(.text.w3d_getf_8024b564) }
  .text.w3d_setf_8024b56c 0x8024b56c : { *(.text.w3d_setf_8024b56c) }
  .text.w3d_getf_8024b574 0x8024b574 : { *(.text.w3d_getf_8024b574) }
  .text.w3d_setf_8024b57c 0x8024b57c : { *(.text.w3d_setf_8024b57c) }
  .text.w3d_getf_8024b584 0x8024b584 : { *(.text.w3d_getf_8024b584) }
  .text.w3d_setf_8024b58c 0x8024b58c : { *(.text.w3d_setf_8024b58c) }
  .text.w3d_getf_8024b594 0x8024b594 : { *(.text.w3d_getf_8024b594) }
  .text.w3d_setf_8024b59c 0x8024b59c : { *(.text.w3d_setf_8024b59c) }
  .text.w3d_getf_8024b5a4 0x8024b5a4 : { *(.text.w3d_getf_8024b5a4) }
  .text.w3d_setf_8024b5ac 0x8024b5ac : { *(.text.w3d_setf_8024b5ac) }
  .text.w3d_getf_8024b5b4 0x8024b5b4 : { *(.text.w3d_getf_8024b5b4) }
  .text.w3d_setf_8024b5bc 0x8024b5bc : { *(.text.w3d_setf_8024b5bc) }
  .text.w3d_getf_8024b5c4 0x8024b5c4 : { *(.text.w3d_getf_8024b5c4) }
  .text.w3d_setf_8024b5cc 0x8024b5cc : { *(.text.w3d_setf_8024b5cc) }
  .text.w3d_getf_8024b5d4 0x8024b5d4 : { *(.text.w3d_getf_8024b5d4) }
  .text.w3d_setf_8024b5dc 0x8024b5dc : { *(.text.w3d_setf_8024b5dc) }
  .text.w3d_getf_8024b5e4 0x8024b5e4 : { *(.text.w3d_getf_8024b5e4) }
  .text.w3d_setf_8024b5fc 0x8024b5fc : { *(.text.w3d_setf_8024b5fc) }
  .text.w3d_getf_8024b604 0x8024b604 : { *(.text.w3d_getf_8024b604) }
  .text.w3d_setf_8024b61c 0x8024b61c : { *(.text.w3d_setf_8024b61c) }
  .text.w3d_getf_8024b624 0x8024b624 : { *(.text.w3d_getf_8024b624) }
  .text.w3d_setf_8024b62c 0x8024b62c : { *(.text.w3d_setf_8024b62c) }
  .text.w3d_getf_8024b634 0x8024b634 : { *(.text.w3d_getf_8024b634) }
  .text.w3d_setf_8024b63c 0x8024b63c : { *(.text.w3d_setf_8024b63c) }
  .text.w3d_getf_8024b644 0x8024b644 : { *(.text.w3d_getf_8024b644) }
  .text.w3d_setf_8024b64c 0x8024b64c : { *(.text.w3d_setf_8024b64c) }
  .text.w3d_getf_8024b654 0x8024b654 : { *(.text.w3d_getf_8024b654) }
  .text.w3d_setf_8024b65c 0x8024b65c : { *(.text.w3d_setf_8024b65c) }
  .text.w3d_getf_8024b664 0x8024b664 : { *(.text.w3d_getf_8024b664) }
  .text.w3d_setf_8024b66c 0x8024b66c : { *(.text.w3d_setf_8024b66c) }
  .text.w3d_getf_8024b674 0x8024b674 : { *(.text.w3d_getf_8024b674) }
  .text.w3d_setf_8024b67c 0x8024b67c : { *(.text.w3d_setf_8024b67c) }
  .text.w3d_getf_8024b684 0x8024b684 : { *(.text.w3d_getf_8024b684) }
  .text.w3d_setf_8024b68c 0x8024b68c : { *(.text.w3d_setf_8024b68c) }
  .text.w3d_getf_8024b694 0x8024b694 : { *(.text.w3d_getf_8024b694) }
  .text.w3d_setf_8024b69c 0x8024b69c : { *(.text.w3d_setf_8024b69c) }
  .text.w3d_getf_8024b6a4 0x8024b6a4 : { *(.text.w3d_getf_8024b6a4) }
  .text.w3d_setf_8024b6ac 0x8024b6ac : { *(.text.w3d_setf_8024b6ac) }
  .text.w3d_getf_8024b6b4 0x8024b6b4 : { *(.text.w3d_getf_8024b6b4) }
  .text.w3d_setf_8024b6bc 0x8024b6bc : { *(.text.w3d_setf_8024b6bc) }
  .text.w3d_getf_8024b6c4 0x8024b6c4 : { *(.text.w3d_getf_8024b6c4) }
  .text.w3d_setf_8024b6cc 0x8024b6cc : { *(.text.w3d_setf_8024b6cc) }
  .text.w3d_getf_8024b6d4 0x8024b6d4 : { *(.text.w3d_getf_8024b6d4) }
  .text.w3d_setf_8024b6dc 0x8024b6dc : { *(.text.w3d_setf_8024b6dc) }
  .text.w3d_getf_8024b6e4 0x8024b6e4 : { *(.text.w3d_getf_8024b6e4) }
  .text.w3d_setf_8024b6ec 0x8024b6ec : { *(.text.w3d_setf_8024b6ec) }
  .text.w3d_getf_8024b6f4 0x8024b6f4 : { *(.text.w3d_getf_8024b6f4) }
  /DISCARD/ : { *(.text*) *(.rodata*) *(.data*) *(.bss*) *(.sdata*) *(.sbss*) *(.comment) }
}
