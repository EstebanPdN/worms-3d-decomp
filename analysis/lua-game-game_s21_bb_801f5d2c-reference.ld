/* Generated reference-only placements. All bodies are source-built. */
OUTPUT_FORMAT("elf32-powerpc")
OUTPUT_ARCH(powerpc)
ENTRY(w3d_s21_normalize4_801f5d2c)
_SDA_BASE_ = 0x804b2540;
_SDA2_BASE_ = 0x804c2540;
fn_801f3fec = 0x801f3fec;
SECTIONS {
  .text.w3d_s21_normalize4_801f5d2c 0x801f5d2c : { *(.text.w3d_s21_normalize4_801f5d2c) }
  /DISCARD/ : { *(.text*) *(.rodata*) *(.data*) *(.bss*) *(.sdata*) *(.sbss*) *(.comment) }
}
