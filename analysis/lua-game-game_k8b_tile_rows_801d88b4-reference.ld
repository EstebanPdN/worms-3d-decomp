/* Generated reference-only placements. All bodies are source-built. */
OUTPUT_FORMAT("elf32-powerpc")
OUTPUT_ARCH(powerpc)
ENTRY(w3d_k8b_tile_rows_801d88b4)
_SDA_BASE_ = 0x804b2540;
_SDA2_BASE_ = 0x804c2540;
fn_801d7f04 = 0x801d7f04;
SECTIONS {
  .text.w3d_k8b_tile_rows_801d88b4 0x801d88b4 : { *(.text.w3d_k8b_tile_rows_801d88b4) }
  /DISCARD/ : { *(.text*) *(.rodata*) *(.data*) *(.bss*) *(.sdata*) *(.sbss*) *(.comment) }
}
