/* Generated reference-only placements. All bodies are source-built. */
OUTPUT_FORMAT("elf32-powerpc")
OUTPUT_ARCH(powerpc)
ENTRY(w3d_cx9c_actor_array_80344a68)
_SDA_BASE_ = 0x804b2540;
_SDA2_BASE_ = 0x804c2540;
__19Cx9cRecord_800de6c4 = 0x800de6c4;
cx9c_array_allocate_800dc5bc = 0x800dc5bc;
SECTIONS {
  .text.w3d_cx9c_actor_array_80344a68 0x80344a68 : { *(.text.w3d_cx9c_actor_array_80344a68) }
  /DISCARD/ : { *(.text*) *(.rodata*) *(.data*) *(.bss*) *(.sdata*) *(.sbss*) *(.comment) }
}
