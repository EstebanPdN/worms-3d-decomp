/* Generated reference-only placements. All bodies are source-built. */
OUTPUT_FORMAT("elf32-powerpc")
OUTPUT_ARCH(powerpc)
ENTRY(f6c_ctor_8023caa8)
_SDA_BASE_ = 0x804b2540;
_SDA2_BASE_ = 0x804c2540;
fn_8020c5c0 = 0x8020c5c0;
fn_8023b59c = 0x8023b59c;
fn_80341884 = 0x80341884;
lbl_803bbec4 = 0x803bbec4;
lbl_8041ac48 = 0x8041ac48;
lbl_8045e708 = 0x8045e708;
lbl_804b06a0 = 0x804b06a0;
SECTIONS {
  .text.f6c_ctor_8023caa8 0x8023caa8 : { *(.text.f6c_ctor_8023caa8) }
  /DISCARD/ : { *(.text*) *(.rodata*) *(.data*) *(.bss*) *(.sdata*) *(.sbss*) *(.comment) }
}
