/* Generated reference-only placements. All bodies are source-built. */
OUTPUT_FORMAT("elf32-powerpc")
OUTPUT_ARCH(powerpc)
ENTRY(w3d_d29e_create_and_run_801de328)
_SDA_BASE_ = 0x804b2540;
_SDA2_BASE_ = 0x804c2540;
cxc2_singleton_8020b884 = 0x8020b884;
lbl_80418f78 = 0x80418f78;
w3d_s10_service_forward_8020b680 = 0x8020b680;
SECTIONS {
  .text.w3d_d29e_create_and_run_801de328 0x801de328 : { *(.text.w3d_d29e_create_and_run_801de328) }
  /DISCARD/ : { *(.text*) *(.rodata*) *(.data*) *(.bss*) *(.sdata*) *(.sbss*) *(.comment) }
}
