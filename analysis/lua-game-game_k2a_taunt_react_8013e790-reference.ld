/* Generated reference-only placements. All bodies are source-built. */
OUTPUT_FORMAT("elf32-powerpc")
OUTPUT_ARCH(powerpc)
ENTRY(k2a_taunt_react_8013e790)
_SDA_BASE_ = 0x804b2540;
_SDA2_BASE_ = 0x804c2540;
FUN_8013bd0c = 0x8013bd0c;
fn_80162C20 = 0x80162c20;
s8_index_query_800fc6dc = 0x800fc6dc;
w3d_auto_80178c48 = 0x80178c48;
w3d_empty_803426b4 = 0x803426b4;
w3d_get_800a830c = 0x800a830c;
w3d_str_8039e988 = 0x8039e988;
w3d_str_8039e990 = 0x8039e990;
w3d_str_8039fcc0 = 0x8039fcc0;
w3d_str_8039fcc8 = 0x8039fcc8;
w3d_str_8039fcd4 = 0x8039fcd4;
w3d_str_8039fcdc = 0x8039fcdc;
w3d_str_8039fcec = 0x8039fcec;
w3d_str_8039fcf8 = 0x8039fcf8;
SECTIONS {
  .text.k2a_taunt_react_8013e790 0x8013e790 : { *(.text.k2a_taunt_react_8013e790) }
  /DISCARD/ : { *(.text*) *(.rodata*) *(.data*) *(.bss*) *(.sdata*) *(.sbss*) *(.comment) }
}
