/* Generated reference-only placements. All bodies are source-built. */
OUTPUT_FORMAT("elf32-powerpc")
OUTPUT_ARCH(powerpc)
ENTRY(tsonnet_c32_stream_write_80208994)
_SDA_BASE_ = 0x804b2540;
_SDA2_BASE_ = 0x804c2540;
fn_801fe45c = 0x801fe45c;
fn_802ef9c0 = 0x802ef9c0;
fn_803434d4 = 0x803434d4;
SECTIONS {
  .text.tsonnet_c32_stream_write_80208994 0x80208994 : { *(.text.tsonnet_c32_stream_write_80208994) }
  /DISCARD/ : { *(.text*) *(.rodata*) *(.data*) *(.bss*) *(.sdata*) *(.sbss*) *(.comment) }
}
