/* Generated reference-only placements. All bodies are source-built. */
OUTPUT_FORMAT("elf32-powerpc")
OUTPUT_ARCH(powerpc)
ENTRY(d26j_rebuild_sorted_edges_8018b638)
_SDA_BASE_ = 0x804b2540;
_SDA2_BASE_ = 0x804c2540;
cmp_8018b628 = 0x8018b628;
fn_801fe220 = 0x801fe220;
fn_801fe240 = 0x801fe240;
qsort = 0x802ede44;
SECTIONS {
  .text.d26j_rebuild_sorted_edges_8018b638 0x8018b638 : { *(.text.d26j_rebuild_sorted_edges_8018b638) }
  /DISCARD/ : { *(.text*) *(.rodata*) *(.data*) *(.bss*) *(.sdata*) *(.sbss*) *(.comment) }
}
