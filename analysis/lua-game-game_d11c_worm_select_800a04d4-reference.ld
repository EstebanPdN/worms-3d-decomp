/* Generated reference-only placements. All bodies are source-built. */
OUTPUT_FORMAT("elf32-powerpc")
OUTPUT_ARCH(powerpc)
ENTRY(d11c_worm_select_800a04d4)
_SDA_BASE_ = 0x804b2540;
_SDA2_BASE_ = 0x804c2540;
__20d11c_String_8020bb54PCc = 0x8020bb54;
d11c_arrow_scale_80437d24 = 0x80437d24;
d11c_cast_80343808 = 0x80343808;
d11c_f32_8038089c = 0x8038089c;
d11c_f32_803808a0 = 0x803808a0;
d11c_f32_803808a4 = 0x803808a4;
d11c_f32_803808a8 = 0x803808a8;
d11c_f32_803808ac = 0x803808ac;
d11c_handle_set_name_8015adf4 = 0x8015adf4;
d11c_locator1_80380890 = 0x80380890;
d11c_locator_arrow_8038087c = 0x8038087c;
d11c_pooled_a_80171ff8 = 0x80171ff8;
d11c_pooled_b_80171fa0 = 0x80171fa0;
d11c_service_lookup_8015ae3c = 0x8015ae3c;
d11c_string_base_finish_8020c5c4 = 0x8020c5c4;
d11c_string_release_80341588 = 0x80341588;
d11c_worm_select_8038086c = 0x8038086c;
SECTIONS {
  .text.d11c_worm_select_800a04d4 0x800a04d4 : { *(.text.d11c_worm_select_800a04d4) }
  /DISCARD/ : { *(.text*) *(.rodata*) *(.data*) *(.bss*) *(.sdata*) *(.sbss*) *(.comment) }
}
