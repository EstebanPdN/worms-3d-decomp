/* Generated reference-only placements. All bodies are source-built. */
OUTPUT_FORMAT("elf32-powerpc")
OUTPUT_ARCH(powerpc)
ENTRY(w3d_cx8b_type_registration_80212bd0)
_SDA_BASE_ = 0x804b2540;
_SDA2_BASE_ = 0x804c2540;
base_80463308 = 0x80463308;
descriptor_80463c34 = 0x80463c34;
fn_80200af8 = 0x80200af8;
fn_802110c4 = 0x802110c4;
name_803b3670 = 0x803b3670;
SECTIONS {
  .text.w3d_cx8b_type_registration_80212bd0 0x80212bd0 : { *(.text.w3d_cx8b_type_registration_80212bd0) }
  /DISCARD/ : { *(.text*) *(.rodata*) *(.data*) *(.bss*) *(.sdata*) *(.sbss*) *(.comment) }
}
