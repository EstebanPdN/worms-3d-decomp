/* Generated reference-only placements. All bodies are source-built. */
OUTPUT_FORMAT("elf32-powerpc")
OUTPUT_ARCH(powerpc)
ENTRY(w3d_constant_8020b320)
_SDA_BASE_ = 0x804b2540;
_SDA2_BASE_ = 0x804c2540;
w3d_fn_8020ddfc = 0x8020ddfc;
w3d_fn_8020e09c = 0x8020e09c;
w3d_fn_802111a8 = 0x802111a8;
w3d_fn_802112d8 = 0x802112d8;
w3d_fn_80218874 = 0x80218874;
w3d_fn_802188f8 = 0x802188f8;
w3d_fn_80218f1c = 0x80218f1c;
w3d_fn_80218f98 = 0x80218f98;
w3d_fn_8021950c = 0x8021950c;
w3d_fn_80219578 = 0x80219578;
w3d_fn_8021a4a0 = 0x8021a4a0;
w3d_fn_8021a540 = 0x8021a540;
w3d_fn_8021cbc8 = 0x8021cbc8;
w3d_fn_8021cc18 = 0x8021cc18;
w3d_global_80365a18 = 0x80365a18;
w3d_global_80365a48 = 0x80365a48;
w3d_global_80365a78 = 0x80365a78;
w3d_global_80365aa8 = 0x80365aa8;
w3d_global_80365ad8 = 0x80365ad8;
w3d_global_80365b28 = 0x80365b28;
w3d_global_80365b78 = 0x80365b78;
w3d_global_80365bc8 = 0x80365bc8;
w3d_global_80365c18 = 0x80365c18;
w3d_global_80365c68 = 0x80365c68;
w3d_global_80365cb8 = 0x80365cb8;
w3d_global_803b3194 = 0x803b3194;
w3d_global_803b32c4 = 0x803b32c4;
w3d_global_803b3840 = 0x803b3840;
w3d_global_803b3864 = 0x803b3864;
w3d_global_803b3918 = 0x803b3918;
w3d_global_803b3980 = 0x803b3980;
w3d_global_803b3998 = 0x803b3998;
w3d_global_803b39b0 = 0x803b39b0;
w3d_global_803b39c8 = 0x803b39c8;
w3d_global_803b39e0 = 0x803b39e0;
w3d_global_803b39f8 = 0x803b39f8;
w3d_global_80463360 = 0x80463360;
w3d_heap_allocate_entry_a = 0x801fe1d8;
w3d_owner_list_remove = 0x8020fd2c;
w3d_registry_list_80365a48 = 0x80365a48;
w3d_registry_list_80365a78 = 0x80365a78;
w3d_registry_list_80365aa8 = 0x80365aa8;
w3d_registry_list_80365ad8 = 0x80365ad8;
w3d_registry_list_80365b28 = 0x80365b28;
w3d_registry_list_80365b78 = 0x80365b78;
w3d_registry_list_80365bc8 = 0x80365bc8;
w3d_registry_list_80365c18 = 0x80365c18;
w3d_registry_list_80365c68 = 0x80365c68;
w3d_state_register = 0x8020fd04;
SECTIONS {
  .text.w3d_constant_8020b320 0x8020b320 : { *(.text.w3d_constant_8020b320) }
  .text.w3d_constant_8020b5c8 0x8020b5c8 : { *(.text.w3d_constant_8020b5c8) }
  .text.w3d_empty_8020b5d0 0x8020b5d0 : { *(.text.w3d_empty_8020b5d0) }
  .text.w3d_constant_8020baac 0x8020baac : { *(.text.w3d_constant_8020baac) }
  .text.w3d_empty_8020c5c8 0x8020c5c8 : { *(.text.w3d_empty_8020c5c8) }
  .text.w3d_address_8020d25c 0x8020d25c : { *(.text.w3d_address_8020d25c) }
  .text.w3d_registry_retain_8020d2b8 0x8020d2b8 : { *(.text.w3d_registry_retain_8020d2b8) }
  .text.w3d_address_8020ddf0 0x8020ddf0 : { *(.text.w3d_address_8020ddf0) }
  .text.w3d_address_8020df14 0x8020df14 : { *(.text.w3d_address_8020df14) }
  .text.w3d_registry_release_8020df20 0x8020df20 : { *(.text.w3d_registry_release_8020df20) }
  .text.w3d_registry_retain_8020df7c 0x8020df7c : { *(.text.w3d_registry_retain_8020df7c) }
  .text.w3d_constant_8020fb78 0x8020fb78 : { *(.text.w3d_constant_8020fb78) }
  .text.w3d_constant_8020fb80 0x8020fb80 : { *(.text.w3d_constant_8020fb80) }
  .text.w3d_address_8020fcf8 0x8020fcf8 : { *(.text.w3d_address_8020fcf8) }
  .text.w3d_get_8020fd74 0x8020fd74 : { *(.text.w3d_get_8020fd74) }
  .text.w3d_constant_8020fe48 0x8020fe48 : { *(.text.w3d_constant_8020fe48) }
  .text.w3d_empty_8020fe50 0x8020fe50 : { *(.text.w3d_empty_8020fe50) }
  .text.w3d_registry_release_80211008 0x80211008 : { *(.text.w3d_registry_release_80211008) }
  .text.w3d_registry_retain_80211064 0x80211064 : { *(.text.w3d_registry_retain_80211064) }
  .text.w3d_constant_802110c4 0x802110c4 : { *(.text.w3d_constant_802110c4) }
  .text.w3d_get_802118e0 0x802118e0 : { *(.text.w3d_get_802118e0) }
  .text.w3d_get_80211e0c 0x80211e0c : { *(.text.w3d_get_80211e0c) }
  .text.w3d_empty_80212bcc 0x80212bcc : { *(.text.w3d_empty_80212bcc) }
  .text.w3d_constant_802172c4 0x802172c4 : { *(.text.w3d_constant_802172c4) }
  .text.w3d_address_80218004 0x80218004 : { *(.text.w3d_address_80218004) }
  .text.w3d_registry_release_80218010 0x80218010 : { *(.text.w3d_registry_release_80218010) }
  .text.w3d_registry_retain_8021806c 0x8021806c : { *(.text.w3d_registry_retain_8021806c) }
  .text.w3d_address_802180cc 0x802180cc : { *(.text.w3d_address_802180cc) }
  .text.w3d_registry_retain_80218134 0x80218134 : { *(.text.w3d_registry_retain_80218134) }
  .text.w3d_constant_8021876c 0x8021876c : { *(.text.w3d_constant_8021876c) }
  .text.w3d_constant_80218bb8 0x80218bb8 : { *(.text.w3d_constant_80218bb8) }
  .text.w3d_constant_80218c48 0x80218c48 : { *(.text.w3d_constant_80218c48) }
  .text.w3d_address_80218dfc 0x80218dfc : { *(.text.w3d_address_80218dfc) }
  .text.w3d_registry_release_80218e08 0x80218e08 : { *(.text.w3d_registry_release_80218e08) }
  .text.w3d_registry_retain_80218e64 0x80218e64 : { *(.text.w3d_registry_retain_80218e64) }
  .text.w3d_address_80219394 0x80219394 : { *(.text.w3d_address_80219394) }
  .text.w3d_registry_unlink_802193a0 0x802193a0 : { *(.text.w3d_registry_unlink_802193a0) }
  .text.w3d_registry_create_802193e4 0x802193e4 : { *(.text.w3d_registry_create_802193e4) }
  .text.w3d_address_80219444 0x80219444 : { *(.text.w3d_address_80219444) }
  .text.w3d_registry_release_80219450 0x80219450 : { *(.text.w3d_registry_release_80219450) }
  .text.w3d_registry_retain_802194ac 0x802194ac : { *(.text.w3d_registry_retain_802194ac) }
  .text.w3d_address_80219aac 0x80219aac : { *(.text.w3d_address_80219aac) }
  .text.w3d_address_80219b68 0x80219b68 : { *(.text.w3d_address_80219b68) }
  .text.w3d_address_80219c24 0x80219c24 : { *(.text.w3d_address_80219c24) }
  .text.w3d_address_80219ce0 0x80219ce0 : { *(.text.w3d_address_80219ce0) }
  .text.w3d_address_80219d9c 0x80219d9c : { *(.text.w3d_address_80219d9c) }
  .text.w3d_constant_8021a270 0x8021a270 : { *(.text.w3d_constant_8021a270) }
  .text.w3d_address_8021a37c 0x8021a37c : { *(.text.w3d_address_8021a37c) }
  .text.w3d_registry_unlink_8021a388 0x8021a388 : { *(.text.w3d_registry_unlink_8021a388) }
  .text.w3d_registry_create_8021a3cc 0x8021a3cc : { *(.text.w3d_registry_create_8021a3cc) }
  .text.w3d_registry_release_8021a42c 0x8021a42c : { *(.text.w3d_registry_release_8021a42c) }
  .text.w3d_registry_retain_8021a488 0x8021a488 : { *(.text.w3d_registry_retain_8021a488) }
  .text.w3d_empty_8021b00c 0x8021b00c : { *(.text.w3d_empty_8021b00c) }
  .text.w3d_empty_8021b0a8 0x8021b0a8 : { *(.text.w3d_empty_8021b0a8) }
  .text.w3d_address_8021caa4 0x8021caa4 : { *(.text.w3d_address_8021caa4) }
  .text.w3d_registry_unlink_8021cab0 0x8021cab0 : { *(.text.w3d_registry_unlink_8021cab0) }
  .text.w3d_registry_create_8021caf4 0x8021caf4 : { *(.text.w3d_registry_create_8021caf4) }
  .text.w3d_registry_release_8021cb54 0x8021cb54 : { *(.text.w3d_registry_release_8021cb54) }
  .text.w3d_registry_retain_8021cbb0 0x8021cbb0 : { *(.text.w3d_registry_retain_8021cbb0) }
  .text.w3d_constant_8021cd00 0x8021cd00 : { *(.text.w3d_constant_8021cd00) }
  .text.w3d_empty_8021cd08 0x8021cd08 : { *(.text.w3d_empty_8021cd08) }
  .text.w3d_empty_8021cd0c 0x8021cd0c : { *(.text.w3d_empty_8021cd0c) }
  .text.w3d_empty_8021cfec 0x8021cfec : { *(.text.w3d_empty_8021cfec) }
  .text.w3d_constant_8021cff0 0x8021cff0 : { *(.text.w3d_constant_8021cff0) }
  .text.w3d_empty_8021d0fc 0x8021d0fc : { *(.text.w3d_empty_8021d0fc) }
  .text.w3d_get_8021ed0c 0x8021ed0c : { *(.text.w3d_get_8021ed0c) }
  .text.w3d_get_8021ed14 0x8021ed14 : { *(.text.w3d_get_8021ed14) }
  .text.w3d_address_8021ee50 0x8021ee50 : { *(.text.w3d_address_8021ee50) }
  .text.w3d_registry_unlink_8021eec4 0x8021eec4 : { *(.text.w3d_registry_unlink_8021eec4) }
  .text.w3d_address_8021fc70 0x8021fc70 : { *(.text.w3d_address_8021fc70) }
  .text.w3d_registry_unlink_8021fce4 0x8021fce4 : { *(.text.w3d_registry_unlink_8021fce4) }
  .text.w3d_address_80220148 0x80220148 : { *(.text.w3d_address_80220148) }
  .text.w3d_registry_unlink_802201bc 0x802201bc : { *(.text.w3d_registry_unlink_802201bc) }
  .text.w3d_address_802205b0 0x802205b0 : { *(.text.w3d_address_802205b0) }
  .text.w3d_registry_unlink_80220624 0x80220624 : { *(.text.w3d_registry_unlink_80220624) }
  .text.w3d_address_80220a44 0x80220a44 : { *(.text.w3d_address_80220a44) }
  .text.w3d_registry_unlink_80220ab8 0x80220ab8 : { *(.text.w3d_registry_unlink_80220ab8) }
  .text.w3d_address_80220db0 0x80220db0 : { *(.text.w3d_address_80220db0) }
  .text.w3d_registry_unlink_80220e24 0x80220e24 : { *(.text.w3d_registry_unlink_80220e24) }
  .text.w3d_address_802210bc 0x802210bc : { *(.text.w3d_address_802210bc) }
  /DISCARD/ : { *(.text*) *(.rodata*) *(.data*) *(.bss*) *(.sdata*) *(.sbss*) *(.comment) }
}
