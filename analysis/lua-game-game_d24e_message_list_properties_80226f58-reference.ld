/* Generated reference-only placements. All bodies are source-built. */
OUTPUT_FORMAT("elf32-powerpc")
OUTPUT_ARCH(powerpc)
ENTRY(w3d_d24e_register_message_list_properties_80226f58)
_SDA_BASE_ = 0x804b2540;
_SDA2_BASE_ = 0x804c2540;
__15String_8020bb54PCc = 0x8020bb54;
d20e_release_header_8020bb2c = 0x8020bb2c;
d20e_string_finish_8020c5c4 = 0x8020c5c4;
d20e_string_release_80341588 = 0x80341588;
desc_803b80e0 = 0x803b80e0;
desc_803b8110 = 0x803b8110;
fn_801e8d9c = 0x801e8d9c;
fn_801ec52c = 0x801ec52c;
fn_801ed24c = 0x801ed24c;
fn_801eff8c = 0x801eff8c;
fn_801efff0 = 0x801efff0;
lbl_803b80cc = 0x803b80cc;
lbl_803b80d4 = 0x803b80d4;
lbl_804007d8 = 0x804007d8;
lbl_8045e004 = 0x8045e004;
lbl_8045ed94 = 0x8045ed94;
lit_803b6408 = 0x803b6408;
memset = 0x802eefe0;
SECTIONS {
  .text.w3d_d24e_register_message_list_properties_80226f58 0x80226f58 : { *(.text.w3d_d24e_register_message_list_properties_80226f58) }
  .bss 0x80464aa4 : { *(.bss) }
  .sbss 0x804b07ec : { *(.sbss) }
  /DISCARD/ : { *(.text*) *(.rodata*) *(.data*) *(.bss*) *(.sdata*) *(.sbss*) *(.comment) }
}
