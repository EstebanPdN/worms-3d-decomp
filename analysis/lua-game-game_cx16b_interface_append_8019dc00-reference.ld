/* Generated reference-only placements. All bodies are source-built. */
OUTPUT_FORMAT("elf32-powerpc")
OUTPUT_ARCH(powerpc)
ENTRY(w3d_cx16b_interface_append_8019dc00)
_SDA_BASE_ = 0x804b2540;
_SDA2_BASE_ = 0x804c2540;
fn_80210d54 = 0x80210d54;
SECTIONS {
  .text.w3d_cx16b_interface_append_8019dc00 0x8019dc00 : { *(.text.w3d_cx16b_interface_append_8019dc00) }
  /DISCARD/ : { *(.text*) *(.rodata*) *(.data*) *(.bss*) *(.sdata*) *(.sbss*) *(.comment) }
}
