/* Generated reference-only placements. All bodies are source-built. */
OUTPUT_FORMAT("elf32-powerpc")
OUTPUT_ARCH(powerpc)
ENTRY(w3d_sol35d_normalize_path_80218194)
_SDA_BASE_ = 0x804b2540;
_SDA2_BASE_ = 0x804c2540;
fn_8020bb2c = 0x8020bb2c;
fn_8020c00c = 0x8020c00c;
fn_8020c5c4 = 0x8020c5c4;
fn_80341588 = 0x80341588;
fn_803426b8 = 0x803426b8;
SECTIONS {
  .text.w3d_sol35d_normalize_path_80218194 0x80218194 : { *(.text.w3d_sol35d_normalize_path_80218194) }
  /DISCARD/ : { *(.text*) *(.rodata*) *(.data*) *(.bss*) *(.sdata*) *(.sbss*) *(.comment) }
}
