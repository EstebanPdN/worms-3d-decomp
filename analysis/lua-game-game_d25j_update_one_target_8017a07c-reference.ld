/* Generated reference-only placements. All bodies are source-built. */
OUTPUT_FORMAT("elf32-powerpc")
OUTPUT_ARCH(powerpc)
ENTRY(d25j_update_one_target_8017a07c)
_SDA_BASE_ = 0x804b2540;
_SDA2_BASE_ = 0x804c2540;
__4Vec3 = 0x80343740;
float_803a7068 = 0x803a7068;
fn_801a3eb0 = 0x801a3eb0;
fn_801f6034 = 0x801f6034;
fn_801f6448 = 0x801f6448;
fn_801f740c = 0x801f740c;
SECTIONS {
  .text.d25j_update_one_target_8017a07c 0x8017a07c : { *(.text.d25j_update_one_target_8017a07c) }
  /DISCARD/ : { *(.text*) *(.rodata*) *(.data*) *(.bss*) *(.sdata*) *(.sbss*) *(.comment) }
}
