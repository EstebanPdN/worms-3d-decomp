/* Generated reference-only placements. All bodies are source-built. */
OUTPUT_FORMAT("elf32-powerpc")
OUTPUT_ARCH(powerpc)
ENTRY(w3d_member_802597d4)
_SDA_BASE_ = 0x804b2540;
_SDA2_BASE_ = 0x804c2540;
SECTIONS {
  .text.w3d_member_802597d4 0x802597d4 : { *(.text.w3d_member_802597d4) }
  .text.w3d_member_80259844 0x80259844 : { *(.text.w3d_member_80259844) }
  .text.w3d_member_802598b4 0x802598b4 : { *(.text.w3d_member_802598b4) }
  .text.w3d_member_80259924 0x80259924 : { *(.text.w3d_member_80259924) }
  .text.w3d_member_802599a4 0x802599a4 : { *(.text.w3d_member_802599a4) }
  .text.w3d_setf_802599ac 0x802599ac : { *(.text.w3d_setf_802599ac) }
  .text.w3d_getf_802599b4 0x802599b4 : { *(.text.w3d_getf_802599b4) }
  .text.w3d_setf_802599fc 0x802599fc : { *(.text.w3d_setf_802599fc) }
  .text.w3d_getf_80259a04 0x80259a04 : { *(.text.w3d_getf_80259a04) }
  .text.w3d_setf_80259a2c 0x80259a2c : { *(.text.w3d_setf_80259a2c) }
  .text.w3d_getf_80259a34 0x80259a34 : { *(.text.w3d_getf_80259a34) }
  .text.w3d_setf_80259a3c 0x80259a3c : { *(.text.w3d_setf_80259a3c) }
  .text.w3d_getf_80259a44 0x80259a44 : { *(.text.w3d_getf_80259a44) }
  .text.w3d_setf_80259a4c 0x80259a4c : { *(.text.w3d_setf_80259a4c) }
  .text.w3d_getf_80259a54 0x80259a54 : { *(.text.w3d_getf_80259a54) }
  .text.w3d_setf_80259a5c 0x80259a5c : { *(.text.w3d_setf_80259a5c) }
  .text.w3d_getf_80259a64 0x80259a64 : { *(.text.w3d_getf_80259a64) }
  .text.w3d_setf_80259a6c 0x80259a6c : { *(.text.w3d_setf_80259a6c) }
  .text.w3d_getf_80259a74 0x80259a74 : { *(.text.w3d_getf_80259a74) }
  .text.w3d_setf_80259a7c 0x80259a7c : { *(.text.w3d_setf_80259a7c) }
  .text.w3d_getf_80259a84 0x80259a84 : { *(.text.w3d_getf_80259a84) }
  .text.w3d_setf_80259a8c 0x80259a8c : { *(.text.w3d_setf_80259a8c) }
  .text.w3d_getf_80259a94 0x80259a94 : { *(.text.w3d_getf_80259a94) }
  .text.w3d_setf_80259a9c 0x80259a9c : { *(.text.w3d_setf_80259a9c) }
  .text.w3d_getf_80259aa4 0x80259aa4 : { *(.text.w3d_getf_80259aa4) }
  .text.w3d_setf_80259abc 0x80259abc : { *(.text.w3d_setf_80259abc) }
  .text.w3d_getf_80259ac4 0x80259ac4 : { *(.text.w3d_getf_80259ac4) }
  .text.w3d_setf_80259afc 0x80259afc : { *(.text.w3d_setf_80259afc) }
  .text.w3d_getf_80259b04 0x80259b04 : { *(.text.w3d_getf_80259b04) }
  .text.w3d_setf_80259b0c 0x80259b0c : { *(.text.w3d_setf_80259b0c) }
  .text.w3d_getf_80259b14 0x80259b14 : { *(.text.w3d_getf_80259b14) }
  .text.w3d_setf_80259b2c 0x80259b2c : { *(.text.w3d_setf_80259b2c) }
  .text.w3d_getf_80259b34 0x80259b34 : { *(.text.w3d_getf_80259b34) }
  .text.w3d_setf_80259b3c 0x80259b3c : { *(.text.w3d_setf_80259b3c) }
  .text.w3d_getf_80259b44 0x80259b44 : { *(.text.w3d_getf_80259b44) }
  .text.w3d_setf_80259b4c 0x80259b4c : { *(.text.w3d_setf_80259b4c) }
  .text.w3d_getf_80259b54 0x80259b54 : { *(.text.w3d_getf_80259b54) }
  .text.w3d_setf_80259b5c 0x80259b5c : { *(.text.w3d_setf_80259b5c) }
  .text.w3d_getf_80259b64 0x80259b64 : { *(.text.w3d_getf_80259b64) }
  .text.w3d_setf_80259b6c 0x80259b6c : { *(.text.w3d_setf_80259b6c) }
  .text.w3d_getf_80259b74 0x80259b74 : { *(.text.w3d_getf_80259b74) }
  .text.w3d_setf_80259b7c 0x80259b7c : { *(.text.w3d_setf_80259b7c) }
  .text.w3d_getf_80259b84 0x80259b84 : { *(.text.w3d_getf_80259b84) }
  .text.w3d_setf_80259b8c 0x80259b8c : { *(.text.w3d_setf_80259b8c) }
  .text.w3d_getf_80259b94 0x80259b94 : { *(.text.w3d_getf_80259b94) }
  .text.w3d_setf_80259b9c 0x80259b9c : { *(.text.w3d_setf_80259b9c) }
  .text.w3d_getf_80259ba4 0x80259ba4 : { *(.text.w3d_getf_80259ba4) }
  .text.w3d_setf_80259bac 0x80259bac : { *(.text.w3d_setf_80259bac) }
  .text.w3d_getf_80259bb4 0x80259bb4 : { *(.text.w3d_getf_80259bb4) }
  .text.w3d_setf_80259bbc 0x80259bbc : { *(.text.w3d_setf_80259bbc) }
  .text.w3d_getf_80259bc4 0x80259bc4 : { *(.text.w3d_getf_80259bc4) }
  .text.w3d_setf_80259bcc 0x80259bcc : { *(.text.w3d_setf_80259bcc) }
  .text.w3d_getf_80259bd4 0x80259bd4 : { *(.text.w3d_getf_80259bd4) }
  .text.w3d_setf_80259bdc 0x80259bdc : { *(.text.w3d_setf_80259bdc) }
  .text.w3d_getf_80259be4 0x80259be4 : { *(.text.w3d_getf_80259be4) }
  .text.w3d_setf_80259bec 0x80259bec : { *(.text.w3d_setf_80259bec) }
  .text.w3d_getf_80259bf4 0x80259bf4 : { *(.text.w3d_getf_80259bf4) }
  .text.w3d_setf_80259bfc 0x80259bfc : { *(.text.w3d_setf_80259bfc) }
  .text.w3d_getf_80259c04 0x80259c04 : { *(.text.w3d_getf_80259c04) }
  .text.w3d_setf_80259c0c 0x80259c0c : { *(.text.w3d_setf_80259c0c) }
  .text.w3d_getf_80259c14 0x80259c14 : { *(.text.w3d_getf_80259c14) }
  .text.w3d_setf_80259c1c 0x80259c1c : { *(.text.w3d_setf_80259c1c) }
  .text.w3d_getf_80259c24 0x80259c24 : { *(.text.w3d_getf_80259c24) }
  .text.w3d_setf_80259c2c 0x80259c2c : { *(.text.w3d_setf_80259c2c) }
  .text.w3d_getf_80259c34 0x80259c34 : { *(.text.w3d_getf_80259c34) }
  .text.w3d_setf_80259c4c 0x80259c4c : { *(.text.w3d_setf_80259c4c) }
  .text.w3d_getf_80259c54 0x80259c54 : { *(.text.w3d_getf_80259c54) }
  .text.w3d_setf_80259c5c 0x80259c5c : { *(.text.w3d_setf_80259c5c) }
  .text.w3d_getf_80259c64 0x80259c64 : { *(.text.w3d_getf_80259c64) }
  .text.w3d_member_80259cd4 0x80259cd4 : { *(.text.w3d_member_80259cd4) }
  .text.w3d_member_80259d44 0x80259d44 : { *(.text.w3d_member_80259d44) }
  .text.w3d_member_80259db4 0x80259db4 : { *(.text.w3d_member_80259db4) }
  .text.w3d_member_80259e24 0x80259e24 : { *(.text.w3d_member_80259e24) }
  .text.w3d_member_80259e94 0x80259e94 : { *(.text.w3d_member_80259e94) }
  .text.w3d_member_80259f04 0x80259f04 : { *(.text.w3d_member_80259f04) }
  .text.w3d_member_80259f74 0x80259f74 : { *(.text.w3d_member_80259f74) }
  .text.w3d_setf_8025a04c 0x8025a04c : { *(.text.w3d_setf_8025a04c) }
  .text.w3d_getf_8025a054 0x8025a054 : { *(.text.w3d_getf_8025a054) }
  .text.w3d_setf_8025a05c 0x8025a05c : { *(.text.w3d_setf_8025a05c) }
  .text.w3d_getf_8025a064 0x8025a064 : { *(.text.w3d_getf_8025a064) }
  /DISCARD/ : { *(.text*) *(.rodata*) *(.data*) *(.bss*) *(.sdata*) *(.sbss*) *(.comment) }
}
