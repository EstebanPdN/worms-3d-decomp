/* Generated reference-only placements. All bodies are source-built. */
OUTPUT_FORMAT("elf32-powerpc")
OUTPUT_ARCH(powerpc)
ENTRY(w3d_cc28b_read_map_8018b9a0)
_SDA_BASE_ = 0x804b2540;
_SDA2_BASE_ = 0x804c2540;
fn_80190538 = 0x80190538;
fn_801fe220 = 0x801fe220;
fn_801fe240 = 0x801fe240;
lbl_803a7db4 = 0x803a7db4;
lbl_803a7dc0 = 0x803a7dc0;
lbl_803a7dcc = 0x803a7dcc;
lbl_803a7dd4 = 0x803a7dd4;
lbl_803a7de0 = 0x803a7de0;
SECTIONS {
  .text.w3d_cc28b_read_map_8018b9a0 0x8018b9a0 : { *(.text.w3d_cc28b_read_map_8018b9a0) }
  /DISCARD/ : { *(.text*) *(.rodata*) *(.data*) *(.bss*) *(.sdata*) *(.sbss*) *(.comment) }
}
