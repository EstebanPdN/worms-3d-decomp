/* Generated reference-only placements. All bodies are source-built. */
OUTPUT_FORMAT("elf32-powerpc")
OUTPUT_ARCH(powerpc)
ENTRY(w3d_s10_string_ctor_80225658)
_SDA_BASE_ = 0x804b2540;
_SDA2_BASE_ = 0x804c2540;
fn_8020c5c0 = 0x8020c5c0;
fn_8021ef08 = 0x8021ef08;
fn_80341884 = 0x80341884;
lbl_8041a2f8 = 0x8041a2f8;
lbl_804b06a0 = 0x804b06a0;
SECTIONS {
  .text.w3d_s10_string_ctor_80225658 0x80225658 : { *(.text.w3d_s10_string_ctor_80225658) }
  /DISCARD/ : { *(.text*) *(.rodata*) *(.data*) *(.bss*) *(.sdata*) *(.sbss*) *(.comment) }
}
