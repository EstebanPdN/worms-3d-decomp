/* Generated reference-only placements. All bodies are source-built. */
OUTPUT_FORMAT("elf32-powerpc")
OUTPUT_ARCH(powerpc)
ENTRY(w3d_cx16b_interface_key_nth_801af870)
_SDA_BASE_ = 0x804b2540;
_SDA2_BASE_ = 0x804c2540;
fn_802eedc0 = 0x802eedc0;
SECTIONS {
  .text.w3d_cx16b_interface_key_nth_801af870 0x801af870 : { *(.text.w3d_cx16b_interface_key_nth_801af870) }
  /DISCARD/ : { *(.text*) *(.rodata*) *(.data*) *(.bss*) *(.sdata*) *(.sbss*) *(.comment) }
}
