/* Generated reference-only placements. All bodies are source-built. */
OUTPUT_FORMAT("elf32-powerpc")
OUTPUT_ARCH(powerpc)
ENTRY(__14W3dVec4TablesC)
_SDA_BASE_ = 0x804b2540;
_SDA2_BASE_ = 0x804c2540;
_vt.13W3dTablesBase = 0x80418470;
SECTIONS {
  .text.__14W3dVec4TablesC 0x8035a2c0 : { *(.text.__14W3dVec4TablesC) }
  /DISCARD/ : { *(.text*) *(.rodata*) *(.data*) *(.bss*) *(.sdata*) *(.sbss*) *(.comment) }
}
