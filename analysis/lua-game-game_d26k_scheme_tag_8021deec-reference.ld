/* Generated reference-only placements. All bodies are source-built. */
OUTPUT_FORMAT("elf32-powerpc")
OUTPUT_ARCH(powerpc)
ENTRY(w3d_d26k_scheme_tag_8021deec)
_SDA_BASE_ = 0x804b2540;
_SDA2_BASE_ = 0x804c2540;
_._19Descriptor_80178474 = 0x80178474;
as_type_80179598 = 0x80179598;
identity_80341584 = 0x80341584;
propagate_801ea4c8 = 0x801ea4c8;
property_800fc1b0 = 0x800fc1b0;
text_803b46f8 = 0x803b46f8;
SECTIONS {
  .text.w3d_d26k_scheme_tag_8021deec 0x8021deec : { *(.text.w3d_d26k_scheme_tag_8021deec) }
  /DISCARD/ : { *(.text*) *(.rodata*) *(.data*) *(.bss*) *(.sdata*) *(.sbss*) *(.comment) }
}
