/* Generated reference-only placements. All bodies are source-built. */
OUTPUT_FORMAT("elf32-powerpc")
OUTPUT_ARCH(powerpc)
ENTRY(w3d_d24e_register_slider_properties_80220370)
_SDA_BASE_ = 0x804b2540;
_SDA2_BASE_ = 0x804c2540;
__15String_8020bb54PCc = 0x8020bb54;
d20e_empty_804b06a0 = 0x804b06a0;
d20e_release_header_8020bb2c = 0x8020bb2c;
d20e_string_finish_8020c5c4 = 0x8020c5c4;
d20e_string_header_80341884 = 0x80341884;
d20e_string_init_8020c5c0 = 0x8020c5c0;
d20e_string_release_80341588 = 0x80341588;
desc_803b6434 = 0x803b6434;
desc_803b6468 = 0x803b6468;
desc_803b649c = 0x803b649c;
desc_803b64d4 = 0x803b64d4;
desc_803b650c = 0x803b650c;
desc_803b653c = 0x803b653c;
fn_801e8d9c = 0x801e8d9c;
fn_801eb674 = 0x801eb674;
fn_801ec52c = 0x801ec52c;
fn_801ed24c = 0x801ed24c;
lit_803b6408 = 0x803b6408;
lit_803b6410 = 0x803b6410;
SECTIONS {
  .text.w3d_d24e_register_slider_properties_80220370 0x80220370 : { *(.text.w3d_d24e_register_slider_properties_80220370) }
  /DISCARD/ : { *(.text*) *(.rodata*) *(.data*) *(.bss*) *(.sdata*) *(.sbss*) *(.comment) }
}
