/* Generated reference-only placements. All bodies are source-built. */
OUTPUT_FORMAT("elf32-powerpc")
OUTPUT_ARCH(powerpc)
ENTRY(s8_destroy_800ea324)
_SDA_BASE_ = 0x804b2540;
_SDA2_BASE_ = 0x804c2540;
fn_80161050 = 0x80161050;
fn_8020c5c4 = 0x8020c5c4;
fn_802134fc = 0x802134fc;
fn_80341588 = 0x80341588;
w3d_vtable_804101f8 = 0x804101f8;
SECTIONS {
  .text.s8_destroy_800ea324 0x800ea324 : { *(.text.s8_destroy_800ea324) }
  /DISCARD/ : { *(.text*) *(.rodata*) *(.data*) *(.bss*) *(.sdata*) *(.sbss*) *(.comment) }
}
