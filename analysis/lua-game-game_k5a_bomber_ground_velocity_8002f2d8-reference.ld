/* Generated reference-only placements. All bodies are source-built. */
OUTPUT_FORMAT("elf32-powerpc")
OUTPUT_ARCH(powerpc)
ENTRY(k5a_bomber_ground_velocity_8002f2d8)
_SDA_BASE_ = 0x804b2540;
_SDA2_BASE_ = 0x804c2540;
w3d_auto_800fc270 = 0x800fc270;
w3d_string_80372d2c = 0x80372d2c;
SECTIONS {
  .text.k5a_bomber_ground_velocity_8002f2d8 0x8002f2d8 : { *(.text.k5a_bomber_ground_velocity_8002f2d8) }
  /DISCARD/ : { *(.text*) *(.rodata*) *(.data*) *(.bss*) *(.sdata*) *(.sbss*) *(.comment) }
}
