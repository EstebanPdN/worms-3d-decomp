/* Generated reference-only placements. All bodies are source-built. */
OUTPUT_FORMAT("elf32-powerpc")
OUTPUT_ARCH(powerpc)
ENTRY(w3d_cx12b_child_scale_update_802c629c)
_SDA_BASE_ = 0x804b2540;
_SDA2_BASE_ = 0x804c2540;
multiplier_803d8d1c = 0x803d8d1c;
z_803d8d20 = 0x803d8d20;
SECTIONS {
  .text.w3d_cx12b_child_scale_update_802c629c 0x802c629c : { *(.text.w3d_cx12b_child_scale_update_802c629c) }
  /DISCARD/ : { *(.text*) *(.rodata*) *(.data*) *(.bss*) *(.sdata*) *(.sbss*) *(.comment) }
}
