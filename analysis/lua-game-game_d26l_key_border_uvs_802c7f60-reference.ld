/* Generated reference-only placements. All bodies are source-built. */
OUTPUT_FORMAT("elf32-powerpc")
OUTPUT_ARCH(powerpc)
ENTRY(d26l_key_border_uvs_802c7f60)
_SDA_BASE_ = 0x804b2540;
_SDA2_BASE_ = 0x804c2540;
__10S_8020bb54PCc = 0x8020bb54;
fn_8015ae3c = 0x8015ae3c;
fn_80171ee0 = 0x80171ee0;
fn_80171f90 = 0x80171f90;
fn_80171fa0 = 0x80171fa0;
fn_80171ff8 = 0x80171ff8;
fn_8020c5c4 = 0x8020c5c4;
fn_80341588 = 0x80341588;
fn_80343808 = 0x80343808;
memset = 0x802eefe0;
name_803d8df0 = 0x803d8df0;
SECTIONS {
  .text.d26l_key_border_uvs_802c7f60 0x802c7f60 : { *(.text.d26l_key_border_uvs_802c7f60) }
  .rodata 0x803d8e28 : { *(.rodata) }
  /DISCARD/ : { *(.text*) *(.rodata*) *(.data*) *(.bss*) *(.sdata*) *(.sbss*) *(.comment) }
}
