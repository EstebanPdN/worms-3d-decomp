/* Generated reference-only placements. All bodies are source-built. */
OUTPUT_FORMAT("elf32-powerpc")
OUTPUT_ARCH(powerpc)
ENTRY(w3d_cx16b_track_owner_destroy_80194318)
_SDA_BASE_ = 0x804b2540;
_SDA2_BASE_ = 0x804c2540;
fn_801907d0 = 0x801907d0;
fn_801fe1f8 = 0x801fe1f8;
fn_80210990 = 0x80210990;
lbl_80413378 = 0x80413378;
lbl_804133c8 = 0x804133c8;
SECTIONS {
  .text.w3d_cx16b_track_owner_destroy_80194318 0x80194318 : { *(.text.w3d_cx16b_track_owner_destroy_80194318) }
  /DISCARD/ : { *(.text*) *(.rodata*) *(.data*) *(.bss*) *(.sdata*) *(.sbss*) *(.comment) }
}
