/* Generated reference-only placements. All bodies are source-built. */
OUTPUT_FORMAT("elf32-powerpc")
OUTPUT_ARCH(powerpc)
ENTRY(f2c_tag_init_801fa01c)
_SDA_BASE_ = 0x804b2540;
_SDA2_BASE_ = 0x804c2540;
fn_8035a2c0 = 0x8035a2c0;
lbl_80418268 = 0x80418268;
lbl_80418328 = 0x80418328;
lbl_80418470 = 0x80418470;
SECTIONS {
  .text.f2c_tag_init_801fa01c 0x801fa01c : { *(.text.f2c_tag_init_801fa01c) }
  /DISCARD/ : { *(.text*) *(.rodata*) *(.data*) *(.bss*) *(.sdata*) *(.sbss*) *(.comment) }
}
