/* Generated reference-only placements. All bodies are source-built. */
OUTPUT_FORMAT("elf32-powerpc")
OUTPUT_ARCH(powerpc)
ENTRY(w3d_s21_check_number_802dd10c)
_SDA_BASE_ = 0x804b2540;
_SDA2_BASE_ = 0x804c2540;
fn_802cda9c = 0x802cda9c;
fn_802cdc5c = 0x802cdc5c;
fn_802dcda8 = 0x802dcda8;
lbl_803da850 = 0x803da850;
SECTIONS {
  .text.w3d_s21_check_number_802dd10c 0x802dd10c : { *(.text.w3d_s21_check_number_802dd10c) }
  /DISCARD/ : { *(.text*) *(.rodata*) *(.data*) *(.bss*) *(.sdata*) *(.sbss*) *(.comment) }
}
