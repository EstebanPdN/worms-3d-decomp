/* Generated reference-only placements. All bodies are source-built. */
OUTPUT_FORMAT("elf32-powerpc")
OUTPUT_ARCH(powerpc)
ENTRY(w3d_f2a_polar_vector_80028f48)
_SDA_BASE_ = 0x804b2540;
_SDA2_BASE_ = 0x804c2540;
fn_80178df0 = 0x80178df0;
fn_802e86d4 = 0x802e86d4;
fn_802e88ac = 0x802e88ac;
lbl_8036cedc = 0x8036cedc;
lbl_8036cee0 = 0x8036cee0;
SECTIONS {
  .text.w3d_f2a_polar_vector_80028f48 0x80028f48 : { *(.text.w3d_f2a_polar_vector_80028f48) }
  /DISCARD/ : { *(.text*) *(.rodata*) *(.data*) *(.bss*) *(.sdata*) *(.sbss*) *(.comment) }
}
