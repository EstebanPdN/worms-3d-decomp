/* Generated reference-only placements. All bodies are source-built. */
OUTPUT_FORMAT("elf32-powerpc")
OUTPUT_ARCH(powerpc)
ENTRY(g4b_create_flagged_entry_801dcf08)
_SDA_BASE_ = 0x804b2540;
_SDA2_BASE_ = 0x804c2540;
fn_8020fcb4 = 0x8020fcb4;
fn_80210d54 = 0x80210d54;
type_803655bc = 0x803655bc;
SECTIONS {
  .text.g4b_create_flagged_entry_801dcf08 0x801dcf08 : { *(.text.g4b_create_flagged_entry_801dcf08) }
  /DISCARD/ : { *(.text*) *(.rodata*) *(.data*) *(.bss*) *(.sdata*) *(.sbss*) *(.comment) }
}
