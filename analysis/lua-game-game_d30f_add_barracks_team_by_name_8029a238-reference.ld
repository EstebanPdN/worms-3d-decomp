/* Generated reference-only placements. All bodies are source-built. */
OUTPUT_FORMAT("elf32-powerpc")
OUTPUT_ARCH(powerpc)
ENTRY(d30f_add_barracks_team_by_name_8029a238)
_SDA_BASE_ = 0x804b2540;
_SDA2_BASE_ = 0x804c2540;
_._19Descriptor_80178474 = 0x80178474;
fn_8029a5b4 = 0x8029a5b4;
lbl_803d097c = 0x803d097c;
lbl_803d09e0 = 0x803d09e0;
lbl_803d0bf0 = 0x803d0bf0;
strcmp = 0x802ef234;
w3d_auto_80179598 = 0x80179598;
w3d_constructor_lookup_name = 0x800fc1b0;
w3d_empty_80341584 = 0x80341584;
SECTIONS {
  .text.d30f_add_barracks_team_by_name_8029a238 0x8029a238 : { *(.text.d30f_add_barracks_team_by_name_8029a238) }
  /DISCARD/ : { *(.text*) *(.rodata*) *(.data*) *(.bss*) *(.sdata*) *(.sbss*) *(.comment) }
}
