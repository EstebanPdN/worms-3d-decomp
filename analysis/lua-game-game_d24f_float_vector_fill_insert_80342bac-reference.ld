/* Generated reference-only placements. All bodies are source-built. */
OUTPUT_FORMAT("elf32-powerpc")
OUTPUT_ARCH(powerpc)
ENTRY(d24f_float_vector_fill_insert_80342bac)
_SDA_BASE_ = 0x804b2540;
_SDA2_BASE_ = 0x804c2540;
memmove = 0x802eeef4;
w3d_auto_8001528c = 0x8001528c;
w3d_auto_800152ac = 0x800152ac;
SECTIONS {
  .text.d24f_float_vector_fill_insert_80342bac 0x80342bac : { *(.text.d24f_float_vector_fill_insert_80342bac) }
  /DISCARD/ : { *(.text*) *(.rodata*) *(.data*) *(.bss*) *(.sdata*) *(.sbss*) *(.comment) }
}
