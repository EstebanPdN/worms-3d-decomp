/* Generated reference-only placements. All bodies are source-built. */
OUTPUT_FORMAT("elf32-powerpc")
OUTPUT_ARCH(powerpc)
ENTRY(w3d_s21_static_register_memory_manager_80209c28)
_SDA_BASE_ = 0x804b2540;
_SDA2_BASE_ = 0x804c2540;
fn_80200af8 = 0x80200af8;
lbl_80209ac0 = 0x80209ac0;
lbl_803b2fbc = 0x803b2fbc;
lbl_804632d0 = 0x804632d0;
lbl_80463308 = 0x80463308;
SECTIONS {
  .text.w3d_s21_static_register_memory_manager_80209c28 0x80209c28 : { *(.text.w3d_s21_static_register_memory_manager_80209c28) }
  /DISCARD/ : { *(.text*) *(.rodata*) *(.data*) *(.bss*) *(.sdata*) *(.sbss*) *(.comment) }
}
