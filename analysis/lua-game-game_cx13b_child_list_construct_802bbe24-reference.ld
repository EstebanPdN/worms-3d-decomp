/* Generated reference-only placements. All bodies are source-built. */
OUTPUT_FORMAT("elf32-powerpc")
OUTPUT_ARCH(powerpc)
ENTRY(w3d_cx13b_child_list_construct_802bbe24)
_SDA_BASE_ = 0x804b2540;
_SDA2_BASE_ = 0x804c2540;
base_8015fef0 = 0x8015fef0;
initial_803d82c0 = 0x803d82c0;
secondary_803d82c4 = 0x803d82c4;
table_8041c860 = 0x8041c860;
SECTIONS {
  .text.w3d_cx13b_child_list_construct_802bbe24 0x802bbe24 : { *(.text.w3d_cx13b_child_list_construct_802bbe24) }
  /DISCARD/ : { *(.text*) *(.rodata*) *(.data*) *(.bss*) *(.sdata*) *(.sbss*) *(.comment) }
}
