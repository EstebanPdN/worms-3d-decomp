/* Generated reference-only placements. All bodies are source-built. */
OUTPUT_FORMAT("elf32-powerpc")
OUTPUT_ARCH(powerpc)
ENTRY(w3d_d29e_apply_mode_row_801fde88)
_SDA_BASE_ = 0x804b2540;
_SDA2_BASE_ = 0x804c2540;
fn_802ff854 = 0x802ff854;
lbl_803b2700 = 0x803b2700;
lbl_803b270c = 0x803b270c;
lbl_803b2718 = 0x803b2718;
lbl_803b2724 = 0x803b2724;
lbl_803b2730 = 0x803b2730;
w3d_auto_801fdf60 = 0x801fdf60;
SECTIONS {
  .text.w3d_d29e_apply_mode_row_801fde88 0x801fde88 : { *(.text.w3d_d29e_apply_mode_row_801fde88) }
  /DISCARD/ : { *(.text*) *(.rodata*) *(.data*) *(.bss*) *(.sdata*) *(.sbss*) *(.comment) }
}
