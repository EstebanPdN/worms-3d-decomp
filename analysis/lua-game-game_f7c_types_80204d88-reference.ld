/* Generated reference-only placements. All bodies are source-built. */
OUTPUT_FORMAT("elf32-powerpc")
OUTPUT_ARCH(powerpc)
ENTRY(f7c_types_80204d88)
_SDA_BASE_ = 0x804b2540;
_SDA2_BASE_ = 0x804c2540;
fn_801ffea8 = 0x801ffea8;
fn_801fff18 = 0x801fff18;
fn_801fff3c = 0x801fff3c;
fn_802eefe0 = 0x802eefe0;
fn_802efbfc = 0x802efbfc;
fn_80351ef8 = 0x80351ef8;
SECTIONS {
  .text.f7c_types_80204d88 0x80204d88 : { *(.text.f7c_types_80204d88) }
  /DISCARD/ : { *(.text*) *(.rodata*) *(.data*) *(.bss*) *(.sdata*) *(.sbss*) *(.comment) }
}
