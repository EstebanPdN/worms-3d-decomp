/* Generated reference-only placements. All bodies are source-built. */
OUTPUT_FORMAT("elf32-powerpc")
OUTPUT_ARCH(powerpc)
ENTRY(d25i_pause_menu_fill_80113c18)
_SDA_BASE_ = 0x804b2540;
_SDA2_BASE_ = 0x804c2540;
_._19Descriptor_80178474 = 0x80178474;
array_lock_801ef048 = 0x801ef048;
as_table_80341584 = 0x80341584;
class_80419e68 = 0x80419e68;
create_8020b680 = 0x8020b680;
list_append_801ef174 = 0x801ef174;
list_begin_801ef380 = 0x801ef380;
n_8039a658 = 0x8039a658;
n_8039a680 = 0x8039a680;
n_8039a704 = 0x8039a704;
n_8039a710 = 0x8039a710;
read_key_800fc2b0 = 0x800fc2b0;
string_assign_8020bd38 = 0x8020bd38;
table_get_80179598 = 0x80179598;
SECTIONS {
  .text.d25i_pause_menu_fill_80113c18 0x80113c18 : { *(.text.d25i_pause_menu_fill_80113c18) }
  /DISCARD/ : { *(.text*) *(.rodata*) *(.data*) *(.bss*) *(.sdata*) *(.sbss*) *(.comment) }
}
