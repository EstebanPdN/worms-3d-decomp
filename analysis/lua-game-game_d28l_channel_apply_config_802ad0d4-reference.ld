/* Generated reference-only placements. All bodies are source-built. */
OUTPUT_FORMAT("elf32-powerpc")
OUTPUT_ARCH(powerpc)
ENTRY(d28l_channel_apply_config_802ad0d4)
_SDA_BASE_ = 0x804b2540;
_SDA2_BASE_ = 0x804c2540;
fn_802fb7ac = 0x802fb7ac;
fn_80318b48 = 0x80318b48;
s_803d70d4 = 0x803d70d4;
SECTIONS {
  .text.d28l_channel_apply_config_802ad0d4 0x802ad0d4 : { *(.text.d28l_channel_apply_config_802ad0d4) }
  /DISCARD/ : { *(.text*) *(.rodata*) *(.data*) *(.bss*) *(.sdata*) *(.sbss*) *(.comment) }
}
