/* Generated reference-only placements. All bodies are source-built. */
OUTPUT_FORMAT("elf32-powerpc")
OUTPUT_ARCH(powerpc)
ENTRY(w3d_k8b_classify_801d57ac)
_SDA_BASE_ = 0x804b2540;
_SDA2_BASE_ = 0x804c2540;
lbl_803af22c = 0x803af22c;
lbl_803af230 = 0x803af230;
SECTIONS {
  .text.w3d_k8b_classify_801d57ac 0x801d57ac : { *(.text.w3d_k8b_classify_801d57ac) }
  /DISCARD/ : { *(.text*) *(.rodata*) *(.data*) *(.bss*) *(.sdata*) *(.sbss*) *(.comment) }
}
