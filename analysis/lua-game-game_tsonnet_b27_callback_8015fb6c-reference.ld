/* Generated reference-only placements. All bodies are source-built. */
OUTPUT_FORMAT("elf32-powerpc")
OUTPUT_ARCH(powerpc)
ENTRY(tsonnet_b27_callback_8015fb6c)
_SDA_BASE_ = 0x804b2540;
_SDA2_BASE_ = 0x804c2540;
fn_8015f7e0 = 0x8015f7e0;
lbl_803a45c4 = 0x803a45c4;
SECTIONS {
  .text.tsonnet_b27_callback_8015fb6c 0x8015fb6c : { *(.text.tsonnet_b27_callback_8015fb6c) }
  /DISCARD/ : { *(.text*) *(.rodata*) *(.data*) *(.bss*) *(.sdata*) *(.sbss*) *(.comment) }
}
