/* Generated reference-only placements. All bodies are source-built. */
OUTPUT_FORMAT("elf32-powerpc")
OUTPUT_ARCH(powerpc)
ENTRY(w3d_s20_call_lua_number_8019dfec)
_SDA_BASE_ = 0x804b2540;
_SDA2_BASE_ = 0x804c2540;
fn_802cd808 = 0x802cd808;
fn_802cd9e8 = 0x802cd9e8;
fn_802cdf40 = 0x802cdf40;
fn_802cdfd4 = 0x802cdfd4;
fn_802ce264 = 0x802ce264;
fn_802ce6e4 = 0x802ce6e4;
SECTIONS {
  .text.w3d_s20_call_lua_number_8019dfec 0x8019dfec : { *(.text.w3d_s20_call_lua_number_8019dfec) }
  /DISCARD/ : { *(.text*) *(.rodata*) *(.data*) *(.bss*) *(.sdata*) *(.sbss*) *(.comment) }
}
