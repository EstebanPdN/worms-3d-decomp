/* Generated reference-only placements. All bodies are source-built. */
OUTPUT_FORMAT("elf32-powerpc")
OUTPUT_ARCH(powerpc)
ENTRY(w3d_registry_unlink_801f96f4)
_SDA_BASE_ = 0x804b2540;
_SDA2_BASE_ = 0x804c2540;
fn_8020fd2c = 0x8020fd2c;
w3d_registry_list_80365838 = 0x80365838;
w3d_registry_list_80365868 = 0x80365868;
w3d_registry_list_80365898 = 0x80365898;
w3d_registry_list_803658c8 = 0x803658c8;
SECTIONS {
  .text.w3d_registry_unlink_801f96f4 0x801f96f4 : { *(.text.w3d_registry_unlink_801f96f4) }
  .text.w3d_registry_unlink_801f97a4 0x801f97a4 : { *(.text.w3d_registry_unlink_801f97a4) }
  .text.w3d_registry_unlink_801fc04c 0x801fc04c : { *(.text.w3d_registry_unlink_801fc04c) }
  .text.w3d_registry_unlink_801fc0fc 0x801fc0fc : { *(.text.w3d_registry_unlink_801fc0fc) }
  /DISCARD/ : { *(.text*) *(.rodata*) *(.data*) *(.bss*) *(.sdata*) *(.sbss*) *(.comment) }
}
