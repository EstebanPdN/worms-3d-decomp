/* Generated reference-only placements. All bodies are source-built. */
OUTPUT_FORMAT("elf32-powerpc")
OUTPUT_ARCH(powerpc)
ENTRY(w3d_d31e_dump_object_801b25e8)
_SDA_BASE_ = 0x804b2540;
_SDA2_BASE_ = 0x804c2540;
__ls__6WriterPCc = 0x8020dbf8;
__ls__6WriterRC6String = 0x8020d82c;
__ls__6WriterUi = 0x8020d980;
endl__FR6Writer = 0x8020d5a8;
s_at = 0x803aa9d8;
s_close = 0x803aa9f8;
s_count = 0x803aa9e8;
s_end = 0x803aaa00;
s_eq = 0x803aa9fc;
s_fmt = 0x803aa9dc;
s_mid = 0x803aa9f4;
s_open = 0x803aa9e4;
w3d_auto_801ffea8 = 0x801ffea8;
w3d_auto_801fffc8 = 0x801fffc8;
w3d_d29e_print_array_801ef970 = 0x801ef970;
w3d_format_into_80355a44 = 0x80355a44;
w3d_k4b_writer_append_indent_801b2550 = 0x801b2550;
w3d_s20_shrink_range_801b25ac = 0x801b25ac;
SECTIONS {
  .text.w3d_d31e_dump_object_801b25e8 0x801b25e8 : { *(.text.w3d_d31e_dump_object_801b25e8) }
  /DISCARD/ : { *(.text*) *(.rodata*) *(.data*) *(.bss*) *(.sdata*) *(.sbss*) *(.comment) }
}
