/* Generated reference-only placements. All bodies are source-built. */
OUTPUT_FORMAT("elf32-powerpc")
OUTPUT_ARCH(powerpc)
ENTRY(w3d_cx8c_indexed_assign_80349ec4)
_SDA_BASE_ = 0x804b2540;
_SDA2_BASE_ = 0x804c2540;
cx8c_reserve_80210b90 = 0x80210b90;
SECTIONS {
  .text.w3d_cx8c_indexed_assign_80349ec4 0x80349ec4 : { *(.text.w3d_cx8c_indexed_assign_80349ec4) }
  /DISCARD/ : { *(.text*) *(.rodata*) *(.data*) *(.bss*) *(.sdata*) *(.sbss*) *(.comment) }
}
