/* Generated reference-only placements. All bodies are source-built. */
OUTPUT_FORMAT("elf32-powerpc")
OUTPUT_ARCH(powerpc)
ENTRY(d11c_worm_select_8003bf70)
_SDA_BASE_ = 0x804b2540;
_SDA2_BASE_ = 0x804c2540;
__20d11c_String_8020bb54PCc = 0x8020bb54;
d11c_arrow_scale_804273c8 = 0x804273c8;
d11c_cast_80343808 = 0x80343808;
d11c_f32_803743f4 = 0x803743f4;
d11c_f32_803743f8 = 0x803743f8;
d11c_f32_803743fc = 0x803743fc;
d11c_f32_80374400 = 0x80374400;
d11c_f32_80374404 = 0x80374404;
d11c_handle_set_name_8015adf4 = 0x8015adf4;
d11c_locator1_803743e8 = 0x803743e8;
d11c_pooled_a_80171ff8 = 0x80171ff8;
d11c_pooled_b_80171fa0 = 0x80171fa0;
d11c_select_arrow_803743d4 = 0x803743d4;
d11c_service_lookup_8015ae3c = 0x8015ae3c;
d11c_string_base_finish_8020c5c4 = 0x8020c5c4;
d11c_string_release_80341588 = 0x80341588;
d11c_worm_select_803743c4 = 0x803743c4;
SECTIONS {
  .text.d11c_worm_select_8003bf70 0x8003bf70 : { *(.text.d11c_worm_select_8003bf70) }
  /DISCARD/ : { *(.text*) *(.rodata*) *(.data*) *(.bss*) *(.sdata*) *(.sbss*) *(.comment) }
}
