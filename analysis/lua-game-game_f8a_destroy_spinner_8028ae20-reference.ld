/* Generated reference-only placements. All bodies are source-built. */
OUTPUT_FORMAT("elf32-powerpc")
OUTPUT_ARCH(powerpc)
ENTRY(_._19F8aSpinner_8028ae20)
_SDA_BASE_ = 0x804b2540;
_SDA2_BASE_ = 0x804c2540;
_._16F8aBase_8015ff2c = 0x8015ff2c;
_._18F8aMember_802afc40 = 0x802afc40;
vt_8041c090 = 0x8041c090;
vt_8041c0e0 = 0x8041c0e0;
SECTIONS {
  .text._._19F8aSpinner_8028ae20 0x8028ae20 : { *(.text._._19F8aSpinner_8028ae20) }
  /DISCARD/ : { *(.text*) *(.rodata*) *(.data*) *(.bss*) *(.sdata*) *(.sbss*) *(.comment) }
}
