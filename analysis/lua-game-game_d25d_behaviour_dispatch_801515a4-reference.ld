/* Generated reference-only placements. All bodies are source-built. */
OUTPUT_FORMAT("elf32-powerpc")
OUTPUT_ARCH(powerpc)
ENTRY(d25d_behaviour_dispatch_801515a4)
_SDA_BASE_ = 0x804b2540;
_SDA2_BASE_ = 0x804c2540;
d15d_actor_80152730 = 0x80152730;
d24d_aim_update_80151a14 = 0x80151a14;
f5b_choose_801518f8 = 0x801518f8;
f6b_aim_80151784 = 0x80151784;
f6b_height_80151d64 = 0x80151d64;
fn_80151ea4 = 0x80151ea4;
fn_80152474 = 0x80152474;
sqrtf_802e82c0 = 0x802e82c0;
w3d_actor_c_80151c78 = 0x80151c78;
w3d_actor_c_80152694 = 0x80152694;
w3d_actor_c_8015287c = 0x8015287c;
w3d_empty_80152690 = 0x80152690;
SECTIONS {
  .text.d25d_behaviour_dispatch_801515a4 0x801515a4 : { *(.text.d25d_behaviour_dispatch_801515a4) }
  .rodata 0x803a18b4 : { *(.rodata) }
  /DISCARD/ : { *(.text*) *(.rodata*) *(.data*) *(.bss*) *(.sdata*) *(.sbss*) *(.comment) }
}
