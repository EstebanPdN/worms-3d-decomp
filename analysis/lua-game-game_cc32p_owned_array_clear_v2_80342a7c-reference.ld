/* Generated reference-only placements. All bodies are source-built. */
OUTPUT_FORMAT("elf32-powerpc")
OUTPUT_ARCH(powerpc)
ENTRY(w3d_cc32p_owned_array_clear_v2_80342a7c)
_SDA_BASE_ = 0x804b2540;
_SDA2_BASE_ = 0x804c2540;
__builtin_delete = 0x80015264;
fn_800152ac = 0x800152ac;
fn_8001d1d8 = 0x8001d1d8;
SECTIONS {
  .text.w3d_cc32p_owned_array_clear_v2_80342a7c 0x80342a7c : { *(.text.w3d_cc32p_owned_array_clear_v2_80342a7c) }
  /DISCARD/ : { *(.text*) *(.rodata*) *(.data*) *(.bss*) *(.sdata*) *(.sbss*) *(.comment) }
}
