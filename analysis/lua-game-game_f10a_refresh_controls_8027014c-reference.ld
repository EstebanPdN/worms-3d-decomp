/* Generated reference-only placements. All bodies are source-built. */
OUTPUT_FORMAT("elf32-powerpc")
OUTPUT_ARCH(powerpc)
ENTRY(w3d_f10a_refresh_controls_8027014c)
_SDA_BASE_ = 0x804b2540;
_SDA2_BASE_ = 0x804c2540;
fn_8025eed0 = 0x8025eed0;
fn_8025f064 = 0x8025f064;
fn_80294408 = 0x80294408;
fn_8029459c = 0x8029459c;
fn_8029677c = 0x8029677c;
fn_802bcd18 = 0x802bcd18;
fn_802eefe0 = 0x802eefe0;
SECTIONS {
  .text.w3d_f10a_refresh_controls_8027014c 0x8027014c : { *(.text.w3d_f10a_refresh_controls_8027014c) }
  /DISCARD/ : { *(.text*) *(.rodata*) *(.data*) *(.bss*) *(.sdata*) *(.sbss*) *(.comment) }
}
