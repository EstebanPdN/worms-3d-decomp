/* Generated reference-only placements. All bodies are source-built. */
OUTPUT_FORMAT("elf32-powerpc")
OUTPUT_ARCH(powerpc)
ENTRY(d26f_list_box_edit_page_80274a4c)
_SDA_BASE_ = 0x804b2540;
_SDA2_BASE_ = 0x804c2540;
__17D26fText_803426b8 = 0x803426b8;
lbl_803cc0d8 = 0x803cc0d8;
lbl_803cc864 = 0x803cc864;
lbl_803cc86c = 0x803cc86c;
lbl_803cc8b4 = 0x803cc8b4;
lbl_803cd40c = 0x803cd40c;
lbl_803cd420 = 0x803cd420;
lbl_803cd434 = 0x803cd434;
lbl_803cd45c = 0x803cd45c;
lbl_803cd47c = 0x803cd47c;
lbl_803cd49c = 0x803cd49c;
lbl_803cd4bc = 0x803cd4bc;
lbl_803cd4dc = 0x803cd4dc;
lbl_803cd4fc = 0x803cd4fc;
lbl_803cd51c = 0x803cd51c;
lbl_803cd544 = 0x803cd544;
lbl_803cd564 = 0x803cd564;
lbl_803cd56c = 0x803cd56c;
lbl_803cd574 = 0x803cd574;
lbl_803cd588 = 0x803cd588;
lbl_803cd590 = 0x803cd590;
lbl_803cd5b0 = 0x803cd5b0;
lbl_803cd5d0 = 0x803cd5d0;
w3d_auto_802cbf2c = 0x802cbf2c;
w3d_auto_802cbfa4 = 0x802cbfa4;
w3d_auto_802cd128 = 0x802cd128;
w3d_cc32b_append_lines_v2_802cc0ac = 0x802cc0ac;
w3d_cx7b_script_flag_set_8027a934 = 0x8027a934;
w3d_dtor_node_8020d36c = 0x8020d36c;
w3d_registry_retain_8020d2b8 = 0x8020d2b8;
w3d_s21_append_position_802cd26c = 0x802cd26c;
w3d_s21_repeat_request_802cd220 = 0x802cd220;
w3d_s21_sink_write_indexed_802cbdf8 = 0x802cbdf8;
w3d_s21_vector_get_801e9db8 = 0x801e9db8;
w3d_string_base_finish = 0x8020c5c4;
w3d_string_release = 0x80341588;
w3d_tagged_construct_8020d318 = 0x8020d318;
SECTIONS {
  .text.d26f_list_box_edit_page_80274a4c 0x80274a4c : { *(.text.d26f_list_box_edit_page_80274a4c) }
  /DISCARD/ : { *(.text*) *(.rodata*) *(.data*) *(.bss*) *(.sdata*) *(.sbss*) *(.comment) }
}
