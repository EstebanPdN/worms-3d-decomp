/* Generated reference-only placements. All bodies are source-built. */
OUTPUT_FORMAT("elf32-powerpc")
OUTPUT_ARCH(powerpc)
ENTRY(w3d_facing_term_801e5314)
_SDA_BASE_ = 0x804b2540;
_SDA2_BASE_ = 0x804c2540;
fn_802e7e5c = 0x802e7e5c;
fn_802e88ac = 0x802e88ac;
lbl_803b0708 = 0x803b0708;
lbl_803b070c = 0x803b070c;
lbl_803b0710 = 0x803b0710;
lbl_803b0714 = 0x803b0714;
lbl_803b0718 = 0x803b0718;
lbl_803b07e4 = 0x803b07e4;
lbl_803b07e8 = 0x803b07e8;
lbl_803b07ec = 0x803b07ec;
lbl_803b07f0 = 0x803b07f0;
lbl_803b07f4 = 0x803b07f4;
SECTIONS {
  .text.w3d_facing_term_801e5314 0x801e5314 : { *(.text.w3d_facing_term_801e5314) }
  .text.w3d_facing_term_801e6788 0x801e6788 : { *(.text.w3d_facing_term_801e6788) }
  /DISCARD/ : { *(.text*) *(.rodata*) *(.data*) *(.bss*) *(.sdata*) *(.sbss*) *(.comment) }
}
