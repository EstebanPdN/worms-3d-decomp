/* Generated reference-only placements. All bodies are source-built. */
OUTPUT_FORMAT("elf32-powerpc")
OUTPUT_ARCH(powerpc)
ENTRY(w3d_cx9c_actor_array_803449cc)
_SDA_BASE_ = 0x804b2540;
_SDA2_BASE_ = 0x804c2540;
__19Cx9cRecord_800e6738 = 0x800e6738;
cx9c_array_allocate_800dc5bc = 0x800dc5bc;
SECTIONS {
  .text.w3d_cx9c_actor_array_803449cc 0x803449cc : { *(.text.w3d_cx9c_actor_array_803449cc) }
  /DISCARD/ : { *(.text*) *(.rodata*) *(.data*) *(.bss*) *(.sdata*) *(.sbss*) *(.comment) }
}
