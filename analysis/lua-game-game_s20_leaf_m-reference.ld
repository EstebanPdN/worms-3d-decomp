/* Generated reference-only placements. All bodies are source-built. */
OUTPUT_FORMAT("elf32-powerpc")
OUTPUT_ARCH(powerpc)
ENTRY(w3d_s20_set_inner_matrix_8017b0b8)
_SDA_BASE_ = 0x804b2540;
_SDA2_BASE_ = 0x804c2540;
SECTIONS {
  .text.w3d_s20_set_inner_matrix_8017b0b8 0x8017b0b8 : { *(.text.w3d_s20_set_inner_matrix_8017b0b8) }
  .text.w3d_s20_get_inner_matrix_8017b5f4 0x8017b5f4 : { *(.text.w3d_s20_get_inner_matrix_8017b5f4) }
  /DISCARD/ : { *(.text*) *(.rodata*) *(.data*) *(.bss*) *(.sdata*) *(.sbss*) *(.comment) }
}
