/* Generated reference-only placements. All bodies are source-built. */
OUTPUT_FORMAT("elf32-powerpc")
OUTPUT_ARCH(powerpc)
ENTRY(w3d_cx16b_descriptor_defaults_8018a218)
_SDA_BASE_ = 0x804b2540;
_SDA2_BASE_ = 0x804c2540;
fn_8020bd38 = 0x8020bd38;
SECTIONS {
  .text.w3d_cx16b_descriptor_defaults_8018a218 0x8018a218 : { *(.text.w3d_cx16b_descriptor_defaults_8018a218) }
  /DISCARD/ : { *(.text*) *(.rodata*) *(.data*) *(.bss*) *(.sdata*) *(.sbss*) *(.comment) }
}
