/* Generated reference-only placements. All bodies are source-built. */
OUTPUT_FORMAT("elf32-powerpc")
OUTPUT_ARCH(powerpc)
ENTRY(w3d_d31e_transform_children_801ad168)
_SDA_BASE_ = 0x804b2540;
_SDA2_BASE_ = 0x804c2540;
_S_oom_malloc__Q24_STLt14__malloc_alloc1i0Ui = 0x803413d8;
fn_801ef380 = 0x801ef380;
free = 0x802134fc;
malloc = 0x80212fd4;
memmove = 0x802eeef4;
w3d_k5b_iface_array_field_set_801ef2ec = 0x801ef2ec;
w3d_k7b_task_owner_append_801acdd4 = 0x801acdd4;
w3d_s20_query_then_run_801ad108 = 0x801ad108;
SECTIONS {
  .text.w3d_d31e_transform_children_801ad168 0x801ad168 : { *(.text.w3d_d31e_transform_children_801ad168) }
  /DISCARD/ : { *(.text*) *(.rodata*) *(.data*) *(.bss*) *(.sdata*) *(.sbss*) *(.comment) }
}
