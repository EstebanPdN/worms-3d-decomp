/* Generated reference-only placements. All bodies are source-built. */
OUTPUT_FORMAT("elf32-powerpc")
OUTPUT_ARCH(powerpc)
ENTRY(cc34a_consume_property_8008aacc)
_SDA_BASE_ = 0x804b2540;
_SDA2_BASE_ = 0x804c2540;
cc34a_context_803426b4 = 0x803426b4;
cc34a_current_80178c48 = 0x80178c48;
cc34a_destroy_80178474 = 0x80178474;
cc34a_groupdata_800fcd84 = 0x800fcd84;
cc34a_groupwrite_800fcdb8 = 0x800fcdb8;
cc34a_player_800fc6dc = 0x800fc6dc;
cc34a_playerdata_800fca30 = 0x800fca30;
cc34a_playerwrite_800fca64 = 0x800fca64;
cc34a_read_8025cbe0 = 0x8025cbe0;
cc34a_team_800fc7f8 = 0x800fc7f8;
cc34a_teamdata_800fcc68 = 0x800fcc68;
cc34a_teamwrite_800fcc9c = 0x800fcc9c;
cc34a_write_8025d020 = 0x8025d020;
SECTIONS {
  .text.cc34a_consume_property_8008aacc 0x8008aacc : { *(.text.cc34a_consume_property_8008aacc) }
  /DISCARD/ : { *(.text*) *(.rodata*) *(.data*) *(.bss*) *(.sdata*) *(.sbss*) *(.comment) }
}
