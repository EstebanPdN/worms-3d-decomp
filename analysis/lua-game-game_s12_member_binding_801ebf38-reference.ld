/* Generated reference-only placements. All bodies are source-built. */
OUTPUT_FORMAT("elf32-powerpc")
OUTPUT_ARCH(powerpc)
ENTRY(w3d_s12_create_member_binding_801ebf38)
_SDA_BASE_ = 0x804b2540;
_SDA2_BASE_ = 0x804c2540;
fn_801e8bc4__FPvP18S12PropertyBinding = 0x801e8bc4;
fn_801eb058__FP18S12PropertyBinding = 0x801eb058;
fn_801eb0a8__FP18S12PropertyBindingP17S12PropertySource = 0x801eb0a8;
fn_801fe1d8__Fi = 0x801fe1d8;
lbl_804173c0 = 0x804173c0;
lbl_804174b0 = 0x804174b0;
lbl_804174e0 = 0x804174e0;
SECTIONS {
  .text.w3d_s12_create_member_binding_801ebf38 0x801ebf38 : { *(.text.w3d_s12_create_member_binding_801ebf38) }
  .text.w3d_s12_create_member_binding_801ec0f8 0x801ec0f8 : { *(.text.w3d_s12_create_member_binding_801ec0f8) }
  .text.w3d_s12_create_member_binding_801ece2c 0x801ece2c : { *(.text.w3d_s12_create_member_binding_801ece2c) }
  /DISCARD/ : { *(.text*) *(.rodata*) *(.data*) *(.bss*) *(.sdata*) *(.sbss*) *(.comment) }
}
