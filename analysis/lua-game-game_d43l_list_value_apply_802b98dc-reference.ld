/* Generated reference-only placements. All bodies are source-built. */
OUTPUT_FORMAT("elf32-powerpc")
OUTPUT_ARCH(powerpc)
ENTRY(d43l_list_value_apply_802b98dc)
_SDA_BASE_ = 0x804b2540;
_SDA2_BASE_ = 0x804c2540;
__3Str = 0x803426b8;
atoi = 0x802ed89c;
fn_800fc1b0 = 0x800fc1b0;
fn_80178c54 = 0x80178c54;
fn_80178d28 = 0x80178d28;
fn_801790bc = 0x801790bc;
fn_801797b4 = 0x801797b4;
fn_8020bb2c = 0x8020bb2c;
fn_8020c510 = 0x8020c510;
fn_8020c5c0 = 0x8020c5c0;
fn_8020c5c4 = 0x8020c5c4;
fn_802b8be0 = 0x802b8be0;
fn_80341584 = 0x80341584;
fn_80341588 = 0x80341588;
fn_80341884 = 0x80341884;
fn_803426b4 = 0x803426b4;
fn_80342a78 = 0x80342a78;
fn_80343744 = 0x80343744;
s_803d7fd0 = 0x803d7fd0;
SECTIONS {
  .text.d43l_list_value_apply_802b98dc 0x802b98dc : { *(.text.d43l_list_value_apply_802b98dc) }
  /DISCARD/ : { *(.text*) *(.rodata*) *(.data*) *(.bss*) *(.sdata*) *(.sbss*) *(.comment) }
}
