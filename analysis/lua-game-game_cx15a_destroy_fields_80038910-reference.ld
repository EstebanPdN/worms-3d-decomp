/* Generated reference-only placements. All bodies are source-built. */
OUTPUT_FORMAT("elf32-powerpc")
OUTPUT_ARCH(powerpc)
ENTRY(w3d_cx15a_destroy_fields_80038910)
_SDA_BASE_ = 0x804b2540;
_SDA2_BASE_ = 0x804c2540;
base_801628ec = 0x801628ec;
finish_8020c5c4 = 0x8020c5c4;
release_string_80341588 = 0x80341588;
vtable_8040e690 = 0x8040e690;
SECTIONS {
  .text.w3d_cx15a_destroy_fields_80038910 0x80038910 : { *(.text.w3d_cx15a_destroy_fields_80038910) }
  /DISCARD/ : { *(.text*) *(.rodata*) *(.data*) *(.bss*) *(.sdata*) *(.sbss*) *(.comment) }
}
