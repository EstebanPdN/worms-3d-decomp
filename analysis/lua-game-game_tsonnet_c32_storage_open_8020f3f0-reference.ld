/* Generated reference-only placements. All bodies are source-built. */
OUTPUT_FORMAT("elf32-powerpc")
OUTPUT_ARCH(powerpc)
ENTRY(tsonnet_c32_storage_open_8020f3f0)
_SDA_BASE_ = 0x804b2540;
_SDA2_BASE_ = 0x804c2540;
fn_8020f850 = 0x8020f850;
fn_8020f8d4 = 0x8020f8d4;
SECTIONS {
  .text.tsonnet_c32_storage_open_8020f3f0 0x8020f3f0 : { *(.text.tsonnet_c32_storage_open_8020f3f0) }
  /DISCARD/ : { *(.text*) *(.rodata*) *(.data*) *(.bss*) *(.sdata*) *(.sbss*) *(.comment) }
}
