/* Generated reference-only placements. All bodies are source-built. */
OUTPUT_FORMAT("elf32-powerpc")
OUTPUT_ARCH(powerpc)
ENTRY(sol29c_record_fill_insert_8034d1c8)
_SDA_BASE_ = 0x804b2540;
_SDA2_BASE_ = 0x804c2540;
native_array_allocate_801907a8 = 0x801907a8;
native_array_free_801907d0 = 0x801907d0;
SECTIONS {
  .text.sol29c_record_fill_insert_8034d1c8 0x8034d1c8 : { *(.text.sol29c_record_fill_insert_8034d1c8) }
  .text.sol29c_record_fill_insert_8034f47c 0x8034f47c : { *(.text.sol29c_record_fill_insert_8034f47c) }
  /DISCARD/ : { *(.text*) *(.rodata*) *(.data*) *(.bss*) *(.sdata*) *(.sbss*) *(.comment) }
}
