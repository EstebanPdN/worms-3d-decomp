/* Generated reference-only placements. All bodies are source-built. */
OUTPUT_FORMAT("elf32-powerpc")
OUTPUT_ARCH(powerpc)
ENTRY(w3d_named_tagged_construct_80219e58)
_SDA_BASE_ = 0x804b2540;
_SDA2_BASE_ = 0x804c2540;
w3d_string_default = 0x803426b8;
w3d_vtable_80419888 = 0x80419888;
w3d_vtable_804198c8 = 0x804198c8;
w3d_vtable_80419908 = 0x80419908;
w3d_vtable_80419a08 = 0x80419a08;
w3d_vtable_80419a48 = 0x80419a48;
w3d_vtable_80419a88 = 0x80419a88;
w3d_vtable_80419ac8 = 0x80419ac8;
w3d_vtable_80419b08 = 0x80419b08;
w3d_vtable_80419b48 = 0x80419b48;
w3d_vtable_80419b88 = 0x80419b88;
w3d_vtable_80419bc8 = 0x80419bc8;
w3d_vtable_80419c08 = 0x80419c08;
SECTIONS {
  .text.w3d_named_tagged_construct_80219e58 0x80219e58 : { *(.text.w3d_named_tagged_construct_80219e58) }
  .text.w3d_named_tagged_construct_80219f44 0x80219f44 : { *(.text.w3d_named_tagged_construct_80219f44) }
  .text.w3d_named_tagged_construct_8021a030 0x8021a030 : { *(.text.w3d_named_tagged_construct_8021a030) }
  .text.w3d_named_tagged_construct_8021a184 0x8021a184 : { *(.text.w3d_named_tagged_construct_8021a184) }
  /DISCARD/ : { *(.text*) *(.rodata*) *(.data*) *(.bss*) *(.sdata*) *(.sbss*) *(.comment) }
}
