/* Generated reference-only placements. All bodies are source-built. */
OUTPUT_FORMAT("elf32-powerpc")
OUTPUT_ARCH(powerpc)
ENTRY(w3d_tagged_construct_8015eccc)
_SDA_BASE_ = 0x804b2540;
_SDA2_BASE_ = 0x804c2540;
w3d_construct_802109dc = 0x802109dc;
w3d_float_803a4568 = 0x803a4568;
w3d_s10_service_forward_8020b680 = 0x8020b680;
w3d_type_80412790 = 0x80412790;
w3d_vtable_80411378 = 0x80411378;
w3d_vtable_80411420 = 0x80411420;
w3d_vtable_804114b8 = 0x804114b8;
SECTIONS {
  .text.w3d_tagged_construct_8015eccc 0x8015eccc : { *(.text.w3d_tagged_construct_8015eccc) }
  /DISCARD/ : { *(.text*) *(.rodata*) *(.data*) *(.bss*) *(.sdata*) *(.sbss*) *(.comment) }
}
