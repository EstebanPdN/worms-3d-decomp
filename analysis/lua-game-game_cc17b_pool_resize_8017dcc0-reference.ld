/* Generated reference-only placements. All bodies are source-built. */
OUTPUT_FORMAT("elf32-powerpc")
OUTPUT_ARCH(powerpc)
ENTRY(w3d_cc17b_pool_resize_8017dcc0)
_SDA_BASE_ = 0x804b2540;
_SDA2_BASE_ = 0x804c2540;
fn_801709b0 = 0x801709b0;
fn_801743b4 = 0x801743b4;
fn_8017f3b8 = 0x8017f3b8;
fn_80182850 = 0x80182850;
fn_80183d48 = 0x80183d48;
fn_801875e0 = 0x801875e0;
fn_8018a678 = 0x8018a678;
SECTIONS {
  .text.w3d_cc17b_pool_resize_8017dcc0 0x8017dcc0 : { *(.text.w3d_cc17b_pool_resize_8017dcc0) }
  /DISCARD/ : { *(.text*) *(.rodata*) *(.data*) *(.bss*) *(.sdata*) *(.sbss*) *(.comment) }
}
