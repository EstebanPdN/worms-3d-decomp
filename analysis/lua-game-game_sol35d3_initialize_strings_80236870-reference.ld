/* Generated reference-only placements. All bodies are source-built. */
OUTPUT_FORMAT("elf32-powerpc")
OUTPUT_ARCH(powerpc)
ENTRY(w3d_sol35d3_initialize_strings_80236870)
_SDA_BASE_ = 0x804b2540;
_SDA2_BASE_ = 0x804c2540;
fn_801e8d9c = 0x801e8d9c;
fn_801eb674 = 0x801eb674;
fn_801ebf38 = 0x801ebf38;
fn_801ec0f8 = 0x801ec0f8;
fn_801ed24c = 0x801ed24c;
fn_8020bb2c = 0x8020bb2c;
fn_8020c5c0 = 0x8020c5c0;
fn_8020c5c4 = 0x8020c5c4;
fn_80341588 = 0x80341588;
fn_80341884 = 0x80341884;
lbl_803bac20 = 0x803bac20;
lbl_803bac50 = 0x803bac50;
lbl_803bac80 = 0x803bac80;
lbl_803bacac = 0x803bacac;
lbl_803bacdc = 0x803bacdc;
lbl_803bad10 = 0x803bad10;
lbl_803bad4c = 0x803bad4c;
lbl_803bad88 = 0x803bad88;
lbl_803badbc = 0x803badbc;
lbl_803badec = 0x803badec;
lbl_803bae18 = 0x803bae18;
lbl_803bae4c = 0x803bae4c;
lbl_803bae7c = 0x803bae7c;
lbl_804b06a0 = 0x804b06a0;
SECTIONS {
  .text.w3d_sol35d3_initialize_strings_80236870 0x80236870 : { *(.text.w3d_sol35d3_initialize_strings_80236870) }
  /DISCARD/ : { *(.text*) *(.rodata*) *(.data*) *(.bss*) *(.sdata*) *(.sbss*) *(.comment) }
}
