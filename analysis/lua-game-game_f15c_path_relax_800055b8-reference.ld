/* Generated reference-only placements. All bodies are source-built. */
OUTPUT_FORMAT("elf32-powerpc")
OUTPUT_ARCH(powerpc)
ENTRY(f15c_path_relax_800055b8)
_SDA_BASE_ = 0x804b2540;
_SDA2_BASE_ = 0x804c2540;
__9F15cRange = 0x8034141c;
__builtin_delete = 0x80015264;
allocate_8001523c = 0x8001523c;
distance_8000443c = 0x8000443c;
empty_80341448 = 0x80341448;
empty_8034144c = 0x8034144c;
erase_8000553c = 0x8000553c;
find_800052d4 = 0x800052d4;
insert_800053e4 = 0x800053e4;
queue_80005a98 = 0x80005a98;
remove_800059dc = 0x800059dc;
SECTIONS {
  .text.f15c_path_relax_800055b8 0x800055b8 : { *(.text.f15c_path_relax_800055b8) }
  /DISCARD/ : { *(.text*) *(.rodata*) *(.data*) *(.bss*) *(.sdata*) *(.sbss*) *(.comment) }
}
