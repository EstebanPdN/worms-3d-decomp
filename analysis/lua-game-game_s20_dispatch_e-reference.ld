/* Generated reference-only placements. All bodies are source-built. */
OUTPUT_FORMAT("elf32-powerpc")
OUTPUT_ARCH(powerpc)
ENTRY(w3d_s20_dispatch_until_done_801689e4)
_SDA_BASE_ = 0x804b2540;
_SDA2_BASE_ = 0x804c2540;
fn_8016a0a4 = 0x8016a0a4;
SECTIONS {
  .text.w3d_s20_dispatch_until_done_801689e4 0x801689e4 : { *(.text.w3d_s20_dispatch_until_done_801689e4) }
  /DISCARD/ : { *(.text*) *(.rodata*) *(.data*) *(.bss*) *(.sdata*) *(.sbss*) *(.comment) }
}
