/* Generated reference-only placements. All bodies are source-built. */
OUTPUT_FORMAT("elf32-powerpc")
OUTPUT_ARCH(powerpc)
ENTRY(w3d_cx16c_panel_children_destroy_802b40c8)
_SDA_BASE_ = 0x804b2540;
_SDA2_BASE_ = 0x804c2540;
cx16c_base_destroy_8015ff2c = 0x8015ff2c;
cx16c_context_destroy_802afc40 = 0x802afc40;
cx16c_table_8041c6b0 = 0x8041c6b0;
cx16c_table_8041c700 = 0x8041c700;
SECTIONS {
  .text.w3d_cx16c_panel_children_destroy_802b40c8 0x802b40c8 : { *(.text.w3d_cx16c_panel_children_destroy_802b40c8) }
  /DISCARD/ : { *(.text*) *(.rodata*) *(.data*) *(.bss*) *(.sdata*) *(.sbss*) *(.comment) }
}
