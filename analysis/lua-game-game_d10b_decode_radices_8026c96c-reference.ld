/* Generated reference-only placements. All bodies are source-built. */
OUTPUT_FORMAT("elf32-powerpc")
OUTPUT_ARCH(powerpc)
ENTRY(d10b_decode_radices_8026c96c)
_SDA_BASE_ = 0x804b2540;
_SDA2_BASE_ = 0x804c2540;
d10b_radices_803cbcb0 = 0x803cbcb0;
SECTIONS {
  .text.d10b_decode_radices_8026c96c 0x8026c96c : { *(.text.d10b_decode_radices_8026c96c) }
  /DISCARD/ : { *(.text*) *(.rodata*) *(.data*) *(.bss*) *(.sdata*) *(.sbss*) *(.comment) }
}
