/* Generated reference-only placements. All bodies are source-built. */
OUTPUT_FORMAT("elf32-powerpc")
OUTPUT_ARCH(powerpc)
ENTRY(w3d_cx14a_capture_direction_8009f7cc)
_SDA_BASE_ = 0x804b2540;
_SDA2_BASE_ = 0x804c2540;
lookup_80341584 = 0x80341584;
one_80380788 = 0x80380788;
parameters_801797b4 = 0x801797b4;
sqrt_802e82c0 = 0x802e82c0;
SECTIONS {
  .text.w3d_cx14a_capture_direction_8009f7cc 0x8009f7cc : { *(.text.w3d_cx14a_capture_direction_8009f7cc) }
  /DISCARD/ : { *(.text*) *(.rodata*) *(.data*) *(.bss*) *(.sdata*) *(.sbss*) *(.comment) }
}
