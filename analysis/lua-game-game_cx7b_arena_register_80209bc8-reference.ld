/* Generated reference-only placements. All bodies are source-built. */
OUTPUT_FORMAT("elf32-powerpc")
OUTPUT_ARCH(powerpc)
ENTRY(w3d_cx7b_arena_register_80209bc8)
_SDA_BASE_ = 0x804b2540;
_SDA2_BASE_ = 0x804c2540;
fn_801fcb64 = 0x801fcb64;
text_803b2fa4 = 0x803b2fa4;
SECTIONS {
  .text.w3d_cx7b_arena_register_80209bc8 0x80209bc8 : { *(.text.w3d_cx7b_arena_register_80209bc8) }
  /DISCARD/ : { *(.text*) *(.rodata*) *(.data*) *(.bss*) *(.sdata*) *(.sbss*) *(.comment) }
}
