/* Generated reference-only placements. All bodies are source-built. */
OUTPUT_FORMAT("elf32-powerpc")
OUTPUT_ARCH(powerpc)
ENTRY(w3d_auto_802551dc)
_SDA_BASE_ = 0x804b2540;
_SDA2_BASE_ = 0x804c2540;
fn_801E8D9C = 0x801e8d9c;
fn_801EBF38 = 0x801ebf38;
fn_801EC52C = 0x801ec52c;
lbl_803C7B44 = 0x803c7b44;
lbl_803C7B88 = 0x803c7b88;
lbl_803C7BCC = 0x803c7bcc;
lbl_803C7C0C = 0x803c7c0c;
lbl_803C7C4C = 0x803c7c4c;
lbl_803C7C8C = 0x803c7c8c;
lbl_803C7CBC = 0x803c7cbc;
lbl_803C7CF8 = 0x803c7cf8;
lbl_803C7D34 = 0x803c7d34;
SECTIONS {
  .text.w3d_auto_802551dc 0x802551dc : { *(.text.w3d_auto_802551dc) }
  /DISCARD/ : { *(.text*) *(.rodata*) *(.data*) *(.bss*) *(.sdata*) *(.sbss*) *(.comment) }
}
