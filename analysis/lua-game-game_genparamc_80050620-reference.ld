/* Generated reference-only placements. All bodies are source-built. */
OUTPUT_FORMAT("elf32-powerpc")
OUTPUT_ARCH(powerpc)
ENTRY(w3d_show_options_line_80050620)
_SDA_BASE_ = 0x804b2540;
_SDA2_BASE_ = 0x804c2540;
__18W3dString_803426b8 = 0x803426b8;
fn_8020c5c4 = 0x8020c5c4;
fn_802cbdf8 = 0x802cbdf8;
fn_802cc0ac = 0x802cc0ac;
fn_802cd26c = 0x802cd26c;
fn_80341588 = 0x80341588;
lbl_803f3ff4 = 0x803f3ff4;
lbl_80435bbc = 0x80435bbc;
SECTIONS {
  .text.w3d_show_options_line_80050620 0x80050620 : { *(.text.w3d_show_options_line_80050620) }
  .text.w3d_show_options_line_80099998 0x80099998 : { *(.text.w3d_show_options_line_80099998) }
  /DISCARD/ : { *(.text*) *(.rodata*) *(.data*) *(.bss*) *(.sdata*) *(.sbss*) *(.comment) }
}
