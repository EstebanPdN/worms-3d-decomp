/* Generated reference-only placements. All bodies are source-built. */
OUTPUT_FORMAT("elf32-powerpc")
OUTPUT_ARCH(powerpc)
ENTRY(s9_remove_owner_node_80165d4c)
_SDA_BASE_ = 0x804b2540;
_SDA2_BASE_ = 0x804c2540;
fn_80210990 = 0x80210990;
fn_802134fc = 0x802134fc;
lbl_80411ac0 = 0x80411ac0;
SECTIONS {
  .text.s9_remove_owner_node_80165d4c 0x80165d4c : { *(.text.s9_remove_owner_node_80165d4c) }
  .text.s9_remove_owner_node_80165fd4 0x80165fd4 : { *(.text.s9_remove_owner_node_80165fd4) }
  .text.s9_remove_owner_node_801662a8 0x801662a8 : { *(.text.s9_remove_owner_node_801662a8) }
  /DISCARD/ : { *(.text*) *(.rodata*) *(.data*) *(.bss*) *(.sdata*) *(.sbss*) *(.comment) }
}
