/* Generated reference-only placements. All bodies are source-built. */
OUTPUT_FORMAT("elf32-powerpc")
OUTPUT_ARCH(powerpc)
ENTRY(w3d_d24e_register_scroll_text_properties_80222588)
_SDA_BASE_ = 0x804b2540;
_SDA2_BASE_ = 0x804c2540;
__15String_8020bb54PCc = 0x8020bb54;
d20e_empty_804b06a0 = 0x804b06a0;
d20e_release_header_8020bb2c = 0x8020bb2c;
d20e_string_finish_8020c5c4 = 0x8020c5c4;
d20e_string_header_80341884 = 0x80341884;
d20e_string_init_8020c5c0 = 0x8020c5c0;
d20e_string_release_80341588 = 0x80341588;
desc_803b6ca0 = 0x803b6ca0;
desc_803b6cd4 = 0x803b6cd4;
desc_803b6d0c = 0x803b6d0c;
desc_803b6d30 = 0x803b6d30;
desc_803b6d68 = 0x803b6d68;
desc_803b6d90 = 0x803b6d90;
desc_803b6dc4 = 0x803b6dc4;
desc_803b6df8 = 0x803b6df8;
desc_803b6e20 = 0x803b6e20;
desc_803b6e4c = 0x803b6e4c;
fn_801e8d9c = 0x801e8d9c;
fn_801eb674 = 0x801eb674;
fn_801ec52c = 0x801ec52c;
fn_801ece2c = 0x801ece2c;
fn_801ed24c = 0x801ed24c;
fn_801f15e0 = 0x801f15e0;
lit_803b6408 = 0x803b6408;
SECTIONS {
  .text.w3d_d24e_register_scroll_text_properties_80222588 0x80222588 : { *(.text.w3d_d24e_register_scroll_text_properties_80222588) }
  /DISCARD/ : { *(.text*) *(.rodata*) *(.data*) *(.bss*) *(.sdata*) *(.sbss*) *(.comment) }
}
