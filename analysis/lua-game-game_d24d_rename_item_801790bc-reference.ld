/* Generated reference-only placements. All bodies are source-built. */
OUTPUT_FORMAT("elf32-powerpc")
OUTPUT_ARCH(powerpc)
ENTRY(d24d_rename_item_801790bc)
_SDA_BASE_ = 0x804b2540;
_SDA2_BASE_ = 0x804c2540;
__20d24d_String_8020bb54PCc = 0x8020bb54;
d24d_item_refresh_80178b5c = 0x80178b5c;
d24d_string_finish_8020c5c4 = 0x8020c5c4;
d24d_string_release_80341588 = 0x80341588;
d24d_string_release_header_8020bb2c = 0x8020bb2c;
strcmp = 0x802ef234;
SECTIONS {
  .text.d24d_rename_item_801790bc 0x801790bc : { *(.text.d24d_rename_item_801790bc) }
  /DISCARD/ : { *(.text*) *(.rodata*) *(.data*) *(.bss*) *(.sdata*) *(.sbss*) *(.comment) }
}
