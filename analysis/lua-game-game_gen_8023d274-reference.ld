/* Generated reference-only placements. All bodies are source-built. */
OUTPUT_FORMAT("elf32-powerpc")
OUTPUT_ARCH(powerpc)
ENTRY(w3d_address_8023d274)
_SDA_BASE_ = 0x804b2540;
_SDA2_BASE_ = 0x804c2540;
w3d_fn_80238d44 = 0x80238d44;
w3d_fn_80238dcc = 0x80238dcc;
w3d_fn_80238ed0 = 0x80238ed0;
w3d_fn_80238f88 = 0x80238f88;
w3d_fn_802391c0 = 0x802391c0;
w3d_fn_80239270 = 0x80239270;
w3d_fn_80239408 = 0x80239408;
w3d_fn_80239490 = 0x80239490;
w3d_fn_80239594 = 0x80239594;
w3d_fn_80239614 = 0x80239614;
w3d_fn_802396fc = 0x802396fc;
w3d_fn_80239784 = 0x80239784;
w3d_fn_80239888 = 0x80239888;
w3d_fn_80239910 = 0x80239910;
w3d_fn_80239a14 = 0x80239a14;
w3d_fn_80239aa0 = 0x80239aa0;
w3d_fn_80239bb4 = 0x80239bb4;
w3d_fn_80239c34 = 0x80239c34;
w3d_fn_80239d1c = 0x80239d1c;
w3d_fn_80239ddc = 0x80239ddc;
w3d_fn_80239fa4 = 0x80239fa4;
w3d_fn_8023a024 = 0x8023a024;
w3d_fn_8023a10c = 0x8023a10c;
w3d_fn_8023a194 = 0x8023a194;
w3d_fn_8023a298 = 0x8023a298;
w3d_fn_8023a320 = 0x8023a320;
w3d_fn_8023a424 = 0x8023a424;
w3d_fn_8023a4cc = 0x8023a4cc;
w3d_fn_8023a688 = 0x8023a688;
w3d_fn_8023a710 = 0x8023a710;
w3d_fn_8023a814 = 0x8023a814;
w3d_fn_8023a934 = 0x8023a934;
w3d_fn_8023abc4 = 0x8023abc4;
w3d_fn_8023ac9c = 0x8023ac9c;
w3d_fn_8023af0c = 0x8023af0c;
w3d_fn_8023aff0 = 0x8023aff0;
w3d_fn_8023b304 = 0x8023b304;
w3d_fn_8023b3a4 = 0x8023b3a4;
w3d_fn_8023b558 = 0x8023b558;
w3d_fn_8023b5f0 = 0x8023b5f0;
w3d_fn_8023b6f4 = 0x8023b6f4;
w3d_fn_8023b7b4 = 0x8023b7b4;
w3d_fn_8023ba18 = 0x8023ba18;
w3d_fn_8023bab8 = 0x8023bab8;
w3d_fn_8023bc68 = 0x8023bc68;
w3d_fn_8023bd08 = 0x8023bd08;
w3d_fn_8023beb8 = 0x8023beb8;
w3d_fn_8023bf78 = 0x8023bf78;
w3d_fn_8023c1dc = 0x8023c1dc;
w3d_fn_8023c27c = 0x8023c27c;
w3d_fn_8023c42c = 0x8023c42c;
w3d_fn_8023c4ec = 0x8023c4ec;
w3d_global_80367568 = 0x80367568;
w3d_global_803675b8 = 0x803675b8;
w3d_global_80367608 = 0x80367608;
w3d_global_80367658 = 0x80367658;
w3d_global_803676a8 = 0x803676a8;
w3d_global_803676f8 = 0x803676f8;
w3d_owner_list_remove = 0x8020fd2c;
w3d_registry_list_80367568 = 0x80367568;
w3d_registry_list_803675b8 = 0x803675b8;
w3d_registry_list_80367608 = 0x80367608;
w3d_registry_list_80367658 = 0x80367658;
w3d_registry_list_803676a8 = 0x803676a8;
w3d_registry_list_803676f8 = 0x803676f8;
SECTIONS {
  .text.w3d_address_8023d274 0x8023d274 : { *(.text.w3d_address_8023d274) }
  .text.w3d_registry_unlink_8023d2e8 0x8023d2e8 : { *(.text.w3d_registry_unlink_8023d2e8) }
  .text.w3d_address_8023d4bc 0x8023d4bc : { *(.text.w3d_address_8023d4bc) }
  .text.w3d_registry_unlink_8023d530 0x8023d530 : { *(.text.w3d_registry_unlink_8023d530) }
  .text.w3d_address_8023d624 0x8023d624 : { *(.text.w3d_address_8023d624) }
  .text.w3d_registry_unlink_8023d698 0x8023d698 : { *(.text.w3d_registry_unlink_8023d698) }
  .text.w3d_address_8023d930 0x8023d930 : { *(.text.w3d_address_8023d930) }
  .text.w3d_registry_unlink_8023d9a4 0x8023d9a4 : { *(.text.w3d_registry_unlink_8023d9a4) }
  .text.w3d_address_8023da98 0x8023da98 : { *(.text.w3d_address_8023da98) }
  .text.w3d_registry_unlink_8023db0c 0x8023db0c : { *(.text.w3d_registry_unlink_8023db0c) }
  .text.w3d_address_8023dda4 0x8023dda4 : { *(.text.w3d_address_8023dda4) }
  .text.w3d_registry_unlink_8023de18 0x8023de18 : { *(.text.w3d_registry_unlink_8023de18) }
  .text.w3d_registry_release_8023e6f4 0x8023e6f4 : { *(.text.w3d_registry_release_8023e6f4) }
  .text.w3d_empty_8023e750 0x8023e750 : { *(.text.w3d_empty_8023e750) }
  .text.w3d_registry_release_8023e754 0x8023e754 : { *(.text.w3d_registry_release_8023e754) }
  .text.w3d_empty_8023e7b0 0x8023e7b0 : { *(.text.w3d_empty_8023e7b0) }
  .text.w3d_registry_release_8023e7b4 0x8023e7b4 : { *(.text.w3d_registry_release_8023e7b4) }
  .text.w3d_registry_release_8023e810 0x8023e810 : { *(.text.w3d_registry_release_8023e810) }
  .text.w3d_registry_release_8023e86c 0x8023e86c : { *(.text.w3d_registry_release_8023e86c) }
  .text.w3d_registry_release_8023e8c8 0x8023e8c8 : { *(.text.w3d_registry_release_8023e8c8) }
  .text.w3d_registry_release_8023e924 0x8023e924 : { *(.text.w3d_registry_release_8023e924) }
  .text.w3d_registry_release_8023e980 0x8023e980 : { *(.text.w3d_registry_release_8023e980) }
  .text.w3d_registry_release_8023e9dc 0x8023e9dc : { *(.text.w3d_registry_release_8023e9dc) }
  .text.w3d_registry_release_8023ea38 0x8023ea38 : { *(.text.w3d_registry_release_8023ea38) }
  .text.w3d_registry_release_8023ea94 0x8023ea94 : { *(.text.w3d_registry_release_8023ea94) }
  .text.w3d_registry_release_8023eaf0 0x8023eaf0 : { *(.text.w3d_registry_release_8023eaf0) }
  .text.w3d_registry_release_8023eb4c 0x8023eb4c : { *(.text.w3d_registry_release_8023eb4c) }
  .text.w3d_registry_release_8023eba8 0x8023eba8 : { *(.text.w3d_registry_release_8023eba8) }
  .text.w3d_registry_release_8023ec04 0x8023ec04 : { *(.text.w3d_registry_release_8023ec04) }
  .text.w3d_registry_release_8023ec60 0x8023ec60 : { *(.text.w3d_registry_release_8023ec60) }
  .text.w3d_registry_release_8023ecbc 0x8023ecbc : { *(.text.w3d_registry_release_8023ecbc) }
  .text.w3d_registry_release_8023ed18 0x8023ed18 : { *(.text.w3d_registry_release_8023ed18) }
  .text.w3d_registry_release_8023ed74 0x8023ed74 : { *(.text.w3d_registry_release_8023ed74) }
  .text.w3d_registry_release_8023edd0 0x8023edd0 : { *(.text.w3d_registry_release_8023edd0) }
  .text.w3d_registry_release_8023ee2c 0x8023ee2c : { *(.text.w3d_registry_release_8023ee2c) }
  .text.w3d_registry_release_8023f0cc 0x8023f0cc : { *(.text.w3d_registry_release_8023f0cc) }
  .text.w3d_registry_release_8023f4b4 0x8023f4b4 : { *(.text.w3d_registry_release_8023f4b4) }
  .text.w3d_registry_release_8023f7ac 0x8023f7ac : { *(.text.w3d_registry_release_8023f7ac) }
  .text.w3d_registry_release_8023faec 0x8023faec : { *(.text.w3d_registry_release_8023faec) }
  .text.w3d_registry_release_8023fde4 0x8023fde4 : { *(.text.w3d_registry_release_8023fde4) }
  .text.w3d_set_80249704 0x80249704 : { *(.text.w3d_set_80249704) }
  .text.w3d_set_80249718 0x80249718 : { *(.text.w3d_set_80249718) }
  .text.w3d_set_8024972c 0x8024972c : { *(.text.w3d_set_8024972c) }
  .text.w3d_set_80249740 0x80249740 : { *(.text.w3d_set_80249740) }
  .text.w3d_set_80249754 0x80249754 : { *(.text.w3d_set_80249754) }
  .text.w3d_set_80249768 0x80249768 : { *(.text.w3d_set_80249768) }
  .text.w3d_set_8024977c 0x8024977c : { *(.text.w3d_set_8024977c) }
  .text.w3d_set_80249790 0x80249790 : { *(.text.w3d_set_80249790) }
  .text.w3d_set_802497a4 0x802497a4 : { *(.text.w3d_set_802497a4) }
  .text.w3d_set_802497b8 0x802497b8 : { *(.text.w3d_set_802497b8) }
  .text.w3d_set_802497cc 0x802497cc : { *(.text.w3d_set_802497cc) }
  .text.w3d_set_802497e0 0x802497e0 : { *(.text.w3d_set_802497e0) }
  .text.w3d_set_802497f4 0x802497f4 : { *(.text.w3d_set_802497f4) }
  .text.w3d_set_80249808 0x80249808 : { *(.text.w3d_set_80249808) }
  .text.w3d_set_8024981c 0x8024981c : { *(.text.w3d_set_8024981c) }
  .text.w3d_set_80249830 0x80249830 : { *(.text.w3d_set_80249830) }
  .text.w3d_set_80249844 0x80249844 : { *(.text.w3d_set_80249844) }
  .text.w3d_set_80249858 0x80249858 : { *(.text.w3d_set_80249858) }
  .text.w3d_set_8024986c 0x8024986c : { *(.text.w3d_set_8024986c) }
  .text.w3d_set_80249880 0x80249880 : { *(.text.w3d_set_80249880) }
  .text.w3d_set_80249894 0x80249894 : { *(.text.w3d_set_80249894) }
  .text.w3d_set_802498a8 0x802498a8 : { *(.text.w3d_set_802498a8) }
  .text.w3d_set_802498bc 0x802498bc : { *(.text.w3d_set_802498bc) }
  .text.w3d_set_802498d0 0x802498d0 : { *(.text.w3d_set_802498d0) }
  .text.w3d_set_802498e4 0x802498e4 : { *(.text.w3d_set_802498e4) }
  .text.w3d_set_802498f8 0x802498f8 : { *(.text.w3d_set_802498f8) }
  .text.w3d_set_8024990c 0x8024990c : { *(.text.w3d_set_8024990c) }
  .text.w3d_set_80249920 0x80249920 : { *(.text.w3d_set_80249920) }
  .text.w3d_set_80249934 0x80249934 : { *(.text.w3d_set_80249934) }
  .text.w3d_set_80249948 0x80249948 : { *(.text.w3d_set_80249948) }
  .text.w3d_set_8024995c 0x8024995c : { *(.text.w3d_set_8024995c) }
  .text.w3d_set_80249970 0x80249970 : { *(.text.w3d_set_80249970) }
  .text.w3d_set_80249984 0x80249984 : { *(.text.w3d_set_80249984) }
  .text.w3d_set_80249998 0x80249998 : { *(.text.w3d_set_80249998) }
  .text.w3d_set_802499ac 0x802499ac : { *(.text.w3d_set_802499ac) }
  .text.w3d_get_802499b4 0x802499b4 : { *(.text.w3d_get_802499b4) }
  .text.w3d_set_802499bc 0x802499bc : { *(.text.w3d_set_802499bc) }
  .text.w3d_get_802499c4 0x802499c4 : { *(.text.w3d_get_802499c4) }
  .text.w3d_set_802499cc 0x802499cc : { *(.text.w3d_set_802499cc) }
  .text.w3d_get_802499d4 0x802499d4 : { *(.text.w3d_get_802499d4) }
  /DISCARD/ : { *(.text*) *(.rodata*) *(.data*) *(.bss*) *(.sdata*) *(.sbss*) *(.comment) }
}
