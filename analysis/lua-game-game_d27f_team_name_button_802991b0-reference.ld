/* Generated reference-only placements. All bodies are source-built. */
OUTPUT_FORMAT("elf32-powerpc")
OUTPUT_ARCH(powerpc)
ENTRY(d27f_team_name_button_802991b0)
_SDA_BASE_ = 0x804b2540;
_SDA2_BASE_ = 0x804c2540;
__15String_803426b8 = 0x803426b8;
lbl_803d097c = 0x803d097c;
lbl_803d09ec = 0x803d09ec;
lbl_803d0b64 = 0x803d0b64;
lbl_803d0b70 = 0x803d0b70;
lbl_803d0b80 = 0x803d0b80;
s8_property_read_800fc550 = 0x800fc550;
strcmp = 0x802ef234;
strlen = 0x802ef9c0;
w3d_auto_800fc2b0 = 0x800fc2b0;
w3d_auto_801797b4 = 0x801797b4;
w3d_constructor_lookup_name = 0x800fc1b0;
w3d_empty_80341584 = 0x80341584;
w3d_f6a_set_flag_80299b48 = 0x80299b48;
w3d_string_assign = 0x8020bd38;
w3d_string_base_finish = 0x8020c5c4;
w3d_string_base_init = 0x8020c5c0;
w3d_string_format = 0x8020c510;
w3d_string_header = 0x80341884;
w3d_string_release = 0x80341588;
SECTIONS {
  .text.d27f_team_name_button_802991b0 0x802991b0 : { *(.text.d27f_team_name_button_802991b0) }
  /DISCARD/ : { *(.text*) *(.rodata*) *(.data*) *(.bss*) *(.sdata*) *(.sbss*) *(.comment) }
}
