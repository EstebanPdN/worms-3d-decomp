/* Generated reference-only placements. All bodies are source-built. */
OUTPUT_FORMAT("elf32-powerpc")
OUTPUT_ARCH(powerpc)
ENTRY(tsonnet_c26_read_swapped_header_80202bb4)
_SDA_BASE_ = 0x804b2540;
_SDA2_BASE_ = 0x804c2540;
fn_802025a8 = 0x802025a8;
SECTIONS {
  .text.tsonnet_c26_read_swapped_header_80202bb4 0x80202bb4 : { *(.text.tsonnet_c26_read_swapped_header_80202bb4) }
  /DISCARD/ : { *(.text*) *(.rodata*) *(.data*) *(.bss*) *(.sdata*) *(.sbss*) *(.comment) }
}
