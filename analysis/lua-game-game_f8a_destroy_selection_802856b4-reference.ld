/* Generated reference-only placements. All bodies are source-built. */
OUTPUT_FORMAT("elf32-powerpc")
OUTPUT_ARCH(powerpc)
ENTRY(_._21F8aSelection_802856b4)
_SDA_BASE_ = 0x804b2540;
_SDA2_BASE_ = 0x804c2540;
_._16F8aBase_8015ff2c = 0x8015ff2c;
_._18F8aMember_802afc40 = 0x802afc40;
fn_8020c5c4 = 0x8020c5c4;
fn_802134fc = 0x802134fc;
fn_80341588 = 0x80341588;
vt_8041bf40 = 0x8041bf40;
vt_8041bf90 = 0x8041bf90;
SECTIONS {
  .text._._21F8aSelection_802856b4 0x802856b4 : { *(.text._._21F8aSelection_802856b4) }
  /DISCARD/ : { *(.text*) *(.rodata*) *(.data*) *(.bss*) *(.sdata*) *(.sbss*) *(.comment) }
}
