/* Generated reference-only placements. All bodies are source-built. */
OUTPUT_FORMAT("elf32-powerpc")
OUTPUT_ARCH(powerpc)
ENTRY(w3d_d28e_add_keyed_refs_801ace68)
_SDA_BASE_ = 0x804b2540;
_SDA2_BASE_ = 0x804c2540;
alloc_80212fd4 = 0x80212fd4;
free_802134fc = 0x802134fc;
w3d_auto_801f2758 = 0x801f2758;
w3d_construct_801f2678 = 0x801f2678;
w3d_copy_refs_801f2698 = 0x801f2698;
w3d_handle_storage_fallback_803413d8 = 0x803413d8;
SECTIONS {
  .text.w3d_d28e_add_keyed_refs_801ace68 0x801ace68 : { *(.text.w3d_d28e_add_keyed_refs_801ace68) }
  /DISCARD/ : { *(.text*) *(.rodata*) *(.data*) *(.bss*) *(.sdata*) *(.sbss*) *(.comment) }
}
