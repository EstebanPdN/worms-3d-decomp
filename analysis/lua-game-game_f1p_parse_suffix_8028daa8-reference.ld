/* Generated reference-only placements. All bodies are source-built. */
OUTPUT_FORMAT("elf32-powerpc")
OUTPUT_ARCH(powerpc)
ENTRY(w3d_parse_suffix_8028daa8)
_SDA_BASE_ = 0x804b2540;
_SDA2_BASE_ = 0x804c2540;
__13Temp_803426b8 = 0x803426b8;
fallback_803cffac = 0x803cffac;
fn_8020bb2c = 0x8020bb2c;
fn_8020bd38 = 0x8020bd38;
fn_8020c0fc = 0x8020c0fc;
fn_8020c3a0 = 0x8020c3a0;
fn_8020c5c0 = 0x8020c5c0;
fn_8020c5c4 = 0x8020c5c4;
fn_802ed8c4 = 0x802ed8c4;
fn_802efd14 = 0x802efd14;
fn_80341588 = 0x80341588;
fn_80341884 = 0x80341884;
separator_803cffbc = 0x803cffbc;
SECTIONS {
  .text.w3d_parse_suffix_8028daa8 0x8028daa8 : { *(.text.w3d_parse_suffix_8028daa8) }
  /DISCARD/ : { *(.text*) *(.rodata*) *(.data*) *(.bss*) *(.sdata*) *(.sbss*) *(.comment) }
}
