/* Generated reference-only placements. All bodies are source-built. */
OUTPUT_FORMAT("elf32-powerpc")
OUTPUT_ARCH(powerpc)
ENTRY(_._19F10c_802539c4_Owner)
_SDA_BASE_ = 0x804b2540;
_SDA2_BASE_ = 0x804c2540;
_._27F10c_802539c4_Base_802523b4 = 0x802523b4;
__dl__19F10c_802539c4_OwnerPv = 0x801ea740;
fn_8020c5c4 = 0x8020c5c4;
fn_80341588 = 0x80341588;
vt_8041ba90 = 0x8041ba90;
SECTIONS {
  .text._._19F10c_802539c4_Owner 0x802539c4 : { *(.text._._19F10c_802539c4_Owner) }
  /DISCARD/ : { *(.text*) *(.rodata*) *(.data*) *(.bss*) *(.sdata*) *(.sbss*) *(.comment) }
}
