/* Generated reference-only placements. All bodies are source-built. */
OUTPUT_FORMAT("elf32-powerpc")
OUTPUT_ARCH(powerpc)
ENTRY(d41i_load_resource_folders_80128f6c)
_SDA_BASE_ = 0x804b2540;
_SDA2_BASE_ = 0x804c2540;
__11d24i_StringPCc = 0x8020bb54;
d24i_name_8039c85c = 0x8039c85c;
d24i_name_8039c864 = 0x8039c864;
d24i_name_8039c86c = 0x8039c86c;
d24i_name_8039c874 = 0x8039c874;
d24i_name_8039c878 = 0x8039c878;
d24i_name_8039c88c = 0x8039c88c;
d24i_string_finish_8020c5c4 = 0x8020c5c4;
d24i_string_release_80341588 = 0x80341588;
SECTIONS {
  .text.d41i_load_resource_folders_80128f6c 0x80128f6c : { *(.text.d41i_load_resource_folders_80128f6c) }
  /DISCARD/ : { *(.text*) *(.rodata*) *(.data*) *(.bss*) *(.sdata*) *(.sbss*) *(.comment) }
}
