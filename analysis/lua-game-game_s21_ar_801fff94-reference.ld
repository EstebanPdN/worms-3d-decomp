/* Generated reference-only placements. All bodies are source-built. */
OUTPUT_FORMAT("elf32-powerpc")
OUTPUT_ARCH(powerpc)
ENTRY(w3d_s21_kind_is_two_801fff94)
_SDA_BASE_ = 0x804b2540;
_SDA2_BASE_ = 0x804c2540;
fn_802001a8 = 0x802001a8;
SECTIONS {
  .text.w3d_s21_kind_is_two_801fff94 0x801fff94 : { *(.text.w3d_s21_kind_is_two_801fff94) }
  /DISCARD/ : { *(.text*) *(.rodata*) *(.data*) *(.bss*) *(.sdata*) *(.sbss*) *(.comment) }
}
