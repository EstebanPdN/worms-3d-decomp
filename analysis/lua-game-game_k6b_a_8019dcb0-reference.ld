/* Generated reference-only placements. All bodies are source-built. */
OUTPUT_FORMAT("elf32-powerpc")
OUTPUT_ARCH(powerpc)
ENTRY(w3d_k6b_script_host_create_object_8019dcb0)
_SDA_BASE_ = 0x804b2540;
_SDA2_BASE_ = 0x804c2540;
lbl_8040ebd8 = 0x8040ebd8;
w3d_auto_8020b648 = 0x8020b648;
SECTIONS {
  .text.w3d_k6b_script_host_create_object_8019dcb0 0x8019dcb0 : { *(.text.w3d_k6b_script_host_create_object_8019dcb0) }
  /DISCARD/ : { *(.text*) *(.rodata*) *(.data*) *(.bss*) *(.sdata*) *(.sbss*) *(.comment) }
}
