/* Generated reference-only placements. All bodies are source-built. */
OUTPUT_FORMAT("elf32-powerpc")
OUTPUT_ARCH(powerpc)
ENTRY(w3d_k4b_named_component_construct_801d3150)
_SDA_BASE_ = 0x804b2540;
_SDA2_BASE_ = 0x804c2540;
fn_801e81c8 = 0x801e81c8;
lbl_804164d0 = 0x804164d0;
lbl_80416518 = 0x80416518;
w3d_string_default = 0x803426b8;
SECTIONS {
  .text.w3d_k4b_named_component_construct_801d3150 0x801d3150 : { *(.text.w3d_k4b_named_component_construct_801d3150) }
  /DISCARD/ : { *(.text*) *(.rodata*) *(.data*) *(.bss*) *(.sdata*) *(.sbss*) *(.comment) }
}
