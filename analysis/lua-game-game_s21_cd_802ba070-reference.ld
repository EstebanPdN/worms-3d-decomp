/* Generated reference-only placements. All bodies are source-built. */
OUTPUT_FORMAT("elf32-powerpc")
OUTPUT_ARCH(powerpc)
ENTRY(w3d_s21_release_slots_802ba070)
_SDA_BASE_ = 0x804b2540;
_SDA2_BASE_ = 0x804c2540;
fn_8025e0c4 = 0x8025e0c4;
SECTIONS {
  .text.w3d_s21_release_slots_802ba070 0x802ba070 : { *(.text.w3d_s21_release_slots_802ba070) }
  /DISCARD/ : { *(.text*) *(.rodata*) *(.data*) *(.bss*) *(.sdata*) *(.sbss*) *(.comment) }
}
