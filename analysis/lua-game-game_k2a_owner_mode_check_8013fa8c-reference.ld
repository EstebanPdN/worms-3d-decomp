/* Generated reference-only placements. All bodies are source-built. */
OUTPUT_FORMAT("elf32-powerpc")
OUTPUT_ARCH(powerpc)
ENTRY(k2a_owner_mode_check_8013fa8c)
_SDA_BASE_ = 0x804b2540;
_SDA2_BASE_ = 0x804c2540;
s8_index_query_800fc6dc = 0x800fc6dc;
w3d_auto_80178c48 = 0x80178c48;
w3d_empty_803426b4 = 0x803426b4;
SECTIONS {
  .text.k2a_owner_mode_check_8013fa8c 0x8013fa8c : { *(.text.k2a_owner_mode_check_8013fa8c) }
  /DISCARD/ : { *(.text*) *(.rodata*) *(.data*) *(.bss*) *(.sdata*) *(.sbss*) *(.comment) }
}
