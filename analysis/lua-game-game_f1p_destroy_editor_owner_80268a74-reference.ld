/* Generated reference-only placements. All bodies are source-built. */
OUTPUT_FORMAT("elf32-powerpc")
OUTPUT_ARCH(powerpc)
ENTRY(_._14F1pEditorOwner)
_SDA_BASE_ = 0x804b2540;
_SDA2_BASE_ = 0x804c2540;
_._22F1pEditorBase_8015ff2c = 0x8015ff2c;
_._24F1pEditorMember_802afc40 = 0x802afc40;
_._24F1pEditorNested_8026c860 = 0x8026c860;
fn_8020c5c4 = 0x8020c5c4;
fn_80341588 = 0x80341588;
vt_8041bc90 = 0x8041bc90;
vt_8041bce0 = 0x8041bce0;
SECTIONS {
  .text._._14F1pEditorOwner 0x80268a74 : { *(.text._._14F1pEditorOwner) }
  /DISCARD/ : { *(.text*) *(.rodata*) *(.data*) *(.bss*) *(.sdata*) *(.sbss*) *(.comment) }
}
