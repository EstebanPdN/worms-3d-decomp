/* Generated reference-only placements. All bodies are source-built. */
OUTPUT_FORMAT("elf32-powerpc")
OUTPUT_ARCH(powerpc)
ENTRY(w3d_d28e_service_remove_8020a808)
_SDA_BASE_ = 0x804b2540;
_SDA2_BASE_ = 0x804c2540;
memcpy_802eee50 = 0x802eee50;
w3d_find_8035c414 = 0x8035c414;
SECTIONS {
  .text.w3d_d28e_service_remove_8020a808 0x8020a808 : { *(.text.w3d_d28e_service_remove_8020a808) }
  /DISCARD/ : { *(.text*) *(.rodata*) *(.data*) *(.bss*) *(.sdata*) *(.sbss*) *(.comment) }
}
