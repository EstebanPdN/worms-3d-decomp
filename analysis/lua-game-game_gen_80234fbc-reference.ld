/* Generated reference-only placements. All bodies are source-built. */
OUTPUT_FORMAT("elf32-powerpc")
OUTPUT_ARCH(powerpc)
ENTRY(w3d_get_80234fbc)
_SDA_BASE_ = 0x804b2540;
_SDA2_BASE_ = 0x804c2540;
w3d_fn_802359d4 = 0x802359d4;
w3d_fn_80235c58 = 0x80235c58;
w3d_fn_80235f28 = 0x80235f28;
w3d_fn_8023616c = 0x8023616c;
w3d_fn_80236318 = 0x80236318;
w3d_fn_802364bc = 0x802364bc;
w3d_fn_802367cc = 0x802367cc;
w3d_fn_80236c5c = 0x80236c5c;
w3d_fn_80236f08 = 0x80236f08;
w3d_fn_80237240 = 0x80237240;
w3d_fn_802374d0 = 0x802374d0;
w3d_fn_802377a8 = 0x802377a8;
w3d_fn_80237a38 = 0x80237a38;
w3d_fn_80237d08 = 0x80237d08;
w3d_global_803667f8 = 0x803667f8;
w3d_global_80366848 = 0x80366848;
w3d_global_80366898 = 0x80366898;
w3d_global_803668e8 = 0x803668e8;
w3d_global_80366938 = 0x80366938;
w3d_global_80366988 = 0x80366988;
w3d_global_803669d8 = 0x803669d8;
w3d_global_80366a28 = 0x80366a28;
w3d_global_80366a78 = 0x80366a78;
w3d_global_80366ac8 = 0x80366ac8;
w3d_global_80366b18 = 0x80366b18;
w3d_global_80366b68 = 0x80366b68;
w3d_global_80366bb8 = 0x80366bb8;
w3d_global_80366c08 = 0x80366c08;
w3d_owner_list_remove = 0x8020fd2c;
w3d_registry_list_803667f8 = 0x803667f8;
w3d_registry_list_80366848 = 0x80366848;
w3d_registry_list_80366898 = 0x80366898;
w3d_registry_list_803668e8 = 0x803668e8;
w3d_registry_list_80366938 = 0x80366938;
w3d_registry_list_80366988 = 0x80366988;
w3d_registry_list_803669d8 = 0x803669d8;
w3d_registry_list_80366a28 = 0x80366a28;
w3d_registry_list_80366a78 = 0x80366a78;
w3d_registry_list_80366ac8 = 0x80366ac8;
w3d_registry_list_80366b18 = 0x80366b18;
w3d_registry_list_80366b68 = 0x80366b68;
w3d_registry_list_80366bb8 = 0x80366bb8;
w3d_registry_list_80366c08 = 0x80366c08;
SECTIONS {
  .text.w3d_get_80234fbc 0x80234fbc : { *(.text.w3d_get_80234fbc) }
  .text.w3d_set_80234fc4 0x80234fc4 : { *(.text.w3d_set_80234fc4) }
  .text.w3d_get_80234fcc 0x80234fcc : { *(.text.w3d_get_80234fcc) }
  .text.w3d_set_80234fd4 0x80234fd4 : { *(.text.w3d_set_80234fd4) }
  .text.w3d_get_80234fdc 0x80234fdc : { *(.text.w3d_get_80234fdc) }
  .text.w3d_set_80234fe4 0x80234fe4 : { *(.text.w3d_set_80234fe4) }
  .text.w3d_get_80234fec 0x80234fec : { *(.text.w3d_get_80234fec) }
  .text.w3d_set_80234ff4 0x80234ff4 : { *(.text.w3d_set_80234ff4) }
  .text.w3d_get_80234ffc 0x80234ffc : { *(.text.w3d_get_80234ffc) }
  .text.w3d_set_80235004 0x80235004 : { *(.text.w3d_set_80235004) }
  .text.w3d_get_8023500c 0x8023500c : { *(.text.w3d_get_8023500c) }
  .text.w3d_set_80235014 0x80235014 : { *(.text.w3d_set_80235014) }
  .text.w3d_get_8023501c 0x8023501c : { *(.text.w3d_get_8023501c) }
  .text.w3d_set_80235024 0x80235024 : { *(.text.w3d_set_80235024) }
  .text.w3d_get_8023502c 0x8023502c : { *(.text.w3d_get_8023502c) }
  .text.w3d_set_80235034 0x80235034 : { *(.text.w3d_set_80235034) }
  .text.w3d_get_8023503c 0x8023503c : { *(.text.w3d_get_8023503c) }
  .text.w3d_set_80235274 0x80235274 : { *(.text.w3d_set_80235274) }
  .text.w3d_get_8023527c 0x8023527c : { *(.text.w3d_get_8023527c) }
  .text.w3d_set_802353d4 0x802353d4 : { *(.text.w3d_set_802353d4) }
  .text.w3d_get_802353dc 0x802353dc : { *(.text.w3d_get_802353dc) }
  .text.w3d_set_802356f4 0x802356f4 : { *(.text.w3d_set_802356f4) }
  .text.w3d_get_802356fc 0x802356fc : { *(.text.w3d_get_802356fc) }
  .text.w3d_set_802357e4 0x802357e4 : { *(.text.w3d_set_802357e4) }
  .text.w3d_get_802357ec 0x802357ec : { *(.text.w3d_get_802357ec) }
  .text.w3d_set_80235864 0x80235864 : { *(.text.w3d_set_80235864) }
  .text.w3d_get_8023586c 0x8023586c : { *(.text.w3d_get_8023586c) }
  .text.w3d_address_802358c0 0x802358c0 : { *(.text.w3d_address_802358c0) }
  .text.w3d_registry_unlink_80235934 0x80235934 : { *(.text.w3d_registry_unlink_80235934) }
  .text.w3d_address_80235b08 0x80235b08 : { *(.text.w3d_address_80235b08) }
  .text.w3d_registry_unlink_80235b7c 0x80235b7c : { *(.text.w3d_registry_unlink_80235b7c) }
  .text.w3d_address_80235e14 0x80235e14 : { *(.text.w3d_address_80235e14) }
  .text.w3d_registry_unlink_80235e88 0x80235e88 : { *(.text.w3d_registry_unlink_80235e88) }
  .text.w3d_address_80236068 0x80236068 : { *(.text.w3d_address_80236068) }
  .text.w3d_registry_unlink_802360dc 0x802360dc : { *(.text.w3d_registry_unlink_802360dc) }
  .text.w3d_address_8023621c 0x8023621c : { *(.text.w3d_address_8023621c) }
  .text.w3d_registry_unlink_80236290 0x80236290 : { *(.text.w3d_registry_unlink_80236290) }
  .text.w3d_address_802363a8 0x802363a8 : { *(.text.w3d_address_802363a8) }
  .text.w3d_registry_unlink_8023641c 0x8023641c : { *(.text.w3d_registry_unlink_8023641c) }
  .text.w3d_address_802365fc 0x802365fc : { *(.text.w3d_address_802365fc) }
  .text.w3d_registry_unlink_80236670 0x80236670 : { *(.text.w3d_registry_unlink_80236670) }
  .text.w3d_address_80236b48 0x80236b48 : { *(.text.w3d_address_80236b48) }
  .text.w3d_registry_unlink_80236bbc 0x80236bbc : { *(.text.w3d_registry_unlink_80236bbc) }
  .text.w3d_address_80236d9c 0x80236d9c : { *(.text.w3d_address_80236d9c) }
  .text.w3d_registry_unlink_80236e10 0x80236e10 : { *(.text.w3d_registry_unlink_80236e10) }
  .text.w3d_address_80237124 0x80237124 : { *(.text.w3d_address_80237124) }
  .text.w3d_registry_unlink_80237198 0x80237198 : { *(.text.w3d_registry_unlink_80237198) }
  .text.w3d_address_80237380 0x80237380 : { *(.text.w3d_address_80237380) }
  .text.w3d_registry_unlink_802373f4 0x802373f4 : { *(.text.w3d_registry_unlink_802373f4) }
  .text.w3d_address_8023768c 0x8023768c : { *(.text.w3d_address_8023768c) }
  .text.w3d_registry_unlink_80237700 0x80237700 : { *(.text.w3d_registry_unlink_80237700) }
  .text.w3d_address_802378e8 0x802378e8 : { *(.text.w3d_address_802378e8) }
  .text.w3d_registry_unlink_8023795c 0x8023795c : { *(.text.w3d_registry_unlink_8023795c) }
  .text.w3d_address_80237bf4 0x80237bf4 : { *(.text.w3d_address_80237bf4) }
  .text.w3d_registry_unlink_80237c68 0x80237c68 : { *(.text.w3d_registry_unlink_80237c68) }
  .text.w3d_registry_release_802380f0 0x802380f0 : { *(.text.w3d_registry_release_802380f0) }
  .text.w3d_registry_release_8023814c 0x8023814c : { *(.text.w3d_registry_release_8023814c) }
  .text.w3d_registry_release_802381a8 0x802381a8 : { *(.text.w3d_registry_release_802381a8) }
  .text.w3d_registry_release_80238204 0x80238204 : { *(.text.w3d_registry_release_80238204) }
  .text.w3d_registry_release_80238260 0x80238260 : { *(.text.w3d_registry_release_80238260) }
  .text.w3d_registry_release_802382bc 0x802382bc : { *(.text.w3d_registry_release_802382bc) }
  .text.w3d_registry_release_80238318 0x80238318 : { *(.text.w3d_registry_release_80238318) }
  .text.w3d_registry_release_80238374 0x80238374 : { *(.text.w3d_registry_release_80238374) }
  .text.w3d_registry_release_802383d0 0x802383d0 : { *(.text.w3d_registry_release_802383d0) }
  .text.w3d_registry_release_8023842c 0x8023842c : { *(.text.w3d_registry_release_8023842c) }
  .text.w3d_registry_release_80238488 0x80238488 : { *(.text.w3d_registry_release_80238488) }
  .text.w3d_registry_release_802384e4 0x802384e4 : { *(.text.w3d_registry_release_802384e4) }
  .text.w3d_registry_release_80238540 0x80238540 : { *(.text.w3d_registry_release_80238540) }
  .text.w3d_registry_release_8023859c 0x8023859c : { *(.text.w3d_registry_release_8023859c) }
  .text.w3d_get_8023873c 0x8023873c : { *(.text.w3d_get_8023873c) }
  .text.w3d_set_80238744 0x80238744 : { *(.text.w3d_set_80238744) }
  .text.w3d_get_8023874c 0x8023874c : { *(.text.w3d_get_8023874c) }
  .text.w3d_set_802388a4 0x802388a4 : { *(.text.w3d_set_802388a4) }
  .text.w3d_get_802388ac 0x802388ac : { *(.text.w3d_get_802388ac) }
  .text.w3d_set_802388b4 0x802388b4 : { *(.text.w3d_set_802388b4) }
  .text.w3d_get_802388bc 0x802388bc : { *(.text.w3d_get_802388bc) }
  .text.w3d_set_802388c4 0x802388c4 : { *(.text.w3d_set_802388c4) }
  .text.w3d_get_802388cc 0x802388cc : { *(.text.w3d_get_802388cc) }
  .text.w3d_set_802388d4 0x802388d4 : { *(.text.w3d_set_802388d4) }
  .text.w3d_get_802388dc 0x802388dc : { *(.text.w3d_get_802388dc) }
  /DISCARD/ : { *(.text*) *(.rodata*) *(.data*) *(.bss*) *(.sdata*) *(.sbss*) *(.comment) }
}
