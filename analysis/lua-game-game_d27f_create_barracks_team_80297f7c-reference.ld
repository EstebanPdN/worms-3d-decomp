/* Generated reference-only placements. All bodies are source-built. */
OUTPUT_FORMAT("elf32-powerpc")
OUTPUT_ARCH(powerpc)
ENTRY(d27f_create_barracks_team_80297f7c)
_SDA_BASE_ = 0x804b2540;
_SDA2_BASE_ = 0x804c2540;
_._19Descriptor_80178474 = 0x80178474;
__15String_803426b8 = 0x803426b8;
__15String_803426b8PCc = 0x8020bb54;
fn_80297620 = 0x80297620;
lbl_803d097c = 0x803d097c;
lbl_803d0a00 = 0x803d0a00;
lbl_803d0a54 = 0x803d0a54;
lbl_803d0ab8 = 0x803d0ab8;
lbl_803d0ac8 = 0x803d0ac8;
lbl_803d0acc = 0x803d0acc;
lbl_803d0ad4 = 0x803d0ad4;
lbl_803d0ad8 = 0x803d0ad8;
lbl_803d0adc = 0x803d0adc;
lbl_803d0ae4 = 0x803d0ae4;
lbl_803d0ae8 = 0x803d0ae8;
lbl_803d0af0 = 0x803d0af0;
lbl_803d0af4 = 0x803d0af4;
lbl_803d0afc = 0x803d0afc;
lbl_803d0b00 = 0x803d0b00;
lbl_803d0b04 = 0x803d0b04;
lbl_803d0b08 = 0x803d0b08;
lbl_803d0b0c = 0x803d0b0c;
lbl_803d0b14 = 0x803d0b14;
lbl_803d0b18 = 0x803d0b18;
lbl_80419eb8 = 0x80419eb8;
s8_property_read_800fc550 = 0x800fc550;
strcmp = 0x802ef234;
w3d_auto_800fc230 = 0x800fc230;
w3d_auto_800fc2b0 = 0x800fc2b0;
w3d_auto_80179598 = 0x80179598;
w3d_constructor_lookup_name = 0x800fc1b0;
w3d_empty_80341584 = 0x80341584;
w3d_k5b_iface_array_field_801ef174 = 0x801ef174;
w3d_s10_service_forward_8020b680 = 0x8020b680;
w3d_string_assign = 0x8020bd38;
w3d_string_base_finish = 0x8020c5c4;
w3d_string_base_init = 0x8020c5c0;
w3d_string_format = 0x8020c510;
w3d_string_header = 0x80341884;
w3d_string_release = 0x80341588;
w3d_string_release_header = 0x8020bb2c;
SECTIONS {
  .text.d27f_create_barracks_team_80297f7c 0x80297f7c : { *(.text.d27f_create_barracks_team_80297f7c) }
  /DISCARD/ : { *(.text*) *(.rodata*) *(.data*) *(.bss*) *(.sdata*) *(.sbss*) *(.comment) }
}
