/* Generated reference-only placements. All bodies are source-built. */
OUTPUT_FORMAT("elf32-powerpc")
OUTPUT_ARCH(powerpc)
ENTRY(d40i_random_grid_rename_8012f180)
_SDA_BASE_ = 0x804b2540;
_SDA2_BASE_ = 0x804c2540;
__11d40i_String = 0x803426b8;
__11d40i_StringPCc = 0x8020bb54;
d40i_changed_8039dc68 = 0x8039dc68;
d40i_empty_8039d9b0 = 0x8039d9b0;
d40i_play_sound_8039dc40 = 0x8039dc40;
d40i_random_80161080 = 0x80161080;
d40i_release_header_8020bb2c = 0x8020bb2c;
d40i_string_finish_8020c5c4 = 0x8020c5c4;
d40i_string_format_8020c510 = 0x8020c510;
d40i_string_release_80341588 = 0x80341588;
strcmp = 0x802ef234;
SECTIONS {
  .text.d40i_random_grid_rename_8012f180 0x8012f180 : { *(.text.d40i_random_grid_rename_8012f180) }
  /DISCARD/ : { *(.text*) *(.rodata*) *(.data*) *(.bss*) *(.sdata*) *(.sbss*) *(.comment) }
}
