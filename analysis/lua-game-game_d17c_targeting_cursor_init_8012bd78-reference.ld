/* Generated reference-only placements. All bodies are source-built. */
OUTPUT_FORMAT("elf32-powerpc")
OUTPUT_ARCH(powerpc)
ENTRY(d17c_targeting_cursor_init_8012bd78)
_SDA_BASE_ = 0x804b2540;
_SDA2_BASE_ = 0x804c2540;
__20d17c_String_8020bb54PCc = 0x8020bb54;
d17c_as_node_8034357c = 0x8034357c;
d17c_camera_mode_8039d388 = 0x8039d388;
d17c_cursor_mesh_8039d39c = 0x8039d39c;
d17c_cursor_scale_8039d3b0 = 0x8039d3b0;
d17c_handle_load_8015adf4 = 0x8015adf4;
d17c_node_set_colour_80173df0 = 0x80173df0;
d17c_read_float_800fc270 = 0x800fc270;
d17c_read_int_800fc1b0 = 0x800fc1b0;
d17c_string_finish_8020c5c4 = 0x8020c5c4;
d17c_string_release_80341588 = 0x80341588;
d17c_vec3_zero_8045e788 = 0x8045e788;
SECTIONS {
  .text.d17c_targeting_cursor_init_8012bd78 0x8012bd78 : { *(.text.d17c_targeting_cursor_init_8012bd78) }
  /DISCARD/ : { *(.text*) *(.rodata*) *(.data*) *(.bss*) *(.sdata*) *(.sbss*) *(.comment) }
}
