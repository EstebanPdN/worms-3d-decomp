/* Generated reference-only placements. All bodies are source-built. */
OUTPUT_FORMAT("elf32-powerpc")
OUTPUT_ARCH(powerpc)
ENTRY(w3d_address_801b9858)
_SDA_BASE_ = 0x804b2540;
_SDA2_BASE_ = 0x804c2540;
w3d_global_803631f4 = 0x803631f4;
w3d_global_80363244 = 0x80363244;
w3d_global_80363294 = 0x80363294;
w3d_global_803632e4 = 0x803632e4;
w3d_global_80363334 = 0x80363334;
w3d_global_80363384 = 0x80363384;
w3d_global_803633d4 = 0x803633d4;
w3d_global_80363424 = 0x80363424;
w3d_global_80363474 = 0x80363474;
w3d_global_803634c4 = 0x803634c4;
w3d_global_80363514 = 0x80363514;
w3d_global_80363564 = 0x80363564;
w3d_global_803635b4 = 0x803635b4;
w3d_global_80363604 = 0x80363604;
w3d_global_80363654 = 0x80363654;
w3d_global_803636a4 = 0x803636a4;
w3d_global_803636f4 = 0x803636f4;
w3d_global_80363744 = 0x80363744;
w3d_global_80363794 = 0x80363794;
w3d_global_803637e4 = 0x803637e4;
w3d_global_80363834 = 0x80363834;
w3d_global_80363884 = 0x80363884;
w3d_global_803638d4 = 0x803638d4;
w3d_global_80363924 = 0x80363924;
w3d_global_80363974 = 0x80363974;
w3d_global_803639c4 = 0x803639c4;
w3d_global_80363a14 = 0x80363a14;
w3d_global_80363a64 = 0x80363a64;
w3d_global_80363ab4 = 0x80363ab4;
w3d_global_80363b04 = 0x80363b04;
w3d_global_80363b54 = 0x80363b54;
w3d_global_80363ba4 = 0x80363ba4;
w3d_global_80363bf4 = 0x80363bf4;
w3d_global_80363c44 = 0x80363c44;
w3d_global_80363c94 = 0x80363c94;
w3d_global_80363ce4 = 0x80363ce4;
w3d_global_80363d34 = 0x80363d34;
w3d_global_80363d84 = 0x80363d84;
w3d_global_80363dd4 = 0x80363dd4;
w3d_global_80363e24 = 0x80363e24;
w3d_owner_list_remove = 0x8020fd2c;
w3d_registry_list_803631f4 = 0x803631f4;
w3d_registry_list_80363244 = 0x80363244;
w3d_registry_list_80363294 = 0x80363294;
w3d_registry_list_803632e4 = 0x803632e4;
w3d_registry_list_80363334 = 0x80363334;
w3d_registry_list_80363384 = 0x80363384;
w3d_registry_list_803633d4 = 0x803633d4;
w3d_registry_list_80363424 = 0x80363424;
w3d_registry_list_80363474 = 0x80363474;
w3d_registry_list_803634c4 = 0x803634c4;
w3d_registry_list_80363514 = 0x80363514;
w3d_registry_list_80363564 = 0x80363564;
w3d_registry_list_803635b4 = 0x803635b4;
w3d_registry_list_80363604 = 0x80363604;
w3d_registry_list_80363654 = 0x80363654;
w3d_registry_list_803636a4 = 0x803636a4;
w3d_registry_list_803636f4 = 0x803636f4;
w3d_registry_list_80363744 = 0x80363744;
w3d_registry_list_80363794 = 0x80363794;
w3d_registry_list_803637e4 = 0x803637e4;
w3d_registry_list_80363834 = 0x80363834;
w3d_registry_list_80363884 = 0x80363884;
w3d_registry_list_803638d4 = 0x803638d4;
w3d_registry_list_80363924 = 0x80363924;
w3d_registry_list_80363974 = 0x80363974;
w3d_registry_list_803639c4 = 0x803639c4;
w3d_registry_list_80363a14 = 0x80363a14;
w3d_registry_list_80363a64 = 0x80363a64;
w3d_registry_list_80363ab4 = 0x80363ab4;
w3d_registry_list_80363b04 = 0x80363b04;
w3d_registry_list_80363b54 = 0x80363b54;
w3d_registry_list_80363ba4 = 0x80363ba4;
w3d_registry_list_80363bf4 = 0x80363bf4;
w3d_registry_list_80363c44 = 0x80363c44;
w3d_registry_list_80363c94 = 0x80363c94;
w3d_registry_list_80363ce4 = 0x80363ce4;
w3d_registry_list_80363d34 = 0x80363d34;
w3d_registry_list_80363d84 = 0x80363d84;
w3d_registry_list_80363dd4 = 0x80363dd4;
w3d_registry_list_80363e24 = 0x80363e24;
SECTIONS {
  .text.w3d_address_801b9858 0x801b9858 : { *(.text.w3d_address_801b9858) }
  .text.w3d_registry_unlink_801b98cc 0x801b98cc : { *(.text.w3d_registry_unlink_801b98cc) }
  .text.w3d_address_801b9b74 0x801b9b74 : { *(.text.w3d_address_801b9b74) }
  .text.w3d_registry_unlink_801b9be8 0x801b9be8 : { *(.text.w3d_registry_unlink_801b9be8) }
  .text.w3d_address_801b9dbc 0x801b9dbc : { *(.text.w3d_address_801b9dbc) }
  .text.w3d_registry_unlink_801b9e30 0x801b9e30 : { *(.text.w3d_registry_unlink_801b9e30) }
  .text.w3d_address_801b9f48 0x801b9f48 : { *(.text.w3d_address_801b9f48) }
  .text.w3d_registry_unlink_801b9fbc 0x801b9fbc : { *(.text.w3d_registry_unlink_801b9fbc) }
  .text.w3d_address_801ba190 0x801ba190 : { *(.text.w3d_address_801ba190) }
  .text.w3d_registry_unlink_801ba204 0x801ba204 : { *(.text.w3d_registry_unlink_801ba204) }
  .text.w3d_address_801ba3d8 0x801ba3d8 : { *(.text.w3d_address_801ba3d8) }
  .text.w3d_registry_unlink_801ba44c 0x801ba44c : { *(.text.w3d_registry_unlink_801ba44c) }
  .text.w3d_address_801ba620 0x801ba620 : { *(.text.w3d_address_801ba620) }
  .text.w3d_registry_unlink_801ba694 0x801ba694 : { *(.text.w3d_registry_unlink_801ba694) }
  .text.w3d_address_801ba868 0x801ba868 : { *(.text.w3d_address_801ba868) }
  .text.w3d_registry_unlink_801ba8dc 0x801ba8dc : { *(.text.w3d_registry_unlink_801ba8dc) }
  .text.w3d_address_801baab0 0x801baab0 : { *(.text.w3d_address_801baab0) }
  .text.w3d_registry_unlink_801bab24 0x801bab24 : { *(.text.w3d_registry_unlink_801bab24) }
  .text.w3d_address_801bac94 0x801bac94 : { *(.text.w3d_address_801bac94) }
  .text.w3d_registry_unlink_801bad08 0x801bad08 : { *(.text.w3d_registry_unlink_801bad08) }
  .text.w3d_address_801baee8 0x801baee8 : { *(.text.w3d_address_801baee8) }
  .text.w3d_registry_unlink_801baf5c 0x801baf5c : { *(.text.w3d_registry_unlink_801baf5c) }
  .text.w3d_address_801bb130 0x801bb130 : { *(.text.w3d_address_801bb130) }
  .text.w3d_registry_unlink_801bb1a4 0x801bb1a4 : { *(.text.w3d_registry_unlink_801bb1a4) }
  .text.w3d_address_801bb378 0x801bb378 : { *(.text.w3d_address_801bb378) }
  .text.w3d_registry_unlink_801bb3ec 0x801bb3ec : { *(.text.w3d_registry_unlink_801bb3ec) }
  .text.w3d_address_801bb5c0 0x801bb5c0 : { *(.text.w3d_address_801bb5c0) }
  .text.w3d_registry_unlink_801bb634 0x801bb634 : { *(.text.w3d_registry_unlink_801bb634) }
  .text.w3d_address_801bb824 0x801bb824 : { *(.text.w3d_address_801bb824) }
  .text.w3d_registry_unlink_801bb898 0x801bb898 : { *(.text.w3d_registry_unlink_801bb898) }
  .text.w3d_address_801bba74 0x801bba74 : { *(.text.w3d_address_801bba74) }
  .text.w3d_registry_unlink_801bbae8 0x801bbae8 : { *(.text.w3d_registry_unlink_801bbae8) }
  .text.w3d_address_801bbc00 0x801bbc00 : { *(.text.w3d_address_801bbc00) }
  .text.w3d_registry_unlink_801bbc74 0x801bbc74 : { *(.text.w3d_registry_unlink_801bbc74) }
  .text.w3d_address_801bbe50 0x801bbe50 : { *(.text.w3d_address_801bbe50) }
  .text.w3d_registry_unlink_801bbec4 0x801bbec4 : { *(.text.w3d_registry_unlink_801bbec4) }
  .text.w3d_address_801bc0a0 0x801bc0a0 : { *(.text.w3d_address_801bc0a0) }
  .text.w3d_registry_unlink_801bc114 0x801bc114 : { *(.text.w3d_registry_unlink_801bc114) }
  .text.w3d_address_801bc2dc 0x801bc2dc : { *(.text.w3d_address_801bc2dc) }
  .text.w3d_registry_unlink_801bc350 0x801bc350 : { *(.text.w3d_registry_unlink_801bc350) }
  .text.w3d_address_801bc480 0x801bc480 : { *(.text.w3d_address_801bc480) }
  .text.w3d_registry_unlink_801bc4f4 0x801bc4f4 : { *(.text.w3d_registry_unlink_801bc4f4) }
  .text.w3d_address_801bc60c 0x801bc60c : { *(.text.w3d_address_801bc60c) }
  .text.w3d_registry_unlink_801bc680 0x801bc680 : { *(.text.w3d_registry_unlink_801bc680) }
  .text.w3d_address_801bc88c 0x801bc88c : { *(.text.w3d_address_801bc88c) }
  .text.w3d_registry_unlink_801bc900 0x801bc900 : { *(.text.w3d_registry_unlink_801bc900) }
  .text.w3d_address_801bca54 0x801bca54 : { *(.text.w3d_address_801bca54) }
  .text.w3d_registry_unlink_801bcac8 0x801bcac8 : { *(.text.w3d_registry_unlink_801bcac8) }
  .text.w3d_address_801bcd08 0x801bcd08 : { *(.text.w3d_address_801bcd08) }
  .text.w3d_registry_unlink_801bcd7c 0x801bcd7c : { *(.text.w3d_registry_unlink_801bcd7c) }
  .text.w3d_address_801bcf34 0x801bcf34 : { *(.text.w3d_address_801bcf34) }
  .text.w3d_registry_unlink_801bcfa8 0x801bcfa8 : { *(.text.w3d_registry_unlink_801bcfa8) }
  .text.w3d_address_801bd160 0x801bd160 : { *(.text.w3d_address_801bd160) }
  .text.w3d_registry_unlink_801bd1d4 0x801bd1d4 : { *(.text.w3d_registry_unlink_801bd1d4) }
  .text.w3d_address_801bd2c8 0x801bd2c8 : { *(.text.w3d_address_801bd2c8) }
  .text.w3d_registry_unlink_801bd33c 0x801bd33c : { *(.text.w3d_registry_unlink_801bd33c) }
  .text.w3d_address_801bd458 0x801bd458 : { *(.text.w3d_address_801bd458) }
  .text.w3d_registry_unlink_801bd4cc 0x801bd4cc : { *(.text.w3d_registry_unlink_801bd4cc) }
  .text.w3d_address_801bd600 0x801bd600 : { *(.text.w3d_address_801bd600) }
  .text.w3d_registry_unlink_801bd674 0x801bd674 : { *(.text.w3d_registry_unlink_801bd674) }
  .text.w3d_address_801bd8a8 0x801bd8a8 : { *(.text.w3d_address_801bd8a8) }
  .text.w3d_registry_unlink_801bd91c 0x801bd91c : { *(.text.w3d_registry_unlink_801bd91c) }
  .text.w3d_address_801bdaf0 0x801bdaf0 : { *(.text.w3d_address_801bdaf0) }
  .text.w3d_registry_unlink_801bdb64 0x801bdb64 : { *(.text.w3d_registry_unlink_801bdb64) }
  .text.w3d_address_801bdd38 0x801bdd38 : { *(.text.w3d_address_801bdd38) }
  .text.w3d_registry_unlink_801bddac 0x801bddac : { *(.text.w3d_registry_unlink_801bddac) }
  .text.w3d_address_801bdf2c 0x801bdf2c : { *(.text.w3d_address_801bdf2c) }
  .text.w3d_registry_unlink_801bdfa0 0x801bdfa0 : { *(.text.w3d_registry_unlink_801bdfa0) }
  .text.w3d_address_801be094 0x801be094 : { *(.text.w3d_address_801be094) }
  .text.w3d_registry_unlink_801be108 0x801be108 : { *(.text.w3d_registry_unlink_801be108) }
  .text.w3d_address_801be270 0x801be270 : { *(.text.w3d_address_801be270) }
  .text.w3d_registry_unlink_801be2e4 0x801be2e4 : { *(.text.w3d_registry_unlink_801be2e4) }
  .text.w3d_address_801be41c 0x801be41c : { *(.text.w3d_address_801be41c) }
  .text.w3d_registry_unlink_801be490 0x801be490 : { *(.text.w3d_registry_unlink_801be490) }
  .text.w3d_address_801be678 0x801be678 : { *(.text.w3d_address_801be678) }
  .text.w3d_registry_unlink_801be6ec 0x801be6ec : { *(.text.w3d_registry_unlink_801be6ec) }
  .text.w3d_address_801be9e0 0x801be9e0 : { *(.text.w3d_address_801be9e0) }
  .text.w3d_registry_unlink_801bea54 0x801bea54 : { *(.text.w3d_registry_unlink_801bea54) }
  .text.w3d_address_801bef80 0x801bef80 : { *(.text.w3d_address_801bef80) }
  .text.w3d_registry_unlink_801beff4 0x801beff4 : { *(.text.w3d_registry_unlink_801beff4) }
  /DISCARD/ : { *(.text*) *(.rodata*) *(.data*) *(.bss*) *(.sdata*) *(.sbss*) *(.comment) }
}
