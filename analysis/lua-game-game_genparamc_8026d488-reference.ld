/* Generated reference-only placements. All bodies are source-built. */
OUTPUT_FORMAT("elf32-powerpc")
OUTPUT_ARCH(powerpc)
ENTRY(w3d_set_triple_notify_8026d488)
_SDA_BASE_ = 0x804b2540;
_SDA2_BASE_ = 0x804c2540;
SECTIONS {
  .text.w3d_set_triple_notify_8026d488 0x8026d488 : { *(.text.w3d_set_triple_notify_8026d488) }
  .text.w3d_set_triple_notify_8026d524 0x8026d524 : { *(.text.w3d_set_triple_notify_8026d524) }
  /DISCARD/ : { *(.text*) *(.rodata*) *(.data*) *(.bss*) *(.sdata*) *(.sbss*) *(.comment) }
}
