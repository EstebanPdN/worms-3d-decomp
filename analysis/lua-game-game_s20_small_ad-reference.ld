/* Generated reference-only placements. All bodies are source-built. */
OUTPUT_FORMAT("elf32-powerpc")
OUTPUT_ARCH(powerpc)
ENTRY(w3d_s20_apply_if_enabled_8016b384)
_SDA_BASE_ = 0x804b2540;
_SDA2_BASE_ = 0x804c2540;
fn_8016ac3c = 0x8016ac3c;
fn_8016acac = 0x8016acac;
fn_803089c8 = 0x803089c8;
SECTIONS {
  .text.w3d_s20_apply_if_enabled_8016b384 0x8016b384 : { *(.text.w3d_s20_apply_if_enabled_8016b384) }
  /DISCARD/ : { *(.text*) *(.rodata*) *(.data*) *(.bss*) *(.sdata*) *(.sbss*) *(.comment) }
}
