/* Generated reference-only placements. All bodies are source-built. */
OUTPUT_FORMAT("elf32-powerpc")
OUTPUT_ARCH(powerpc)
ENTRY(w3d_f5a_show_wormpot_edit_80273560)
_SDA_BASE_ = 0x804b2540;
_SDA2_BASE_ = 0x804c2540;
__13Text_803426b8 = 0x803426b8;
empty_803cc0d8 = 0x803cc0d8;
fn_8020c5c4 = 0x8020c5c4;
fn_8027a934 = 0x8027a934;
fn_802cbdf8 = 0x802cbdf8;
fn_802cbf2c = 0x802cbf2c;
fn_802cc0ac = 0x802cc0ac;
fn_802cd128 = 0x802cd128;
fn_802cd220 = 0x802cd220;
fn_802cd26c = 0x802cd26c;
fn_80341588 = 0x80341588;
help_803cc8b4 = 0x803cc8b4;
label_803ccc9c = 0x803ccc9c;
label_803cccbc = 0x803cccbc;
label_803cccdc = 0x803cccdc;
label_803cccfc = 0x803cccfc;
label_803ccd28 = 0x803ccd28;
label_803ccd48 = 0x803ccd48;
label_803ccd68 = 0x803ccd68;
label_803ccd88 = 0x803ccd88;
label_803ccda8 = 0x803ccda8;
label_803ccdc8 = 0x803ccdc8;
label_803ccde8 = 0x803ccde8;
line_803ccb48 = 0x803ccb48;
tips_803ccd1c = 0x803ccd1c;
title_803cc65c = 0x803cc65c;
SECTIONS {
  .text.w3d_f5a_show_wormpot_edit_80273560 0x80273560 : { *(.text.w3d_f5a_show_wormpot_edit_80273560) }
  /DISCARD/ : { *(.text*) *(.rodata*) *(.data*) *(.bss*) *(.sdata*) *(.sbss*) *(.comment) }
}
