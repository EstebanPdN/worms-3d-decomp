/* Generated reference-only placements. All bodies are source-built. */
OUTPUT_FORMAT("elf32-powerpc")
OUTPUT_ARCH(powerpc)
ENTRY(w3d_s12_create_member_binding_801eb674)
_SDA_BASE_ = 0x804b2540;
_SDA2_BASE_ = 0x804c2540;
fn_801e8bc4__FPvP18S12PropertyBinding = 0x801e8bc4;
fn_801eb058__FP18S12PropertyBinding = 0x801eb058;
fn_801eb0a8__FP18S12PropertyBindingP17S12PropertySource = 0x801eb0a8;
fn_801fe1d8__Fi = 0x801fe1d8;
lbl_804175d0 = 0x804175d0;
SECTIONS {
  .text.w3d_s12_create_member_binding_801eb674 0x801eb674 : { *(.text.w3d_s12_create_member_binding_801eb674) }
  /DISCARD/ : { *(.text*) *(.rodata*) *(.data*) *(.bss*) *(.sdata*) *(.sbss*) *(.comment) }
}
