/* Generated reference-only placements. All bodies are source-built. */
OUTPUT_FORMAT("elf32-powerpc")
OUTPUT_ARCH(powerpc)
ENTRY(w3d_f5a_show_add_item_80275cdc)
_SDA_BASE_ = 0x804b2540;
_SDA2_BASE_ = 0x804c2540;
__13Text_803426b8 = 0x803426b8;
fn_8020c5c4 = 0x8020c5c4;
fn_8027a934 = 0x8027a934;
fn_802cbdf8 = 0x802cbdf8;
fn_802cbf2c = 0x802cbf2c;
fn_802cc0ac = 0x802cc0ac;
fn_802cd128 = 0x802cd128;
fn_802cd220 = 0x802cd220;
fn_802cd26c = 0x802cd26c;
fn_80341588 = 0x80341588;
help_803cdba8 = 0x803cdba8;
text_803cc0d8 = 0x803cc0d8;
text_803cda44 = 0x803cda44;
text_803cda50 = 0x803cda50;
text_803cda5c = 0x803cda5c;
text_803cda68 = 0x803cda68;
text_803cda80 = 0x803cda80;
text_803cda90 = 0x803cda90;
text_803cda9c = 0x803cda9c;
text_803cdab0 = 0x803cdab0;
text_803cdac0 = 0x803cdac0;
text_803cdad0 = 0x803cdad0;
text_803cdae0 = 0x803cdae0;
text_803cdaf4 = 0x803cdaf4;
text_803cdb08 = 0x803cdb08;
text_803cdb1c = 0x803cdb1c;
text_803cdb30 = 0x803cdb30;
text_803cdb40 = 0x803cdb40;
text_803cdb54 = 0x803cdb54;
text_803cdb68 = 0x803cdb68;
text_803cdb7c = 0x803cdb7c;
text_803cdb94 = 0x803cdb94;
SECTIONS {
  .text.w3d_f5a_show_add_item_80275cdc 0x80275cdc : { *(.text.w3d_f5a_show_add_item_80275cdc) }
  /DISCARD/ : { *(.text*) *(.rodata*) *(.data*) *(.bss*) *(.sdata*) *(.sbss*) *(.comment) }
}
