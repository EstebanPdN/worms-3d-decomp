/* Generated reference-only placements. All bodies are source-built. */
OUTPUT_FORMAT("elf32-powerpc")
OUTPUT_ARCH(powerpc)
ENTRY(w3d_member_80230e6c)
_SDA_BASE_ = 0x804b2540;
_SDA2_BASE_ = 0x804c2540;
SECTIONS {
  .text.w3d_member_80230e6c 0x80230e6c : { *(.text.w3d_member_80230e6c) }
  .text.w3d_member_80230edc 0x80230edc : { *(.text.w3d_member_80230edc) }
  .text.w3d_member_80230f4c 0x80230f4c : { *(.text.w3d_member_80230f4c) }
  .text.w3d_member_80230fbc 0x80230fbc : { *(.text.w3d_member_80230fbc) }
  .text.w3d_copy12_80230fd4 0x80230fd4 : { *(.text.w3d_copy12_80230fd4) }
  .text.w3d_member_80230ff4 0x80230ff4 : { *(.text.w3d_member_80230ff4) }
  .text.w3d_copy12_80230ffc 0x80230ffc : { *(.text.w3d_copy12_80230ffc) }
  .text.w3d_member_8023101c 0x8023101c : { *(.text.w3d_member_8023101c) }
  .text.w3d_member_8023108c 0x8023108c : { *(.text.w3d_member_8023108c) }
  .text.w3d_member_802310fc 0x802310fc : { *(.text.w3d_member_802310fc) }
  .text.w3d_member_8023116c 0x8023116c : { *(.text.w3d_member_8023116c) }
  .text.w3d_member_802311dc 0x802311dc : { *(.text.w3d_member_802311dc) }
  .text.w3d_member_8023124c 0x8023124c : { *(.text.w3d_member_8023124c) }
  .text.w3d_member_802312bc 0x802312bc : { *(.text.w3d_member_802312bc) }
  .text.w3d_member_8023132c 0x8023132c : { *(.text.w3d_member_8023132c) }
  .text.w3d_member_802313ac 0x802313ac : { *(.text.w3d_member_802313ac) }
  .text.w3d_member_8023141c 0x8023141c : { *(.text.w3d_member_8023141c) }
  .text.w3d_member_8023148c 0x8023148c : { *(.text.w3d_member_8023148c) }
  .text.w3d_member_802314fc 0x802314fc : { *(.text.w3d_member_802314fc) }
  .text.w3d_member_8023156c 0x8023156c : { *(.text.w3d_member_8023156c) }
  .text.w3d_member_802315dc 0x802315dc : { *(.text.w3d_member_802315dc) }
  .text.w3d_setf_80231614 0x80231614 : { *(.text.w3d_setf_80231614) }
  .text.w3d_getf_8023161c 0x8023161c : { *(.text.w3d_getf_8023161c) }
  .text.w3d_setf_80231624 0x80231624 : { *(.text.w3d_setf_80231624) }
  .text.w3d_getf_8023162c 0x8023162c : { *(.text.w3d_getf_8023162c) }
  .text.w3d_member_8023169c 0x8023169c : { *(.text.w3d_member_8023169c) }
  .text.w3d_member_8023170c 0x8023170c : { *(.text.w3d_member_8023170c) }
  .text.w3d_member_8023177c 0x8023177c : { *(.text.w3d_member_8023177c) }
  .text.w3d_member_802317ec 0x802317ec : { *(.text.w3d_member_802317ec) }
  .text.w3d_member_8023185c 0x8023185c : { *(.text.w3d_member_8023185c) }
  .text.w3d_member_802318cc 0x802318cc : { *(.text.w3d_member_802318cc) }
  .text.w3d_member_8023196c 0x8023196c : { *(.text.w3d_member_8023196c) }
  .text.w3d_member_802319dc 0x802319dc : { *(.text.w3d_member_802319dc) }
  .text.w3d_member_80231a6c 0x80231a6c : { *(.text.w3d_member_80231a6c) }
  .text.w3d_member_80231adc 0x80231adc : { *(.text.w3d_member_80231adc) }
  .text.w3d_member_80231b4c 0x80231b4c : { *(.text.w3d_member_80231b4c) }
  .text.w3d_member_80231bbc 0x80231bbc : { *(.text.w3d_member_80231bbc) }
  .text.w3d_member_80231c2c 0x80231c2c : { *(.text.w3d_member_80231c2c) }
  .text.w3d_member_80231c9c 0x80231c9c : { *(.text.w3d_member_80231c9c) }
  .text.w3d_member_80231d2c 0x80231d2c : { *(.text.w3d_member_80231d2c) }
  .text.w3d_setf_80231d34 0x80231d34 : { *(.text.w3d_setf_80231d34) }
  .text.w3d_getf_80231d3c 0x80231d3c : { *(.text.w3d_getf_80231d3c) }
  .text.w3d_setf_80231d44 0x80231d44 : { *(.text.w3d_setf_80231d44) }
  .text.w3d_getf_80231d4c 0x80231d4c : { *(.text.w3d_getf_80231d4c) }
  .text.w3d_member_80231dec 0x80231dec : { *(.text.w3d_member_80231dec) }
  .text.w3d_member_80231e6c 0x80231e6c : { *(.text.w3d_member_80231e6c) }
  .text.w3d_setf_80231e74 0x80231e74 : { *(.text.w3d_setf_80231e74) }
  .text.w3d_getf_80231e7c 0x80231e7c : { *(.text.w3d_getf_80231e7c) }
  .text.w3d_member_80231f0c 0x80231f0c : { *(.text.w3d_member_80231f0c) }
  .text.w3d_member_802320b4 0x802320b4 : { *(.text.w3d_member_802320b4) }
  .text.w3d_member_80232124 0x80232124 : { *(.text.w3d_member_80232124) }
  .text.w3d_member_802321a4 0x802321a4 : { *(.text.w3d_member_802321a4) }
  .text.w3d_member_80232294 0x80232294 : { *(.text.w3d_member_80232294) }
  .text.w3d_member_80232304 0x80232304 : { *(.text.w3d_member_80232304) }
  .text.w3d_member_80232384 0x80232384 : { *(.text.w3d_member_80232384) }
  .text.w3d_member_802323f4 0x802323f4 : { *(.text.w3d_member_802323f4) }
  .text.w3d_member_80232464 0x80232464 : { *(.text.w3d_member_80232464) }
  .text.w3d_member_802324d4 0x802324d4 : { *(.text.w3d_member_802324d4) }
  .text.w3d_member_80232544 0x80232544 : { *(.text.w3d_member_80232544) }
  .text.w3d_member_802325b4 0x802325b4 : { *(.text.w3d_member_802325b4) }
  .text.w3d_member_80232654 0x80232654 : { *(.text.w3d_member_80232654) }
  .text.w3d_member_802326c4 0x802326c4 : { *(.text.w3d_member_802326c4) }
  .text.w3d_member_80232764 0x80232764 : { *(.text.w3d_member_80232764) }
  .text.w3d_member_802327d4 0x802327d4 : { *(.text.w3d_member_802327d4) }
  .text.w3d_member_80232854 0x80232854 : { *(.text.w3d_member_80232854) }
  .text.w3d_member_802328c4 0x802328c4 : { *(.text.w3d_member_802328c4) }
  .text.w3d_member_80232934 0x80232934 : { *(.text.w3d_member_80232934) }
  .text.w3d_member_802329a4 0x802329a4 : { *(.text.w3d_member_802329a4) }
  .text.w3d_member_80232a14 0x80232a14 : { *(.text.w3d_member_80232a14) }
  .text.w3d_member_80232a84 0x80232a84 : { *(.text.w3d_member_80232a84) }
  .text.w3d_member_80232b24 0x80232b24 : { *(.text.w3d_member_80232b24) }
  .text.w3d_member_80232b94 0x80232b94 : { *(.text.w3d_member_80232b94) }
  .text.w3d_member_80232c34 0x80232c34 : { *(.text.w3d_member_80232c34) }
  .text.w3d_member_80232ca4 0x80232ca4 : { *(.text.w3d_member_80232ca4) }
  .text.w3d_member_80232d24 0x80232d24 : { *(.text.w3d_member_80232d24) }
  .text.w3d_member_80232d94 0x80232d94 : { *(.text.w3d_member_80232d94) }
  .text.w3d_member_80232e04 0x80232e04 : { *(.text.w3d_member_80232e04) }
  .text.w3d_member_80232e74 0x80232e74 : { *(.text.w3d_member_80232e74) }
  .text.w3d_member_80232ee4 0x80232ee4 : { *(.text.w3d_member_80232ee4) }
  .text.w3d_member_80232f54 0x80232f54 : { *(.text.w3d_member_80232f54) }
  /DISCARD/ : { *(.text*) *(.rodata*) *(.data*) *(.bss*) *(.sdata*) *(.sbss*) *(.comment) }
}
