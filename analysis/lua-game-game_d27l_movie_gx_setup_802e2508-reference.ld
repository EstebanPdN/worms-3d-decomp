/* Generated reference-only placements. All bodies are source-built. */
OUTPUT_FORMAT("elf32-powerpc")
OUTPUT_ARCH(powerpc)
ENTRY(d27l_movie_gx_setup_802e2508)
_SDA_BASE_ = 0x804b2540;
_SDA2_BASE_ = 0x804c2540;
colour_803db3bc = 0x803db3bc;
fn_80302b60 = 0x80302b60;
fn_80302ec4 = 0x80302ec4;
fn_80306cd0 = 0x80306cd0;
fn_80307558 = 0x80307558;
fn_80307590 = 0x80307590;
fn_80307e24 = 0x80307e24;
fn_803080a4 = 0x803080a4;
fn_8030990c = 0x8030990c;
fn_8030a46c = 0x8030a46c;
fn_8030b014 = 0x8030b014;
fn_8030b058 = 0x8030b058;
fn_8030b09c = 0x8030b09c;
fn_8030b104 = 0x8030b104;
fn_8030b16c = 0x8030b16c;
fn_8030b1e8 = 0x8030b1e8;
fn_8030b25c = 0x8030b25c;
fn_8030b2b8 = 0x8030b2b8;
fn_8030b314 = 0x8030b314;
fn_8030b35c = 0x8030b35c;
fn_8030b3dc = 0x8030b3dc;
fn_8030b4ac = 0x8030b4ac;
fn_8030b648 = 0x8030b648;
fn_8030b9b8 = 0x8030b9b8;
fn_8030ba0c = 0x8030ba0c;
fn_8030ba38 = 0x8030ba38;
fn_8030ba64 = 0x8030ba64;
fn_8030ba98 = 0x8030ba98;
fn_8030bacc = 0x8030bacc;
fn_8030bec4 = 0x8030bec4;
fn_8030bff4 = 0x8030bff4;
fn_8030c094 = 0x8030c094;
fn_8030c264 = 0x8030c264;
fn_8030c2ac = 0x8030c2ac;
SECTIONS {
  .text.d27l_movie_gx_setup_802e2508 0x802e2508 : { *(.text.d27l_movie_gx_setup_802e2508) }
  .rodata 0x803db3c8 : { *(.rodata) }
  /DISCARD/ : { *(.text*) *(.rodata*) *(.data*) *(.bss*) *(.sdata*) *(.sbss*) *(.comment) }
}
