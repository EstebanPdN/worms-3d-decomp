/* Generated reference-only placements. All bodies are source-built. */
OUTPUT_FORMAT("elf32-powerpc")
OUTPUT_ARCH(powerpc)
ENTRY(w3d_d42n_buffer_manager_save_stream_80190aa8)
_SDA_BASE_ = 0x804b2540;
_SDA2_BASE_ = 0x804c2540;
__12Str_803426b8 = 0x803426b8;
__12Str_803426b8PCc = 0x8020bb54;
fn_8019800c = 0x8019800c;
fn_8019805c = 0x8019805c;
fn_8020bb2c = 0x8020bb2c;
fn_8020bf2c = 0x8020bf2c;
fn_8020c5c0 = 0x8020c5c0;
fn_8020c5c4 = 0x8020c5c4;
fn_80341588 = 0x80341588;
fn_80341884 = 0x80341884;
lbl_803a825c = 0x803a825c;
SECTIONS {
  .text.w3d_d42n_buffer_manager_save_stream_80190aa8 0x80190aa8 : { *(.text.w3d_d42n_buffer_manager_save_stream_80190aa8) }
  /DISCARD/ : { *(.text*) *(.rodata*) *(.data*) *(.bss*) *(.sdata*) *(.sbss*) *(.comment) }
}
