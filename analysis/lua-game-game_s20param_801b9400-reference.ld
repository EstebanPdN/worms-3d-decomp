/* Generated reference-only placements. All bodies are source-built. */
OUTPUT_FORMAT("elf32-powerpc")
OUTPUT_ARCH(powerpc)
ENTRY(w3d_s20reg4_801b9400)
_SDA_BASE_ = 0x804b2540;
_SDA2_BASE_ = 0x804c2540;
fn_801e8d9c = 0x801e8d9c;
fn_801f0624 = 0x801f0624;
fn_801f0b70 = 0x801f0b70;
lbl_803ab490 = 0x803ab490;
lbl_803ab4b4 = 0x803ab4b4;
lbl_803ab5e4 = 0x803ab5e4;
lbl_803ab608 = 0x803ab608;
SECTIONS {
  .text.w3d_s20reg4_801b9400 0x801b9400 : { *(.text.w3d_s20reg4_801b9400) }
  .text.w3d_s20reg4_801bac10 0x801bac10 : { *(.text.w3d_s20reg4_801bac10) }
  /DISCARD/ : { *(.text*) *(.rodata*) *(.data*) *(.bss*) *(.sdata*) *(.sbss*) *(.comment) }
}
