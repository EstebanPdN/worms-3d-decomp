/* Generated reference-only placements. All bodies are source-built. */
OUTPUT_FORMAT("elf32-powerpc")
OUTPUT_ARCH(powerpc)
ENTRY(w3d_offset_item_vector_802c4998)
_SDA_BASE_ = 0x804b2540;
_SDA2_BASE_ = 0x804c2540;
fn_8018c8bc = 0x8018c8bc;
fn_8018c938 = 0x8018c938;
fn_80343580 = 0x80343580;
offset_803d87ec = 0x803d87ec;
scale_803d87e8 = 0x803d87e8;
value_803d87e4 = 0x803d87e4;
SECTIONS {
  .text.w3d_offset_item_vector_802c4998 0x802c4998 : { *(.text.w3d_offset_item_vector_802c4998) }
  /DISCARD/ : { *(.text*) *(.rodata*) *(.data*) *(.bss*) *(.sdata*) *(.sbss*) *(.comment) }
}
