/* Generated reference-only placements. All bodies are source-built. */
OUTPUT_FORMAT("elf32-powerpc")
OUTPUT_ARCH(powerpc)
ENTRY(w3d_cx9c_binary_name_find_80347194)
_SDA_BASE_ = 0x804b2540;
_SDA2_BASE_ = 0x804c2540;
cx9c_name_greater_8010e698 = 0x8010e698;
cx9c_strcmp_802ef234 = 0x802ef234;
SECTIONS {
  .text.w3d_cx9c_binary_name_find_80347194 0x80347194 : { *(.text.w3d_cx9c_binary_name_find_80347194) }
  /DISCARD/ : { *(.text*) *(.rodata*) *(.data*) *(.bss*) *(.sdata*) *(.sbss*) *(.comment) }
}
