/* Generated reference-only placements. All bodies are source-built. */
OUTPUT_FORMAT("elf32-powerpc")
OUTPUT_ARCH(powerpc)
ENTRY(w3d_s20_apply_two_textures_8016a72c)
_SDA_BASE_ = 0x804b2540;
_SDA2_BASE_ = 0x804c2540;
fn_8016c014 = 0x8016c014;
fn_8016c07c = 0x8016c07c;
fn_8016c1f4 = 0x8016c1f4;
fn_801a2bf4 = 0x801a2bf4;
fn_803080a4 = 0x803080a4;
fn_8030b014 = 0x8030b014;
fn_8030b09c = 0x8030b09c;
fn_8030b4ac = 0x8030b4ac;
fn_8030b648 = 0x8030b648;
SECTIONS {
  .text.w3d_s20_apply_two_textures_8016a72c 0x8016a72c : { *(.text.w3d_s20_apply_two_textures_8016a72c) }
  /DISCARD/ : { *(.text*) *(.rodata*) *(.data*) *(.bss*) *(.sdata*) *(.sbss*) *(.comment) }
}
