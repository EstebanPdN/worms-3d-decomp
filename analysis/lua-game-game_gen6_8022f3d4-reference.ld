/* Generated reference-only placements. All bodies are source-built. */
OUTPUT_FORMAT("elf32-powerpc")
OUTPUT_ARCH(powerpc)
ENTRY(w3d_member_8022f3d4)
_SDA_BASE_ = 0x804b2540;
_SDA2_BASE_ = 0x804c2540;
SECTIONS {
  .text.w3d_member_8022f3d4 0x8022f3d4 : { *(.text.w3d_member_8022f3d4) }
  .text.w3d_member_8022f444 0x8022f444 : { *(.text.w3d_member_8022f444) }
  .text.w3d_member_8022f4b4 0x8022f4b4 : { *(.text.w3d_member_8022f4b4) }
  .text.w3d_member_8022f524 0x8022f524 : { *(.text.w3d_member_8022f524) }
  .text.w3d_member_8022f594 0x8022f594 : { *(.text.w3d_member_8022f594) }
  .text.w3d_member_8022f604 0x8022f604 : { *(.text.w3d_member_8022f604) }
  .text.w3d_member_8022f674 0x8022f674 : { *(.text.w3d_member_8022f674) }
  .text.w3d_member_8022f6e4 0x8022f6e4 : { *(.text.w3d_member_8022f6e4) }
  .text.w3d_setf_8022f71c 0x8022f71c : { *(.text.w3d_setf_8022f71c) }
  .text.w3d_getf_8022f724 0x8022f724 : { *(.text.w3d_getf_8022f724) }
  .text.w3d_member_8022f7a4 0x8022f7a4 : { *(.text.w3d_member_8022f7a4) }
  .text.w3d_member_8022f814 0x8022f814 : { *(.text.w3d_member_8022f814) }
  .text.w3d_member_8022f894 0x8022f894 : { *(.text.w3d_member_8022f894) }
  .text.w3d_member_8022f904 0x8022f904 : { *(.text.w3d_member_8022f904) }
  .text.w3d_setf_8022f90c 0x8022f90c : { *(.text.w3d_setf_8022f90c) }
  .text.w3d_getf_8022f914 0x8022f914 : { *(.text.w3d_getf_8022f914) }
  .text.w3d_member_8022f984 0x8022f984 : { *(.text.w3d_member_8022f984) }
  .text.w3d_member_8022f9f4 0x8022f9f4 : { *(.text.w3d_member_8022f9f4) }
  .text.w3d_member_8022fa64 0x8022fa64 : { *(.text.w3d_member_8022fa64) }
  .text.w3d_member_8022fad4 0x8022fad4 : { *(.text.w3d_member_8022fad4) }
  .text.w3d_member_8022fb44 0x8022fb44 : { *(.text.w3d_member_8022fb44) }
  .text.w3d_member_8022fbb4 0x8022fbb4 : { *(.text.w3d_member_8022fbb4) }
  .text.w3d_member_8022fbc8 0x8022fbc8 : { *(.text.w3d_member_8022fbc8) }
  .text.w3d_setf_8022fbf0 0x8022fbf0 : { *(.text.w3d_setf_8022fbf0) }
  .text.w3d_getf_8022fbf8 0x8022fbf8 : { *(.text.w3d_getf_8022fbf8) }
  .text.w3d_member_8022fc68 0x8022fc68 : { *(.text.w3d_member_8022fc68) }
  .text.w3d_member_8022fcd8 0x8022fcd8 : { *(.text.w3d_member_8022fcd8) }
  .text.w3d_member_8022fd48 0x8022fd48 : { *(.text.w3d_member_8022fd48) }
  .text.w3d_member_8022fdb8 0x8022fdb8 : { *(.text.w3d_member_8022fdb8) }
  .text.w3d_member_8022fe28 0x8022fe28 : { *(.text.w3d_member_8022fe28) }
  .text.w3d_member_8022fe98 0x8022fe98 : { *(.text.w3d_member_8022fe98) }
  .text.w3d_member_8022ff08 0x8022ff08 : { *(.text.w3d_member_8022ff08) }
  .text.w3d_member_8022ff78 0x8022ff78 : { *(.text.w3d_member_8022ff78) }
  .text.w3d_member_8022ffe8 0x8022ffe8 : { *(.text.w3d_member_8022ffe8) }
  .text.w3d_member_80230058 0x80230058 : { *(.text.w3d_member_80230058) }
  .text.w3d_member_802300c8 0x802300c8 : { *(.text.w3d_member_802300c8) }
  .text.w3d_member_80230138 0x80230138 : { *(.text.w3d_member_80230138) }
  .text.w3d_member_802301a8 0x802301a8 : { *(.text.w3d_member_802301a8) }
  .text.w3d_member_80230218 0x80230218 : { *(.text.w3d_member_80230218) }
  .text.w3d_member_80230288 0x80230288 : { *(.text.w3d_member_80230288) }
  .text.w3d_member_80230308 0x80230308 : { *(.text.w3d_member_80230308) }
  .text.w3d_member_80230378 0x80230378 : { *(.text.w3d_member_80230378) }
  .text.w3d_member_802303e8 0x802303e8 : { *(.text.w3d_member_802303e8) }
  .text.w3d_member_80230458 0x80230458 : { *(.text.w3d_member_80230458) }
  .text.w3d_member_802304c8 0x802304c8 : { *(.text.w3d_member_802304c8) }
  .text.w3d_member_80230578 0x80230578 : { *(.text.w3d_member_80230578) }
  .text.w3d_member_802305e8 0x802305e8 : { *(.text.w3d_member_802305e8) }
  .text.w3d_member_80230658 0x80230658 : { *(.text.w3d_member_80230658) }
  .text.w3d_setf_80230680 0x80230680 : { *(.text.w3d_setf_80230680) }
  .text.w3d_getf_80230688 0x80230688 : { *(.text.w3d_getf_80230688) }
  .text.w3d_member_802306bc 0x802306bc : { *(.text.w3d_member_802306bc) }
  .text.w3d_member_8023073c 0x8023073c : { *(.text.w3d_member_8023073c) }
  .text.w3d_member_802307ac 0x802307ac : { *(.text.w3d_member_802307ac) }
  .text.w3d_setf_802307e4 0x802307e4 : { *(.text.w3d_setf_802307e4) }
  .text.w3d_getf_802307ec 0x802307ec : { *(.text.w3d_getf_802307ec) }
  .text.w3d_member_8023087c 0x8023087c : { *(.text.w3d_member_8023087c) }
  .text.w3d_member_802308ec 0x802308ec : { *(.text.w3d_member_802308ec) }
  .text.w3d_member_8023095c 0x8023095c : { *(.text.w3d_member_8023095c) }
  .text.w3d_member_802309cc 0x802309cc : { *(.text.w3d_member_802309cc) }
  .text.w3d_setf_80230a14 0x80230a14 : { *(.text.w3d_setf_80230a14) }
  .text.w3d_getf_80230a1c 0x80230a1c : { *(.text.w3d_getf_80230a1c) }
  .text.w3d_setf_80230a24 0x80230a24 : { *(.text.w3d_setf_80230a24) }
  .text.w3d_getf_80230a2c 0x80230a2c : { *(.text.w3d_getf_80230a2c) }
  .text.w3d_member_80230abc 0x80230abc : { *(.text.w3d_member_80230abc) }
  .text.w3d_member_80230b2c 0x80230b2c : { *(.text.w3d_member_80230b2c) }
  .text.w3d_member_80230b9c 0x80230b9c : { *(.text.w3d_member_80230b9c) }
  .text.w3d_member_80230c0c 0x80230c0c : { *(.text.w3d_member_80230c0c) }
  .text.w3d_member_80230c7c 0x80230c7c : { *(.text.w3d_member_80230c7c) }
  .text.w3d_setf_80230cc4 0x80230cc4 : { *(.text.w3d_setf_80230cc4) }
  .text.w3d_getf_80230ccc 0x80230ccc : { *(.text.w3d_getf_80230ccc) }
  .text.w3d_setf_80230cd4 0x80230cd4 : { *(.text.w3d_setf_80230cd4) }
  .text.w3d_getf_80230cdc 0x80230cdc : { *(.text.w3d_getf_80230cdc) }
  .text.w3d_setf_80230ce4 0x80230ce4 : { *(.text.w3d_setf_80230ce4) }
  .text.w3d_getf_80230cec 0x80230cec : { *(.text.w3d_getf_80230cec) }
  .text.w3d_setf_80230cf4 0x80230cf4 : { *(.text.w3d_setf_80230cf4) }
  .text.w3d_getf_80230cfc 0x80230cfc : { *(.text.w3d_getf_80230cfc) }
  .text.w3d_member_80230d6c 0x80230d6c : { *(.text.w3d_member_80230d6c) }
  .text.w3d_member_80230ddc 0x80230ddc : { *(.text.w3d_member_80230ddc) }
  .text.w3d_setf_80230df4 0x80230df4 : { *(.text.w3d_setf_80230df4) }
  .text.w3d_getf_80230dfc 0x80230dfc : { *(.text.w3d_getf_80230dfc) }
  /DISCARD/ : { *(.text*) *(.rodata*) *(.data*) *(.bss*) *(.sdata*) *(.sbss*) *(.comment) }
}
