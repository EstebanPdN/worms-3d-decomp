/* Generated reference-only placements. All bodies are source-built. */
OUTPUT_FORMAT("elf32-powerpc")
OUTPUT_ARCH(powerpc)
ENTRY(w3d_cx9c_apply_actor_types_8034ad50)
_SDA_BASE_ = 0x804b2540;
_SDA2_BASE_ = 0x804c2540;
cx9c_first_8020fe00 = 0x8020fe00;
cx9c_next_8020fe18 = 0x8020fe18;
cx9c_types_8020ff3c = 0x8020ff3c;
SECTIONS {
  .text.w3d_cx9c_apply_actor_types_8034ad50 0x8034ad50 : { *(.text.w3d_cx9c_apply_actor_types_8034ad50) }
  /DISCARD/ : { *(.text*) *(.rodata*) *(.data*) *(.bss*) *(.sdata*) *(.sbss*) *(.comment) }
}
