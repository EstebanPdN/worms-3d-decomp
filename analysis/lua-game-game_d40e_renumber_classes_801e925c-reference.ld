/* Generated reference-only placements. All bodies are source-built. */
OUTPUT_FORMAT("elf32-powerpc")
OUTPUT_ARCH(powerpc)
ENTRY(w3d_d40e_renumber_classes_801e925c)
_SDA_BASE_ = 0x804b2540;
_SDA2_BASE_ = 0x804c2540;
f5c_search_801e8ff8 = 0x801e8ff8;
free_802134fc = 0x802134fc;
lbl_8045e080 = 0x8045e080;
malloc = 0x80212fd4;
memcpy_802eee50 = 0x802eee50;
memmove_802eeef4 = 0x802eeef4;
w3d_auto_801e80f0 = 0x801e80f0;
w3d_d24k_heap_resize_80213750 = 0x80213750;
w3d_find_80356934 = 0x80356934;
w3d_local_static_801ea954 = 0x801ea954;
w3d_s21_set_class_801e9090 = 0x801e9090;
SECTIONS {
  .text.w3d_d40e_renumber_classes_801e925c 0x801e925c : { *(.text.w3d_d40e_renumber_classes_801e925c) }
  /DISCARD/ : { *(.text*) *(.rodata*) *(.data*) *(.bss*) *(.sdata*) *(.sbss*) *(.comment) }
}
