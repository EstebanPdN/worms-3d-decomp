/* Generated reference-only placements. All bodies are source-built. */
OUTPUT_FORMAT("elf32-powerpc")
OUTPUT_ARCH(powerpc)
ENTRY(f6b_take_lowest_cost_80005858)
_SDA_BASE_ = 0x804b2540;
_SDA2_BASE_ = 0x804c2540;
fn_8000553c = 0x8000553c;
SECTIONS {
  .text.f6b_take_lowest_cost_80005858 0x80005858 : { *(.text.f6b_take_lowest_cost_80005858) }
  /DISCARD/ : { *(.text*) *(.rodata*) *(.data*) *(.bss*) *(.sdata*) *(.sbss*) *(.comment) }
}
