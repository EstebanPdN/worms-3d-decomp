/* Generated reference-only placements. All bodies are source-built. */
OUTPUT_FORMAT("elf32-powerpc")
OUTPUT_ARCH(powerpc)
ENTRY(w3d_k7a_quintet_create_8002d778)
_SDA_BASE_ = 0x804b2540;
_SDA2_BASE_ = 0x804c2540;
w3d_cx13a_initialize_property_owner_8004db14 = 0x8004db14;
w3d_heap_allocate_entry_a = 0x801fe1d8;
w3d_state_class_8035fdc0 = 0x8035fdc0;
w3d_state_register = 0x8020fd04;
w3d_vtable_8040e430 = 0x8040e430;
SECTIONS {
  .text.w3d_k7a_quintet_create_8002d778 0x8002d778 : { *(.text.w3d_k7a_quintet_create_8002d778) }
  /DISCARD/ : { *(.text*) *(.rodata*) *(.data*) *(.bss*) *(.sdata*) *(.sbss*) *(.comment) }
}
