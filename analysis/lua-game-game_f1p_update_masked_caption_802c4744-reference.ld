/* Generated reference-only placements. All bodies are source-built. */
OUTPUT_FORMAT("elf32-powerpc")
OUTPUT_ARCH(powerpc)
ENTRY(w3d_update_masked_caption_802c4744)
_SDA_BASE_ = 0x804b2540;
_SDA2_BASE_ = 0x804c2540;
__22F1pMaskedText_803426b8 = 0x803426b8;
fn_8018c5b0 = 0x8018c5b0;
fn_8020bdf4 = 0x8020bdf4;
fn_8020c5c4 = 0x8020c5c4;
fn_8020c5cc = 0x8020c5cc;
fn_80341588 = 0x80341588;
fn_80343580 = 0x80343580;
text_803d8764 = 0x803d8764;
SECTIONS {
  .text.w3d_update_masked_caption_802c4744 0x802c4744 : { *(.text.w3d_update_masked_caption_802c4744) }
  /DISCARD/ : { *(.text*) *(.rodata*) *(.data*) *(.bss*) *(.sdata*) *(.sbss*) *(.comment) }
}
