/* Generated reference-only placements. All bodies are source-built. */
OUTPUT_FORMAT("elf32-powerpc")
OUTPUT_ARCH(powerpc)
ENTRY(d26l_movie_frame_decode_802e1854)
_SDA_BASE_ = 0x804b2540;
_SDA2_BASE_ = 0x804c2540;
fn_802e1a98 = 0x802e1a98;
fn_802e2248 = 0x802e2248;
fn_802fb7ac = 0x802fb7ac;
fn_802fdb6c = 0x802fdb6c;
fn_802fdb94 = 0x802fdb94;
fn_80322308 = 0x80322308;
msg_803db344 = 0x803db344;
SECTIONS {
  .text.d26l_movie_frame_decode_802e1854 0x802e1854 : { *(.text.d26l_movie_frame_decode_802e1854) }
  /DISCARD/ : { *(.text*) *(.rodata*) *(.data*) *(.bss*) *(.sdata*) *(.sbss*) *(.comment) }
}
