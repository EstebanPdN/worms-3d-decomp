/* Generated reference-only placements. All bodies are source-built. */
OUTPUT_FORMAT("elf32-powerpc")
OUTPUT_ARCH(powerpc)
ENTRY(w3d_k8c_panel_release_slots_8027035c)
_SDA_BASE_ = 0x804b2540;
_SDA2_BASE_ = 0x804c2540;
fn_8025e0c4 = 0x8025e0c4;
fn_80293528 = 0x80293528;
SECTIONS {
  .text.w3d_k8c_panel_release_slots_8027035c 0x8027035c : { *(.text.w3d_k8c_panel_release_slots_8027035c) }
  /DISCARD/ : { *(.text*) *(.rodata*) *(.data*) *(.bss*) *(.sdata*) *(.sbss*) *(.comment) }
}
