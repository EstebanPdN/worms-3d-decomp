/* Generated reference-only placements. All bodies are source-built. */
OUTPUT_FORMAT("elf32-powerpc")
OUTPUT_ARCH(powerpc)
ENTRY(w3d_cx7a_actor_defaults_800485b0)
_SDA_BASE_ = 0x804b2540;
_SDA2_BASE_ = 0x804c2540;
base_8015fef0 = 0x8015fef0;
vtable_8040e978 = 0x8040e978;
SECTIONS {
  .text.w3d_cx7a_actor_defaults_800485b0 0x800485b0 : { *(.text.w3d_cx7a_actor_defaults_800485b0) }
  /DISCARD/ : { *(.text*) *(.rodata*) *(.data*) *(.bss*) *(.sdata*) *(.sbss*) *(.comment) }
}
