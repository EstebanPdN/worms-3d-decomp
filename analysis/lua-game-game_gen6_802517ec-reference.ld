/* Generated reference-only placements. All bodies are source-built. */
OUTPUT_FORMAT("elf32-powerpc")
OUTPUT_ARCH(powerpc)
ENTRY(w3d_copy12_802517ec)
_SDA_BASE_ = 0x804b2540;
_SDA2_BASE_ = 0x804c2540;
SECTIONS {
  .text.w3d_copy12_802517ec 0x802517ec : { *(.text.w3d_copy12_802517ec) }
  .text.w3d_member_8025180c 0x8025180c : { *(.text.w3d_member_8025180c) }
  .text.w3d_copy12_80251814 0x80251814 : { *(.text.w3d_copy12_80251814) }
  .text.w3d_member_80251834 0x80251834 : { *(.text.w3d_member_80251834) }
  .text.w3d_copy12_8025183c 0x8025183c : { *(.text.w3d_copy12_8025183c) }
  .text.w3d_member_8025185c 0x8025185c : { *(.text.w3d_member_8025185c) }
  .text.w3d_copy12_80251864 0x80251864 : { *(.text.w3d_copy12_80251864) }
  .text.w3d_member_80251884 0x80251884 : { *(.text.w3d_member_80251884) }
  .text.w3d_member_802518f4 0x802518f4 : { *(.text.w3d_member_802518f4) }
  .text.w3d_copy12_802518fc 0x802518fc : { *(.text.w3d_copy12_802518fc) }
  .text.w3d_member_8025191c 0x8025191c : { *(.text.w3d_member_8025191c) }
  .text.w3d_copy12_80251924 0x80251924 : { *(.text.w3d_copy12_80251924) }
  .text.w3d_member_80251944 0x80251944 : { *(.text.w3d_member_80251944) }
  .text.w3d_copy12_8025194c 0x8025194c : { *(.text.w3d_copy12_8025194c) }
  .text.w3d_member_8025196c 0x8025196c : { *(.text.w3d_member_8025196c) }
  .text.w3d_copy12_80251974 0x80251974 : { *(.text.w3d_copy12_80251974) }
  .text.w3d_member_80251994 0x80251994 : { *(.text.w3d_member_80251994) }
  .text.w3d_copy12_8025199c 0x8025199c : { *(.text.w3d_copy12_8025199c) }
  .text.w3d_member_802519bc 0x802519bc : { *(.text.w3d_member_802519bc) }
  .text.w3d_copy12_802519c4 0x802519c4 : { *(.text.w3d_copy12_802519c4) }
  .text.w3d_member_802519e4 0x802519e4 : { *(.text.w3d_member_802519e4) }
  .text.w3d_copy12_802519ec 0x802519ec : { *(.text.w3d_copy12_802519ec) }
  .text.w3d_member_80251a0c 0x80251a0c : { *(.text.w3d_member_80251a0c) }
  .text.w3d_member_80251a28 0x80251a28 : { *(.text.w3d_member_80251a28) }
  .text.w3d_member_80251a44 0x80251a44 : { *(.text.w3d_member_80251a44) }
  .text.w3d_copy12_80251a4c 0x80251a4c : { *(.text.w3d_copy12_80251a4c) }
  .text.w3d_member_80251a6c 0x80251a6c : { *(.text.w3d_member_80251a6c) }
  .text.w3d_setf_80251ac4 0x80251ac4 : { *(.text.w3d_setf_80251ac4) }
  .text.w3d_getf_80251acc 0x80251acc : { *(.text.w3d_getf_80251acc) }
  .text.w3d_member_80251b00 0x80251b00 : { *(.text.w3d_member_80251b00) }
  .text.w3d_member_80251b70 0x80251b70 : { *(.text.w3d_member_80251b70) }
  .text.w3d_member_80251be0 0x80251be0 : { *(.text.w3d_member_80251be0) }
  .text.w3d_copy12_80251c08 0x80251c08 : { *(.text.w3d_copy12_80251c08) }
  .text.w3d_member_80251c28 0x80251c28 : { *(.text.w3d_member_80251c28) }
  .text.w3d_copy12_80251c30 0x80251c30 : { *(.text.w3d_copy12_80251c30) }
  .text.w3d_member_80251c50 0x80251c50 : { *(.text.w3d_member_80251c50) }
  .text.w3d_copy12_80251c58 0x80251c58 : { *(.text.w3d_copy12_80251c58) }
  .text.w3d_member_80251c78 0x80251c78 : { *(.text.w3d_member_80251c78) }
  .text.w3d_copy12_80251c80 0x80251c80 : { *(.text.w3d_copy12_80251c80) }
  .text.w3d_member_80251ca0 0x80251ca0 : { *(.text.w3d_member_80251ca0) }
  .text.w3d_copy12_80251ca8 0x80251ca8 : { *(.text.w3d_copy12_80251ca8) }
  .text.w3d_member_80251cc8 0x80251cc8 : { *(.text.w3d_member_80251cc8) }
  .text.w3d_copy12_80251cd0 0x80251cd0 : { *(.text.w3d_copy12_80251cd0) }
  .text.w3d_member_80251cf0 0x80251cf0 : { *(.text.w3d_member_80251cf0) }
  .text.w3d_copy12_80251d74 0x80251d74 : { *(.text.w3d_copy12_80251d74) }
  .text.w3d_member_80251d94 0x80251d94 : { *(.text.w3d_member_80251d94) }
  .text.w3d_copy12_80251d9c 0x80251d9c : { *(.text.w3d_copy12_80251d9c) }
  .text.w3d_member_80251dbc 0x80251dbc : { *(.text.w3d_member_80251dbc) }
  .text.w3d_copy12_80251dc4 0x80251dc4 : { *(.text.w3d_copy12_80251dc4) }
  .text.w3d_member_80251de4 0x80251de4 : { *(.text.w3d_member_80251de4) }
  .text.w3d_setf_80251e4c 0x80251e4c : { *(.text.w3d_setf_80251e4c) }
  .text.w3d_getf_80251e54 0x80251e54 : { *(.text.w3d_getf_80251e54) }
  .text.w3d_member_80257f5c 0x80257f5c : { *(.text.w3d_member_80257f5c) }
  .text.w3d_member_80257fcc 0x80257fcc : { *(.text.w3d_member_80257fcc) }
  .text.w3d_member_8025803c 0x8025803c : { *(.text.w3d_member_8025803c) }
  .text.w3d_member_802580ac 0x802580ac : { *(.text.w3d_member_802580ac) }
  .text.w3d_member_8025811c 0x8025811c : { *(.text.w3d_member_8025811c) }
  .text.w3d_member_8025818c 0x8025818c : { *(.text.w3d_member_8025818c) }
  .text.w3d_member_802581fc 0x802581fc : { *(.text.w3d_member_802581fc) }
  .text.w3d_setf_80258214 0x80258214 : { *(.text.w3d_setf_80258214) }
  .text.w3d_getf_8025821c 0x8025821c : { *(.text.w3d_getf_8025821c) }
  .text.w3d_setf_80258224 0x80258224 : { *(.text.w3d_setf_80258224) }
  .text.w3d_getf_8025822c 0x8025822c : { *(.text.w3d_getf_8025822c) }
  .text.w3d_copy12_80258254 0x80258254 : { *(.text.w3d_copy12_80258254) }
  .text.w3d_member_80258274 0x80258274 : { *(.text.w3d_member_80258274) }
  .text.w3d_copy12_8025827c 0x8025827c : { *(.text.w3d_copy12_8025827c) }
  .text.w3d_member_8025829c 0x8025829c : { *(.text.w3d_member_8025829c) }
  .text.w3d_member_8025830c 0x8025830c : { *(.text.w3d_member_8025830c) }
  .text.w3d_member_8025837c 0x8025837c : { *(.text.w3d_member_8025837c) }
  .text.w3d_member_802583ec 0x802583ec : { *(.text.w3d_member_802583ec) }
  .text.w3d_member_8025845c 0x8025845c : { *(.text.w3d_member_8025845c) }
  .text.w3d_member_802584cc 0x802584cc : { *(.text.w3d_member_802584cc) }
  .text.w3d_member_8025853c 0x8025853c : { *(.text.w3d_member_8025853c) }
  .text.w3d_member_802585ac 0x802585ac : { *(.text.w3d_member_802585ac) }
  .text.w3d_member_8025861c 0x8025861c : { *(.text.w3d_member_8025861c) }
  .text.w3d_member_8025868c 0x8025868c : { *(.text.w3d_member_8025868c) }
  .text.w3d_member_802586fc 0x802586fc : { *(.text.w3d_member_802586fc) }
  .text.w3d_member_8025876c 0x8025876c : { *(.text.w3d_member_8025876c) }
  .text.w3d_member_802587dc 0x802587dc : { *(.text.w3d_member_802587dc) }
  .text.w3d_member_8025884c 0x8025884c : { *(.text.w3d_member_8025884c) }
  /DISCARD/ : { *(.text*) *(.rodata*) *(.data*) *(.bss*) *(.sdata*) *(.sbss*) *(.comment) }
}
