/* Generated reference-only placements. All bodies are source-built. */
OUTPUT_FORMAT("elf32-powerpc")
OUTPUT_ARCH(powerpc)
ENTRY(w3d_s21_create_80208af8)
_SDA_BASE_ = 0x804b2540;
_SDA2_BASE_ = 0x804c2540;
fn_801fe1d8 = 0x801fe1d8;
fn_80208c0c = 0x80208c0c;
fn_80208f48 = 0x80208f48;
SECTIONS {
  .text.w3d_s21_create_80208af8 0x80208af8 : { *(.text.w3d_s21_create_80208af8) }
  /DISCARD/ : { *(.text*) *(.rodata*) *(.data*) *(.bss*) *(.sdata*) *(.sbss*) *(.comment) }
}
