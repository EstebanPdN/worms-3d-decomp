/* Generated reference-only placements. All bodies are source-built. */
OUTPUT_FORMAT("elf32-powerpc")
OUTPUT_ARCH(powerpc)
ENTRY(d33b_queue_drain_8008f1e8)
_SDA_BASE_ = 0x804b2540;
_SDA2_BASE_ = 0x804c2540;
sol35a_camera_group_8008ed58 = 0x8008ed58;
w3d_active_80431e94 = 0x80431e94;
w3d_d24b_queue_input_8008e9c0 = 0x8008e9c0;
w3d_entries_80431e88 = 0x80431e88;
w3d_refresh_801ef380 = 0x801ef380;
w3d_step_8008ee80 = 0x8008ee80;
SECTIONS {
  .text.d33b_queue_drain_8008f1e8 0x8008f1e8 : { *(.text.d33b_queue_drain_8008f1e8) }
  /DISCARD/ : { *(.text*) *(.rodata*) *(.data*) *(.bss*) *(.sdata*) *(.sbss*) *(.comment) }
}
