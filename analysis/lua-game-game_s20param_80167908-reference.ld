/* Generated reference-only placements. All bodies are source-built. */
OUTPUT_FORMAT("elf32-powerpc")
OUTPUT_ARCH(powerpc)
ENTRY(w3d_s20_get_matrix_80167908)
_SDA_BASE_ = 0x804b2540;
_SDA2_BASE_ = 0x804c2540;
SECTIONS {
  .text.w3d_s20_get_matrix_80167908 0x80167908 : { *(.text.w3d_s20_get_matrix_80167908) }
  .text.w3d_s20_set_matrix_801a0890 0x801a0890 : { *(.text.w3d_s20_set_matrix_801a0890) }
  /DISCARD/ : { *(.text*) *(.rodata*) *(.data*) *(.bss*) *(.sdata*) *(.sbss*) *(.comment) }
}
