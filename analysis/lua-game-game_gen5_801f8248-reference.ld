/* Generated reference-only placements. All bodies are source-built. */
OUTPUT_FORMAT("elf32-powerpc")
OUTPUT_ARCH(powerpc)
ENTRY(w3d_registry_unlink_801f8248)
_SDA_BASE_ = 0x804b2540;
_SDA2_BASE_ = 0x804c2540;
w3d_fn_801f83b4 = 0x801f83b4;
w3d_fn_801f84a0 = 0x801f84a0;
w3d_fn_801f8e24 = 0x801f8e24;
w3d_fn_801fbeac = 0x801fbeac;
w3d_fn_801fbfcc = 0x801fbfcc;
w3d_fn_801fc6d0 = 0x801fc6d0;
w3d_fn_801fca98 = 0x801fca98;
w3d_fn_801fd90c = 0x801fd90c;
w3d_fn_801ffecc = 0x801ffecc;
w3d_fn_8020b460 = 0x8020b460;
w3d_global_80365838 = 0x80365838;
w3d_global_80365868 = 0x80365868;
w3d_global_80365898 = 0x80365898;
w3d_global_803658c8 = 0x803658c8;
w3d_global_803b18c0 = 0x803b18c0;
w3d_global_803b1998 = 0x803b1998;
w3d_global_803b19b0 = 0x803b19b0;
w3d_global_803b1a18 = 0x803b1a18;
w3d_global_803b1a3c = 0x803b1a3c;
w3d_global_803b1cd8 = 0x803b1cd8;
w3d_global_803b1cfc = 0x803b1cfc;
w3d_global_80400468 = 0x80400468;
w3d_global_80400484 = 0x80400484;
w3d_global_804004a0 = 0x804004a0;
w3d_global_804004bc = 0x804004bc;
w3d_global_804004d8 = 0x804004d8;
w3d_global_804004f4 = 0x804004f4;
w3d_global_80400510 = 0x80400510;
w3d_global_8040052c = 0x8040052c;
w3d_global_80400548 = 0x80400548;
w3d_global_80400564 = 0x80400564;
w3d_global_80400580 = 0x80400580;
w3d_global_8040059c = 0x8040059c;
w3d_global_804005b8 = 0x804005b8;
w3d_global_804005d4 = 0x804005d4;
w3d_global_804005f0 = 0x804005f0;
w3d_heap_allocate_entry_a = 0x801fe1d8;
w3d_owner_list_remove = 0x8020fd2c;
w3d_registry_list_80365808 = 0x80365808;
w3d_state_register = 0x8020fd04;
w3d_vtable_80418c90 = 0x80418c90;
SECTIONS {
  .text.w3d_registry_unlink_801f8248 0x801f8248 : { *(.text.w3d_registry_unlink_801f8248) }
  .text.w3d_registry_create_801f828c 0x801f828c : { *(.text.w3d_registry_create_801f828c) }
  .text.w3d_address_801f82ec 0x801f82ec : { *(.text.w3d_address_801f82ec) }
  .text.w3d_registry_release_801f82f8 0x801f82f8 : { *(.text.w3d_registry_release_801f82f8) }
  .text.w3d_registry_retain_801f8354 0x801f8354 : { *(.text.w3d_registry_retain_801f8354) }
  .text.w3d_forward_801f836c 0x801f836c : { *(.text.w3d_forward_801f836c) }
  .text.w3d_constant_801f874c 0x801f874c : { *(.text.w3d_constant_801f874c) }
  .text.w3d_get_801f8830 0x801f8830 : { *(.text.w3d_get_801f8830) }
  .text.w3d_static_init_801f8e80 0x801f8e80 : { *(.text.w3d_static_init_801f8e80) }
  .text.w3d_address_801f8eac 0x801f8eac : { *(.text.w3d_address_801f8eac) }
  .text.w3d_registry_retain_801f8f08 0x801f8f08 : { *(.text.w3d_registry_retain_801f8f08) }
  .text.w3d_forward_801f8f20 0x801f8f20 : { *(.text.w3d_forward_801f8f20) }
  .text.w3d_address_801f91c8 0x801f91c8 : { *(.text.w3d_address_801f91c8) }
  .text.w3d_registry_retain_801f9230 0x801f9230 : { *(.text.w3d_registry_retain_801f9230) }
  .text.w3d_forward_801f9248 0x801f9248 : { *(.text.w3d_forward_801f9248) }
  .text.w3d_empty_801f9480 0x801f9480 : { *(.text.w3d_empty_801f9480) }
  .text.w3d_address_801f96e8 0x801f96e8 : { *(.text.w3d_address_801f96e8) }
  .text.w3d_address_801f9798 0x801f9798 : { *(.text.w3d_address_801f9798) }
  .text.w3d_address_801f9848 0x801f9848 : { *(.text.w3d_address_801f9848) }
  .text.w3d_forward_801f98c8 0x801f98c8 : { *(.text.w3d_forward_801f98c8) }
  .text.w3d_address_801f9910 0x801f9910 : { *(.text.w3d_address_801f9910) }
  .text.w3d_forward_801f9990 0x801f9990 : { *(.text.w3d_forward_801f9990) }
  .text.w3d_constant_801fb0b8 0x801fb0b8 : { *(.text.w3d_constant_801fb0b8) }
  .text.w3d_constant_801fbe18 0x801fbe18 : { *(.text.w3d_constant_801fbe18) }
  .text.w3d_constant_801fbf30 0x801fbf30 : { *(.text.w3d_constant_801fbf30) }
  .text.w3d_static_init_801fbf38 0x801fbf38 : { *(.text.w3d_static_init_801fbf38) }
  .text.w3d_static_init_801fc014 0x801fc014 : { *(.text.w3d_static_init_801fc014) }
  .text.w3d_address_801fc040 0x801fc040 : { *(.text.w3d_address_801fc040) }
  .text.w3d_address_801fc0f0 0x801fc0f0 : { *(.text.w3d_address_801fc0f0) }
  .text.w3d_address_801fc1a0 0x801fc1a0 : { *(.text.w3d_address_801fc1a0) }
  .text.w3d_forward_801fc220 0x801fc220 : { *(.text.w3d_forward_801fc220) }
  .text.w3d_address_801fc268 0x801fc268 : { *(.text.w3d_address_801fc268) }
  .text.w3d_forward_801fc2e8 0x801fc2e8 : { *(.text.w3d_forward_801fc2e8) }
  .text.w3d_constant_801fc4c8 0x801fc4c8 : { *(.text.w3d_constant_801fc4c8) }
  .text.w3d_constant_801fc6c8 0x801fc6c8 : { *(.text.w3d_constant_801fc6c8) }
  .text.w3d_constant_801fc754 0x801fc754 : { *(.text.w3d_constant_801fc754) }
  .text.w3d_constant_801fc75c 0x801fc75c : { *(.text.w3d_constant_801fc75c) }
  .text.w3d_static_init_801fc764 0x801fc764 : { *(.text.w3d_static_init_801fc764) }
  .text.w3d_static_init_801fcb38 0x801fcb38 : { *(.text.w3d_static_init_801fcb38) }
  .text.w3d_static_init_801fdb40 0x801fdb40 : { *(.text.w3d_static_init_801fdb40) }
  .text.w3d_ctor_801fe52c 0x801fe52c : { *(.text.w3d_ctor_801fe52c) }
  .text.w3d_constant_801fe5a0 0x801fe5a0 : { *(.text.w3d_constant_801fe5a0) }
  .text.w3d_address_801fe5a8 0x801fe5a8 : { *(.text.w3d_address_801fe5a8) }
  .text.w3d_empty_801fe5b4 0x801fe5b4 : { *(.text.w3d_empty_801fe5b4) }
  .text.w3d_constant_801fe5e8 0x801fe5e8 : { *(.text.w3d_constant_801fe5e8) }
  .text.w3d_constant_801fe5f0 0x801fe5f0 : { *(.text.w3d_constant_801fe5f0) }
  .text.w3d_constant_801fe5f8 0x801fe5f8 : { *(.text.w3d_constant_801fe5f8) }
  .text.w3d_constant_801fe600 0x801fe600 : { *(.text.w3d_constant_801fe600) }
  .text.w3d_address_801fe608 0x801fe608 : { *(.text.w3d_address_801fe608) }
  .text.w3d_constant_801fe778 0x801fe778 : { *(.text.w3d_constant_801fe778) }
  .text.w3d_address_801fe780 0x801fe780 : { *(.text.w3d_address_801fe780) }
  .text.w3d_constant_801fe894 0x801fe894 : { *(.text.w3d_constant_801fe894) }
  .text.w3d_address_801fe89c 0x801fe89c : { *(.text.w3d_address_801fe89c) }
  .text.w3d_constant_801fe9b8 0x801fe9b8 : { *(.text.w3d_constant_801fe9b8) }
  .text.w3d_address_801fe9c0 0x801fe9c0 : { *(.text.w3d_address_801fe9c0) }
  .text.w3d_constant_801fead4 0x801fead4 : { *(.text.w3d_constant_801fead4) }
  .text.w3d_address_801feadc 0x801feadc : { *(.text.w3d_address_801feadc) }
  .text.w3d_constant_801febf0 0x801febf0 : { *(.text.w3d_constant_801febf0) }
  .text.w3d_address_801febf8 0x801febf8 : { *(.text.w3d_address_801febf8) }
  .text.w3d_constant_801fed0c 0x801fed0c : { *(.text.w3d_constant_801fed0c) }
  .text.w3d_address_801fed14 0x801fed14 : { *(.text.w3d_address_801fed14) }
  .text.w3d_constant_801fee28 0x801fee28 : { *(.text.w3d_constant_801fee28) }
  .text.w3d_address_801fee30 0x801fee30 : { *(.text.w3d_address_801fee30) }
  .text.w3d_constant_801fef58 0x801fef58 : { *(.text.w3d_constant_801fef58) }
  .text.w3d_address_801fef60 0x801fef60 : { *(.text.w3d_address_801fef60) }
  .text.w3d_constant_801ff08c 0x801ff08c : { *(.text.w3d_constant_801ff08c) }
  .text.w3d_address_801ff094 0x801ff094 : { *(.text.w3d_address_801ff094) }
  .text.w3d_constant_801ff1ac 0x801ff1ac : { *(.text.w3d_constant_801ff1ac) }
  .text.w3d_address_801ff1b4 0x801ff1b4 : { *(.text.w3d_address_801ff1b4) }
  .text.w3d_constant_801ff2c8 0x801ff2c8 : { *(.text.w3d_constant_801ff2c8) }
  .text.w3d_address_801ff2d0 0x801ff2d0 : { *(.text.w3d_address_801ff2d0) }
  .text.w3d_constant_801ff40c 0x801ff40c : { *(.text.w3d_constant_801ff40c) }
  .text.w3d_address_801ff414 0x801ff414 : { *(.text.w3d_address_801ff414) }
  .text.w3d_constant_801ff528 0x801ff528 : { *(.text.w3d_constant_801ff528) }
  .text.w3d_address_801ff530 0x801ff530 : { *(.text.w3d_address_801ff530) }
  /DISCARD/ : { *(.text*) *(.rodata*) *(.data*) *(.bss*) *(.sdata*) *(.sbss*) *(.comment) }
}
