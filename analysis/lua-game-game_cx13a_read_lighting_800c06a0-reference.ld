/* Generated reference-only placements. All bodies are source-built. */
OUTPUT_FORMAT("elf32-powerpc")
OUTPUT_ARCH(powerpc)
ENTRY(w3d_cx13a_read_lighting_800c06a0)
_SDA_BASE_ = 0x804b2540;
_SDA2_BASE_ = 0x804c2540;
cast_80342fa4 = 0x80342fa4;
first_8043c3d0 = 0x8043c3d0;
key_80382f94 = 0x80382f94;
light_8043c3b8 = 0x8043c3b8;
negative_8043c3ac = 0x8043c3ac;
query_800fc2f0 = 0x800fc2f0;
read_80178ec4 = 0x80178ec4;
second_8043c3c4 = 0x8043c3c4;
SECTIONS {
  .text.w3d_cx13a_read_lighting_800c06a0 0x800c06a0 : { *(.text.w3d_cx13a_read_lighting_800c06a0) }
  /DISCARD/ : { *(.text*) *(.rodata*) *(.data*) *(.bss*) *(.sdata*) *(.sbss*) *(.comment) }
}
