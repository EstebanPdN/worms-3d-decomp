/* Generated reference-only placements. All bodies are source-built. */
OUTPUT_FORMAT("elf32-powerpc")
OUTPUT_ARCH(powerpc)
ENTRY(__Q24_STLt8hash_map5Z11D30sGuidKeyZP9D30sIfaceZ12D30sGuidHashZ10D30sGuidEqZQ24_STLt9allocator1ZQ24_STLt4pair2ZC11D30sGuidKeyZP9D30sIface)
_SDA_BASE_ = 0x804b2540;
_SDA2_BASE_ = 0x804c2540;
_M_fill_insert__Q24_STLt6vector2ZPvZQ24_STLt9allocator1ZPvPPvUiRCPv = 0x8035dc78;
_M_next_size__CQ24_STLt9hashtable6ZQ24_STLt4pair2ZC11D30sGuidKeyZP9D30sIfaceZ11D30sGuidKeyZ12D30sGuidHashZQ24_STLt10_Select1st1ZQ24_STLt4pair2ZC11D30sGuidKeyZP9D30sIfaceZ10D30sGuidEqZQ24_STLt9allocator1ZQ24_STLt4pair2ZC11D30sGuidKeyZP9D30sIfaceUi = 0x8035c518;
reserve__Q24_STLt6vector2ZPvZQ24_STLt9allocator1ZPvUi = 0x8035db70;
SECTIONS {
  .text.__Q24_STLt8hash_map5Z11D30sGuidKeyZP9D30sIfaceZ12D30sGuidHashZ10D30sGuidEqZQ24_STLt9allocator1ZQ24_STLt4pair2ZC11D30sGuidKeyZP9D30sIface 0x8035e070 : { *(.text.__Q24_STLt8hash_map5Z11D30sGuidKeyZP9D30sIfaceZ12D30sGuidHashZ10D30sGuidEqZQ24_STLt9allocator1ZQ24_STLt4pair2ZC11D30sGuidKeyZP9D30sIface) }
  /DISCARD/ : { *(.text*) *(.rodata*) *(.data*) *(.bss*) *(.sdata*) *(.sbss*) *(.comment) }
}
