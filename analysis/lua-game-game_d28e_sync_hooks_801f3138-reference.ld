/* Generated reference-only placements. All bodies are source-built. */
OUTPUT_FORMAT("elf32-powerpc")
OUTPUT_ARCH(powerpc)
ENTRY(w3d_d28e_sync_hooks_801f3138)
_SDA_BASE_ = 0x804b2540;
_SDA2_BASE_ = 0x804c2540;
alloc_80212fd4 = 0x80212fd4;
fn_801e716c = 0x801e716c;
fn_801f3850 = 0x801f3850;
free_802134fc = 0x802134fc;
lbl_8045e080 = 0x8045e080;
memcpy_802eee50 = 0x802eee50;
memmove_802eeef4 = 0x802eeef4;
w3d_auto_801f39a0 = 0x801f39a0;
w3d_d24k_heap_resize_80213750 = 0x80213750;
SECTIONS {
  .text.w3d_d28e_sync_hooks_801f3138 0x801f3138 : { *(.text.w3d_d28e_sync_hooks_801f3138) }
  /DISCARD/ : { *(.text*) *(.rodata*) *(.data*) *(.bss*) *(.sdata*) *(.sbss*) *(.comment) }
}
