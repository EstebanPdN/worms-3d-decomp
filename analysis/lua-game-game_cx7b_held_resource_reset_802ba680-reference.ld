/* Generated reference-only placements. All bodies are source-built. */
OUTPUT_FORMAT("elf32-powerpc")
OUTPUT_ARCH(powerpc)
ENTRY(w3d_cx7b_held_resource_reset_802ba680)
_SDA_BASE_ = 0x804b2540;
_SDA2_BASE_ = 0x804c2540;
fn_802b0fec = 0x802b0fec;
fn_802bacc8 = 0x802bacc8;
SECTIONS {
  .text.w3d_cx7b_held_resource_reset_802ba680 0x802ba680 : { *(.text.w3d_cx7b_held_resource_reset_802ba680) }
  /DISCARD/ : { *(.text*) *(.rodata*) *(.data*) *(.bss*) *(.sdata*) *(.sbss*) *(.comment) }
}
