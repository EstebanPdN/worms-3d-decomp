/* Generated reference-only placements. All bodies are source-built. */
OUTPUT_FORMAT("elf32-powerpc")
OUTPUT_ARCH(powerpc)
ENTRY(__15D30eDeviceOwner)
_SDA_BASE_ = 0x804b2540;
_SDA2_BASE_ = 0x804c2540;
_S_oom_malloc__Q24_STLt14__malloc_alloc1i0Ui = 0x803413d8;
__vt_15D30eDeviceOwner = 0x80418210;
__vt_7Service = 0x804182d0;
fn_80301cb4 = 0x80301cb4;
free = 0x802134fc;
lbl_804181f0 = 0x804181f0;
malloc = 0x80212fd4;
memmove = 0x802eeef4;
w3d_s10_service_forward_8020b680 = 0x8020b680;
SECTIONS {
  .text.__15D30eDeviceOwner 0x801fb270 : { *(.text.__15D30eDeviceOwner) }
  /DISCARD/ : { *(.text*) *(.rodata*) *(.data*) *(.bss*) *(.sdata*) *(.sbss*) *(.comment) }
}
