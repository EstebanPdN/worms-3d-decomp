/* Generated reference-only placements. All bodies are source-built. */
OUTPUT_FORMAT("elf32-powerpc")
OUTPUT_ARCH(powerpc)
ENTRY(w3d_k8b_key_dispatch_801aade4)
_SDA_BASE_ = 0x804b2540;
_SDA2_BASE_ = 0x804c2540;
fn_801d0858 = 0x801d0858;
SECTIONS {
  .text.w3d_k8b_key_dispatch_801aade4 0x801aade4 : { *(.text.w3d_k8b_key_dispatch_801aade4) }
  /DISCARD/ : { *(.text*) *(.rodata*) *(.data*) *(.bss*) *(.sdata*) *(.sbss*) *(.comment) }
}
