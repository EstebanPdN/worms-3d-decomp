/* Generated reference-only placements. All bodies are source-built. */
OUTPUT_FORMAT("elf32-powerpc")
OUTPUT_ARCH(powerpc)
ENTRY(w3d_s21_get_entry_value_801fbccc)
_SDA_BASE_ = 0x804b2540;
_SDA2_BASE_ = 0x804c2540;
fn_801f9fbc = 0x801f9fbc;
SECTIONS {
  .text.w3d_s21_get_entry_value_801fbccc 0x801fbccc : { *(.text.w3d_s21_get_entry_value_801fbccc) }
  /DISCARD/ : { *(.text*) *(.rodata*) *(.data*) *(.bss*) *(.sdata*) *(.sbss*) *(.comment) }
}
