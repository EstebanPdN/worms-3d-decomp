/* Generated reference-only placements. All bodies are source-built. */
OUTPUT_FORMAT("elf32-powerpc")
OUTPUT_ARCH(powerpc)
ENTRY(w3d_cx14b_affine_inverse_801f69ec)
_SDA_BASE_ = 0x804b2540;
_SDA2_BASE_ = 0x804c2540;
epsilon_803b16a8 = 0x803b16a8;
one_803b16a4 = 0x803b16a4;
zero_803b16ac = 0x803b16ac;
SECTIONS {
  .text.w3d_cx14b_affine_inverse_801f69ec 0x801f69ec : { *(.text.w3d_cx14b_affine_inverse_801f69ec) }
  /DISCARD/ : { *(.text*) *(.rodata*) *(.data*) *(.bss*) *(.sdata*) *(.sbss*) *(.comment) }
}
