/* Generated reference-only placements. All bodies are source-built. */
OUTPUT_FORMAT("elf32-powerpc")
OUTPUT_ARCH(powerpc)
ENTRY(w3d_k3b_tagged_construct_801ea0ec)
_SDA_BASE_ = 0x804b2540;
_SDA2_BASE_ = 0x804c2540;
w3d_vtable_80411590 = 0x80411590;
w3d_vtable_80417168 = 0x80417168;
SECTIONS {
  .text.w3d_k3b_tagged_construct_801ea0ec 0x801ea0ec : { *(.text.w3d_k3b_tagged_construct_801ea0ec) }
  /DISCARD/ : { *(.text*) *(.rodata*) *(.data*) *(.bss*) *(.sdata*) *(.sbss*) *(.comment) }
}
