/* Generated reference-only placements. All bodies are source-built. */
OUTPUT_FORMAT("elf32-powerpc")
OUTPUT_ARCH(powerpc)
ENTRY(w3d_s21_gauge_sync_8026f948)
_SDA_BASE_ = 0x804b2540;
_SDA2_BASE_ = 0x804c2540;
fn_8026fc98 = 0x8026fc98;
fn_80296410 = 0x80296410;
fn_802bc93c = 0x802bc93c;
SECTIONS {
  .text.w3d_s21_gauge_sync_8026f948 0x8026f948 : { *(.text.w3d_s21_gauge_sync_8026f948) }
  /DISCARD/ : { *(.text*) *(.rodata*) *(.data*) *(.bss*) *(.sdata*) *(.sbss*) *(.comment) }
}
