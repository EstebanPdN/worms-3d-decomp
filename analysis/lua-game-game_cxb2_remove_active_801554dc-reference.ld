/* Generated reference-only placements. All bodies are source-built. */
OUTPUT_FORMAT("elf32-powerpc")
OUTPUT_ARCH(powerpc)
ENTRY(cxb2_remove_active_801554dc)
_SDA_BASE_ = 0x804b2540;
_SDA2_BASE_ = 0x804c2540;
_._19Cxb2Borrow_80178474 = 0x80178474;
fn_800fc1f0 = 0x800fc1f0;
fn_800fc6dc = 0x800fc6dc;
fn_800fc82c = 0x800fc82c;
fn_801565e4 = 0x801565e4;
lbl_803a27ac = 0x803a27ac;
SECTIONS {
  .text.cxb2_remove_active_801554dc 0x801554dc : { *(.text.cxb2_remove_active_801554dc) }
  /DISCARD/ : { *(.text*) *(.rodata*) *(.data*) *(.bss*) *(.sdata*) *(.sbss*) *(.comment) }
}
