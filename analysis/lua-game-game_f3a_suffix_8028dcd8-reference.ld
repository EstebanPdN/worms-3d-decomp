/* Generated reference-only placements. All bodies are source-built. */
OUTPUT_FORMAT("elf32-powerpc")
OUTPUT_ARCH(powerpc)
ENTRY(w3d_f3a_suffix_8028dcd8)
_SDA_BASE_ = 0x804b2540;
_SDA2_BASE_ = 0x804c2540;
ext_803cffc0 = 0x803cffc0;
fn_8020c2e8 = 0x8020c2e8;
fn_8020c5c0 = 0x8020c5c0;
fn_8020c5c4 = 0x8020c5c4;
fn_802ef234 = 0x802ef234;
fn_802ef9c0 = 0x802ef9c0;
fn_80341588 = 0x80341588;
fn_80341884 = 0x80341884;
SECTIONS {
  .text.w3d_f3a_suffix_8028dcd8 0x8028dcd8 : { *(.text.w3d_f3a_suffix_8028dcd8) }
  /DISCARD/ : { *(.text*) *(.rodata*) *(.data*) *(.bss*) *(.sdata*) *(.sbss*) *(.comment) }
}
