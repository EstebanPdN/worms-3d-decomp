/* Generated reference-only placements. All bodies are source-built. */
OUTPUT_FORMAT("elf32-powerpc")
OUTPUT_ARCH(powerpc)
ENTRY(w3d_d29e_write_name_suffix_801ff970)
_SDA_BASE_ = 0x804b2540;
_SDA2_BASE_ = 0x804c2540;
lbl_803b2a50 = 0x803b2a50;
strlen = 0x802ef9c0;
w3d_cx10b_text_format_variadic_8020d6bc = 0x8020d6bc;
w3d_s21_write_text_8020dbf8 = 0x8020dbf8;
SECTIONS {
  .text.w3d_d29e_write_name_suffix_801ff970 0x801ff970 : { *(.text.w3d_d29e_write_name_suffix_801ff970) }
  /DISCARD/ : { *(.text*) *(.rodata*) *(.data*) *(.bss*) *(.sdata*) *(.sbss*) *(.comment) }
}
