/* Generated reference-only placements. All bodies are source-built. */
OUTPUT_FORMAT("elf32-powerpc")
OUTPUT_ARCH(powerpc)
ENTRY(f5c_ctor_801bc6c4)
_SDA_BASE_ = 0x804b2540;
_SDA2_BASE_ = 0x804c2540;
__13Vec3_80343740 = 0x80343740;
fn_801b529c = 0x801b529c;
lbl_804152d0 = 0x804152d0;
lbl_8045e748 = 0x8045e748;
SECTIONS {
  .text.f5c_ctor_801bc6c4 0x801bc6c4 : { *(.text.f5c_ctor_801bc6c4) }
  /DISCARD/ : { *(.text*) *(.rodata*) *(.data*) *(.bss*) *(.sdata*) *(.sbss*) *(.comment) }
}
