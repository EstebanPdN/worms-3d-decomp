/* Generated reference-only placements. All bodies are source-built. */
OUTPUT_FORMAT("elf32-powerpc")
OUTPUT_ARCH(powerpc)
ENTRY(sol35d7_aligned_allocate_80213a8c_v2)
_SDA_BASE_ = 0x804b2540;
_SDA2_BASE_ = 0x804c2540;
fn_80212fd4 = 0x80212fd4;
fn_802134fc = 0x802134fc;
fn_802eafc4 = 0x802eafc4;
SECTIONS {
  .text.sol35d7_aligned_allocate_80213a8c_v2 0x80213a8c : { *(.text.sol35d7_aligned_allocate_80213a8c_v2) }
  /DISCARD/ : { *(.text*) *(.rodata*) *(.data*) *(.bss*) *(.sdata*) *(.sbss*) *(.comment) }
}
