/* Generated reference-only placements. All bodies are source-built. */
OUTPUT_FORMAT("elf32-powerpc")
OUTPUT_ARCH(powerpc)
ENTRY(s9_update_actor_interfaces_8013c890)
_SDA_BASE_ = 0x804b2540;
_SDA2_BASE_ = 0x804c2540;
fn_800da818 = 0x800da818;
fn_800e5bb8 = 0x800e5bb8;
fn_80139158 = 0x80139158;
fn_8013f844 = 0x8013f844;
fn_80164fc8 = 0x80164fc8;
SECTIONS {
  .text.s9_update_actor_interfaces_8013c890 0x8013c890 : { *(.text.s9_update_actor_interfaces_8013c890) }
  .text.s9_clear_actor_handles_8013e3d4 0x8013e3d4 : { *(.text.s9_clear_actor_handles_8013e3d4) }
  /DISCARD/ : { *(.text*) *(.rodata*) *(.data*) *(.bss*) *(.sdata*) *(.sbss*) *(.comment) }
}
