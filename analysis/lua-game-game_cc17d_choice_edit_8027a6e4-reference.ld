/* Generated reference-only placements. All bodies are source-built. */
OUTPUT_FORMAT("elf32-powerpc")
OUTPUT_ARCH(powerpc)
ENTRY(w3d_cc17d_choice6_edit_8027a0cc)
_SDA_BASE_ = 0x804b2540;
_SDA2_BASE_ = 0x804c2540;
w3d_auto_8027a98c = 0x8027a98c;
w3d_s21_state_dispatch_8027ae00 = 0x8027ae00;
w3d_s21_vector_get_801e9db8 = 0x801e9db8;
SECTIONS {
  .text.w3d_cc17d_choice6_edit_8027a0cc 0x8027a0cc : { *(.text.w3d_cc17d_choice6_edit_8027a0cc) }
  .text.w3d_cc17d_choice9_edit_8027a348 0x8027a348 : { *(.text.w3d_cc17d_choice9_edit_8027a348) }
  .text.w3d_cc17d_choice6b_edit_8027a568 0x8027a568 : { *(.text.w3d_cc17d_choice6b_edit_8027a568) }
  .text.w3d_cc17d_choice4_edit_8027a6e4 0x8027a6e4 : { *(.text.w3d_cc17d_choice4_edit_8027a6e4) }
  /DISCARD/ : { *(.text*) *(.rodata*) *(.data*) *(.bss*) *(.sdata*) *(.sbss*) *(.comment) }
}
