/* Generated reference-only placements. All bodies are source-built. */
OUTPUT_FORMAT("elf32-powerpc")
OUTPUT_ARCH(powerpc)
ENTRY(w3d_s10_init_two_properties_80239af0)
_SDA_BASE_ = 0x804b2540;
_SDA2_BASE_ = 0x804c2540;
fn_801e8d9c = 0x801e8d9c;
fn_801ebf38 = 0x801ebf38;
lbl_803bb34c = 0x803bb34c;
lbl_803bb384 = 0x803bb384;
SECTIONS {
  .text.w3d_s10_init_two_properties_80239af0 0x80239af0 : { *(.text.w3d_s10_init_two_properties_80239af0) }
  /DISCARD/ : { *(.text*) *(.rodata*) *(.data*) *(.bss*) *(.sdata*) *(.sbss*) *(.comment) }
}
