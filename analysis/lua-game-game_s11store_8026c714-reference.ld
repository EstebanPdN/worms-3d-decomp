/* Generated reference-only placements. All bodies are source-built. */
OUTPUT_FORMAT("elf32-powerpc")
OUTPUT_ARCH(powerpc)
ENTRY(w3d_auto_8026c714)
_SDA_BASE_ = 0x804b2540;
_SDA2_BASE_ = 0x804c2540;
fn_800FC43C = 0x800fc43c;
fn_802EEFE0 = 0x802eefe0;
fn_803426B8 = 0x803426b8;
lbl_803CBB70 = 0x803cbb70;
lbl_803CBB78 = 0x803cbb78;
lbl_803CBB84 = 0x803cbb84;
lbl_803CBB8C = 0x803cbb8c;
lbl_803CBB98 = 0x803cbb98;
lbl_803CBBA4 = 0x803cbba4;
lbl_803CBBB0 = 0x803cbbb0;
lbl_803CBBBC = 0x803cbbbc;
lbl_803CBBC8 = 0x803cbbc8;
lbl_803CBCB0 = 0x803cbcb0;
SECTIONS {
  .text.w3d_auto_8026c714 0x8026c714 : { *(.text.w3d_auto_8026c714) }
  /DISCARD/ : { *(.text*) *(.rodata*) *(.data*) *(.bss*) *(.sdata*) *(.sbss*) *(.comment) }
}
