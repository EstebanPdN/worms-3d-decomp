/* Generated reference-only placements. All bodies are source-built. */
OUTPUT_FORMAT("elf32-powerpc")
OUTPUT_ARCH(powerpc)
ENTRY(w3d_d31e_init_actor_tree_801e7e24)
_SDA_BASE_ = 0x804b2540;
_SDA2_BASE_ = 0x804c2540;
fn_801e7658 = 0x801e7658;
k_803657d8 = 0x803657d8;
w3d_actor_types_first = 0x8020ff3c;
w3d_auto_8020ff34 = 0x8020ff34;
w3d_constant_8020b5c8 = 0x8020b5c8;
w3d_empty_8020b5d0 = 0x8020b5d0;
w3d_r24b_invoke_ready_callback_8020fcb4 = 0x8020fcb4;
SECTIONS {
  .text.w3d_d31e_init_actor_tree_801e7e24 0x801e7e24 : { *(.text.w3d_d31e_init_actor_tree_801e7e24) }
  /DISCARD/ : { *(.text*) *(.rodata*) *(.data*) *(.bss*) *(.sdata*) *(.sbss*) *(.comment) }
}
