/* Generated reference-only placements. All bodies are source-built. */
OUTPUT_FORMAT("elf32-powerpc")
OUTPUT_ARCH(powerpc)
ENTRY(w3d_cx13b_string_panel_destroy_802c0f68)
_SDA_BASE_ = 0x804b2540;
_SDA2_BASE_ = 0x804c2540;
base_8015ff2c = 0x8015ff2c;
finish_8020c5c4 = 0x8020c5c4;
string_80341588 = 0x80341588;
table_8041c8a0 = 0x8041c8a0;
SECTIONS {
  .text.w3d_cx13b_string_panel_destroy_802c0f68 0x802c0f68 : { *(.text.w3d_cx13b_string_panel_destroy_802c0f68) }
  /DISCARD/ : { *(.text*) *(.rodata*) *(.data*) *(.bss*) *(.sdata*) *(.sbss*) *(.comment) }
}
