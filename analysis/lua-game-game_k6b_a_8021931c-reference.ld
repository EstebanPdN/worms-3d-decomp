/* Generated reference-only placements. All bodies are source-built. */
OUTPUT_FORMAT("elf32-powerpc")
OUTPUT_ARCH(powerpc)
ENTRY(w3d_k6b_file_reader_query_size_8021931c)
_SDA_BASE_ = 0x804b2540;
_SDA2_BASE_ = 0x804c2540;
fn_802e4d04 = 0x802e4d04;
SECTIONS {
  .text.w3d_k6b_file_reader_query_size_8021931c 0x8021931c : { *(.text.w3d_k6b_file_reader_query_size_8021931c) }
  /DISCARD/ : { *(.text*) *(.rodata*) *(.data*) *(.bss*) *(.sdata*) *(.sbss*) *(.comment) }
}
