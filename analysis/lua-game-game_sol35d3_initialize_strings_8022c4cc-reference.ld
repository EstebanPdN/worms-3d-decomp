/* Generated reference-only placements. All bodies are source-built. */
OUTPUT_FORMAT("elf32-powerpc")
OUTPUT_ARCH(powerpc)
ENTRY(w3d_sol35d3_initialize_strings_8022c4cc)
_SDA_BASE_ = 0x804b2540;
_SDA2_BASE_ = 0x804c2540;
fn_801e8d9c = 0x801e8d9c;
fn_801ebf38 = 0x801ebf38;
fn_801ed24c = 0x801ed24c;
fn_8020bb2c = 0x8020bb2c;
fn_8020c5c0 = 0x8020c5c0;
fn_8020c5c4 = 0x8020c5c4;
fn_80341588 = 0x80341588;
fn_80341884 = 0x80341884;
lbl_803ba558 = 0x803ba558;
lbl_803ba584 = 0x803ba584;
lbl_803ba5b0 = 0x803ba5b0;
lbl_803ba5dc = 0x803ba5dc;
lbl_803ba608 = 0x803ba608;
lbl_803ba638 = 0x803ba638;
lbl_804b06a0 = 0x804b06a0;
SECTIONS {
  .text.w3d_sol35d3_initialize_strings_8022c4cc 0x8022c4cc : { *(.text.w3d_sol35d3_initialize_strings_8022c4cc) }
  /DISCARD/ : { *(.text*) *(.rodata*) *(.data*) *(.bss*) *(.sdata*) *(.sbss*) *(.comment) }
}
