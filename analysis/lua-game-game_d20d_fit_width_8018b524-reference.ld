/* Generated reference-only placements. All bodies are source-built. */
OUTPUT_FORMAT("elf32-powerpc")
OUTPUT_ARCH(powerpc)
ENTRY(d20d_fit_width_8018b524)
_SDA_BASE_ = 0x804b2540;
_SDA2_BASE_ = 0x804c2540;
cc39d_utf8_decode_8018b360 = 0x8018b360;
lbl_803a7db0 = 0x803a7db0;
w3d_k1d_lookup_entry_8018b260 = 0x8018b260;
SECTIONS {
  .text.d20d_fit_width_8018b524 0x8018b524 : { *(.text.d20d_fit_width_8018b524) }
  /DISCARD/ : { *(.text*) *(.rodata*) *(.data*) *(.bss*) *(.sdata*) *(.sbss*) *(.comment) }
}
