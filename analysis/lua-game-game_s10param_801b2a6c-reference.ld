/* Generated reference-only placements. All bodies are source-built. */
OUTPUT_FORMAT("elf32-powerpc")
OUTPUT_ARCH(powerpc)
ENTRY(w3d_s10_registry_remove_801b2a6c)
_SDA_BASE_ = 0x804b2540;
_SDA2_BASE_ = 0x804c2540;
fn_801b2b78 = 0x801b2b78;
fn_8020fd2c = 0x8020fd2c;
lbl_8045ce60 = 0x8045ce60;
SECTIONS {
  .text.w3d_s10_registry_remove_801b2a6c 0x801b2a6c : { *(.text.w3d_s10_registry_remove_801b2a6c) }
  /DISCARD/ : { *(.text*) *(.rodata*) *(.data*) *(.bss*) *(.sdata*) *(.sbss*) *(.comment) }
}
