/* Generated reference-only placements. All bodies are source-built. */
OUTPUT_FORMAT("elf32-powerpc")
OUTPUT_ARCH(powerpc)
ENTRY(w3d_cc17p_hash_insert_8035c75c)
_SDA_BASE_ = 0x804b2540;
_SDA2_BASE_ = 0x804c2540;
allocate_80212fd4 = 0x80212fd4;
fallback_803413d8 = 0x803413d8;
rehash_8035c588 = 0x8035c588;
SECTIONS {
  .text.w3d_cc17p_hash_insert_8035c75c 0x8035c75c : { *(.text.w3d_cc17p_hash_insert_8035c75c) }
  /DISCARD/ : { *(.text*) *(.rodata*) *(.data*) *(.bss*) *(.sdata*) *(.sbss*) *(.comment) }
}
