/* Generated reference-only placements. All bodies are source-built. */
OUTPUT_FORMAT("elf32-powerpc")
OUTPUT_ARCH(powerpc)
ENTRY(w3d_registry_retain_8015dae0)
_SDA_BASE_ = 0x804b2540;
_SDA2_BASE_ = 0x804c2540;
w3d_actor_base_cleanup_backend = 0x8015fa94;
w3d_actor_reference_initialize = 0x8015fa40;
w3d_fn_8015eccc = 0x8015eccc;
w3d_fn_8015ee04 = 0x8015ee04;
w3d_fn_80162e10 = 0x80162e10;
w3d_fn_80162e94 = 0x80162e94;
w3d_fn_801655b0 = 0x801655b0;
w3d_fn_80165af0 = 0x80165af0;
w3d_fn_801666f4 = 0x801666f4;
w3d_fn_8016675c = 0x8016675c;
w3d_fn_80166d8c = 0x80166d8c;
w3d_fn_80166f5c = 0x80166f5c;
w3d_fn_80169c10 = 0x80169c10;
w3d_fn_80169dec = 0x80169dec;
w3d_global_80361770 = 0x80361770;
w3d_global_803617a0 = 0x803617a0;
w3d_global_80361800 = 0x80361800;
w3d_global_80361890 = 0x80361890;
w3d_global_80361920 = 0x80361920;
w3d_global_80361950 = 0x80361950;
w3d_global_803619b0 = 0x803619b0;
w3d_global_803619fc = 0x803619fc;
w3d_global_80361a2c = 0x80361a2c;
w3d_global_803a4550 = 0x803a4550;
w3d_global_803a45ac = 0x803a45ac;
w3d_global_803a4a64 = 0x803a4a64;
w3d_global_803a4b70 = 0x803a4b70;
w3d_global_803a4b88 = 0x803a4b88;
w3d_global_803a4c34 = 0x803a4c34;
w3d_global_803a4d10 = 0x803a4d10;
w3d_global_803a508c = 0x803a508c;
w3d_global_804552b0 = 0x804552b0;
w3d_heap_allocate_entry_a = 0x801fe1d8;
w3d_owner_list_remove = 0x8020fd2c;
w3d_registry_list_80361770 = 0x80361770;
w3d_registry_list_803617a0 = 0x803617a0;
w3d_registry_list_80361950 = 0x80361950;
w3d_registry_list_803619b0 = 0x803619b0;
w3d_registry_list_803619fc = 0x803619fc;
w3d_registry_list_80361a2c = 0x80361a2c;
w3d_state_register = 0x8020fd04;
SECTIONS {
  .text.w3d_registry_retain_8015dae0 0x8015dae0 : { *(.text.w3d_registry_retain_8015dae0) }
  .text.w3d_address_8015eb54 0x8015eb54 : { *(.text.w3d_address_8015eb54) }
  .text.w3d_registry_unlink_8015eb60 0x8015eb60 : { *(.text.w3d_registry_unlink_8015eb60) }
  .text.w3d_registry_create_8015eba4 0x8015eba4 : { *(.text.w3d_registry_create_8015eba4) }
  .text.w3d_address_8015ec04 0x8015ec04 : { *(.text.w3d_address_8015ec04) }
  .text.w3d_registry_release_8015ec10 0x8015ec10 : { *(.text.w3d_registry_release_8015ec10) }
  .text.w3d_registry_retain_8015ec6c 0x8015ec6c : { *(.text.w3d_registry_retain_8015ec6c) }
  .text.w3d_empty_8015f4c8 0x8015f4c8 : { *(.text.w3d_empty_8015f4c8) }
  .text.w3d_constant_8015f618 0x8015f618 : { *(.text.w3d_constant_8015f618) }
  .text.w3d_address_8015f8c8 0x8015f8c8 : { *(.text.w3d_address_8015f8c8) }
  .text.w3d_registry_unlink_8015f8d4 0x8015f8d4 : { *(.text.w3d_registry_unlink_8015f8d4) }
  .text.w3d_registry_create_8015f918 0x8015f918 : { *(.text.w3d_registry_create_8015f918) }
  .text.w3d_address_8015f978 0x8015f978 : { *(.text.w3d_address_8015f978) }
  .text.w3d_registry_release_8015f984 0x8015f984 : { *(.text.w3d_registry_release_8015f984) }
  .text.w3d_registry_retain_8015f9e0 0x8015f9e0 : { *(.text.w3d_registry_retain_8015f9e0) }
  .text.w3d_constant_8015fb2c 0x8015fb2c : { *(.text.w3d_constant_8015fb2c) }
  .text.w3d_constant_80160028 0x80160028 : { *(.text.w3d_constant_80160028) }
  .text.w3d_constant_80160030 0x80160030 : { *(.text.w3d_constant_80160030) }
  .text.w3d_address_801600b8 0x801600b8 : { *(.text.w3d_address_801600b8) }
  .text.w3d_constant_80160164 0x80160164 : { *(.text.w3d_constant_80160164) }
  .text.w3d_constant_8016016c 0x8016016c : { *(.text.w3d_constant_8016016c) }
  .text.w3d_get_80160e2c 0x80160e2c : { *(.text.w3d_get_80160e2c) }
  .text.w3d_constant_8016114c 0x8016114c : { *(.text.w3d_constant_8016114c) }
  .text.w3d_constant_80161154 0x80161154 : { *(.text.w3d_constant_80161154) }
  .text.w3d_address_801611dc 0x801611dc : { *(.text.w3d_address_801611dc) }
  .text.w3d_constant_80161288 0x80161288 : { *(.text.w3d_constant_80161288) }
  .text.w3d_constant_80161290 0x80161290 : { *(.text.w3d_constant_80161290) }
  .text.w3d_constant_80161dc8 0x80161dc8 : { *(.text.w3d_constant_80161dc8) }
  .text.w3d_empty_80161dd0 0x80161dd0 : { *(.text.w3d_empty_80161dd0) }
  .text.w3d_constant_80162934 0x80162934 : { *(.text.w3d_constant_80162934) }
  .text.w3d_constant_801629e8 0x801629e8 : { *(.text.w3d_constant_801629e8) }
  .text.w3d_constant_801629f0 0x801629f0 : { *(.text.w3d_constant_801629f0) }
  .text.w3d_address_80162a78 0x80162a78 : { *(.text.w3d_address_80162a78) }
  .text.w3d_constant_80162b24 0x80162b24 : { *(.text.w3d_constant_80162b24) }
  .text.w3d_constant_80162b2c 0x80162b2c : { *(.text.w3d_constant_80162b2c) }
  .text.w3d_address_80162c98 0x80162c98 : { *(.text.w3d_address_80162c98) }
  .text.w3d_registry_unlink_80162ca4 0x80162ca4 : { *(.text.w3d_registry_unlink_80162ca4) }
  .text.w3d_registry_create_80162ce8 0x80162ce8 : { *(.text.w3d_registry_create_80162ce8) }
  .text.w3d_address_80162d48 0x80162d48 : { *(.text.w3d_address_80162d48) }
  .text.w3d_registry_release_80162d54 0x80162d54 : { *(.text.w3d_registry_release_80162d54) }
  .text.w3d_registry_retain_80162db0 0x80162db0 : { *(.text.w3d_registry_retain_80162db0) }
  .text.w3d_empty_801651e4 0x801651e4 : { *(.text.w3d_empty_801651e4) }
  .text.w3d_address_801655a4 0x801655a4 : { *(.text.w3d_address_801655a4) }
  .text.w3d_address_801656c8 0x801656c8 : { *(.text.w3d_address_801656c8) }
  .text.w3d_registry_retain_801657fc 0x801657fc : { *(.text.w3d_registry_retain_801657fc) }
  .text.w3d_address_8016585c 0x8016585c : { *(.text.w3d_address_8016585c) }
  .text.w3d_registry_release_80165868 0x80165868 : { *(.text.w3d_registry_release_80165868) }
  .text.w3d_registry_retain_801658c4 0x801658c4 : { *(.text.w3d_registry_retain_801658c4) }
  .text.w3d_address_8016651c 0x8016651c : { *(.text.w3d_address_8016651c) }
  .text.w3d_registry_unlink_80166528 0x80166528 : { *(.text.w3d_registry_unlink_80166528) }
  .text.w3d_registry_create_8016656c 0x8016656c : { *(.text.w3d_registry_create_8016656c) }
  .text.w3d_get_80166624 0x80166624 : { *(.text.w3d_get_80166624) }
  .text.w3d_address_8016662c 0x8016662c : { *(.text.w3d_address_8016662c) }
  .text.w3d_registry_release_80166638 0x80166638 : { *(.text.w3d_registry_release_80166638) }
  .text.w3d_registry_retain_80166694 0x80166694 : { *(.text.w3d_registry_retain_80166694) }
  .text.w3d_constant_80166960 0x80166960 : { *(.text.w3d_constant_80166960) }
  .text.w3d_get_801669d0 0x801669d0 : { *(.text.w3d_get_801669d0) }
  .text.w3d_get_801669e4 0x801669e4 : { *(.text.w3d_get_801669e4) }
  .text.w3d_get_801669f8 0x801669f8 : { *(.text.w3d_get_801669f8) }
  .text.w3d_get_80166a68 0x80166a68 : { *(.text.w3d_get_80166a68) }
  .text.w3d_address_80166c14 0x80166c14 : { *(.text.w3d_address_80166c14) }
  .text.w3d_registry_unlink_80166c20 0x80166c20 : { *(.text.w3d_registry_unlink_80166c20) }
  .text.w3d_registry_create_80166c64 0x80166c64 : { *(.text.w3d_registry_create_80166c64) }
  .text.w3d_address_80166cc4 0x80166cc4 : { *(.text.w3d_address_80166cc4) }
  .text.w3d_registry_release_80166cd0 0x80166cd0 : { *(.text.w3d_registry_release_80166cd0) }
  .text.w3d_registry_retain_80166d2c 0x80166d2c : { *(.text.w3d_registry_retain_80166d2c) }
  .text.w3d_constant_8016742c 0x8016742c : { *(.text.w3d_constant_8016742c) }
  .text.w3d_get_80167434 0x80167434 : { *(.text.w3d_get_80167434) }
  .text.w3d_constant_801675a8 0x801675a8 : { *(.text.w3d_constant_801675a8) }
  .text.w3d_constant_801676d8 0x801676d8 : { *(.text.w3d_constant_801676d8) }
  .text.w3d_empty_801686a0 0x801686a0 : { *(.text.w3d_empty_801686a0) }
  .text.w3d_address_80169a38 0x80169a38 : { *(.text.w3d_address_80169a38) }
  .text.w3d_registry_unlink_80169a44 0x80169a44 : { *(.text.w3d_registry_unlink_80169a44) }
  .text.w3d_registry_create_80169a88 0x80169a88 : { *(.text.w3d_registry_create_80169a88) }
  .text.w3d_get_80169b40 0x80169b40 : { *(.text.w3d_get_80169b40) }
  .text.w3d_address_80169b48 0x80169b48 : { *(.text.w3d_address_80169b48) }
  .text.w3d_registry_release_80169b54 0x80169b54 : { *(.text.w3d_registry_release_80169b54) }
  .text.w3d_registry_retain_80169bb0 0x80169bb0 : { *(.text.w3d_registry_retain_80169bb0) }
  .text.w3d_constant_8016a094 0x8016a094 : { *(.text.w3d_constant_8016a094) }
  .text.w3d_constant_8016a09c 0x8016a09c : { *(.text.w3d_constant_8016a09c) }
  /DISCARD/ : { *(.text*) *(.rodata*) *(.data*) *(.bss*) *(.sdata*) *(.sbss*) *(.comment) }
}
