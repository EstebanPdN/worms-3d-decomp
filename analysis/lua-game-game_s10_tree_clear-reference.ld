/* Generated reference-only placements. All bodies are source-built. */
OUTPUT_FORMAT("elf32-powerpc")
OUTPUT_ARCH(powerpc)
ENTRY(w3d_s10_tree_clear_801a6458)
_SDA_BASE_ = 0x804b2540;
_SDA2_BASE_ = 0x804c2540;
fn_80352f34 = 0x80352f34;
SECTIONS {
  .text.w3d_s10_tree_clear_801a6458 0x801a6458 : { *(.text.w3d_s10_tree_clear_801a6458) }
  /DISCARD/ : { *(.text*) *(.rodata*) *(.data*) *(.bss*) *(.sdata*) *(.sbss*) *(.comment) }
}
