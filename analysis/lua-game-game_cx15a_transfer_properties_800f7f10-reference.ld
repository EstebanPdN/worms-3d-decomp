/* Generated reference-only placements. All bodies are source-built. */
OUTPUT_FORMAT("elf32-powerpc")
OUTPUT_ARCH(powerpc)
ENTRY(w3d_cx15a_transfer_properties_800f7f10)
_SDA_BASE_ = 0x804b2540;
_SDA2_BASE_ = 0x804c2540;
finish_800f8018 = 0x800f8018;
transfer_80344dc4 = 0x80344dc4;
transfer_8034505c = 0x8034505c;
transfer_80345330 = 0x80345330;
transfer_80345648 = 0x80345648;
transfer_803459fc = 0x803459fc;
transfer_80345cd0 = 0x80345cd0;
transfer_80345fe8 = 0x80345fe8;
transfer_80346210 = 0x80346210;
transfer_80346470 = 0x80346470;
transfer_803466fc = 0x803466fc;
transfer_80346a04 = 0x80346a04;
transfer_80346c64 = 0x80346c64;
SECTIONS {
  .text.w3d_cx15a_transfer_properties_800f7f10 0x800f7f10 : { *(.text.w3d_cx15a_transfer_properties_800f7f10) }
  /DISCARD/ : { *(.text*) *(.rodata*) *(.data*) *(.bss*) *(.sdata*) *(.sbss*) *(.comment) }
}
