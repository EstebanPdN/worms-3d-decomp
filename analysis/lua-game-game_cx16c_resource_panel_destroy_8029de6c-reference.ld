/* Generated reference-only placements. All bodies are source-built. */
OUTPUT_FORMAT("elf32-powerpc")
OUTPUT_ARCH(powerpc)
ENTRY(w3d_cx16c_resource_panel_destroy_8029de6c)
_SDA_BASE_ = 0x804b2540;
_SDA2_BASE_ = 0x804c2540;
cx16c_base_destroy_8015ff2c = 0x8015ff2c;
cx16c_context_destroy_802afc40 = 0x802afc40;
cx16c_member_destroy_80210abc = 0x80210abc;
cx16c_storage_release_802134fc = 0x802134fc;
cx16c_table_8041c2b0 = 0x8041c2b0;
cx16c_table_8041c300 = 0x8041c300;
SECTIONS {
  .text.w3d_cx16c_resource_panel_destroy_8029de6c 0x8029de6c : { *(.text.w3d_cx16c_resource_panel_destroy_8029de6c) }
  /DISCARD/ : { *(.text*) *(.rodata*) *(.data*) *(.bss*) *(.sdata*) *(.sbss*) *(.comment) }
}
