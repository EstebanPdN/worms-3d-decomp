/* Generated reference-only placements. All bodies are source-built. */
OUTPUT_FORMAT("elf32-powerpc")
OUTPUT_ARCH(powerpc)
ENTRY(f6b_configure_held_8015b78c)
_SDA_BASE_ = 0x804b2540;
_SDA2_BASE_ = 0x804c2540;
a_803a42fc = 0x803a42fc;
b_803a4304 = 0x803a4304;
c_803a4300 = 0x803a4300;
d_803a4308 = 0x803a4308;
lookup_8020b680 = 0x8020b680;
one_803a42f4 = 0x803a42f4;
service_804138c0 = 0x804138c0;
v_803a42f8 = 0x803a42f8;
x_803a42e4 = 0x803a42e4;
y_803a42e8 = 0x803a42e8;
z_803a42ec = 0x803a42ec;
zero_803a42f0 = 0x803a42f0;
SECTIONS {
  .text.f6b_configure_held_8015b78c 0x8015b78c : { *(.text.f6b_configure_held_8015b78c) }
  /DISCARD/ : { *(.text*) *(.rodata*) *(.data*) *(.bss*) *(.sdata*) *(.sbss*) *(.comment) }
}
