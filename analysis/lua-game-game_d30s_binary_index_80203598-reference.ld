/* Generated reference-only placements. All bodies are source-built. */
OUTPUT_FORMAT("elf32-powerpc")
OUTPUT_ARCH(powerpc)
ENTRY(d30s_binary_index_80203598)
_SDA_BASE_ = 0x804b2540;
_SDA2_BASE_ = 0x804c2540;
insert_unique__Q24_STLt8_Rb_tree5Z7D30sKeyZQ24_STLt4pair2ZC7D30sKeyZiZQ24_STLt10_Select1st1ZQ24_STLt4pair2ZC7D30sKeyZiZ11D30sKeyLessZQ24_STLt9allocator1ZQ24_STLt4pair2ZC7D30sKeyZiGQ24_STLt17_Rb_tree_iterator2ZQ24_STLt4pair2ZC7D30sKeyZiZQ24_STLt16_Nonconst_traits1ZQ24_STLt4pair2ZC7D30sKeyZiRCQ24_STLt4pair2ZC7D30sKeyZi = 0x8035b594;
memcmp = 0x802eedc0;
SECTIONS {
  .text.d30s_binary_index_80203598 0x80203598 : { *(.text.d30s_binary_index_80203598) }
  /DISCARD/ : { *(.text*) *(.rodata*) *(.data*) *(.bss*) *(.sdata*) *(.sbss*) *(.comment) }
}
