/* Generated reference-only placements. All bodies are source-built. */
OUTPUT_FORMAT("elf32-powerpc")
OUTPUT_ARCH(powerpc)
ENTRY(sol35d11_assign_utf8_prefix_8020c6a4_v2)
_SDA_BASE_ = 0x804b2540;
_SDA2_BASE_ = 0x804c2540;
sol35d11_allocate_8020bc88 = 0x8020bc88;
sol35d11_base_finish_8020c5c4 = 0x8020c5c4;
sol35d11_base_init_8020c5c0 = 0x8020c5c0;
sol35d11_character_count_8020c5cc = 0x8020c5cc;
sol35d11_free_header_8020bb2c = 0x8020bb2c;
sol35d11_header_80341884 = 0x80341884;
sol35d11_prefix_bytes_8020c620 = 0x8020c620;
sol35d11_release_80341588 = 0x80341588;
sol35d11_transfer_802eee50 = 0x802eee50;
SECTIONS {
  .text.sol35d11_assign_utf8_prefix_8020c6a4_v2 0x8020c6a4 : { *(.text.sol35d11_assign_utf8_prefix_8020c6a4_v2) }
  /DISCARD/ : { *(.text*) *(.rodata*) *(.data*) *(.bss*) *(.sdata*) *(.sbss*) *(.comment) }
}
