/* Generated reference-only placements. All bodies are source-built. */
OUTPUT_FORMAT("elf32-powerpc")
OUTPUT_ARCH(powerpc)
ENTRY(w3d_s21_destroy_refs_801ee46c)
_SDA_BASE_ = 0x804b2540;
_SDA2_BASE_ = 0x804c2540;
fn_80210990 = 0x80210990;
lbl_80411ac0 = 0x80411ac0;
lbl_804176d0 = 0x804176d0;
SECTIONS {
  .text.w3d_s21_destroy_refs_801ee46c 0x801ee46c : { *(.text.w3d_s21_destroy_refs_801ee46c) }
  /DISCARD/ : { *(.text*) *(.rodata*) *(.data*) *(.bss*) *(.sdata*) *(.sbss*) *(.comment) }
}
