/* Generated reference-only placements. All bodies are source-built. */
OUTPUT_FORMAT("elf32-powerpc")
OUTPUT_ARCH(powerpc)
ENTRY(w3d_cx9c_pair_tree_unique_80355e40)
_SDA_BASE_ = 0x804b2540;
_SDA2_BASE_ = 0x804c2540;
cx9c_insert_80355b6c = 0x80355b6c;
cx9c_previous_803526a0 = 0x803526a0;
SECTIONS {
  .text.w3d_cx9c_pair_tree_unique_80355e40 0x80355e40 : { *(.text.w3d_cx9c_pair_tree_unique_80355e40) }
  /DISCARD/ : { *(.text*) *(.rodata*) *(.data*) *(.bss*) *(.sdata*) *(.sbss*) *(.comment) }
}
