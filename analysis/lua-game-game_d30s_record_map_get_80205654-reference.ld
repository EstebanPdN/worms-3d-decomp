/* Generated reference-only placements. All bodies are source-built. */
OUTPUT_FORMAT("elf32-powerpc")
OUTPUT_ARCH(powerpc)
ENTRY(d30s_record_map_get_80205654)
_SDA_BASE_ = 0x804b2540;
_SDA2_BASE_ = 0x804c2540;
insert_unique__Q24_STLt8_Rb_tree5ZUiZQ24_STLt4pair2ZCUiZ15D30sCountRecordZQ24_STLt10_Select1st1ZQ24_STLt4pair2ZCUiZ15D30sCountRecordZQ24_STLt4less1ZUiZQ24_STLt9allocator1ZQ24_STLt4pair2ZCUiZ15D30sCountRecordRCQ24_STLt4pair2ZCUiZ15D30sCountRecord = 0x8035bf94;
SECTIONS {
  .text.d30s_record_map_get_80205654 0x80205654 : { *(.text.d30s_record_map_get_80205654) }
  /DISCARD/ : { *(.text*) *(.rodata*) *(.data*) *(.bss*) *(.sdata*) *(.sbss*) *(.comment) }
}
