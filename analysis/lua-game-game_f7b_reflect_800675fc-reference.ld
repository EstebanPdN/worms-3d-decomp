/* Generated reference-only placements. All bodies are source-built. */
OUTPUT_FORMAT("elf32-powerpc")
OUTPUT_ARCH(powerpc)
ENTRY(f7b_reflect_800675fc)
_SDA_BASE_ = 0x804b2540;
_SDA2_BASE_ = 0x804c2540;
damping_8037a0e8 = 0x8037a0e8;
lower_8037a0e0 = 0x8037a0e0;
normal_80067770 = 0x80067770;
upper_8037a0e4 = 0x8037a0e4;
SECTIONS {
  .text.f7b_reflect_800675fc 0x800675fc : { *(.text.f7b_reflect_800675fc) }
  /DISCARD/ : { *(.text*) *(.rodata*) *(.data*) *(.bss*) *(.sdata*) *(.sbss*) *(.comment) }
}
