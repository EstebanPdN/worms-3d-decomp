/* Generated reference-only placements. All bodies are source-built. */
OUTPUT_FORMAT("elf32-powerpc")
OUTPUT_ARCH(powerpc)
ENTRY(w3d_d40j_reset_queue_times_80164070)
_SDA_BASE_ = 0x804b2540;
_SDA2_BASE_ = 0x804c2540;
_S_oom_malloc__Q24_STLt14__malloc_alloc1i0Ui = 0x803413d8;
__as__Q24_STLt6vector2Z15D31sQueueRecordZQ24_STLt9allocator1Z15D31sQueueRecordRCQ24_STLt6vector2Z15D31sQueueRecordZQ24_STLt9allocator1Z15D31sQueueRecord = 0x8034a85c;
empty_801651e4 = 0x801651e4;
free = 0x802134fc;
malloc = 0x80212fd4;
pop_heap__H2ZP15D31sQueueRecordZ13D31sQueueLess_4_STLX01X01X11_v = 0x8034a7fc;
push_heap__H2ZP15D31sQueueRecordZ13D31sQueueLess_4_STLX01X01X11_v = 0x8034a400;
set_time2_8034b408 = 0x8034b408;
set_time_8034b3f8 = 0x8034b3f8;
SECTIONS {
  .text.w3d_d40j_reset_queue_times_80164070 0x80164070 : { *(.text.w3d_d40j_reset_queue_times_80164070) }
  /DISCARD/ : { *(.text*) *(.rodata*) *(.data*) *(.bss*) *(.sdata*) *(.sbss*) *(.comment) }
}
