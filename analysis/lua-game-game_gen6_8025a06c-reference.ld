/* Generated reference-only placements. All bodies are source-built. */
OUTPUT_FORMAT("elf32-powerpc")
OUTPUT_ARCH(powerpc)
ENTRY(w3d_setf_8025a06c)
_SDA_BASE_ = 0x804b2540;
_SDA2_BASE_ = 0x804c2540;
w3d_data_803eb2cc = 0x803eb2cc;
w3d_data_803eb374 = 0x803eb374;
w3d_data_803eb3c8 = 0x803eb3c8;
w3d_data_803eb470 = 0x803eb470;
w3d_data_803eb4e0 = 0x803eb4e0;
w3d_data_803eb534 = 0x803eb534;
w3d_data_803eb550 = 0x803eb550;
w3d_data_803eb5a4 = 0x803eb5a4;
w3d_data_803eb5c0 = 0x803eb5c0;
w3d_fn_80160038 = 0x80160038;
w3d_global_803617d0 = 0x803617d0;
w3d_global_803686f8 = 0x803686f8;
w3d_global_80368818 = 0x80368818;
w3d_global_803688a8 = 0x803688a8;
w3d_global_803689c8 = 0x803689c8;
w3d_global_80368a88 = 0x80368a88;
w3d_global_80368b18 = 0x80368b18;
w3d_global_80368b48 = 0x80368b48;
w3d_global_80368bd8 = 0x80368bd8;
w3d_global_80368c08 = 0x80368c08;
w3d_registry_80368bd8_create = 0x802c5c68;
w3d_registry_create_8027056c = 0x8027056c;
w3d_registry_create_802879b0 = 0x802879b0;
w3d_registry_create_8028cd0c = 0x8028cd0c;
w3d_registry_create_802a2d50 = 0x802a2d50;
w3d_registry_create_802b2ad0 = 0x802b2ad0;
w3d_registry_create_802ba328 = 0x802ba328;
w3d_registry_create_802bbd50 = 0x802bbd50;
w3d_shared_object_create = 0x802c6a3c;
SECTIONS {
  .text.w3d_setf_8025a06c 0x8025a06c : { *(.text.w3d_setf_8025a06c) }
  .text.w3d_getf_8025a074 0x8025a074 : { *(.text.w3d_getf_8025a074) }
  .text.w3d_setf_8025a07c 0x8025a07c : { *(.text.w3d_setf_8025a07c) }
  .text.w3d_getf_8025a084 0x8025a084 : { *(.text.w3d_getf_8025a084) }
  .text.w3d_setf_8025a08c 0x8025a08c : { *(.text.w3d_setf_8025a08c) }
  .text.w3d_getf_8025a094 0x8025a094 : { *(.text.w3d_getf_8025a094) }
  .text.w3d_setf_8025a09c 0x8025a09c : { *(.text.w3d_setf_8025a09c) }
  .text.w3d_getf_8025a0a4 0x8025a0a4 : { *(.text.w3d_getf_8025a0a4) }
  .text.w3d_setf_8025a0ac 0x8025a0ac : { *(.text.w3d_setf_8025a0ac) }
  .text.w3d_getf_8025a0b4 0x8025a0b4 : { *(.text.w3d_getf_8025a0b4) }
  .text.w3d_setf_8025a0bc 0x8025a0bc : { *(.text.w3d_setf_8025a0bc) }
  .text.w3d_getf_8025a0c4 0x8025a0c4 : { *(.text.w3d_getf_8025a0c4) }
  .text.w3d_setf_8025a0cc 0x8025a0cc : { *(.text.w3d_setf_8025a0cc) }
  .text.w3d_getf_8025a0d4 0x8025a0d4 : { *(.text.w3d_getf_8025a0d4) }
  .text.w3d_setf_8025a0dc 0x8025a0dc : { *(.text.w3d_setf_8025a0dc) }
  .text.w3d_getf_8025a0e4 0x8025a0e4 : { *(.text.w3d_getf_8025a0e4) }
  .text.w3d_setf_8025a0ec 0x8025a0ec : { *(.text.w3d_setf_8025a0ec) }
  .text.w3d_getf_8025a0f4 0x8025a0f4 : { *(.text.w3d_getf_8025a0f4) }
  .text.w3d_setf_8025a0fc 0x8025a0fc : { *(.text.w3d_setf_8025a0fc) }
  .text.w3d_getf_8025a104 0x8025a104 : { *(.text.w3d_getf_8025a104) }
  .text.w3d_member_8025a174 0x8025a174 : { *(.text.w3d_member_8025a174) }
  .text.w3d_member_8025a1e4 0x8025a1e4 : { *(.text.w3d_member_8025a1e4) }
  .text.w3d_member_8025a254 0x8025a254 : { *(.text.w3d_member_8025a254) }
  .text.w3d_member_8025a2c4 0x8025a2c4 : { *(.text.w3d_member_8025a2c4) }
  .text.w3d_member_8025a334 0x8025a334 : { *(.text.w3d_member_8025a334) }
  .text.w3d_member_8025a3a4 0x8025a3a4 : { *(.text.w3d_member_8025a3a4) }
  .text.w3d_member_8025a414 0x8025a414 : { *(.text.w3d_member_8025a414) }
  .text.w3d_member_8025a484 0x8025a484 : { *(.text.w3d_member_8025a484) }
  .text.w3d_member_8025a4f4 0x8025a4f4 : { *(.text.w3d_member_8025a4f4) }
  .text.w3d_copy12_8025a4fc 0x8025a4fc : { *(.text.w3d_copy12_8025a4fc) }
  .text.w3d_member_8025a51c 0x8025a51c : { *(.text.w3d_member_8025a51c) }
  .text.w3d_copy12_8025a524 0x8025a524 : { *(.text.w3d_copy12_8025a524) }
  .text.w3d_member_8025a544 0x8025a544 : { *(.text.w3d_member_8025a544) }
  .text.w3d_setf_8025a54c 0x8025a54c : { *(.text.w3d_setf_8025a54c) }
  .text.w3d_getf_8025a554 0x8025a554 : { *(.text.w3d_getf_8025a554) }
  .text.w3d_setf_8025a55c 0x8025a55c : { *(.text.w3d_setf_8025a55c) }
  .text.w3d_getf_8025a564 0x8025a564 : { *(.text.w3d_getf_8025a564) }
  .text.w3d_setf_8025a5bc 0x8025a5bc : { *(.text.w3d_setf_8025a5bc) }
  .text.w3d_getf_8025a5c4 0x8025a5c4 : { *(.text.w3d_getf_8025a5c4) }
  .text.w3d_setf_8025a5cc 0x8025a5cc : { *(.text.w3d_setf_8025a5cc) }
  .text.w3d_getf_8025a5d4 0x8025a5d4 : { *(.text.w3d_getf_8025a5d4) }
  .text.w3d_setf_8025a5dc 0x8025a5dc : { *(.text.w3d_setf_8025a5dc) }
  .text.w3d_getf_8025a5e4 0x8025a5e4 : { *(.text.w3d_getf_8025a5e4) }
  .text.w3d_member_8025a654 0x8025a654 : { *(.text.w3d_member_8025a654) }
  .text.w3d_member_8025a6c4 0x8025a6c4 : { *(.text.w3d_member_8025a6c4) }
  .text.w3d_member_8025a734 0x8025a734 : { *(.text.w3d_member_8025a734) }
  .text.w3d_member_8025a7a4 0x8025a7a4 : { *(.text.w3d_member_8025a7a4) }
  .text.w3d_copy12_8025a7ac 0x8025a7ac : { *(.text.w3d_copy12_8025a7ac) }
  .text.w3d_member_8025a7cc 0x8025a7cc : { *(.text.w3d_member_8025a7cc) }
  .text.w3d_copy12_8025a7d4 0x8025a7d4 : { *(.text.w3d_copy12_8025a7d4) }
  .text.w3d_member_8025a7f4 0x8025a7f4 : { *(.text.w3d_member_8025a7f4) }
  .text.w3d_setf_8025a7fc 0x8025a7fc : { *(.text.w3d_setf_8025a7fc) }
  .text.w3d_getf_8025a804 0x8025a804 : { *(.text.w3d_getf_8025a804) }
  .text.w3d_setf_8025a80c 0x8025a80c : { *(.text.w3d_setf_8025a80c) }
  .text.w3d_getf_8025a814 0x8025a814 : { *(.text.w3d_getf_8025a814) }
  .text.w3d_setf_8025a81c 0x8025a81c : { *(.text.w3d_setf_8025a81c) }
  .text.w3d_getf_8025a824 0x8025a824 : { *(.text.w3d_getf_8025a824) }
  .text.w3d_setf_8025a82c 0x8025a82c : { *(.text.w3d_setf_8025a82c) }
  .text.w3d_getf_8025a834 0x8025a834 : { *(.text.w3d_getf_8025a834) }
  .text.w3d_setf_8025a83c 0x8025a83c : { *(.text.w3d_setf_8025a83c) }
  .text.w3d_getf_8025a844 0x8025a844 : { *(.text.w3d_getf_8025a844) }
  .text.w3d_setf_8025a84c 0x8025a84c : { *(.text.w3d_setf_8025a84c) }
  .text.w3d_getf_8025a854 0x8025a854 : { *(.text.w3d_getf_8025a854) }
  .text.w3d_setf_8025a85c 0x8025a85c : { *(.text.w3d_setf_8025a85c) }
  .text.w3d_getf_8025a864 0x8025a864 : { *(.text.w3d_getf_8025a864) }
  .text.w3d_sinit_body_80270c38 0x80270c38 : { *(.text.w3d_sinit_body_80270c38) }
  .text.w3d_sinit_body_80287db4 0x80287db4 : { *(.text.w3d_sinit_body_80287db4) }
  .text.w3d_sinit_body_8028dda8 0x8028dda8 : { *(.text.w3d_sinit_body_8028dda8) }
  .text.w3d_sinit_body_802a3cc8 0x802a3cc8 : { *(.text.w3d_sinit_body_802a3cc8) }
  .text.w3d_sinit_body_802b3e80 0x802b3e80 : { *(.text.w3d_sinit_body_802b3e80) }
  .text.w3d_sinit_body_802bad0c 0x802bad0c : { *(.text.w3d_sinit_body_802bad0c) }
  .text.w3d_sinit_body_802bcd84 0x802bcd84 : { *(.text.w3d_sinit_body_802bcd84) }
  .text.w3d_sinit_body_802c6960 0x802c6960 : { *(.text.w3d_sinit_body_802c6960) }
  .text.w3d_sinit_body_802c817c 0x802c817c : { *(.text.w3d_sinit_body_802c817c) }
  /DISCARD/ : { *(.text*) *(.rodata*) *(.data*) *(.bss*) *(.sdata*) *(.sbss*) *(.comment) }
}
