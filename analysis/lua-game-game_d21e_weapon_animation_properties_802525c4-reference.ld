/* Generated reference-only placements. All bodies are source-built. */
OUTPUT_FORMAT("elf32-powerpc")
OUTPUT_ARCH(powerpc)
ENTRY(w3d_d21e_register_weapon_animation_properties_802525c4)
_SDA_BASE_ = 0x804b2540;
_SDA2_BASE_ = 0x804c2540;
constant_803c66ec = 0x803c66ec;
d20e_empty_804b06a0 = 0x804b06a0;
d20e_release_header_8020bb2c = 0x8020bb2c;
d20e_string_finish_8020c5c4 = 0x8020c5c4;
d20e_string_header_80341884 = 0x80341884;
d20e_string_init_8020c5c0 = 0x8020c5c0;
d20e_string_release_80341588 = 0x80341588;
desc_803c5fa0 = 0x803c5fa0;
desc_803c5fd0 = 0x803c5fd0;
desc_803c5ffc = 0x803c5ffc;
desc_803c602c = 0x803c602c;
desc_803c605c = 0x803c605c;
desc_803c608c = 0x803c608c;
desc_803c60cc = 0x803c60cc;
desc_803c60fc = 0x803c60fc;
desc_803c6138 = 0x803c6138;
desc_803c6174 = 0x803c6174;
desc_803c61a8 = 0x803c61a8;
desc_803c61e0 = 0x803c61e0;
desc_803c621c = 0x803c621c;
desc_803c6254 = 0x803c6254;
desc_803c6298 = 0x803c6298;
desc_803c62d0 = 0x803c62d0;
desc_803c630c = 0x803c630c;
desc_803c6344 = 0x803c6344;
desc_803c6380 = 0x803c6380;
desc_803c63bc = 0x803c63bc;
desc_803c63f4 = 0x803c63f4;
desc_803c642c = 0x803c642c;
desc_803c6468 = 0x803c6468;
desc_803c64a8 = 0x803c64a8;
desc_803c64e4 = 0x803c64e4;
desc_803c6524 = 0x803c6524;
desc_803c6564 = 0x803c6564;
desc_803c65a0 = 0x803c65a0;
desc_803c65dc = 0x803c65dc;
desc_803c6618 = 0x803c6618;
desc_803c665c = 0x803c665c;
desc_803c6690 = 0x803c6690;
desc_803c66c4 = 0x803c66c4;
fn_801e8d9c = 0x801e8d9c;
fn_801eb674 = 0x801eb674;
fn_801eb834 = 0x801eb834;
fn_801ebf38 = 0x801ebf38;
fn_801ec52c = 0x801ec52c;
fn_801ece2c = 0x801ece2c;
fn_801ed24c = 0x801ed24c;
fn_801f0210 = 0x801f0210;
SECTIONS {
  .text.w3d_d21e_register_weapon_animation_properties_802525c4 0x802525c4 : { *(.text.w3d_d21e_register_weapon_animation_properties_802525c4) }
  /DISCARD/ : { *(.text*) *(.rodata*) *(.data*) *(.bss*) *(.sdata*) *(.sbss*) *(.comment) }
}
