/* Generated reference-only placements. All bodies are source-built. */
OUTPUT_FORMAT("elf32-powerpc")
OUTPUT_ARCH(powerpc)
ENTRY(sol11a_select_team_801560d8)
_SDA_BASE_ = 0x804b2540;
_SDA2_BASE_ = 0x804c2540;
_._21Sol11aBorrow_80178474 = 0x80178474;
identity_803426b4 = 0x803426b4;
owner_800fc7f8 = 0x800fc7f8;
team_800fc6dc = 0x800fc6dc;
update_80178c54 = 0x80178c54;
SECTIONS {
  .text.sol11a_select_team_801560d8 0x801560d8 : { *(.text.sol11a_select_team_801560d8) }
  /DISCARD/ : { *(.text*) *(.rodata*) *(.data*) *(.bss*) *(.sdata*) *(.sbss*) *(.comment) }
}
