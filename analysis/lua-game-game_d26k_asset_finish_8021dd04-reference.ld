/* Generated reference-only placements. All bodies are source-built. */
OUTPUT_FORMAT("elf32-powerpc")
OUTPUT_ARCH(powerpc)
ENTRY(w3d_d26k_asset_finish_8021dd04)
_SDA_BASE_ = 0x804b2540;
_SDA2_BASE_ = 0x804c2540;
object_80240994 = 0x80240994;
release_held_8020810c = 0x8020810c;
string_finish_8020c5c4 = 0x8020c5c4;
string_header_80341884 = 0x80341884;
string_init_8020c5c0 = 0x8020c5c0;
string_release_80341588 = 0x80341588;
SECTIONS {
  .text.w3d_d26k_asset_finish_8021dd04 0x8021dd04 : { *(.text.w3d_d26k_asset_finish_8021dd04) }
  /DISCARD/ : { *(.text*) *(.rodata*) *(.data*) *(.bss*) *(.sdata*) *(.sbss*) *(.comment) }
}
