/* Generated reference-only placements. All bodies are source-built. */
OUTPUT_FORMAT("elf32-powerpc")
OUTPUT_ARCH(powerpc)
ENTRY(d27l_panel_text_field_802b2664)
_SDA_BASE_ = 0x804b2540;
_SDA2_BASE_ = 0x804c2540;
__3Str = 0x803426b8;
__3StrPCc = 0x8020bb54;
fn_8020bb2c = 0x8020bb2c;
fn_8020bd38 = 0x8020bd38;
fn_8020c3a0 = 0x8020c3a0;
fn_8020c5c0 = 0x8020c5c0;
fn_8020c5c4 = 0x8020c5c4;
fn_80341588 = 0x80341588;
fn_80341884 = 0x80341884;
s_803d7a1c = 0x803d7a1c;
s_803d7a50 = 0x803d7a50;
strcspn = 0x802ef380;
SECTIONS {
  .text.d27l_panel_text_field_802b2664 0x802b2664 : { *(.text.d27l_panel_text_field_802b2664) }
  /DISCARD/ : { *(.text*) *(.rodata*) *(.data*) *(.bss*) *(.sdata*) *(.sbss*) *(.comment) }
}
