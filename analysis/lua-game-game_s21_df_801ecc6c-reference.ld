/* Generated reference-only placements. All bodies are source-built. */
OUTPUT_FORMAT("elf32-powerpc")
OUTPUT_ARCH(powerpc)
ENTRY(w3d_s21_create_typed_801ecc6c)
_SDA_BASE_ = 0x804b2540;
_SDA2_BASE_ = 0x804c2540;
fn_801e8bc4 = 0x801e8bc4;
fn_801eb058 = 0x801eb058;
fn_801eb0a8 = 0x801eb0a8;
fn_801fe1d8 = 0x801fe1d8;
lbl_80417300 = 0x80417300;
SECTIONS {
  .text.w3d_s21_create_typed_801ecc6c 0x801ecc6c : { *(.text.w3d_s21_create_typed_801ecc6c) }
  /DISCARD/ : { *(.text*) *(.rodata*) *(.data*) *(.bss*) *(.sdata*) *(.sbss*) *(.comment) }
}
