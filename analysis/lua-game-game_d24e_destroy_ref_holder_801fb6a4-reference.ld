/* Generated reference-only placements. All bodies are source-built. */
OUTPUT_FORMAT("elf32-powerpc")
OUTPUT_ARCH(powerpc)
ENTRY(w3d_d24e_destroy_ref_holder_801fb6a4)
_SDA_BASE_ = 0x804b2540;
_SDA2_BASE_ = 0x804c2540;
fn_801fe1f8 = 0x801fe1f8;
fn_80210990 = 0x80210990;
fn_802134fc = 0x802134fc;
vt_80418210 = 0x80418210;
vt_804182d0 = 0x804182d0;
SECTIONS {
  .text.w3d_d24e_destroy_ref_holder_801fb6a4 0x801fb6a4 : { *(.text.w3d_d24e_destroy_ref_holder_801fb6a4) }
  /DISCARD/ : { *(.text*) *(.rodata*) *(.data*) *(.bss*) *(.sdata*) *(.sbss*) *(.comment) }
}
