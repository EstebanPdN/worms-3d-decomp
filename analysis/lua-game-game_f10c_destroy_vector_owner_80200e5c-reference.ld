/* Generated reference-only placements. All bodies are source-built. */
OUTPUT_FORMAT("elf32-powerpc")
OUTPUT_ARCH(powerpc)
ENTRY(_._19F10c_80200e5c_Owner)
_SDA_BASE_ = 0x804b2540;
_SDA2_BASE_ = 0x804c2540;
__dl__19F10c_80200e5c_OwnerPv = 0x801fe1f8;
fn_8020c5c4 = 0x8020c5c4;
fn_80210990 = 0x80210990;
fn_802134fc = 0x802134fc;
fn_80341588 = 0x80341588;
vt_80418df0 = 0x80418df0;
vt_80418eb8 = 0x80418eb8;
SECTIONS {
  .text._._19F10c_80200e5c_Owner 0x80200e5c : { *(.text._._19F10c_80200e5c_Owner) }
  /DISCARD/ : { *(.text*) *(.rodata*) *(.data*) *(.bss*) *(.sdata*) *(.sbss*) *(.comment) }
}
