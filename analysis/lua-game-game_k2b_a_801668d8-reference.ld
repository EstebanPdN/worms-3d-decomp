/* Generated reference-only placements. All bodies are source-built. */
OUTPUT_FORMAT("elf32-powerpc")
OUTPUT_ARCH(powerpc)
ENTRY(w3d_k2b_replace_held_interface_801668d8)
_SDA_BASE_ = 0x804b2540;
_SDA2_BASE_ = 0x804c2540;
w3d_auto_8020b648 = 0x8020b648;
w3d_obj_80411a20 = 0x80411a20;
SECTIONS {
  .text.w3d_k2b_replace_held_interface_801668d8 0x801668d8 : { *(.text.w3d_k2b_replace_held_interface_801668d8) }
  /DISCARD/ : { *(.text*) *(.rodata*) *(.data*) *(.bss*) *(.sdata*) *(.sbss*) *(.comment) }
}
