/* Generated reference-only placements. All bodies are source-built. */
OUTPUT_FORMAT("elf32-powerpc")
OUTPUT_ARCH(powerpc)
ENTRY(w3d_cc17c_sinit_801a3648)
_SDA_BASE_ = 0x804b2540;
_SDA2_BASE_ = 0x804c2540;
fn_801a188c = 0x801a188c;
fn_801a18bc = 0x801a18bc;
fn_801a2478 = 0x801a2478;
fn_80200af8 = 0x80200af8;
fn_8020fbd0 = 0x8020fbd0;
fn_80212fd4 = 0x80212fd4;
fn_803413d8 = 0x803413d8;
lbl_80362330 = 0x80362330;
lbl_803a9bf0 = 0x803a9bf0;
lbl_803e8d80 = 0x803e8d80;
lbl_80413a20 = 0x80413a20;
lbl_80413a38 = 0x80413a38;
lbl_8045ce14 = 0x8045ce14;
lbl_8045ce2c = 0x8045ce2c;
lbl_8045ce40 = 0x8045ce40;
lbl_8045cea4 = 0x8045cea4;
SECTIONS {
  .text.w3d_cc17c_sinit_801a3648 0x801a3648 : { *(.text.w3d_cc17c_sinit_801a3648) }
  /DISCARD/ : { *(.text*) *(.rodata*) *(.data*) *(.bss*) *(.sdata*) *(.sbss*) *(.comment) }
}
