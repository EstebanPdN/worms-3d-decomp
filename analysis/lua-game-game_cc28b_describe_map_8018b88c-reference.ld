/* Generated reference-only placements. All bodies are source-built. */
OUTPUT_FORMAT("elf32-powerpc")
OUTPUT_ARCH(powerpc)
ENTRY(w3d_cc28b_describe_map_8018b88c)
_SDA_BASE_ = 0x804b2540;
_SDA2_BASE_ = 0x804c2540;
fn_801904c0 = 0x801904c0;
lbl_803a7db4 = 0x803a7db4;
lbl_803a7dc0 = 0x803a7dc0;
lbl_803a7dcc = 0x803a7dcc;
lbl_803a7dd4 = 0x803a7dd4;
lbl_803a7de0 = 0x803a7de0;
SECTIONS {
  .text.w3d_cc28b_describe_map_8018b88c 0x8018b88c : { *(.text.w3d_cc28b_describe_map_8018b88c) }
  /DISCARD/ : { *(.text*) *(.rodata*) *(.data*) *(.bss*) *(.sdata*) *(.sbss*) *(.comment) }
}
