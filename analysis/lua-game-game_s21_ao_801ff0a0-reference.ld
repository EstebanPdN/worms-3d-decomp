/* Generated reference-only placements. All bodies are source-built. */
OUTPUT_FORMAT("elf32-powerpc")
OUTPUT_ARCH(powerpc)
ENTRY(w3d_s21_float_to_text_801ff0a0)
_SDA_BASE_ = 0x804b2540;
_SDA2_BASE_ = 0x804c2540;
fn_8020dcc8 = 0x8020dcc8;
SECTIONS {
  .text.w3d_s21_float_to_text_801ff0a0 0x801ff0a0 : { *(.text.w3d_s21_float_to_text_801ff0a0) }
  /DISCARD/ : { *(.text*) *(.rodata*) *(.data*) *(.bss*) *(.sdata*) *(.sbss*) *(.comment) }
}
