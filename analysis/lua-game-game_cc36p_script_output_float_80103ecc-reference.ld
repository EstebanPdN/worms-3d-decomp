/* Generated reference-only placements. All bodies are source-built. */
OUTPUT_FORMAT("elf32-powerpc")
OUTPUT_ARCH(powerpc)
ENTRY(cc36p_script_output_float_80103ecc)
_SDA_BASE_ = 0x804b2540;
_SDA2_BASE_ = 0x804c2540;
cc36p_append_8020bf2c = 0x8020bf2c;
cc36p_empty_804b06a0 = 0x804b06a0;
cc36p_error_80399508 = 0x80399508;
cc36p_format_802ec254 = 0x802ec254;
cc36p_format_80399480 = 0x80399480;
cc36p_free_8020bb2c = 0x8020bb2c;
cc36p_number_802cda9c = 0x802cda9c;
cc36p_output_801022e8 = 0x801022e8;
cc36p_report_801022ec = 0x801022ec;
cc36p_settop_802cd808 = 0x802cd808;
cc36p_string_802cdaf4 = 0x802cdaf4;
cc36p_text_802cdd04 = 0x802cdd04;
cc36p_top_802cd7f4 = 0x802cd7f4;
cc36p_value_802cdc5c = 0x802cdc5c;
SECTIONS {
  .text.cc36p_script_output_float_80103ecc 0x80103ecc : { *(.text.cc36p_script_output_float_80103ecc) }
  /DISCARD/ : { *(.text*) *(.rodata*) *(.data*) *(.bss*) *(.sdata*) *(.sbss*) *(.comment) }
}
