/* Generated reference-only placements. All bodies are source-built. */
OUTPUT_FORMAT("elf32-powerpc")
OUTPUT_ARCH(powerpc)
ENTRY(cc40a_graph_fields_8017fa9c)
_SDA_BASE_ = 0x804b2540;
_SDA2_BASE_ = 0x804c2540;
cc40a_flagsKey_803a7794 = 0x803a7794;
cc40a_graphBase_80190538 = 0x80190538;
cc40a_graphId_8040e058 = 0x8040e058;
cc40a_graphKey_803a7788 = 0x803a7788;
SECTIONS {
  .text.cc40a_graph_fields_8017fa9c 0x8017fa9c : { *(.text.cc40a_graph_fields_8017fa9c) }
  /DISCARD/ : { *(.text*) *(.rodata*) *(.data*) *(.bss*) *(.sdata*) *(.sbss*) *(.comment) }
}
