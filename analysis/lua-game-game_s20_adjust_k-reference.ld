/* Generated reference-only placements. All bodies are source-built. */
OUTPUT_FORMAT("elf32-powerpc")
OUTPUT_ARCH(powerpc)
ENTRY(w3d_s20_refresh_item_block_801a58d0)
_SDA_BASE_ = 0x804b2540;
_SDA2_BASE_ = 0x804c2540;
fn_801a572c = 0x801a572c;
lbl_8045e63c = 0x8045e63c;
SECTIONS {
  .text.w3d_s20_refresh_item_block_801a58d0 0x801a58d0 : { *(.text.w3d_s20_refresh_item_block_801a58d0) }
  .text.w3d_s20_refresh_item_block_801a5a6c 0x801a5a6c : { *(.text.w3d_s20_refresh_item_block_801a5a6c) }
  /DISCARD/ : { *(.text*) *(.rodata*) *(.data*) *(.bss*) *(.sdata*) *(.sbss*) *(.comment) }
}
