/* Generated reference-only placements. All bodies are source-built. */
OUTPUT_FORMAT("elf32-powerpc")
OUTPUT_ARCH(powerpc)
ENTRY(cxa_normalized_impulse_8003eb1c)
_SDA_BASE_ = 0x804b2540;
_SDA2_BASE_ = 0x804c2540;
apply_8003ebdc = 0x8003ebdc;
one_80374670 = 0x80374670;
sqrt_802e82c0 = 0x802e82c0;
threshold_80374674 = 0x80374674;
SECTIONS {
  .text.cxa_normalized_impulse_8003eb1c 0x8003eb1c : { *(.text.cxa_normalized_impulse_8003eb1c) }
  /DISCARD/ : { *(.text*) *(.rodata*) *(.data*) *(.bss*) *(.sdata*) *(.sbss*) *(.comment) }
}
