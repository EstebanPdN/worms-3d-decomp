/* Generated reference-only placements. All bodies are source-built. */
OUTPUT_FORMAT("elf32-powerpc")
OUTPUT_ARCH(powerpc)
ENTRY(w3d_auto_80269c54)
_SDA_BASE_ = 0x804b2540;
_SDA2_BASE_ = 0x804c2540;
call__18S11Method_800FC2B0Pi = 0x800fc2b0;
fn_8026B3F0__FPc = 0x8026b3f0;
fn_8026BDF0__FPc = 0x8026bdf0;
fn_8026C008__FPci = 0x8026c008;
fn_8026C54C__FPc = 0x8026c54c;
fn_8026C8A8__FPci = 0x8026c8a8;
lbl_803CB950 = 0x803cb950;
SECTIONS {
  .text.w3d_auto_80269c54 0x80269c54 : { *(.text.w3d_auto_80269c54) }
  /DISCARD/ : { *(.text*) *(.rodata*) *(.data*) *(.bss*) *(.sdata*) *(.sbss*) *(.comment) }
}
