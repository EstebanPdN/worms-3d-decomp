/* Generated reference-only placements. All bodies are source-built. */
OUTPUT_FORMAT("elf32-powerpc")
OUTPUT_ARCH(powerpc)
ENTRY(k1a_toggler_flip_800385fc)
_SDA_BASE_ = 0x804b2540;
_SDA2_BASE_ = 0x804c2540;
w3d_s20_store_byte_value_80173f88 = 0x80173f88;
SECTIONS {
  .text.k1a_toggler_flip_800385fc 0x800385fc : { *(.text.k1a_toggler_flip_800385fc) }
  /DISCARD/ : { *(.text*) *(.rodata*) *(.data*) *(.bss*) *(.sdata*) *(.sbss*) *(.comment) }
}
