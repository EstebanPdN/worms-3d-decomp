/* Generated reference-only placements. All bodies are source-built. */
OUTPUT_FORMAT("elf32-powerpc")
OUTPUT_ARCH(powerpc)
ENTRY(w3d_d24h_names_toggle_800c4b00)
_SDA_BASE_ = 0x804b2540;
_SDA2_BASE_ = 0x804c2540;
fn_80212fd4 = 0x80212fd4;
fn_802134fc = 0x802134fc;
fn_802eee50 = 0x802eee50;
fn_802ef234 = 0x802ef234;
fn_802efbfc = 0x802efbfc;
fn_80344360 = 0x80344360;
SECTIONS {
  .text.w3d_d24h_names_toggle_800c4b00 0x800c4b00 : { *(.text.w3d_d24h_names_toggle_800c4b00) }
  /DISCARD/ : { *(.text*) *(.rodata*) *(.data*) *(.bss*) *(.sdata*) *(.sbss*) *(.comment) }
}
