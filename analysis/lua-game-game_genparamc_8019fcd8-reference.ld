/* Generated reference-only placements. All bodies are source-built. */
OUTPUT_FORMAT("elf32-powerpc")
OUTPUT_ARCH(powerpc)
ENTRY(w3d_push_lua_object_8019fcd8)
_SDA_BASE_ = 0x804b2540;
_SDA2_BASE_ = 0x804c2540;
fn_8019fdd8 = 0x8019fdd8;
fn_8019fe10 = 0x8019fe10;
fn_802ce5ec = 0x802ce5ec;
fn_802ce9d8 = 0x802ce9d8;
fn_802e86d4 = 0x802e86d4;
fn_802e88ac = 0x802e88ac;
SECTIONS {
  .text.w3d_push_lua_object_8019fcd8 0x8019fcd8 : { *(.text.w3d_push_lua_object_8019fcd8) }
  .text.w3d_push_lua_object_8019fd58 0x8019fd58 : { *(.text.w3d_push_lua_object_8019fd58) }
  .text.w3d_rotate_rows_y_801f61a0 0x801f61a0 : { *(.text.w3d_rotate_rows_y_801f61a0) }
  /DISCARD/ : { *(.text*) *(.rodata*) *(.data*) *(.bss*) *(.sdata*) *(.sbss*) *(.comment) }
}
