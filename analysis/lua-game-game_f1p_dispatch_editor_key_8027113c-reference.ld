/* Generated reference-only placements. All bodies are source-built. */
OUTPUT_FORMAT("elf32-powerpc")
OUTPUT_ARCH(powerpc)
ENTRY(w3d_dispatch_editor_key_8027113c)
_SDA_BASE_ = 0x804b2540;
_SDA2_BASE_ = 0x804c2540;
fn_80273174 = 0x80273174;
fn_802732e8 = 0x802732e8;
fn_802733c0 = 0x802733c0;
fn_802734bc = 0x802734bc;
fn_80276e04 = 0x80276e04;
fn_80276e28 = 0x80276e28;
fn_80277494 = 0x80277494;
fn_80277684 = 0x80277684;
fn_802777a4 = 0x802777a4;
fn_80277904 = 0x80277904;
fn_80277a10 = 0x80277a10;
fn_80277b50 = 0x80277b50;
fn_80277c14 = 0x80277c14;
fn_80277d54 = 0x80277d54;
fn_80277e74 = 0x80277e74;
fn_80277fd0 = 0x80277fd0;
fn_80278130 = 0x80278130;
fn_80278304 = 0x80278304;
fn_80278498 = 0x80278498;
fn_802785d8 = 0x802785d8;
fn_8027865c = 0x8027865c;
fn_80278e38 = 0x80278e38;
fn_8027978c = 0x8027978c;
fn_80279bd8 = 0x80279bd8;
fn_8027a0cc = 0x8027a0cc;
fn_8027a348 = 0x8027a348;
fn_8027a568 = 0x8027a568;
fn_8027a6e4 = 0x8027a6e4;
fn_8027a7fc = 0x8027a7fc;
fn_8027aca0 = 0x8027aca0;
fn_8027b1e4 = 0x8027b1e4;
SECTIONS {
  .text.w3d_dispatch_editor_key_8027113c 0x8027113c : { *(.text.w3d_dispatch_editor_key_8027113c) }
  /DISCARD/ : { *(.text*) *(.rodata*) *(.data*) *(.bss*) *(.sdata*) *(.sbss*) *(.comment) }
}
