/* Generated reference-only placements. All bodies are source-built. */
OUTPUT_FORMAT("elf32-powerpc")
OUTPUT_ARCH(powerpc)
ENTRY(w3d_cx11a_planar_basis_800d9b70)
_SDA_BASE_ = 0x804b2540;
_SDA2_BASE_ = 0x804c2540;
one_80389580 = 0x80389580;
root_802e82c0 = 0x802e82c0;
zero_8038957c = 0x8038957c;
SECTIONS {
  .text.w3d_cx11a_planar_basis_800d9b70 0x800d9b70 : { *(.text.w3d_cx11a_planar_basis_800d9b70) }
  /DISCARD/ : { *(.text*) *(.rodata*) *(.data*) *(.bss*) *(.sdata*) *(.sbss*) *(.comment) }
}
