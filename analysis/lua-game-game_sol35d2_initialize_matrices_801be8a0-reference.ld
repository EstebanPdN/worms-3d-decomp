/* Generated reference-only placements. All bodies are source-built. */
OUTPUT_FORMAT("elf32-powerpc")
OUTPUT_ARCH(powerpc)
ENTRY(w3d_sol35d2_initialize_matrices_801be8a0)
_SDA_BASE_ = 0x804b2540;
_SDA2_BASE_ = 0x804c2540;
fn_801e8d9c = 0x801e8d9c;
fn_801eb674 = 0x801eb674;
fn_801f0d2c = 0x801f0d2c;
lbl_803abd70 = 0x803abd70;
lbl_803abda0 = 0x803abda0;
lbl_803abdcc = 0x803abdcc;
lbl_8045e708 = 0x8045e708;
SECTIONS {
  .text.w3d_sol35d2_initialize_matrices_801be8a0 0x801be8a0 : { *(.text.w3d_sol35d2_initialize_matrices_801be8a0) }
  /DISCARD/ : { *(.text*) *(.rodata*) *(.data*) *(.bss*) *(.sdata*) *(.sbss*) *(.comment) }
}
