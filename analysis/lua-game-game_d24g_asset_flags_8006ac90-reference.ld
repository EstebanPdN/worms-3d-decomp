/* Generated reference-only placements. All bodies are source-built. */
OUTPUT_FORMAT("elf32-powerpc")
OUTPUT_ARCH(powerpc)
ENTRY(w3d_d24g_asset_flags_8006ac90)
_SDA_BASE_ = 0x804b2540;
_SDA2_BASE_ = 0x804c2540;
flags_8042e59c = 0x8042e59c;
load_materials_800b9c1c = 0x800b9c1c;
lookup_8015ae3c = 0x8015ae3c;
memset = 0x802eefe0;
read_800fc2b0 = 0x800fc2b0;
s_8037bbbc = 0x8037bbbc;
strcmp = 0x802ef234;
string_assign_8020bd38 = 0x8020bd38;
table_803f477c = 0x803f477c;
SECTIONS {
  .text.w3d_d24g_asset_flags_8006ac90 0x8006ac90 : { *(.text.w3d_d24g_asset_flags_8006ac90) }
  /DISCARD/ : { *(.text*) *(.rodata*) *(.data*) *(.bss*) *(.sdata*) *(.sbss*) *(.comment) }
}
