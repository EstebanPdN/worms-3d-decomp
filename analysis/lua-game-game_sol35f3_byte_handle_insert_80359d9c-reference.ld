/* Generated reference-only placements. All bodies are source-built. */
OUTPUT_FORMAT("elf32-powerpc")
OUTPUT_ARCH(powerpc)
ENTRY(sol35f3_byte_handle_insert_80359d9c)
_SDA_BASE_ = 0x804b2540;
_SDA2_BASE_ = 0x804c2540;
sol35f3_allocate_80212fd4 = 0x80212fd4;
sol35f3_fallback_803413d8 = 0x803413d8;
sol35f3_fill_802eefe0 = 0x802eefe0;
sol35f3_free_802134fc = 0x802134fc;
sol35f3_move_802eeef4 = 0x802eeef4;
SECTIONS {
  .text.sol35f3_byte_handle_insert_80359d9c 0x80359d9c : { *(.text.sol35f3_byte_handle_insert_80359d9c) }
  /DISCARD/ : { *(.text*) *(.rodata*) *(.data*) *(.bss*) *(.sdata*) *(.sbss*) *(.comment) }
}
