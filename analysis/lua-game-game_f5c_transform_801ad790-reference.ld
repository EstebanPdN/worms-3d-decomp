/* Generated reference-only placements. All bodies are source-built. */
OUTPUT_FORMAT("elf32-powerpc")
OUTPUT_ARCH(powerpc)
ENTRY(f5c_transform_801ad790)
_SDA_BASE_ = 0x804b2540;
_SDA2_BASE_ = 0x804c2540;
fn_801acd6c = 0x801acd6c;
fn_801ad168 = 0x801ad168;
fn_801f740c = 0x801f740c;
lbl_8045e748 = 0x8045e748;
SECTIONS {
  .text.f5c_transform_801ad790 0x801ad790 : { *(.text.f5c_transform_801ad790) }
  /DISCARD/ : { *(.text*) *(.rodata*) *(.data*) *(.bss*) *(.sdata*) *(.sbss*) *(.comment) }
}
