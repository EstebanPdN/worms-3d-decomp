/* Generated reference-only placements. All bodies are source-built. */
OUTPUT_FORMAT("elf32-powerpc")
OUTPUT_ARCH(powerpc)
ENTRY(w3d_cc21p_recursive_words_8035b260)
_SDA_BASE_ = 0x804b2540;
_SDA2_BASE_ = 0x804c2540;
dependency_8035b260 = 0x8035b260;
SECTIONS {
  .text.w3d_cc21p_recursive_words_8035b260 0x8035b260 : { *(.text.w3d_cc21p_recursive_words_8035b260) }
  /DISCARD/ : { *(.text*) *(.rodata*) *(.data*) *(.bss*) *(.sdata*) *(.sbss*) *(.comment) }
}
