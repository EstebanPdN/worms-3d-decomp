/* Generated reference-only placements. All bodies are source-built. */
OUTPUT_FORMAT("elf32-powerpc")
OUTPUT_ARCH(powerpc)
ENTRY(f6c_kernel_801d6bf0)
_SDA_BASE_ = 0x804b2540;
_SDA2_BASE_ = 0x804c2540;
lbl_803af680 = 0x803af680;
lbl_803af684 = 0x803af684;
lbl_803af688 = 0x803af688;
lbl_803af68c = 0x803af68c;
lbl_803af690 = 0x803af690;
lbl_803af694 = 0x803af694;
lbl_803af698 = 0x803af698;
lbl_803af69c = 0x803af69c;
lbl_803af6a0 = 0x803af6a0;
lbl_803af6a4 = 0x803af6a4;
lbl_803af6a8 = 0x803af6a8;
SECTIONS {
  .text.f6c_kernel_801d6bf0 0x801d6bf0 : { *(.text.f6c_kernel_801d6bf0) }
  /DISCARD/ : { *(.text*) *(.rodata*) *(.data*) *(.bss*) *(.sdata*) *(.sbss*) *(.comment) }
}
