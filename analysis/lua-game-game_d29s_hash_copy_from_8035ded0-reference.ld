/* Generated reference-only placements. All bodies are source-built. */
OUTPUT_FORMAT("elf32-powerpc")
OUTPUT_ARCH(powerpc)
ENTRY(_M_copy_from__Q24_STLt9hashtable6ZQ24_STLt4pair2ZCUiZiZUiZQ24_STLt4hash1ZUiZQ24_STLt10_Select1st1ZQ24_STLt4pair2ZCUiZiZQ24_STLt8equal_to1ZUiZQ24_STLt9allocator1ZQ24_STLt4pair2ZCUiZiRCQ24_STLt9hashtable6ZQ24_STLt4pair2ZCUiZiZUiZQ24_STLt4hash1ZUiZQ24_STLt10_Select1st1ZQ24_STLt4pair2ZCUiZiZQ24_STLt8equal_to1ZUiZQ24_STLt9allocator1ZQ24_STLt4pair2ZCUiZi)
_SDA_BASE_ = 0x804b2540;
_SDA2_BASE_ = 0x804c2540;
_M_fill_insert__Q24_STLt6vector2ZPvZQ24_STLt9allocator1ZPvPPvUiRCPv = 0x8035dc78;
_S_oom_malloc__Q24_STLt14__malloc_alloc1i0Ui = 0x803413d8;
malloc = 0x80212fd4;
reserve__Q24_STLt6vector2ZPvZQ24_STLt9allocator1ZPvUi = 0x8035db70;
SECTIONS {
  .text._M_copy_from__Q24_STLt9hashtable6ZQ24_STLt4pair2ZCUiZiZUiZQ24_STLt4hash1ZUiZQ24_STLt10_Select1st1ZQ24_STLt4pair2ZCUiZiZQ24_STLt8equal_to1ZUiZQ24_STLt9allocator1ZQ24_STLt4pair2ZCUiZiRCQ24_STLt9hashtable6ZQ24_STLt4pair2ZCUiZiZUiZQ24_STLt4hash1ZUiZQ24_STLt10_Select1st1ZQ24_STLt4pair2ZCUiZiZQ24_STLt8equal_to1ZUiZQ24_STLt9allocator1ZQ24_STLt4pair2ZCUiZi 0x8035ded0 : { *(.text._M_copy_from__Q24_STLt9hashtable6ZQ24_STLt4pair2ZCUiZiZUiZQ24_STLt4hash1ZUiZQ24_STLt10_Select1st1ZQ24_STLt4pair2ZCUiZiZQ24_STLt8equal_to1ZUiZQ24_STLt9allocator1ZQ24_STLt4pair2ZCUiZiRCQ24_STLt9hashtable6ZQ24_STLt4pair2ZCUiZiZUiZQ24_STLt4hash1ZUiZQ24_STLt10_Select1st1ZQ24_STLt4pair2ZCUiZiZQ24_STLt8equal_to1ZUiZQ24_STLt9allocator1ZQ24_STLt4pair2ZCUiZi) }
  /DISCARD/ : { *(.text*) *(.rodata*) *(.data*) *(.bss*) *(.sdata*) *(.sbss*) *(.comment) }
}
