/* Generated reference-only placements. All bodies are source-built. */
OUTPUT_FORMAT("elf32-powerpc")
OUTPUT_ARCH(powerpc)
ENTRY(w3d_set_80258244)
_SDA_BASE_ = 0x804b2540;
_SDA2_BASE_ = 0x804c2540;
SECTIONS {
  .text.w3d_set_80258244 0x80258244 : { *(.text.w3d_set_80258244) }
  .text.w3d_get_8025824c 0x8025824c : { *(.text.w3d_get_8025824c) }
  .text.w3d_set_80258934 0x80258934 : { *(.text.w3d_set_80258934) }
  .text.w3d_get_8025893c 0x8025893c : { *(.text.w3d_get_8025893c) }
  .text.w3d_set_80258944 0x80258944 : { *(.text.w3d_set_80258944) }
  .text.w3d_get_8025894c 0x8025894c : { *(.text.w3d_get_8025894c) }
  .text.w3d_set_80258954 0x80258954 : { *(.text.w3d_set_80258954) }
  .text.w3d_get_8025895c 0x8025895c : { *(.text.w3d_get_8025895c) }
  .text.w3d_set_80258964 0x80258964 : { *(.text.w3d_set_80258964) }
  .text.w3d_get_8025896c 0x8025896c : { *(.text.w3d_get_8025896c) }
  .text.w3d_set_80258974 0x80258974 : { *(.text.w3d_set_80258974) }
  .text.w3d_get_8025897c 0x8025897c : { *(.text.w3d_get_8025897c) }
  .text.w3d_set_80258984 0x80258984 : { *(.text.w3d_set_80258984) }
  .text.w3d_get_8025898c 0x8025898c : { *(.text.w3d_get_8025898c) }
  .text.w3d_set_80258994 0x80258994 : { *(.text.w3d_set_80258994) }
  .text.w3d_get_8025899c 0x8025899c : { *(.text.w3d_get_8025899c) }
  .text.w3d_set_802589a4 0x802589a4 : { *(.text.w3d_set_802589a4) }
  .text.w3d_get_802589ac 0x802589ac : { *(.text.w3d_get_802589ac) }
  .text.w3d_set_802589b4 0x802589b4 : { *(.text.w3d_set_802589b4) }
  .text.w3d_get_802589bc 0x802589bc : { *(.text.w3d_get_802589bc) }
  .text.w3d_set_802589c4 0x802589c4 : { *(.text.w3d_set_802589c4) }
  .text.w3d_get_802589cc 0x802589cc : { *(.text.w3d_get_802589cc) }
  .text.w3d_set_802589d4 0x802589d4 : { *(.text.w3d_set_802589d4) }
  .text.w3d_get_802589dc 0x802589dc : { *(.text.w3d_get_802589dc) }
  .text.w3d_set_802589e4 0x802589e4 : { *(.text.w3d_set_802589e4) }
  .text.w3d_get_802589ec 0x802589ec : { *(.text.w3d_get_802589ec) }
  .text.w3d_set_802589f4 0x802589f4 : { *(.text.w3d_set_802589f4) }
  .text.w3d_get_802589fc 0x802589fc : { *(.text.w3d_get_802589fc) }
  .text.w3d_set_80258a04 0x80258a04 : { *(.text.w3d_set_80258a04) }
  .text.w3d_get_80258a0c 0x80258a0c : { *(.text.w3d_get_80258a0c) }
  .text.w3d_set_80258a14 0x80258a14 : { *(.text.w3d_set_80258a14) }
  .text.w3d_get_80258a1c 0x80258a1c : { *(.text.w3d_get_80258a1c) }
  .text.w3d_set_80258a24 0x80258a24 : { *(.text.w3d_set_80258a24) }
  .text.w3d_get_80258a2c 0x80258a2c : { *(.text.w3d_get_80258a2c) }
  .text.w3d_set_80258a34 0x80258a34 : { *(.text.w3d_set_80258a34) }
  .text.w3d_get_80258a3c 0x80258a3c : { *(.text.w3d_get_80258a3c) }
  .text.w3d_set_80258a44 0x80258a44 : { *(.text.w3d_set_80258a44) }
  .text.w3d_get_80258a4c 0x80258a4c : { *(.text.w3d_get_80258a4c) }
  .text.w3d_set_80258de4 0x80258de4 : { *(.text.w3d_set_80258de4) }
  .text.w3d_get_80258dec 0x80258dec : { *(.text.w3d_get_80258dec) }
  .text.w3d_set_80258e04 0x80258e04 : { *(.text.w3d_set_80258e04) }
  .text.w3d_get_80258e0c 0x80258e0c : { *(.text.w3d_get_80258e0c) }
  .text.w3d_set_80258e14 0x80258e14 : { *(.text.w3d_set_80258e14) }
  .text.w3d_get_80258e1c 0x80258e1c : { *(.text.w3d_get_80258e1c) }
  .text.w3d_set_80258e24 0x80258e24 : { *(.text.w3d_set_80258e24) }
  .text.w3d_get_80258e2c 0x80258e2c : { *(.text.w3d_get_80258e2c) }
  .text.w3d_set_80258e34 0x80258e34 : { *(.text.w3d_set_80258e34) }
  .text.w3d_get_80258e3c 0x80258e3c : { *(.text.w3d_get_80258e3c) }
  .text.w3d_set_80258e44 0x80258e44 : { *(.text.w3d_set_80258e44) }
  .text.w3d_get_80258e4c 0x80258e4c : { *(.text.w3d_get_80258e4c) }
  .text.w3d_set_80258e54 0x80258e54 : { *(.text.w3d_set_80258e54) }
  .text.w3d_get_80258e5c 0x80258e5c : { *(.text.w3d_get_80258e5c) }
  .text.w3d_set_80258e64 0x80258e64 : { *(.text.w3d_set_80258e64) }
  .text.w3d_get_80258e6c 0x80258e6c : { *(.text.w3d_get_80258e6c) }
  .text.w3d_set_80258e74 0x80258e74 : { *(.text.w3d_set_80258e74) }
  .text.w3d_get_80258e7c 0x80258e7c : { *(.text.w3d_get_80258e7c) }
  .text.w3d_set_80258ef4 0x80258ef4 : { *(.text.w3d_set_80258ef4) }
  .text.w3d_get_80258efc 0x80258efc : { *(.text.w3d_get_80258efc) }
  .text.w3d_set_80258f44 0x80258f44 : { *(.text.w3d_set_80258f44) }
  .text.w3d_get_80258f4c 0x80258f4c : { *(.text.w3d_get_80258f4c) }
  .text.w3d_set_80258fac 0x80258fac : { *(.text.w3d_set_80258fac) }
  .text.w3d_get_80258fb4 0x80258fb4 : { *(.text.w3d_get_80258fb4) }
  .text.w3d_set_8025944c 0x8025944c : { *(.text.w3d_set_8025944c) }
  .text.w3d_get_80259454 0x80259454 : { *(.text.w3d_get_80259454) }
  .text.w3d_set_8025992c 0x8025992c : { *(.text.w3d_set_8025992c) }
  .text.w3d_get_80259934 0x80259934 : { *(.text.w3d_get_80259934) }
  .text.w3d_set_802599bc 0x802599bc : { *(.text.w3d_set_802599bc) }
  .text.w3d_get_802599c4 0x802599c4 : { *(.text.w3d_get_802599c4) }
  .text.w3d_set_802599cc 0x802599cc : { *(.text.w3d_set_802599cc) }
  .text.w3d_get_802599d4 0x802599d4 : { *(.text.w3d_get_802599d4) }
  .text.w3d_set_802599dc 0x802599dc : { *(.text.w3d_set_802599dc) }
  .text.w3d_get_802599e4 0x802599e4 : { *(.text.w3d_get_802599e4) }
  .text.w3d_set_802599ec 0x802599ec : { *(.text.w3d_set_802599ec) }
  .text.w3d_get_802599f4 0x802599f4 : { *(.text.w3d_get_802599f4) }
  .text.w3d_set_80259a0c 0x80259a0c : { *(.text.w3d_set_80259a0c) }
  .text.w3d_get_80259a14 0x80259a14 : { *(.text.w3d_get_80259a14) }
  .text.w3d_set_80259a1c 0x80259a1c : { *(.text.w3d_set_80259a1c) }
  .text.w3d_get_80259a24 0x80259a24 : { *(.text.w3d_get_80259a24) }
  .text.w3d_set_80259aac 0x80259aac : { *(.text.w3d_set_80259aac) }
  .text.w3d_get_80259ab4 0x80259ab4 : { *(.text.w3d_get_80259ab4) }
  /DISCARD/ : { *(.text*) *(.rodata*) *(.data*) *(.bss*) *(.sdata*) *(.sbss*) *(.comment) }
}
