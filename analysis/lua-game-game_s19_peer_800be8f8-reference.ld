/* Generated reference-only placements. All bodies are source-built. */
OUTPUT_FORMAT("elf32-powerpc")
OUTPUT_ARCH(powerpc)
ENTRY(s19_find_peer_value_800be8f8)
_SDA_BASE_ = 0x804b2540;
_SDA2_BASE_ = 0x804c2540;
lbl_8043bb64 = 0x8043bb64;
w3d_get_800b4d98 = 0x800b4d98;
SECTIONS {
  .text.s19_find_peer_value_800be8f8 0x800be8f8 : { *(.text.s19_find_peer_value_800be8f8) }
  /DISCARD/ : { *(.text*) *(.rodata*) *(.data*) *(.bss*) *(.sdata*) *(.sbss*) *(.comment) }
}
