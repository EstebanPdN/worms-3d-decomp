/* Generated reference-only placements. All bodies are source-built. */
OUTPUT_FORMAT("elf32-powerpc")
OUTPUT_ARCH(powerpc)
ENTRY(w3d_e15d_two_pair_destroy_802c5e10)
_SDA_BASE_ = 0x804b2540;
_SDA2_BASE_ = 0x804c2540;
e15d_base_destroy_8015ff2c = 0x8015ff2c;
e15d_table_8041c920 = 0x8041c920;
SECTIONS {
  .text.w3d_e15d_two_pair_destroy_802c5e10 0x802c5e10 : { *(.text.w3d_e15d_two_pair_destroy_802c5e10) }
  /DISCARD/ : { *(.text*) *(.rodata*) *(.data*) *(.bss*) *(.sdata*) *(.sbss*) *(.comment) }
}
