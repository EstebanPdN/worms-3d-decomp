/* Generated reference-only placements. All bodies are source-built. */
OUTPUT_FORMAT("elf32-powerpc")
OUTPUT_ARCH(powerpc)
ENTRY(w3d_static_init_800f6e94)
_SDA_BASE_ = 0x804b2540;
_SDA2_BASE_ = 0x804c2540;
w3d_empty_801081ac = 0x801081ac;
w3d_fn_800f6e28 = 0x800f6e28;
w3d_fn_800f73e0 = 0x800f73e0;
w3d_fn_800f7530 = 0x800f7530;
w3d_fn_800fbb74 = 0x800fbb74;
w3d_fn_800fbc00 = 0x800fbc00;
w3d_fn_800fd67c = 0x800fd67c;
w3d_fn_800fe1a4 = 0x800fe1a4;
w3d_fn_800fe724 = 0x800fe724;
w3d_fn_800ffa84 = 0x800ffa84;
w3d_fn_80103ffc = 0x80103ffc;
w3d_fn_80104128 = 0x80104128;
w3d_fn_80104568 = 0x80104568;
w3d_fn_801069e4 = 0x801069e4;
w3d_fn_80108040 = 0x80108040;
w3d_fn_80108f7c = 0x80108f7c;
w3d_fn_8010a4b0 = 0x8010a4b0;
w3d_fn_8010a854 = 0x8010a854;
w3d_fn_8010ddc0 = 0x8010ddc0;
w3d_fn_8010e468 = 0x8010e468;
w3d_fn_80118120 = 0x80118120;
w3d_fn_80119008 = 0x80119008;
w3d_fn_801190d8 = 0x801190d8;
w3d_fn_80119b50 = 0x80119b50;
w3d_fn_80119f1c = 0x80119f1c;
w3d_fn_8011a768 = 0x8011a768;
w3d_fn_8011bd84 = 0x8011bd84;
w3d_fn_8011d4d4 = 0x8011d4d4;
w3d_fn_8011f5b0 = 0x8011f5b0;
w3d_fn_80121620 = 0x80121620;
w3d_fn_80123e8c = 0x80123e8c;
w3d_fn_80124914 = 0x80124914;
w3d_fn_80124d2c = 0x80124d2c;
w3d_fn_80125e68 = 0x80125e68;
w3d_fn_8012603c = 0x8012603c;
w3d_fn_80126100 = 0x80126100;
w3d_fn_80129920 = 0x80129920;
w3d_fn_8012a728 = 0x8012a728;
w3d_fn_8012b000 = 0x8012b000;
w3d_fn_8012ba0c = 0x8012ba0c;
w3d_fn_8012bee8 = 0x8012bee8;
w3d_fn_8012fc24 = 0x8012fc24;
w3d_fn_80131818 = 0x80131818;
w3d_fn_801318c4 = 0x801318c4;
w3d_fn_801319d4 = 0x801319d4;
w3d_fn_80131ba0 = 0x80131ba0;
w3d_fn_80140280 = 0x80140280;
w3d_fn_8014106c = 0x8014106c;
w3d_fn_80141b14 = 0x80141b14;
w3d_fn_80154038 = 0x80154038;
w3d_fn_8015903c = 0x8015903c;
w3d_fn_80159c28 = 0x80159c28;
w3d_fn_8015a048 = 0x8015a048;
w3d_fn_8015ac70 = 0x8015ac70;
w3d_fn_8015b1c8 = 0x8015b1c8;
w3d_fn_8015bd38 = 0x8015bd38;
w3d_fn_8015c300 = 0x8015c300;
w3d_fn_8015c3fc = 0x8015c3fc;
w3d_fn_8015cd64 = 0x8015cd64;
w3d_fn_8015e9f0 = 0x8015e9f0;
w3d_fn_8015eae0 = 0x8015eae0;
w3d_fn_8015f43c = 0x8015f43c;
w3d_fn_8015fd44 = 0x8015fd44;
w3d_fn_8015ff9c = 0x8015ff9c;
w3d_fn_801600c4 = 0x801600c4;
w3d_fn_80160e64 = 0x80160e64;
w3d_fn_801610c0 = 0x801610c0;
w3d_fn_801611e8 = 0x801611e8;
w3d_fn_8016263c = 0x8016263c;
w3d_fn_8016295c = 0x8016295c;
w3d_fn_80162a84 = 0x80162a84;
w3d_fn_801651e8 = 0x801651e8;
w3d_fn_8016542c = 0x8016542c;
w3d_fn_80165520 = 0x80165520;
w3d_fn_80166470 = 0x80166470;
w3d_fn_80166b70 = 0x80166b70;
w3d_fn_801686a4 = 0x801686a4;
w3d_fn_8016a278 = 0x8016a278;
SECTIONS {
  .text.w3d_static_init_800f6e94 0x800f6e94 : { *(.text.w3d_static_init_800f6e94) }
  .text.w3d_static_init_800f74a0 0x800f74a0 : { *(.text.w3d_static_init_800f74a0) }
  .text.w3d_static_init_800f757c 0x800f757c : { *(.text.w3d_static_init_800f757c) }
  .text.w3d_static_init_800fbbd4 0x800fbbd4 : { *(.text.w3d_static_init_800fbbd4) }
  .text.w3d_static_init_800fbd1c 0x800fbd1c : { *(.text.w3d_static_init_800fbd1c) }
  .text.w3d_static_init_800fd778 0x800fd778 : { *(.text.w3d_static_init_800fd778) }
  .text.w3d_static_init_800fe214 0x800fe214 : { *(.text.w3d_static_init_800fe214) }
  .text.w3d_static_init_800fe7a4 0x800fe7a4 : { *(.text.w3d_static_init_800fe7a4) }
  .text.w3d_static_init_800ffafc 0x800ffafc : { *(.text.w3d_static_init_800ffafc) }
  .text.w3d_static_init_801040a4 0x801040a4 : { *(.text.w3d_static_init_801040a4) }
  .text.w3d_static_init_801041bc 0x801041bc : { *(.text.w3d_static_init_801041bc) }
  .text.w3d_static_init_80104618 0x80104618 : { *(.text.w3d_static_init_80104618) }
  .text.w3d_static_init_80106a80 0x80106a80 : { *(.text.w3d_static_init_80106a80) }
  .text.w3d_static_init_80108128 0x80108128 : { *(.text.w3d_static_init_80108128) }
  .text.w3d_static_init_801081b0 0x801081b0 : { *(.text.w3d_static_init_801081b0) }
  .text.w3d_static_init_80108fdc 0x80108fdc : { *(.text.w3d_static_init_80108fdc) }
  .text.w3d_static_init_8010a5f0 0x8010a5f0 : { *(.text.w3d_static_init_8010a5f0) }
  .text.w3d_static_init_8010a8b4 0x8010a8b4 : { *(.text.w3d_static_init_8010a8b4) }
  .text.w3d_static_init_8010de30 0x8010de30 : { *(.text.w3d_static_init_8010de30) }
  .text.w3d_static_init_8010e548 0x8010e548 : { *(.text.w3d_static_init_8010e548) }
  .text.w3d_static_init_80118190 0x80118190 : { *(.text.w3d_static_init_80118190) }
  .text.w3d_static_init_80119088 0x80119088 : { *(.text.w3d_static_init_80119088) }
  .text.w3d_static_init_8011919c 0x8011919c : { *(.text.w3d_static_init_8011919c) }
  .text.w3d_static_init_80119cc0 0x80119cc0 : { *(.text.w3d_static_init_80119cc0) }
  .text.w3d_static_init_80119f7c 0x80119f7c : { *(.text.w3d_static_init_80119f7c) }
  .text.w3d_static_init_8011a7c8 0x8011a7c8 : { *(.text.w3d_static_init_8011a7c8) }
  .text.w3d_static_init_8011be1c 0x8011be1c : { *(.text.w3d_static_init_8011be1c) }
  .text.w3d_static_init_8011d8e8 0x8011d8e8 : { *(.text.w3d_static_init_8011d8e8) }
  .text.w3d_static_init_8011f640 0x8011f640 : { *(.text.w3d_static_init_8011f640) }
  .text.w3d_static_init_80121728 0x80121728 : { *(.text.w3d_static_init_80121728) }
  .text.w3d_static_init_80123eec 0x80123eec : { *(.text.w3d_static_init_80123eec) }
  .text.w3d_static_init_801249d4 0x801249d4 : { *(.text.w3d_static_init_801249d4) }
  .text.w3d_static_init_80124d8c 0x80124d8c : { *(.text.w3d_static_init_80124d8c) }
  .text.w3d_static_init_80125fb0 0x80125fb0 : { *(.text.w3d_static_init_80125fb0) }
  .text.w3d_static_init_80126070 0x80126070 : { *(.text.w3d_static_init_80126070) }
  .text.w3d_static_init_80126148 0x80126148 : { *(.text.w3d_static_init_80126148) }
  .text.w3d_static_init_8012998c 0x8012998c : { *(.text.w3d_static_init_8012998c) }
  .text.w3d_static_init_8012a7e8 0x8012a7e8 : { *(.text.w3d_static_init_8012a7e8) }
  .text.w3d_static_init_8012b070 0x8012b070 : { *(.text.w3d_static_init_8012b070) }
  .text.w3d_static_init_8012ba6c 0x8012ba6c : { *(.text.w3d_static_init_8012ba6c) }
  .text.w3d_static_init_8012bf48 0x8012bf48 : { *(.text.w3d_static_init_8012bf48) }
  .text.w3d_static_init_8012fea4 0x8012fea4 : { *(.text.w3d_static_init_8012fea4) }
  .text.w3d_static_init_80131898 0x80131898 : { *(.text.w3d_static_init_80131898) }
  .text.w3d_static_init_80131958 0x80131958 : { *(.text.w3d_static_init_80131958) }
  .text.w3d_static_init_80131a58 0x80131a58 : { *(.text.w3d_static_init_80131a58) }
  .text.w3d_static_init_80131bf4 0x80131bf4 : { *(.text.w3d_static_init_80131bf4) }
  .text.w3d_static_init_801407f0 0x801407f0 : { *(.text.w3d_static_init_801407f0) }
  .text.w3d_static_init_801410cc 0x801410cc : { *(.text.w3d_static_init_801410cc) }
  .text.w3d_static_init_80141c18 0x80141c18 : { *(.text.w3d_static_init_80141c18) }
  .text.w3d_static_init_801547c8 0x801547c8 : { *(.text.w3d_static_init_801547c8) }
  .text.w3d_static_init_8015936c 0x8015936c : { *(.text.w3d_static_init_8015936c) }
  .text.w3d_static_init_80159da8 0x80159da8 : { *(.text.w3d_static_init_80159da8) }
  .text.w3d_static_init_8015a0a8 0x8015a0a8 : { *(.text.w3d_static_init_8015a0a8) }
  .text.w3d_static_init_8015ad14 0x8015ad14 : { *(.text.w3d_static_init_8015ad14) }
  .text.w3d_static_init_8015b228 0x8015b228 : { *(.text.w3d_static_init_8015b228) }
  .text.w3d_static_init_8015bda0 0x8015bda0 : { *(.text.w3d_static_init_8015bda0) }
  .text.w3d_static_init_8015c358 0x8015c358 : { *(.text.w3d_static_init_8015c358) }
  .text.w3d_static_init_8015c444 0x8015c444 : { *(.text.w3d_static_init_8015c444) }
  .text.w3d_static_init_8015cdc0 0x8015cdc0 : { *(.text.w3d_static_init_8015cdc0) }
  .text.w3d_static_init_8015ea4c 0x8015ea4c : { *(.text.w3d_static_init_8015ea4c) }
  .text.w3d_static_init_8015eb28 0x8015eb28 : { *(.text.w3d_static_init_8015eb28) }
  .text.w3d_static_init_8015f498 0x8015f498 : { *(.text.w3d_static_init_8015f498) }
  .text.w3d_static_init_8015fda0 0x8015fda0 : { *(.text.w3d_static_init_8015fda0) }
  .text.w3d_static_init_8015fffc 0x8015fffc : { *(.text.w3d_static_init_8015fffc) }
  .text.w3d_static_init_801601bc 0x801601bc : { *(.text.w3d_static_init_801601bc) }
  .text.w3d_static_init_80160ec4 0x80160ec4 : { *(.text.w3d_static_init_80160ec4) }
  .text.w3d_static_init_80161120 0x80161120 : { *(.text.w3d_static_init_80161120) }
  .text.w3d_static_init_801612e0 0x801612e0 : { *(.text.w3d_static_init_801612e0) }
  .text.w3d_static_init_80162760 0x80162760 : { *(.text.w3d_static_init_80162760) }
  .text.w3d_static_init_801629bc 0x801629bc : { *(.text.w3d_static_init_801629bc) }
  .text.w3d_static_init_80162b7c 0x80162b7c : { *(.text.w3d_static_init_80162b7c) }
  .text.w3d_static_init_8016525c 0x8016525c : { *(.text.w3d_static_init_8016525c) }
  .text.w3d_static_init_8016548c 0x8016548c : { *(.text.w3d_static_init_8016548c) }
  .text.w3d_static_init_80165568 0x80165568 : { *(.text.w3d_static_init_80165568) }
  .text.w3d_static_init_801664f0 0x801664f0 : { *(.text.w3d_static_init_801664f0) }
  .text.w3d_static_init_80166be8 0x80166be8 : { *(.text.w3d_static_init_80166be8) }
  .text.w3d_static_init_80168718 0x80168718 : { *(.text.w3d_static_init_80168718) }
  .text.w3d_static_init_8016a2f0 0x8016a2f0 : { *(.text.w3d_static_init_8016a2f0) }
  .text.w3d_constant_8016a47c 0x8016a47c : { *(.text.w3d_constant_8016a47c) }
  .text.w3d_constant_8016a5bc 0x8016a5bc : { *(.text.w3d_constant_8016a5bc) }
  /DISCARD/ : { *(.text*) *(.rodata*) *(.data*) *(.bss*) *(.sdata*) *(.sbss*) *(.comment) }
}
