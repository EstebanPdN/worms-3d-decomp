/* Generated reference-only placements. All bodies are source-built. */
OUTPUT_FORMAT("elf32-powerpc")
OUTPUT_ARCH(powerpc)
ENTRY(w3d_cx9c_binary_record_find_8035a990)
_SDA_BASE_ = 0x804b2540;
_SDA2_BASE_ = 0x804c2540;
cx9c_key_data_801fff3c = 0x801fff3c;
cx9c_memcmp_802eedc0 = 0x802eedc0;
SECTIONS {
  .text.w3d_cx9c_binary_record_find_8035a990 0x8035a990 : { *(.text.w3d_cx9c_binary_record_find_8035a990) }
  /DISCARD/ : { *(.text*) *(.rodata*) *(.data*) *(.bss*) *(.sdata*) *(.sbss*) *(.comment) }
}
