/* Generated reference-only placements. All bodies are source-built. */
OUTPUT_FORMAT("elf32-powerpc")
OUTPUT_ARCH(powerpc)
ENTRY(w3d_cx12b_child_view_initialize_802c72e4)
_SDA_BASE_ = 0x804b2540;
_SDA2_BASE_ = 0x804c2540;
setup_802c73a4 = 0x802c73a4;
setup_802c76e8 = 0x802c76e8;
setup_802c7a98 = 0x802c7a98;
setup_802c7c1c = 0x802c7c1c;
setup_802c7e20 = 0x802c7e20;
SECTIONS {
  .text.w3d_cx12b_child_view_initialize_802c72e4 0x802c72e4 : { *(.text.w3d_cx12b_child_view_initialize_802c72e4) }
  /DISCARD/ : { *(.text*) *(.rodata*) *(.data*) *(.bss*) *(.sdata*) *(.sbss*) *(.comment) }
}
