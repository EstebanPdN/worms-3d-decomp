/* Generated reference-only placements. All bodies are source-built. */
OUTPUT_FORMAT("elf32-powerpc")
OUTPUT_ARCH(powerpc)
ENTRY(w3d_d24e_register_volume_button_properties_80224890)
_SDA_BASE_ = 0x804b2540;
_SDA2_BASE_ = 0x804c2540;
__15String_8020bb54PCc = 0x8020bb54;
d20e_empty_804b06a0 = 0x804b06a0;
d20e_release_header_8020bb2c = 0x8020bb2c;
d20e_string_finish_8020c5c4 = 0x8020c5c4;
d20e_string_header_80341884 = 0x80341884;
d20e_string_init_8020c5c0 = 0x8020c5c0;
d20e_string_release_80341588 = 0x80341588;
desc_803b78c4 = 0x803b78c4;
desc_803b78e8 = 0x803b78e8;
desc_803b790c = 0x803b790c;
desc_803b7930 = 0x803b7930;
desc_803b7954 = 0x803b7954;
desc_803b797c = 0x803b797c;
desc_803b79a4 = 0x803b79a4;
desc_803b79d8 = 0x803b79d8;
desc_803b7a0c = 0x803b7a0c;
desc_803b7a40 = 0x803b7a40;
desc_803b7a70 = 0x803b7a70;
fn_801e8d9c = 0x801e8d9c;
fn_801eb674 = 0x801eb674;
fn_801ec52c = 0x801ec52c;
fn_801ece2c = 0x801ece2c;
fn_801ed24c = 0x801ed24c;
lit_803b61f8 = 0x803b61f8;
SECTIONS {
  .text.w3d_d24e_register_volume_button_properties_80224890 0x80224890 : { *(.text.w3d_d24e_register_volume_button_properties_80224890) }
  /DISCARD/ : { *(.text*) *(.rodata*) *(.data*) *(.bss*) *(.sdata*) *(.sbss*) *(.comment) }
}
