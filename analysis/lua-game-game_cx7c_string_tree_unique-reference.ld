/* Generated reference-only placements. All bodies are source-built. */
OUTPUT_FORMAT("elf32-powerpc")
OUTPUT_ARCH(powerpc)
ENTRY(w3d_cx7c_string_tree_insert_unique_8035a5e4)
_SDA_BASE_ = 0x804b2540;
_SDA2_BASE_ = 0x804c2540;
cx7c_strcmp_802ef234 = 0x802ef234;
cx7c_tree_insert_8035a464 = 0x8035a464;
cx7c_tree_predecessor_803526a0 = 0x803526a0;
SECTIONS {
  .text.w3d_cx7c_string_tree_insert_unique_8035a5e4 0x8035a5e4 : { *(.text.w3d_cx7c_string_tree_insert_unique_8035a5e4) }
  /DISCARD/ : { *(.text*) *(.rodata*) *(.data*) *(.bss*) *(.sdata*) *(.sbss*) *(.comment) }
}
