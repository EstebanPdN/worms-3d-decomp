/* Generated reference-only placements. All bodies are source-built. */
OUTPUT_FORMAT("elf32-powerpc")
OUTPUT_ARCH(powerpc)
ENTRY(w3d_d20e_reset_timer_widget_80223a78)
_SDA_BASE_ = 0x804b2540;
_SDA2_BASE_ = 0x804c2540;
constant_803b76c8 = 0x803b76c8;
constant_803b76cc = 0x803b76cc;
d20e_empty_804b06a0 = 0x804b06a0;
d20e_release_header_8020bb2c = 0x8020bb2c;
d20e_string_finish_8020c5c4 = 0x8020c5c4;
d20e_string_header_80341884 = 0x80341884;
d20e_string_init_8020c5c0 = 0x8020c5c0;
d20e_string_release_80341588 = 0x80341588;
desc_803b7598 = 0x803b7598;
desc_803b75bc = 0x803b75bc;
desc_803b75e0 = 0x803b75e0;
desc_803b7618 = 0x803b7618;
desc_803b763c = 0x803b763c;
desc_803b7674 = 0x803b7674;
desc_803b76a4 = 0x803b76a4;
fn_801e8d9c = 0x801e8d9c;
fn_801ece2c = 0x801ece2c;
fn_801ed24c = 0x801ed24c;
fn_801f0210 = 0x801f0210;
SECTIONS {
  .text.w3d_d20e_reset_timer_widget_80223a78 0x80223a78 : { *(.text.w3d_d20e_reset_timer_widget_80223a78) }
  /DISCARD/ : { *(.text*) *(.rodata*) *(.data*) *(.bss*) *(.sdata*) *(.sbss*) *(.comment) }
}
