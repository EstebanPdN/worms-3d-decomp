/* Generated reference-only placements. All bodies are source-built. */
OUTPUT_FORMAT("elf32-powerpc")
OUTPUT_ARCH(powerpc)
ENTRY(w3d_d29e_print_array_801ef970)
_SDA_BASE_ = 0x804b2540;
_SDA2_BASE_ = 0x804c2540;
__6String = 0x803426b8;
lbl_803b0d60 = 0x803b0d60;
lbl_803b0d68 = 0x803b0d68;
w3d_auto_80200050 = 0x80200050;
w3d_cx8b_text_line_break_8020d5a8 = 0x8020d5a8;
w3d_s21_kind_is_three_801fff60 = 0x801fff60;
w3d_s21_write_text_8020d82c = 0x8020d82c;
w3d_s21_write_text_8020dbf8 = 0x8020dbf8;
w3d_string_base_finish = 0x8020c5c4;
w3d_string_release = 0x80341588;
SECTIONS {
  .text.w3d_d29e_print_array_801ef970 0x801ef970 : { *(.text.w3d_d29e_print_array_801ef970) }
  /DISCARD/ : { *(.text*) *(.rodata*) *(.data*) *(.bss*) *(.sdata*) *(.sbss*) *(.comment) }
}
