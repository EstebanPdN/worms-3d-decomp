/* Generated reference-only placements. All bodies are source-built. */
OUTPUT_FORMAT("elf32-powerpc")
OUTPUT_ARCH(powerpc)
ENTRY(d40l_item_default_name_802ab3e8)
_SDA_BASE_ = 0x804b2540;
_SDA2_BASE_ = 0x804c2540;
__3Str = 0x803426b8;
empty_803d6ab8 = 0x803d6ab8;
error_803d6abc = 0x803d6abc;
fn_800fc1b0 = 0x800fc1b0;
fn_801790bc = 0x801790bc;
fn_80179170 = 0x80179170;
fn_8020bb2c = 0x8020bb2c;
fn_8020bd38 = 0x8020bd38;
fn_8020c510 = 0x8020c510;
fn_8020c5c4 = 0x8020c5c4;
fn_80341588 = 0x80341588;
fn_80343744 = 0x80343744;
names_80403b9c = 0x80403b9c;
t1_803d6b7c = 0x803d6b7c;
t4_803d6bd0 = 0x803d6bd0;
t7_803d6c24 = 0x803d6c24;
SECTIONS {
  .text.d40l_item_default_name_802ab3e8 0x802ab3e8 : { *(.text.d40l_item_default_name_802ab3e8) }
  /DISCARD/ : { *(.text*) *(.rodata*) *(.data*) *(.bss*) *(.sdata*) *(.sbss*) *(.comment) }
}
