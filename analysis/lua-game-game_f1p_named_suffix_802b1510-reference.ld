/* Generated reference-only placements. All bodies are source-built. */
OUTPUT_FORMAT("elf32-powerpc")
OUTPUT_ARCH(powerpc)
ENTRY(w3d_named_suffix_802b1510)
_SDA_BASE_ = 0x804b2540;
_SDA2_BASE_ = 0x804c2540;
__15String_8020bb54PCc = 0x8020bb54;
fn_8015adf4 = 0x8015adf4;
fn_80173f88 = 0x80173f88;
fn_8020c3a0 = 0x8020c3a0;
fn_8020c5c4 = 0x8020c5c4;
fn_802ed89c = 0x802ed89c;
fn_802ef198 = 0x802ef198;
fn_80341588 = 0x80341588;
fn_8034357c = 0x8034357c;
SECTIONS {
  .text.w3d_named_suffix_802b1510 0x802b1510 : { *(.text.w3d_named_suffix_802b1510) }
  /DISCARD/ : { *(.text*) *(.rodata*) *(.data*) *(.bss*) *(.sdata*) *(.sbss*) *(.comment) }
}
