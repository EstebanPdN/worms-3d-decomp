/* Generated reference-only placements. All bodies are source-built. */
OUTPUT_FORMAT("elf32-powerpc")
OUTPUT_ARCH(powerpc)
ENTRY(w3d_d26e_euler_matrix_801a3eb0)
_SDA_BASE_ = 0x804b2540;
_SDA2_BASE_ = 0x804c2540;
w3d_d24e_sin_cos_801f3db0 = 0x801f3db0;
SECTIONS {
  .text.w3d_d26e_euler_matrix_801a3eb0 0x801a3eb0 : { *(.text.w3d_d26e_euler_matrix_801a3eb0) }
  /DISCARD/ : { *(.text*) *(.rodata*) *(.data*) *(.bss*) *(.sdata*) *(.sbss*) *(.comment) }
}
