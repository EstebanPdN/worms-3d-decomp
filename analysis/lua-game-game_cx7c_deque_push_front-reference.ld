/* Generated reference-only placements. All bodies are source-built. */
OUTPUT_FORMAT("elf32-powerpc")
OUTPUT_ARCH(powerpc)
ENTRY(w3d_cx7c_deque_push_front_aux_8035f0cc)
_SDA_BASE_ = 0x804b2540;
_SDA2_BASE_ = 0x804c2540;
cx7c_allocate_80212fd4 = 0x80212fd4;
cx7c_allocation_fallback_803413d8 = 0x803413d8;
cx7c_reallocate_map_8035ef1c = 0x8035ef1c;
SECTIONS {
  .text.w3d_cx7c_deque_push_front_aux_8035f0cc 0x8035f0cc : { *(.text.w3d_cx7c_deque_push_front_aux_8035f0cc) }
  /DISCARD/ : { *(.text*) *(.rodata*) *(.data*) *(.bss*) *(.sdata*) *(.sbss*) *(.comment) }
}
