/* Generated reference-only placements. All bodies are source-built. */
OUTPUT_FORMAT("elf32-powerpc")
OUTPUT_ARCH(powerpc)
ENTRY(d27c_orbit_camera_construct_800d6b44)
_SDA_BASE_ = 0x804b2540;
_SDA2_BASE_ = 0x804c2540;
as_float_80342a74 = 0x80342a74;
as_int_80342a78 = 0x80342a78;
base_8015a0d4 = 0x8015a0d4;
n_80389028 = 0x80389028;
n_8038903c = 0x8038903c;
n_8038905c = 0x8038905c;
n_80389070 = 0x80389070;
n_8038907c = 0x8038907c;
read_setting_800fc1b0 = 0x800fc1b0;
vtable_8040fd38 = 0x8040fd38;
SECTIONS {
  .text.d27c_orbit_camera_construct_800d6b44 0x800d6b44 : { *(.text.d27c_orbit_camera_construct_800d6b44) }
  /DISCARD/ : { *(.text*) *(.rodata*) *(.data*) *(.bss*) *(.sdata*) *(.sbss*) *(.comment) }
}
