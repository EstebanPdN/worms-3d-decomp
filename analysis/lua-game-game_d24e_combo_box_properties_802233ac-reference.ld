/* Generated reference-only placements. All bodies are source-built. */
OUTPUT_FORMAT("elf32-powerpc")
OUTPUT_ARCH(powerpc)
ENTRY(w3d_d24e_register_combo_box_properties_802233ac)
_SDA_BASE_ = 0x804b2540;
_SDA2_BASE_ = 0x804c2540;
__15String_8020bb54PCc = 0x8020bb54;
d20e_empty_804b06a0 = 0x804b06a0;
d20e_release_header_8020bb2c = 0x8020bb2c;
d20e_string_finish_8020c5c4 = 0x8020c5c4;
d20e_string_header_80341884 = 0x80341884;
d20e_string_init_8020c5c0 = 0x8020c5c0;
d20e_string_release_80341588 = 0x80341588;
desc_803b726c = 0x803b726c;
desc_803b729c = 0x803b729c;
desc_803b72c0 = 0x803b72c0;
desc_803b72e4 = 0x803b72e4;
desc_803b7320 = 0x803b7320;
desc_803b7344 = 0x803b7344;
desc_803b736c = 0x803b736c;
desc_803b7394 = 0x803b7394;
desc_803b73bc = 0x803b73bc;
desc_803b73f4 = 0x803b73f4;
desc_803b741c = 0x803b741c;
desc_803b7450 = 0x803b7450;
desc_803b7488 = 0x803b7488;
desc_803b74bc = 0x803b74bc;
desc_803b74ec = 0x803b74ec;
desc_803b7520 = 0x803b7520;
desc_803b7548 = 0x803b7548;
fn_801e8d9c = 0x801e8d9c;
fn_801eb674 = 0x801eb674;
fn_801ec52c = 0x801ec52c;
fn_801ece2c = 0x801ece2c;
fn_801ed24c = 0x801ed24c;
lit_803b7250 = 0x803b7250;
SECTIONS {
  .text.w3d_d24e_register_combo_box_properties_802233ac 0x802233ac : { *(.text.w3d_d24e_register_combo_box_properties_802233ac) }
  /DISCARD/ : { *(.text*) *(.rodata*) *(.data*) *(.bss*) *(.sdata*) *(.sbss*) *(.comment) }
}
