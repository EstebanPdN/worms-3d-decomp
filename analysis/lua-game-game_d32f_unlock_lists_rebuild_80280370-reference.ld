/* Generated reference-only placements. All bodies are source-built. */
OUTPUT_FORMAT("elf32-powerpc")
OUTPUT_ARCH(powerpc)
ENTRY(d32f_unlock_lists_rebuild_80280370)
_SDA_BASE_ = 0x804b2540;
_SDA2_BASE_ = 0x804c2540;
_S_oom_malloc__Q24_STLt14__malloc_alloc1i0Ui = 0x803413d8;
__15String_803426b8 = 0x803426b8;
__15String_803426b8PCc = 0x8020bb54;
fn_8028496c = 0x8028496c;
free = 0x802134fc;
lbl_803667a8 = 0x803667a8;
lbl_803ceb40 = 0x803ceb40;
lbl_803cee88 = 0x803cee88;
lbl_803cee9c = 0x803cee9c;
lbl_803ceeb0 = 0x803ceeb0;
lbl_803ceec8 = 0x803ceec8;
lbl_803ceedc = 0x803ceedc;
lbl_803ceef0 = 0x803ceef0;
lbl_803cef00 = 0x803cef00;
lbl_803cef18 = 0x803cef18;
lbl_803cef2c = 0x803cef2c;
lbl_803cef48 = 0x803cef48;
malloc = 0x80212fd4;
strcmp = 0x802ef234;
w3d_auto_800fc69c = 0x800fc69c;
w3d_auto_801797b4 = 0x801797b4;
w3d_empty_80341584 = 0x80341584;
w3d_string_assign = 0x8020bd38;
w3d_string_base_finish = 0x8020c5c4;
w3d_string_base_init = 0x8020c5c0;
w3d_string_header = 0x80341884;
w3d_string_release = 0x80341588;
SECTIONS {
  .text.d32f_unlock_lists_rebuild_80280370 0x80280370 : { *(.text.d32f_unlock_lists_rebuild_80280370) }
  /DISCARD/ : { *(.text*) *(.rodata*) *(.data*) *(.bss*) *(.sdata*) *(.sbss*) *(.comment) }
}
