/* Generated reference-only placements. All bodies are source-built. */
OUTPUT_FORMAT("elf32-powerpc")
OUTPUT_ARCH(powerpc)
ENTRY(__15Mx24obCrcObjectUs)
_SDA_BASE_ = 0x804b2540;
_SDA2_BASE_ = 0x804c2540;
__13Mx24obCrcNode = 0x80207fec;
__15Mx24obCrcTaggedUs = 0x801ea0ec;
__vt_15Mx24obCrcObject = 0x8041ae50;
w3d_cx12b_crc_table_initialize_8021d70c = 0x8021d70c;
w3d_empty_string_804b06a0 = 0x804b06a0;
w3d_props_get_i32_80240770 = 0x80240770;
w3d_props_set_i32_80240768 = 0x80240768;
w3d_props_set_i32_80240824 = 0x80240824;
w3d_string_base_init = 0x8020c5c0;
w3d_string_header = 0x80341884;
SECTIONS {
  .text.__15Mx24obCrcObjectUs 0x8023a858 : { *(.text.__15Mx24obCrcObjectUs) }
  /DISCARD/ : { *(.text*) *(.rodata*) *(.data*) *(.bss*) *(.sdata*) *(.sbss*) *(.comment) }
}
