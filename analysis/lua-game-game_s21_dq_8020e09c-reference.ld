/* Generated reference-only placements. All bodies are source-built. */
OUTPUT_FORMAT("elf32-powerpc")
OUTPUT_ARCH(powerpc)
ENTRY(w3d_s21_destroy_list_object_8020e09c)
_SDA_BASE_ = 0x804b2540;
_SDA2_BASE_ = 0x804c2540;
fn_801fe1f8 = 0x801fe1f8;
fn_80210990 = 0x80210990;
fn_802134fc = 0x802134fc;
fn_8035cc1c = 0x8035cc1c;
lbl_80419510 = 0x80419510;
lbl_80419540 = 0x80419540;
SECTIONS {
  .text.w3d_s21_destroy_list_object_8020e09c 0x8020e09c : { *(.text.w3d_s21_destroy_list_object_8020e09c) }
  /DISCARD/ : { *(.text*) *(.rodata*) *(.data*) *(.bss*) *(.sdata*) *(.sbss*) *(.comment) }
}
