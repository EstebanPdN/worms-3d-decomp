/* Generated reference-only placements. All bodies are source-built. */
OUTPUT_FORMAT("elf32-powerpc")
OUTPUT_ARCH(powerpc)
ENTRY(w3d_f10a_setup_textbox_8026e98c)
_SDA_BASE_ = 0x804b2540;
_SDA2_BASE_ = 0x804c2540;
automatic_803cbe90 = 0x803cbe90;
background_803cbe2c = 0x803cbe2c;
border_803cbe08 = 0x803cbe08;
error_803cbe6c = 0x803cbe6c;
fn_800fc1b0 = 0x800fc1b0;
fn_800fd62c = 0x800fd62c;
fn_80165254 = 0x80165254;
fn_80178df0 = 0x80178df0;
fn_8020c510 = 0x8020c510;
fn_8020c5c0 = 0x8020c5c0;
fn_8020c5c4 = 0x8020c5c4;
fn_8026ed00 = 0x8026ed00;
fn_8026f528 = 0x8026f528;
fn_8026f9d0 = 0x8026f9d0;
fn_8026fb88 = 0x8026fb88;
fn_802b0b84 = 0x802b0b84;
fn_80341588 = 0x80341588;
fn_80341884 = 0x80341884;
fn_80342a74 = 0x80342a74;
fn_80343df4 = 0x80343df4;
shadow_803cbe1c = 0x803cbe1c;
SECTIONS {
  .text.w3d_f10a_setup_textbox_8026e98c 0x8026e98c : { *(.text.w3d_f10a_setup_textbox_8026e98c) }
  /DISCARD/ : { *(.text*) *(.rodata*) *(.data*) *(.bss*) *(.sdata*) *(.sbss*) *(.comment) }
}
