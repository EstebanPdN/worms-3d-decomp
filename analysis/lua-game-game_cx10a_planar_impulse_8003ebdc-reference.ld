/* Generated reference-only placements. All bodies are source-built. */
OUTPUT_FORMAT("elf32-powerpc")
OUTPUT_ARCH(powerpc)
ENTRY(w3d_cx10a_planar_impulse_8003ebdc)
_SDA_BASE_ = 0x804b2540;
_SDA2_BASE_ = 0x804c2540;
one_8037467c = 0x8037467c;
root_802e82c0 = 0x802e82c0;
scale_80374680 = 0x80374680;
zero_80374678 = 0x80374678;
SECTIONS {
  .text.w3d_cx10a_planar_impulse_8003ebdc 0x8003ebdc : { *(.text.w3d_cx10a_planar_impulse_8003ebdc) }
  /DISCARD/ : { *(.text*) *(.rodata*) *(.data*) *(.bss*) *(.sdata*) *(.sbss*) *(.comment) }
}
