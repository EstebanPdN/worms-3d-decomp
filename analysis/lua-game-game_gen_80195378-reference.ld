/* Generated reference-only placements. All bodies are source-built. */
OUTPUT_FORMAT("elf32-powerpc")
OUTPUT_ARCH(powerpc)
ENTRY(w3d_get_80195378)
_SDA_BASE_ = 0x804b2540;
_SDA2_BASE_ = 0x804c2540;
w3d_fn_8019895c = 0x8019895c;
w3d_fn_80198a3c = 0x80198a3c;
w3d_fn_8019ae18 = 0x8019ae18;
w3d_fn_8019b178 = 0x8019b178;
w3d_fn_8019b4a0 = 0x8019b4a0;
w3d_fn_8019b7ac = 0x8019b7ac;
w3d_fn_8019bbfc = 0x8019bbfc;
w3d_fn_8019c364 = 0x8019c364;
w3d_fn_8019c3c4 = 0x8019c3c4;
w3d_fn_8019cbfc = 0x8019cbfc;
w3d_fn_8019cc78 = 0x8019cc78;
w3d_fn_8019d78c = 0x8019d78c;
w3d_fn_8019d7d8 = 0x8019d7d8;
w3d_fn_8019da7c = 0x8019da7c;
w3d_fn_8019dafc = 0x8019dafc;
w3d_fn_8019e5b0 = 0x8019e5b0;
w3d_fn_8019e600 = 0x8019e600;
w3d_global_80361fe8 = 0x80361fe8;
w3d_global_80362018 = 0x80362018;
w3d_global_80362068 = 0x80362068;
w3d_global_803620b8 = 0x803620b8;
w3d_global_80362108 = 0x80362108;
w3d_global_80362158 = 0x80362158;
w3d_global_803621a8 = 0x803621a8;
w3d_global_803621f4 = 0x803621f4;
w3d_global_80362240 = 0x80362240;
w3d_global_80362270 = 0x80362270;
w3d_global_803622a0 = 0x803622a0;
w3d_global_803a86ac = 0x803a86ac;
w3d_global_803a978c = 0x803a978c;
w3d_global_803a985c = 0x803a985c;
w3d_global_803a98d4 = 0x803a98d4;
w3d_global_803a98f8 = 0x803a98f8;
w3d_global_803a995c = 0x803a995c;
w3d_heap_allocate_entry_a = 0x801fe1d8;
w3d_owner_list_remove = 0x8020fd2c;
w3d_registry_list_80361fe8 = 0x80361fe8;
w3d_registry_list_80362018 = 0x80362018;
w3d_registry_list_80362068 = 0x80362068;
w3d_registry_list_803620b8 = 0x803620b8;
w3d_registry_list_80362108 = 0x80362108;
w3d_registry_list_80362158 = 0x80362158;
w3d_registry_list_803621a8 = 0x803621a8;
w3d_registry_list_803621f4 = 0x803621f4;
w3d_registry_list_80362240 = 0x80362240;
w3d_registry_list_80362270 = 0x80362270;
w3d_registry_list_803622a0 = 0x803622a0;
w3d_state_register = 0x8020fd04;
SECTIONS {
  .text.w3d_get_80195378 0x80195378 : { *(.text.w3d_get_80195378) }
  .text.w3d_get_80197bfc 0x80197bfc : { *(.text.w3d_get_80197bfc) }
  .text.w3d_address_801987e4 0x801987e4 : { *(.text.w3d_address_801987e4) }
  .text.w3d_registry_unlink_801987f0 0x801987f0 : { *(.text.w3d_registry_unlink_801987f0) }
  .text.w3d_registry_create_80198834 0x80198834 : { *(.text.w3d_registry_create_80198834) }
  .text.w3d_address_80198894 0x80198894 : { *(.text.w3d_address_80198894) }
  .text.w3d_registry_release_801988a0 0x801988a0 : { *(.text.w3d_registry_release_801988a0) }
  .text.w3d_registry_retain_801988fc 0x801988fc : { *(.text.w3d_registry_retain_801988fc) }
  .text.w3d_get_80198fbc 0x80198fbc : { *(.text.w3d_get_80198fbc) }
  .text.w3d_address_8019accc 0x8019accc : { *(.text.w3d_address_8019accc) }
  .text.w3d_registry_unlink_8019ad40 0x8019ad40 : { *(.text.w3d_registry_unlink_8019ad40) }
  .text.w3d_address_8019b028 0x8019b028 : { *(.text.w3d_address_8019b028) }
  .text.w3d_registry_unlink_8019b09c 0x8019b09c : { *(.text.w3d_registry_unlink_8019b09c) }
  .text.w3d_address_8019b36c 0x8019b36c : { *(.text.w3d_address_8019b36c) }
  .text.w3d_registry_unlink_8019b3e0 0x8019b3e0 : { *(.text.w3d_registry_unlink_8019b3e0) }
  .text.w3d_address_8019b638 0x8019b638 : { *(.text.w3d_address_8019b638) }
  .text.w3d_registry_unlink_8019b6ac 0x8019b6ac : { *(.text.w3d_registry_unlink_8019b6ac) }
  .text.w3d_address_8019bafc 0x8019bafc : { *(.text.w3d_address_8019bafc) }
  .text.w3d_registry_unlink_8019bb70 0x8019bb70 : { *(.text.w3d_registry_unlink_8019bb70) }
  .text.w3d_registry_release_8019bdb8 0x8019bdb8 : { *(.text.w3d_registry_release_8019bdb8) }
  .text.w3d_registry_release_8019be14 0x8019be14 : { *(.text.w3d_registry_release_8019be14) }
  .text.w3d_registry_release_8019be70 0x8019be70 : { *(.text.w3d_registry_release_8019be70) }
  .text.w3d_registry_release_8019becc 0x8019becc : { *(.text.w3d_registry_release_8019becc) }
  .text.w3d_registry_release_8019bf28 0x8019bf28 : { *(.text.w3d_registry_release_8019bf28) }
  .text.w3d_get_8019c058 0x8019c058 : { *(.text.w3d_get_8019c058) }
  .text.w3d_set_8019c0e0 0x8019c0e0 : { *(.text.w3d_set_8019c0e0) }
  .text.w3d_get_8019c0e8 0x8019c0e8 : { *(.text.w3d_get_8019c0e8) }
  .text.w3d_set_8019c0f0 0x8019c0f0 : { *(.text.w3d_set_8019c0f0) }
  .text.w3d_get_8019c0f8 0x8019c0f8 : { *(.text.w3d_get_8019c0f8) }
  .text.w3d_set_8019c100 0x8019c100 : { *(.text.w3d_set_8019c100) }
  .text.w3d_get_8019c108 0x8019c108 : { *(.text.w3d_get_8019c108) }
  .text.w3d_set_8019c110 0x8019c110 : { *(.text.w3d_set_8019c110) }
  .text.w3d_get_8019c118 0x8019c118 : { *(.text.w3d_get_8019c118) }
  .text.w3d_set_8019c120 0x8019c120 : { *(.text.w3d_set_8019c120) }
  .text.w3d_get_8019c128 0x8019c128 : { *(.text.w3d_get_8019c128) }
  .text.w3d_set_8019c130 0x8019c130 : { *(.text.w3d_set_8019c130) }
  .text.w3d_get_8019c138 0x8019c138 : { *(.text.w3d_get_8019c138) }
  .text.w3d_set_8019c140 0x8019c140 : { *(.text.w3d_set_8019c140) }
  .text.w3d_get_8019c148 0x8019c148 : { *(.text.w3d_get_8019c148) }
  .text.w3d_set_8019c150 0x8019c150 : { *(.text.w3d_set_8019c150) }
  .text.w3d_get_8019c158 0x8019c158 : { *(.text.w3d_get_8019c158) }
  .text.w3d_address_8019c18c 0x8019c18c : { *(.text.w3d_address_8019c18c) }
  .text.w3d_registry_unlink_8019c198 0x8019c198 : { *(.text.w3d_registry_unlink_8019c198) }
  .text.w3d_registry_create_8019c1dc 0x8019c1dc : { *(.text.w3d_registry_create_8019c1dc) }
  .text.w3d_get_8019c294 0x8019c294 : { *(.text.w3d_get_8019c294) }
  .text.w3d_address_8019c29c 0x8019c29c : { *(.text.w3d_address_8019c29c) }
  .text.w3d_registry_release_8019c2a8 0x8019c2a8 : { *(.text.w3d_registry_release_8019c2a8) }
  .text.w3d_registry_retain_8019c304 0x8019c304 : { *(.text.w3d_registry_retain_8019c304) }
  .text.w3d_constant_8019c524 0x8019c524 : { *(.text.w3d_constant_8019c524) }
  .text.w3d_constant_8019c52c 0x8019c52c : { *(.text.w3d_constant_8019c52c) }
  .text.w3d_get_8019c59c 0x8019c59c : { *(.text.w3d_get_8019c59c) }
  .text.w3d_get_8019c5b0 0x8019c5b0 : { *(.text.w3d_get_8019c5b0) }
  .text.w3d_address_8019ca24 0x8019ca24 : { *(.text.w3d_address_8019ca24) }
  .text.w3d_registry_unlink_8019ca30 0x8019ca30 : { *(.text.w3d_registry_unlink_8019ca30) }
  .text.w3d_registry_create_8019ca74 0x8019ca74 : { *(.text.w3d_registry_create_8019ca74) }
  .text.w3d_get_8019cb2c 0x8019cb2c : { *(.text.w3d_get_8019cb2c) }
  .text.w3d_address_8019cb34 0x8019cb34 : { *(.text.w3d_address_8019cb34) }
  .text.w3d_registry_release_8019cb40 0x8019cb40 : { *(.text.w3d_registry_release_8019cb40) }
  .text.w3d_registry_retain_8019cb9c 0x8019cb9c : { *(.text.w3d_registry_retain_8019cb9c) }
  .text.w3d_constant_8019d41c 0x8019d41c : { *(.text.w3d_constant_8019d41c) }
  .text.w3d_get_8019d48c 0x8019d48c : { *(.text.w3d_get_8019d48c) }
  .text.w3d_address_8019d614 0x8019d614 : { *(.text.w3d_address_8019d614) }
  .text.w3d_registry_unlink_8019d620 0x8019d620 : { *(.text.w3d_registry_unlink_8019d620) }
  .text.w3d_registry_create_8019d664 0x8019d664 : { *(.text.w3d_registry_create_8019d664) }
  .text.w3d_address_8019d6c4 0x8019d6c4 : { *(.text.w3d_address_8019d6c4) }
  .text.w3d_registry_release_8019d6d0 0x8019d6d0 : { *(.text.w3d_registry_release_8019d6d0) }
  .text.w3d_registry_retain_8019d72c 0x8019d72c : { *(.text.w3d_registry_retain_8019d72c) }
  .text.w3d_address_8019d904 0x8019d904 : { *(.text.w3d_address_8019d904) }
  .text.w3d_registry_unlink_8019d910 0x8019d910 : { *(.text.w3d_registry_unlink_8019d910) }
  .text.w3d_registry_create_8019d954 0x8019d954 : { *(.text.w3d_registry_create_8019d954) }
  .text.w3d_address_8019d9b4 0x8019d9b4 : { *(.text.w3d_address_8019d9b4) }
  .text.w3d_registry_release_8019d9c0 0x8019d9c0 : { *(.text.w3d_registry_release_8019d9c0) }
  .text.w3d_registry_retain_8019da1c 0x8019da1c : { *(.text.w3d_registry_retain_8019da1c) }
  .text.w3d_get_8019dd78 0x8019dd78 : { *(.text.w3d_get_8019dd78) }
  .text.w3d_address_8019e438 0x8019e438 : { *(.text.w3d_address_8019e438) }
  .text.w3d_registry_unlink_8019e444 0x8019e444 : { *(.text.w3d_registry_unlink_8019e444) }
  .text.w3d_registry_create_8019e488 0x8019e488 : { *(.text.w3d_registry_create_8019e488) }
  .text.w3d_address_8019e4e8 0x8019e4e8 : { *(.text.w3d_address_8019e4e8) }
  .text.w3d_registry_release_8019e4f4 0x8019e4f4 : { *(.text.w3d_registry_release_8019e4f4) }
  .text.w3d_registry_retain_8019e550 0x8019e550 : { *(.text.w3d_registry_retain_8019e550) }
  /DISCARD/ : { *(.text*) *(.rodata*) *(.data*) *(.bss*) *(.sdata*) *(.sbss*) *(.comment) }
}
