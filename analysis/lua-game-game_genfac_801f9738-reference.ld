/* Generated reference-only placements. All bodies are source-built. */
OUTPUT_FORMAT("elf32-powerpc")
OUTPUT_ARCH(powerpc)
ENTRY(w3d_create_801f9738)
_SDA_BASE_ = 0x804b2540;
_SDA2_BASE_ = 0x804c2540;
__18w3d_class_801fa01c = 0x801fa01c;
__18w3d_class_801fb270 = 0x801fb270;
__18w3d_class_801fc3dc = 0x801fc3dc;
__18w3d_class_801fc518 = 0x801fc518;
__nw__18w3d_class_801fa01cUi = 0x801fe1d8;
__nw__18w3d_class_801fb270Ui = 0x801fe1d8;
__nw__18w3d_class_801fc3dcUi = 0x801fe1d8;
__nw__18w3d_class_801fc518Ui = 0x801fe1d8;
w3d_registry_80365838 = 0x80365838;
w3d_registry_80365868 = 0x80365868;
w3d_registry_80365898 = 0x80365898;
w3d_registry_803658c8 = 0x803658c8;
w3d_state_register = 0x8020fd04;
SECTIONS {
  .text.w3d_create_801f9738 0x801f9738 : { *(.text.w3d_create_801f9738) }
  .text.w3d_create_801f97e8 0x801f97e8 : { *(.text.w3d_create_801f97e8) }
  .text.w3d_create_801fc090 0x801fc090 : { *(.text.w3d_create_801fc090) }
  .text.w3d_create_801fc140 0x801fc140 : { *(.text.w3d_create_801fc140) }
  /DISCARD/ : { *(.text*) *(.rodata*) *(.data*) *(.bss*) *(.sdata*) *(.sbss*) *(.comment) }
}
