/* Generated reference-only placements. All bodies are source-built. */
OUTPUT_FORMAT("elf32-powerpc")
OUTPUT_ARCH(powerpc)
ENTRY(f8b_pack_corner_occupancy_800b3fe4)
_SDA_BASE_ = 0x804b2540;
_SDA2_BASE_ = 0x804c2540;
sample_8002c73c = 0x8002c73c;
SECTIONS {
  .text.f8b_pack_corner_occupancy_800b3fe4 0x800b3fe4 : { *(.text.f8b_pack_corner_occupancy_800b3fe4) }
  /DISCARD/ : { *(.text*) *(.rodata*) *(.data*) *(.bss*) *(.sdata*) *(.sbss*) *(.comment) }
}
