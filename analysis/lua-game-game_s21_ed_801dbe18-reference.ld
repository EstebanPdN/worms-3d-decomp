/* Generated reference-only placements. All bodies are source-built. */
OUTPUT_FORMAT("elf32-powerpc")
OUTPUT_ARCH(powerpc)
ENTRY(w3d_s21_dispatch_by_id_801dbe18)
_SDA_BASE_ = 0x804b2540;
_SDA2_BASE_ = 0x804c2540;
fn_801de13c = 0x801de13c;
fn_801de328 = 0x801de328;
SECTIONS {
  .text.w3d_s21_dispatch_by_id_801dbe18 0x801dbe18 : { *(.text.w3d_s21_dispatch_by_id_801dbe18) }
  /DISCARD/ : { *(.text*) *(.rodata*) *(.data*) *(.bss*) *(.sdata*) *(.sbss*) *(.comment) }
}
