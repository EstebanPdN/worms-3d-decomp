/* Generated reference-only placements. All bodies are source-built. */
OUTPUT_FORMAT("elf32-powerpc")
OUTPUT_ARCH(powerpc)
ENTRY(w3d_cx9b_property_float_select_8021d100)
_SDA_BASE_ = 0x804b2540;
_SDA2_BASE_ = 0x804c2540;
default_value_803b445c = 0x803b445c;
SECTIONS {
  .text.w3d_cx9b_property_float_select_8021d100 0x8021d100 : { *(.text.w3d_cx9b_property_float_select_8021d100) }
  /DISCARD/ : { *(.text*) *(.rodata*) *(.data*) *(.bss*) *(.sdata*) *(.sbss*) *(.comment) }
}
