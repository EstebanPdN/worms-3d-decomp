/* Generated reference-only placements. All bodies are source-built. */
OUTPUT_FORMAT("elf32-powerpc")
OUTPUT_ARCH(powerpc)
ENTRY(w3d_s21_float_format_801ff0c8)
_SDA_BASE_ = 0x804b2540;
_SDA2_BASE_ = 0x804c2540;
fn_8020c510 = 0x8020c510;
lbl_803b2988 = 0x803b2988;
SECTIONS {
  .text.w3d_s21_float_format_801ff0c8 0x801ff0c8 : { *(.text.w3d_s21_float_format_801ff0c8) }
  /DISCARD/ : { *(.text*) *(.rodata*) *(.data*) *(.bss*) *(.sdata*) *(.sbss*) *(.comment) }
}
