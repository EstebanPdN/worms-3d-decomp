/* Generated reference-only placements. All bodies are source-built. */
OUTPUT_FORMAT("elf32-powerpc")
OUTPUT_ARCH(powerpc)
ENTRY(f2c_tag_init_801dec90)
_SDA_BASE_ = 0x804b2540;
_SDA2_BASE_ = 0x804c2540;
fn_8020bd38 = 0x8020bd38;
fn_803426b8 = 0x803426b8;
lbl_803b0364 = 0x803b0364;
lbl_803b036c = 0x803b036c;
lbl_803b0370 = 0x803b0370;
lbl_803b0374 = 0x803b0374;
lbl_80416bb0 = 0x80416bb0;
lbl_80416bf8 = 0x80416bf8;
SECTIONS {
  .text.f2c_tag_init_801dec90 0x801dec90 : { *(.text.f2c_tag_init_801dec90) }
  /DISCARD/ : { *(.text*) *(.rodata*) *(.data*) *(.bss*) *(.sdata*) *(.sbss*) *(.comment) }
}
