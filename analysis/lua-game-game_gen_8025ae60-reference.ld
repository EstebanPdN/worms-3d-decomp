/* Generated reference-only placements. All bodies are source-built. */
OUTPUT_FORMAT("elf32-powerpc")
OUTPUT_ARCH(powerpc)
ENTRY(w3d_get_8025ae60)
_SDA_BASE_ = 0x804b2540;
_SDA2_BASE_ = 0x804c2540;
w3d_fn_8025d818 = 0x8025d818;
w3d_fn_8025d8a0 = 0x8025d8a0;
w3d_fn_8025f1b8 = 0x8025f1b8;
w3d_fn_8025f24c = 0x8025f24c;
w3d_fn_802608dc = 0x802608dc;
w3d_fn_80260a24 = 0x80260a24;
w3d_fn_80264c50 = 0x80264c50;
w3d_fn_80264f60 = 0x80264f60;
w3d_fn_80268808 = 0x80268808;
w3d_fn_80268a74 = 0x80268a74;
w3d_fn_8026cf8c = 0x8026cf8c;
w3d_fn_8026d040 = 0x8026d040;
w3d_fn_8026e05c = 0x8026e05c;
w3d_fn_8026e148 = 0x8026e148;
w3d_global_803685a8 = 0x803685a8;
w3d_global_803685d8 = 0x803685d8;
w3d_global_80368608 = 0x80368608;
w3d_global_80368638 = 0x80368638;
w3d_global_80368668 = 0x80368668;
w3d_global_80368698 = 0x80368698;
w3d_global_803686c8 = 0x803686c8;
w3d_heap_allocate_entry_a = 0x801fe1d8;
w3d_owner_list_remove = 0x8020fd2c;
w3d_registry_list_803685a8 = 0x803685a8;
w3d_registry_list_803685d8 = 0x803685d8;
w3d_registry_list_80368608 = 0x80368608;
w3d_registry_list_80368638 = 0x80368638;
w3d_registry_list_80368668 = 0x80368668;
w3d_registry_list_80368698 = 0x80368698;
w3d_registry_list_803686c8 = 0x803686c8;
w3d_state_register = 0x8020fd04;
SECTIONS {
  .text.w3d_get_8025ae60 0x8025ae60 : { *(.text.w3d_get_8025ae60) }
  .text.w3d_set_8025ae68 0x8025ae68 : { *(.text.w3d_set_8025ae68) }
  .text.w3d_get_8025ae70 0x8025ae70 : { *(.text.w3d_get_8025ae70) }
  .text.w3d_set_8025ae78 0x8025ae78 : { *(.text.w3d_set_8025ae78) }
  .text.w3d_get_8025ae80 0x8025ae80 : { *(.text.w3d_get_8025ae80) }
  .text.w3d_set_8025ae88 0x8025ae88 : { *(.text.w3d_set_8025ae88) }
  .text.w3d_get_8025ae90 0x8025ae90 : { *(.text.w3d_get_8025ae90) }
  .text.w3d_set_8025ae98 0x8025ae98 : { *(.text.w3d_set_8025ae98) }
  .text.w3d_get_8025aea0 0x8025aea0 : { *(.text.w3d_get_8025aea0) }
  .text.w3d_set_8025aea8 0x8025aea8 : { *(.text.w3d_set_8025aea8) }
  .text.w3d_get_8025aeb0 0x8025aeb0 : { *(.text.w3d_get_8025aeb0) }
  .text.w3d_set_8025aeb8 0x8025aeb8 : { *(.text.w3d_set_8025aeb8) }
  .text.w3d_get_8025aec0 0x8025aec0 : { *(.text.w3d_get_8025aec0) }
  .text.w3d_set_8025aec8 0x8025aec8 : { *(.text.w3d_set_8025aec8) }
  .text.w3d_get_8025aed0 0x8025aed0 : { *(.text.w3d_get_8025aed0) }
  .text.w3d_set_8025aed8 0x8025aed8 : { *(.text.w3d_set_8025aed8) }
  .text.w3d_get_8025aee0 0x8025aee0 : { *(.text.w3d_get_8025aee0) }
  .text.w3d_set_8025aee8 0x8025aee8 : { *(.text.w3d_set_8025aee8) }
  .text.w3d_get_8025aef0 0x8025aef0 : { *(.text.w3d_get_8025aef0) }
  .text.w3d_set_8025aef8 0x8025aef8 : { *(.text.w3d_set_8025aef8) }
  .text.w3d_get_8025af00 0x8025af00 : { *(.text.w3d_get_8025af00) }
  .text.w3d_set_8025af08 0x8025af08 : { *(.text.w3d_set_8025af08) }
  .text.w3d_get_8025af10 0x8025af10 : { *(.text.w3d_get_8025af10) }
  .text.w3d_set_8025af18 0x8025af18 : { *(.text.w3d_set_8025af18) }
  .text.w3d_get_8025af20 0x8025af20 : { *(.text.w3d_get_8025af20) }
  .text.w3d_set_8025af28 0x8025af28 : { *(.text.w3d_set_8025af28) }
  .text.w3d_get_8025af30 0x8025af30 : { *(.text.w3d_get_8025af30) }
  .text.w3d_set_8025af38 0x8025af38 : { *(.text.w3d_set_8025af38) }
  .text.w3d_get_8025af40 0x8025af40 : { *(.text.w3d_get_8025af40) }
  .text.w3d_set_8025af48 0x8025af48 : { *(.text.w3d_set_8025af48) }
  .text.w3d_get_8025af50 0x8025af50 : { *(.text.w3d_get_8025af50) }
  .text.w3d_set_8025af58 0x8025af58 : { *(.text.w3d_set_8025af58) }
  .text.w3d_get_8025af60 0x8025af60 : { *(.text.w3d_get_8025af60) }
  .text.w3d_set_8025af68 0x8025af68 : { *(.text.w3d_set_8025af68) }
  .text.w3d_get_8025af70 0x8025af70 : { *(.text.w3d_get_8025af70) }
  .text.w3d_set_8025af78 0x8025af78 : { *(.text.w3d_set_8025af78) }
  .text.w3d_get_8025af80 0x8025af80 : { *(.text.w3d_get_8025af80) }
  .text.w3d_set_8025af88 0x8025af88 : { *(.text.w3d_set_8025af88) }
  .text.w3d_get_8025af90 0x8025af90 : { *(.text.w3d_get_8025af90) }
  .text.w3d_empty_8025d5a4 0x8025d5a4 : { *(.text.w3d_empty_8025d5a4) }
  .text.w3d_empty_8025d618 0x8025d618 : { *(.text.w3d_empty_8025d618) }
  .text.w3d_address_8025d6f4 0x8025d6f4 : { *(.text.w3d_address_8025d6f4) }
  .text.w3d_registry_unlink_8025d700 0x8025d700 : { *(.text.w3d_registry_unlink_8025d700) }
  .text.w3d_registry_create_8025d744 0x8025d744 : { *(.text.w3d_registry_create_8025d744) }
  .text.w3d_registry_release_8025d7a4 0x8025d7a4 : { *(.text.w3d_registry_release_8025d7a4) }
  .text.w3d_registry_retain_8025d800 0x8025d800 : { *(.text.w3d_registry_retain_8025d800) }
  .text.w3d_empty_8025deec 0x8025deec : { *(.text.w3d_empty_8025deec) }
  .text.w3d_address_8025f094 0x8025f094 : { *(.text.w3d_address_8025f094) }
  .text.w3d_registry_unlink_8025f0a0 0x8025f0a0 : { *(.text.w3d_registry_unlink_8025f0a0) }
  .text.w3d_registry_create_8025f0e4 0x8025f0e4 : { *(.text.w3d_registry_create_8025f0e4) }
  .text.w3d_registry_release_8025f144 0x8025f144 : { *(.text.w3d_registry_release_8025f144) }
  .text.w3d_registry_retain_8025f1a0 0x8025f1a0 : { *(.text.w3d_registry_retain_8025f1a0) }
  .text.w3d_get_80260784 0x80260784 : { *(.text.w3d_get_80260784) }
  .text.w3d_address_802607b8 0x802607b8 : { *(.text.w3d_address_802607b8) }
  .text.w3d_registry_unlink_802607c4 0x802607c4 : { *(.text.w3d_registry_unlink_802607c4) }
  .text.w3d_registry_create_80260808 0x80260808 : { *(.text.w3d_registry_create_80260808) }
  .text.w3d_registry_release_80260868 0x80260868 : { *(.text.w3d_registry_release_80260868) }
  .text.w3d_registry_retain_802608c4 0x802608c4 : { *(.text.w3d_registry_retain_802608c4) }
  .text.w3d_address_80264b2c 0x80264b2c : { *(.text.w3d_address_80264b2c) }
  .text.w3d_registry_unlink_80264b38 0x80264b38 : { *(.text.w3d_registry_unlink_80264b38) }
  .text.w3d_registry_create_80264b7c 0x80264b7c : { *(.text.w3d_registry_create_80264b7c) }
  .text.w3d_registry_release_80264bdc 0x80264bdc : { *(.text.w3d_registry_release_80264bdc) }
  .text.w3d_registry_retain_80264c38 0x80264c38 : { *(.text.w3d_registry_retain_80264c38) }
  .text.w3d_get_802686b0 0x802686b0 : { *(.text.w3d_get_802686b0) }
  .text.w3d_address_802686e4 0x802686e4 : { *(.text.w3d_address_802686e4) }
  .text.w3d_registry_unlink_802686f0 0x802686f0 : { *(.text.w3d_registry_unlink_802686f0) }
  .text.w3d_registry_create_80268734 0x80268734 : { *(.text.w3d_registry_create_80268734) }
  .text.w3d_registry_release_80268794 0x80268794 : { *(.text.w3d_registry_release_80268794) }
  .text.w3d_registry_retain_802687f0 0x802687f0 : { *(.text.w3d_registry_retain_802687f0) }
  .text.w3d_get_8026c6e0 0x8026c6e0 : { *(.text.w3d_get_8026c6e0) }
  .text.w3d_address_8026ce68 0x8026ce68 : { *(.text.w3d_address_8026ce68) }
  .text.w3d_registry_unlink_8026ce74 0x8026ce74 : { *(.text.w3d_registry_unlink_8026ce74) }
  .text.w3d_registry_create_8026ceb8 0x8026ceb8 : { *(.text.w3d_registry_create_8026ceb8) }
  .text.w3d_registry_release_8026cf18 0x8026cf18 : { *(.text.w3d_registry_release_8026cf18) }
  .text.w3d_registry_retain_8026cf74 0x8026cf74 : { *(.text.w3d_registry_retain_8026cf74) }
  .text.w3d_address_8026df38 0x8026df38 : { *(.text.w3d_address_8026df38) }
  .text.w3d_registry_unlink_8026df44 0x8026df44 : { *(.text.w3d_registry_unlink_8026df44) }
  .text.w3d_registry_create_8026df88 0x8026df88 : { *(.text.w3d_registry_create_8026df88) }
  .text.w3d_registry_release_8026dfe8 0x8026dfe8 : { *(.text.w3d_registry_release_8026dfe8) }
  .text.w3d_registry_retain_8026e044 0x8026e044 : { *(.text.w3d_registry_retain_8026e044) }
  /DISCARD/ : { *(.text*) *(.rodata*) *(.data*) *(.bss*) *(.sdata*) *(.sbss*) *(.comment) }
}
