/* Generated reference-only placements. All bodies are source-built. */
OUTPUT_FORMAT("elf32-powerpc")
OUTPUT_ARCH(powerpc)
ENTRY(w3d_cx16a_initialize_named_actor_8004971c)
_SDA_BASE_ = 0x804b2540;
_SDA2_BASE_ = 0x804c2540;
base_80161014 = 0x80161014;
handle_80126184 = 0x80126184;
string_803426b8 = 0x803426b8;
value_80376e30 = 0x80376e30;
value_80376e34 = 0x80376e34;
value_80376e38 = 0x80376e38;
vtable_8040e9b8 = 0x8040e9b8;
SECTIONS {
  .text.w3d_cx16a_initialize_named_actor_8004971c 0x8004971c : { *(.text.w3d_cx16a_initialize_named_actor_8004971c) }
  /DISCARD/ : { *(.text*) *(.rodata*) *(.data*) *(.bss*) *(.sdata*) *(.sbss*) *(.comment) }
}
