/* Generated reference-only placements. All bodies are source-built. */
OUTPUT_FORMAT("elf32-powerpc")
OUTPUT_ARCH(powerpc)
ENTRY(d29j_acquire_slot_801983cc)
_SDA_BASE_ = 0x804b2540;
_SDA2_BASE_ = 0x804c2540;
fn_8019805c = 0x8019805c;
fn_801984fc = 0x801984fc;
fn_802fb7ac = 0x802fb7ac;
msg_803a857c = 0x803a857c;
SECTIONS {
  .text.d29j_acquire_slot_801983cc 0x801983cc : { *(.text.d29j_acquire_slot_801983cc) }
  /DISCARD/ : { *(.text*) *(.rodata*) *(.data*) *(.bss*) *(.sdata*) *(.sbss*) *(.comment) }
}
