/* Generated reference-only placements. All bodies are source-built. */
OUTPUT_FORMAT("elf32-powerpc")
OUTPUT_ARCH(powerpc)
ENTRY(d24j_load_filtered_targets_80176d4c)
_SDA_BASE_ = 0x804b2540;
_SDA2_BASE_ = 0x804c2540;
_._6Reader = 0x8020803c;
__6Reader = 0x80207fec;
fn_8018ff84 = 0x8018ff84;
fn_8018ffb0 = 0x8018ffb0;
fn_8018ffdc = 0x8018ffdc;
fn_80190008 = 0x80190008;
fn_80190034 = 0x80190034;
fn_80190060 = 0x80190060;
fn_8019008c = 0x8019008c;
fn_801900b8 = 0x801900b8;
fn_801900e4 = 0x801900e4;
fn_802080a0 = 0x802080a0;
fn_8020810c = 0x8020810c;
fn_8020b680 = 0x8020b680;
name_80413088 = 0x80413088;
name_80418f78 = 0x80418f78;
text_803a6c08 = 0x803a6c08;
type_80361cd8 = 0x80361cd8;
type_80361d28 = 0x80361d28;
type_80361d78 = 0x80361d78;
type_80361dc8 = 0x80361dc8;
type_80361e18 = 0x80361e18;
type_80361e68 = 0x80361e68;
type_80361eb8 = 0x80361eb8;
type_80364964 = 0x80364964;
SECTIONS {
  .text.d24j_load_filtered_targets_80176d4c 0x80176d4c : { *(.text.d24j_load_filtered_targets_80176d4c) }
  /DISCARD/ : { *(.text*) *(.rodata*) *(.data*) *(.bss*) *(.sdata*) *(.sbss*) *(.comment) }
}
