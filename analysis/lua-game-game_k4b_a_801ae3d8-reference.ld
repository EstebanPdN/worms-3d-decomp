/* Generated reference-only placements. All bodies are source-built. */
OUTPUT_FORMAT("elf32-powerpc")
OUTPUT_ARCH(powerpc)
ENTRY(w3d_k4b_component_construct_801ae3d8)
_SDA_BASE_ = 0x804b2540;
_SDA2_BASE_ = 0x804c2540;
fn_801e81c8 = 0x801e81c8;
lbl_804140e0 = 0x804140e0;
lbl_80414120 = 0x80414120;
SECTIONS {
  .text.w3d_k4b_component_construct_801ae3d8 0x801ae3d8 : { *(.text.w3d_k4b_component_construct_801ae3d8) }
  /DISCARD/ : { *(.text*) *(.rodata*) *(.data*) *(.bss*) *(.sdata*) *(.sbss*) *(.comment) }
}
