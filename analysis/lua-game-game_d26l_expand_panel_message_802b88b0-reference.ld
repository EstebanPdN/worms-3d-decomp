/* Generated reference-only placements. All bodies are source-built. */
OUTPUT_FORMAT("elf32-powerpc")
OUTPUT_ARCH(powerpc)
ENTRY(d26l_expand_panel_message_802b88b0)
_SDA_BASE_ = 0x804b2540;
_SDA2_BASE_ = 0x804c2540;
__20MessageFrom_8020bb54PCc = 0x8020bb54;
__23MessageDefault_803426b8 = 0x803426b8;
empty_803d80d8 = 0x803d80d8;
fn_801797b4 = 0x801797b4;
fn_8020bb2c = 0x8020bb2c;
fn_8020bd38 = 0x8020bd38;
fn_8020bf2c = 0x8020bf2c;
fn_8020c3a0 = 0x8020c3a0;
fn_8020c5c0 = 0x8020c5c0;
fn_8020c5c4 = 0x8020c5c4;
fn_802b1258 = 0x802b1258;
fn_802b222c__13Base_802b222c = 0x802b222c;
fn_802ef380 = 0x802ef380;
fn_80341584 = 0x80341584;
fn_80341588 = 0x80341588;
fn_80341884 = 0x80341884;
marker_803d80dc = 0x803d80dc;
SECTIONS {
  .text.d26l_expand_panel_message_802b88b0 0x802b88b0 : { *(.text.d26l_expand_panel_message_802b88b0) }
  /DISCARD/ : { *(.text*) *(.rodata*) *(.data*) *(.bss*) *(.sdata*) *(.sbss*) *(.comment) }
}
