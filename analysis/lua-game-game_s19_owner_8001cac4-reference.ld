/* Generated reference-only placements. All bodies are source-built. */
OUTPUT_FORMAT("elf32-powerpc")
OUTPUT_ARCH(powerpc)
ENTRY(s19_release_owner_8001cac4)
_SDA_BASE_ = 0x804b2540;
_SDA2_BASE_ = 0x804c2540;
FUN_80004394 = 0x80004394;
FUN_80342a7c = 0x80342a7c;
w3d_auto_800200f4 = 0x800200f4;
w3d_vector_free_80342b60 = 0x80342b60;
SECTIONS {
  .text.s19_release_owner_8001cac4 0x8001cac4 : { *(.text.s19_release_owner_8001cac4) }
  /DISCARD/ : { *(.text*) *(.rodata*) *(.data*) *(.bss*) *(.sdata*) *(.sbss*) *(.comment) }
}
