/* Generated reference-only placements. All bodies are source-built. */
OUTPUT_FORMAT("elf32-powerpc")
OUTPUT_ARCH(powerpc)
ENTRY(d31c_group_link_800f5c1c)
_SDA_BASE_ = 0x804b2540;
_SDA2_BASE_ = 0x804c2540;
__4Vec3 = 0x80343740;
euler_8009ed90 = 0x8009ed90;
identity_8045e748 = 0x8045e748;
inv_801f76e0 = 0x801f76e0;
mul_801f740c = 0x801f740c;
rotx_801f6120 = 0x801f6120;
roty_801f61a0 = 0x801f61a0;
rotz_801f621c = 0x801f621c;
update_800f5f44 = 0x800f5f44;
SECTIONS {
  .text.d31c_group_link_800f5c1c 0x800f5c1c : { *(.text.d31c_group_link_800f5c1c) }
  /DISCARD/ : { *(.text*) *(.rodata*) *(.data*) *(.bss*) *(.sdata*) *(.sbss*) *(.comment) }
}
