/* Generated reference-only placements. All bodies are source-built. */
OUTPUT_FORMAT("elf32-powerpc")
OUTPUT_ARCH(powerpc)
ENTRY(w3d_f13c_preview_theme_8026b9bc)
_SDA_BASE_ = 0x804b2540;
_SDA2_BASE_ = 0x804c2540;
_._23F13cThemeOwned_80178474 = 0x80178474;
__23F13cSelectFrom_8020bb54PCc = 0x8020bb54;
__25F13cThemeDefault_803426b8 = 0x803426b8;
arctic_803cbb04 = 0x803cbb04;
day_803cbb0c = 0x803cbb0c;
empty_803cba1c = 0x803cba1c;
england_803cbaf4 = 0x803cbaf4;
evening_803cbb10 = 0x803cbb10;
fn_800fc1b0 = 0x800fc1b0;
fn_800fc230 = 0x800fc230;
fn_80179170 = 0x80179170;
fn_80179598 = 0x80179598;
fn_801797b4 = 0x801797b4;
fn_8020bb2c = 0x8020bb2c;
fn_8020bd38 = 0x8020bd38;
fn_8020c5c4 = 0x8020c5c4;
fn_802ef234 = 0x802ef234;
fn_80341584 = 0x80341584;
fn_80341588 = 0x80341588;
fn_80343744 = 0x80343744;
horror_803cbafc = 0x803cbafc;
lunar_803cbaec = 0x803cbaec;
night_803cbb18 = 0x803cbb18;
pirate_803cbae0 = 0x803cbae0;
random_803cba20 = 0x803cba20;
time_803cb980 = 0x803cb980;
type_803667a8 = 0x803667a8;
war_803cbae8 = 0x803cbae8;
SECTIONS {
  .text.w3d_f13c_preview_theme_8026b9bc 0x8026b9bc : { *(.text.w3d_f13c_preview_theme_8026b9bc) }
  /DISCARD/ : { *(.text*) *(.rodata*) *(.data*) *(.bss*) *(.sdata*) *(.sbss*) *(.comment) }
}
