/* Generated reference-only placements. All bodies are source-built. */
OUTPUT_FORMAT("elf32-powerpc")
OUTPUT_ARCH(powerpc)
ENTRY(d16b_sync_tracked_body_8009785c)
_SDA_BASE_ = 0x804b2540;
_SDA2_BASE_ = 0x804c2540;
w3d_auto_8015fd1c = 0x8015fd1c;
w3d_get_80098370 = 0x80098370;
w3d_getf_8003e30c = 0x8003e30c;
w3d_getf_80098378 = 0x80098378;
w3d_getf_80098380 = 0x80098380;
w3d_handle_member_query_801265ec = 0x801265ec;
w3d_member_8003e304 = 0x8003e304;
w3d_s20_lookup_handle_object_80164fc8 = 0x80164fc8;
w3d_tracker_apply_80097cbc = 0x80097cbc;
SECTIONS {
  .text.d16b_sync_tracked_body_8009785c 0x8009785c : { *(.text.d16b_sync_tracked_body_8009785c) }
  /DISCARD/ : { *(.text*) *(.rodata*) *(.data*) *(.bss*) *(.sdata*) *(.sbss*) *(.comment) }
}
