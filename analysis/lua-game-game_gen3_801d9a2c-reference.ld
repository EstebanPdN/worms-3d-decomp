/* Generated reference-only placements. All bodies are source-built. */
OUTPUT_FORMAT("elf32-powerpc")
OUTPUT_ARCH(powerpc)
ENTRY(w3d_forward_801d9a2c)
_SDA_BASE_ = 0x804b2540;
_SDA2_BASE_ = 0x804c2540;
w3d_address_801d99ac = 0x801d99ac;
w3d_address_801dae70 = 0x801dae70;
w3d_address_801ddd30 = 0x801ddd30;
w3d_address_801de4c0 = 0x801de4c0;
w3d_address_801de754 = 0x801de754;
w3d_address_801debc8 = 0x801debc8;
w3d_address_801df3c8 = 0x801df3c8;
w3d_address_801dfa44 = 0x801dfa44;
w3d_address_801dfb0c = 0x801dfb0c;
w3d_address_801e83f0 = 0x801e83f0;
w3d_address_801ea024 = 0x801ea024;
w3d_address_801f2c5c = 0x801f2c5c;
w3d_fn_801e88b0 = 0x801e88b0;
w3d_fn_801ef45c = 0x801ef45c;
w3d_fn_801f3d28 = 0x801f3d28;
w3d_fn_801f4064 = 0x801f4064;
w3d_fn_801f4c4c = 0x801f4c4c;
w3d_fn_801f5e08 = 0x801f5e08;
w3d_fn_801f5fc0 = 0x801f5fc0;
w3d_fn_801f675c = 0x801f675c;
w3d_fn_801f736c = 0x801f736c;
w3d_fn_801f788c = 0x801f788c;
w3d_fn_801f79d4 = 0x801f79d4;
w3d_fn_801f7a58 = 0x801f7a58;
w3d_fn_801f7b0c = 0x801f7b0c;
w3d_fn_801f7d54 = 0x801f7d54;
w3d_fn_801f80b4 = 0x801f80b4;
w3d_fn_801f81c8 = 0x801f81c8;
w3d_fn_80200340 = 0x80200340;
w3d_fn_8020b460 = 0x8020b460;
w3d_fn_8020fac8 = 0x8020fac8;
w3d_global_80365808 = 0x80365808;
w3d_global_803b1858 = 0x803b1858;
w3d_vtable_80418d88 = 0x80418d88;
SECTIONS {
  .text.w3d_forward_801d9a2c 0x801d9a2c : { *(.text.w3d_forward_801d9a2c) }
  .text.w3d_forward_801daef0 0x801daef0 : { *(.text.w3d_forward_801daef0) }
  .text.w3d_forward_801dddb0 0x801dddb0 : { *(.text.w3d_forward_801dddb0) }
  .text.w3d_forward_801de4dc 0x801de4dc : { *(.text.w3d_forward_801de4dc) }
  .text.w3d_forward_801de7d4 0x801de7d4 : { *(.text.w3d_forward_801de7d4) }
  .text.w3d_forward_801dec48 0x801dec48 : { *(.text.w3d_forward_801dec48) }
  .text.w3d_forward_801df448 0x801df448 : { *(.text.w3d_forward_801df448) }
  .text.w3d_forward_801dfac4 0x801dfac4 : { *(.text.w3d_forward_801dfac4) }
  .text.w3d_forward_801dfb8c 0x801dfb8c : { *(.text.w3d_forward_801dfb8c) }
  .text.w3d_forward_801e8488 0x801e8488 : { *(.text.w3d_forward_801e8488) }
  .text.w3d_forward_801e883c 0x801e883c : { *(.text.w3d_forward_801e883c) }
  .text.w3d_forward_801e8970 0x801e8970 : { *(.text.w3d_forward_801e8970) }
  .text.w3d_forward_801ea0a4 0x801ea0a4 : { *(.text.w3d_forward_801ea0a4) }
  .text.w3d_static_init_801ef5d0 0x801ef5d0 : { *(.text.w3d_static_init_801ef5d0) }
  .text.w3d_forward_801f2cdc 0x801f2cdc : { *(.text.w3d_forward_801f2cdc) }
  .text.w3d_static_init_801f3d84 0x801f3d84 : { *(.text.w3d_static_init_801f3d84) }
  .text.w3d_static_init_801f40e0 0x801f40e0 : { *(.text.w3d_static_init_801f40e0) }
  .text.w3d_ctor_801f410c 0x801f410c : { *(.text.w3d_ctor_801f410c) }
  .text.w3d_ctor_801f4148 0x801f4148 : { *(.text.w3d_ctor_801f4148) }
  .text.w3d_ctor_801f4184 0x801f4184 : { *(.text.w3d_ctor_801f4184) }
  .text.w3d_ctor_801f41c0 0x801f41c0 : { *(.text.w3d_ctor_801f41c0) }
  .text.w3d_ctor_801f41fc 0x801f41fc : { *(.text.w3d_ctor_801f41fc) }
  .text.w3d_ctor_801f4238 0x801f4238 : { *(.text.w3d_ctor_801f4238) }
  .text.w3d_ctor_801f4274 0x801f4274 : { *(.text.w3d_ctor_801f4274) }
  .text.w3d_ctor_801f42b0 0x801f42b0 : { *(.text.w3d_ctor_801f42b0) }
  .text.w3d_ctor_801f42ec 0x801f42ec : { *(.text.w3d_ctor_801f42ec) }
  .text.w3d_ctor_801f4328 0x801f4328 : { *(.text.w3d_ctor_801f4328) }
  .text.w3d_ctor_801f4364 0x801f4364 : { *(.text.w3d_ctor_801f4364) }
  .text.w3d_ctor_801f43a0 0x801f43a0 : { *(.text.w3d_ctor_801f43a0) }
  .text.w3d_ctor_801f43dc 0x801f43dc : { *(.text.w3d_ctor_801f43dc) }
  .text.w3d_ctor_801f4418 0x801f4418 : { *(.text.w3d_ctor_801f4418) }
  .text.w3d_ctor_801f4454 0x801f4454 : { *(.text.w3d_ctor_801f4454) }
  .text.w3d_ctor_801f4490 0x801f4490 : { *(.text.w3d_ctor_801f4490) }
  .text.w3d_ctor_801f44cc 0x801f44cc : { *(.text.w3d_ctor_801f44cc) }
  .text.w3d_ctor_801f4508 0x801f4508 : { *(.text.w3d_ctor_801f4508) }
  .text.w3d_ctor_801f4544 0x801f4544 : { *(.text.w3d_ctor_801f4544) }
  .text.w3d_ctor_801f4580 0x801f4580 : { *(.text.w3d_ctor_801f4580) }
  .text.w3d_ctor_801f45bc 0x801f45bc : { *(.text.w3d_ctor_801f45bc) }
  .text.w3d_ctor_801f45f8 0x801f45f8 : { *(.text.w3d_ctor_801f45f8) }
  .text.w3d_ctor_801f4634 0x801f4634 : { *(.text.w3d_ctor_801f4634) }
  .text.w3d_ctor_801f4670 0x801f4670 : { *(.text.w3d_ctor_801f4670) }
  .text.w3d_ctor_801f46ac 0x801f46ac : { *(.text.w3d_ctor_801f46ac) }
  .text.w3d_ctor_801f46e8 0x801f46e8 : { *(.text.w3d_ctor_801f46e8) }
  .text.w3d_ctor_801f4724 0x801f4724 : { *(.text.w3d_ctor_801f4724) }
  .text.w3d_ctor_801f4760 0x801f4760 : { *(.text.w3d_ctor_801f4760) }
  .text.w3d_ctor_801f479c 0x801f479c : { *(.text.w3d_ctor_801f479c) }
  .text.w3d_ctor_801f47d8 0x801f47d8 : { *(.text.w3d_ctor_801f47d8) }
  .text.w3d_ctor_801f4814 0x801f4814 : { *(.text.w3d_ctor_801f4814) }
  .text.w3d_ctor_801f4850 0x801f4850 : { *(.text.w3d_ctor_801f4850) }
  .text.w3d_ctor_801f488c 0x801f488c : { *(.text.w3d_ctor_801f488c) }
  .text.w3d_ctor_801f48c8 0x801f48c8 : { *(.text.w3d_ctor_801f48c8) }
  .text.w3d_ctor_801f4904 0x801f4904 : { *(.text.w3d_ctor_801f4904) }
  .text.w3d_ctor_801f4940 0x801f4940 : { *(.text.w3d_ctor_801f4940) }
  .text.w3d_ctor_801f497c 0x801f497c : { *(.text.w3d_ctor_801f497c) }
  .text.w3d_ctor_801f49b8 0x801f49b8 : { *(.text.w3d_ctor_801f49b8) }
  .text.w3d_ctor_801f49f4 0x801f49f4 : { *(.text.w3d_ctor_801f49f4) }
  .text.w3d_ctor_801f4a30 0x801f4a30 : { *(.text.w3d_ctor_801f4a30) }
  .text.w3d_ctor_801f4a6c 0x801f4a6c : { *(.text.w3d_ctor_801f4a6c) }
  .text.w3d_ctor_801f4aa8 0x801f4aa8 : { *(.text.w3d_ctor_801f4aa8) }
  .text.w3d_ctor_801f4ae4 0x801f4ae4 : { *(.text.w3d_ctor_801f4ae4) }
  .text.w3d_ctor_801f4b20 0x801f4b20 : { *(.text.w3d_ctor_801f4b20) }
  .text.w3d_ctor_801f4b5c 0x801f4b5c : { *(.text.w3d_ctor_801f4b5c) }
  .text.w3d_ctor_801f4b98 0x801f4b98 : { *(.text.w3d_ctor_801f4b98) }
  .text.w3d_ctor_801f4bd4 0x801f4bd4 : { *(.text.w3d_ctor_801f4bd4) }
  .text.w3d_ctor_801f4c10 0x801f4c10 : { *(.text.w3d_ctor_801f4c10) }
  .text.w3d_static_init_801f5040 0x801f5040 : { *(.text.w3d_static_init_801f5040) }
  .text.w3d_static_init_801f5f2c 0x801f5f2c : { *(.text.w3d_static_init_801f5f2c) }
  .text.w3d_static_init_801f6008 0x801f6008 : { *(.text.w3d_static_init_801f6008) }
  .text.w3d_static_init_801f67b4 0x801f67b4 : { *(.text.w3d_static_init_801f67b4) }
  .text.w3d_static_init_801f73e0 0x801f73e0 : { *(.text.w3d_static_init_801f73e0) }
  .text.w3d_static_init_801f7980 0x801f7980 : { *(.text.w3d_static_init_801f7980) }
  .text.w3d_static_init_801f7a2c 0x801f7a2c : { *(.text.w3d_static_init_801f7a2c) }
  .text.w3d_static_init_801f7ad4 0x801f7ad4 : { *(.text.w3d_static_init_801f7ad4) }
  .text.w3d_address_801f7c24 0x801f7c24 : { *(.text.w3d_address_801f7c24) }
  .text.w3d_registry_release_801f7c30 0x801f7c30 : { *(.text.w3d_registry_release_801f7c30) }
  .text.w3d_registry_retain_801f7c8c 0x801f7c8c : { *(.text.w3d_registry_retain_801f7c8c) }
  .text.w3d_forward_801f7ca4 0x801f7ca4 : { *(.text.w3d_forward_801f7ca4) }
  .text.w3d_static_init_801f8134 0x801f8134 : { *(.text.w3d_static_init_801f8134) }
  .text.w3d_static_init_801f8210 0x801f8210 : { *(.text.w3d_static_init_801f8210) }
  .text.w3d_address_801f823c 0x801f823c : { *(.text.w3d_address_801f823c) }
  /DISCARD/ : { *(.text*) *(.rodata*) *(.data*) *(.bss*) *(.sdata*) *(.sbss*) *(.comment) }
}
