/* Generated reference-only placements. All bodies are source-built. */
OUTPUT_FORMAT("elf32-powerpc")
OUTPUT_ARCH(powerpc)
ENTRY(w3d_k10b_barracks_capacity_8029d7b4)
_SDA_BASE_ = 0x804b2540;
_SDA2_BASE_ = 0x804c2540;
fn_800fc1b0 = 0x800fc1b0;
fn_801797b4 = 0x801797b4;
fn_80341584 = 0x80341584;
lbl_803d097c = 0x803d097c;
SECTIONS {
  .text.w3d_k10b_barracks_capacity_8029d7b4 0x8029d7b4 : { *(.text.w3d_k10b_barracks_capacity_8029d7b4) }
  /DISCARD/ : { *(.text*) *(.rodata*) *(.data*) *(.bss*) *(.sdata*) *(.sbss*) *(.comment) }
}
