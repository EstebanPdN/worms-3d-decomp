/* Generated reference-only placements. All bodies are source-built. */
OUTPUT_FORMAT("elf32-powerpc")
OUTPUT_ARCH(powerpc)
ENTRY(k2a_sinit_cloud_8003dc04)
_SDA_BASE_ = 0x804b2540;
_SDA2_BASE_ = 0x804c2540;
FUN_8003d2a8 = 0x8003d2a8;
__16W3dType_80160038PvN21ii = 0x80160038;
w3d_cloud_804273d4 = 0x804273d4;
w3d_cloud_804273e0 = 0x804273e0;
w3d_str_803617d0 = 0x803617d0;
w3d_str_803e79ec = 0x803e79ec;
w3d_type_8035ffd0 = 0x8035ffd0;
SECTIONS {
  .text.k2a_sinit_cloud_8003dc04 0x8003dc04 : { *(.text.k2a_sinit_cloud_8003dc04) }
  /DISCARD/ : { *(.text*) *(.rodata*) *(.data*) *(.bss*) *(.sdata*) *(.sbss*) *(.comment) }
}
