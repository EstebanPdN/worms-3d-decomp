/* Generated reference-only placements. All bodies are source-built. */
OUTPUT_FORMAT("elf32-powerpc")
OUTPUT_ARCH(powerpc)
ENTRY(w3d_registry_unlink_80296914)
_SDA_BASE_ = 0x804b2540;
_SDA2_BASE_ = 0x804c2540;
w3d_fn_80296a2c = 0x80296a2c;
w3d_fn_80296ae8 = 0x80296ae8;
w3d_fn_8029dd4c = 0x8029dd4c;
w3d_fn_8029de6c = 0x8029de6c;
w3d_fn_802a1730 = 0x802a1730;
w3d_fn_802a17a4 = 0x802a17a4;
w3d_fn_802a2e24 = 0x802a2e24;
w3d_fn_802a2eb8 = 0x802a2eb8;
w3d_fn_802a4098 = 0x802a4098;
w3d_fn_802a43ec = 0x802a43ec;
w3d_fn_802a7f9c = 0x802a7f9c;
w3d_fn_802a81b0 = 0x802a81b0;
w3d_fn_802af3b4 = 0x802af3b4;
w3d_fn_802af41c = 0x802af41c;
w3d_fn_802b2ba4 = 0x802b2ba4;
w3d_fn_802b2c7c = 0x802b2c7c;
w3d_fn_802b4030 = 0x802b4030;
w3d_fn_802b40c8 = 0x802b40c8;
w3d_fn_802b5524 = 0x802b5524;
w3d_fn_802b5740 = 0x802b5740;
w3d_fn_802ba3fc = 0x802ba3fc;
w3d_fn_802ba45c = 0x802ba45c;
w3d_fn_802bbe24 = 0x802bbe24;
w3d_fn_802bbeb4 = 0x802bbeb4;
w3d_global_80368968 = 0x80368968;
w3d_global_80368998 = 0x80368998;
w3d_global_803689c8 = 0x803689c8;
w3d_global_803689f8 = 0x803689f8;
w3d_global_80368a28 = 0x80368a28;
w3d_global_80368a58 = 0x80368a58;
w3d_global_80368a88 = 0x80368a88;
w3d_global_80368ab8 = 0x80368ab8;
w3d_global_80368ae8 = 0x80368ae8;
w3d_global_80368b18 = 0x80368b18;
w3d_global_80368b48 = 0x80368b48;
w3d_heap_allocate_entry_a = 0x801fe1d8;
w3d_owner_list_remove = 0x8020fd2c;
w3d_registry_list_80368968 = 0x80368968;
w3d_registry_list_80368998 = 0x80368998;
w3d_registry_list_803689c8 = 0x803689c8;
w3d_registry_list_803689f8 = 0x803689f8;
w3d_registry_list_80368a28 = 0x80368a28;
w3d_registry_list_80368a58 = 0x80368a58;
w3d_registry_list_80368a88 = 0x80368a88;
w3d_registry_list_80368ab8 = 0x80368ab8;
w3d_registry_list_80368ae8 = 0x80368ae8;
w3d_registry_list_80368b18 = 0x80368b18;
w3d_registry_list_80368b48 = 0x80368b48;
w3d_registry_list_80470900 = 0x80470900;
w3d_state_register = 0x8020fd04;
SECTIONS {
  .text.w3d_registry_unlink_80296914 0x80296914 : { *(.text.w3d_registry_unlink_80296914) }
  .text.w3d_registry_create_80296958 0x80296958 : { *(.text.w3d_registry_create_80296958) }
  .text.w3d_registry_release_802969b8 0x802969b8 : { *(.text.w3d_registry_release_802969b8) }
  .text.w3d_registry_retain_80296a14 0x80296a14 : { *(.text.w3d_registry_retain_80296a14) }
  .text.w3d_constant_802972e8 0x802972e8 : { *(.text.w3d_constant_802972e8) }
  .text.w3d_address_8029dc28 0x8029dc28 : { *(.text.w3d_address_8029dc28) }
  .text.w3d_registry_unlink_8029dc34 0x8029dc34 : { *(.text.w3d_registry_unlink_8029dc34) }
  .text.w3d_registry_create_8029dc78 0x8029dc78 : { *(.text.w3d_registry_create_8029dc78) }
  .text.w3d_registry_release_8029dcd8 0x8029dcd8 : { *(.text.w3d_registry_release_8029dcd8) }
  .text.w3d_registry_retain_8029dd34 0x8029dd34 : { *(.text.w3d_registry_retain_8029dd34) }
  .text.w3d_empty_802a0c44 0x802a0c44 : { *(.text.w3d_empty_802a0c44) }
  .text.w3d_get_802a15d8 0x802a15d8 : { *(.text.w3d_get_802a15d8) }
  .text.w3d_address_802a160c 0x802a160c : { *(.text.w3d_address_802a160c) }
  .text.w3d_registry_unlink_802a1618 0x802a1618 : { *(.text.w3d_registry_unlink_802a1618) }
  .text.w3d_registry_create_802a165c 0x802a165c : { *(.text.w3d_registry_create_802a165c) }
  .text.w3d_registry_release_802a16bc 0x802a16bc : { *(.text.w3d_registry_release_802a16bc) }
  .text.w3d_registry_retain_802a1718 0x802a1718 : { *(.text.w3d_registry_retain_802a1718) }
  .text.w3d_empty_802a1bbc 0x802a1bbc : { *(.text.w3d_empty_802a1bbc) }
  .text.w3d_address_802a2d00 0x802a2d00 : { *(.text.w3d_address_802a2d00) }
  .text.w3d_registry_unlink_802a2d0c 0x802a2d0c : { *(.text.w3d_registry_unlink_802a2d0c) }
  .text.w3d_registry_create_802a2d50 0x802a2d50 : { *(.text.w3d_registry_create_802a2d50) }
  .text.w3d_registry_release_802a2db0 0x802a2db0 : { *(.text.w3d_registry_release_802a2db0) }
  .text.w3d_registry_retain_802a2e0c 0x802a2e0c : { *(.text.w3d_registry_retain_802a2e0c) }
  .text.w3d_constant_802a3d28 0x802a3d28 : { *(.text.w3d_constant_802a3d28) }
  .text.w3d_get_802a3d30 0x802a3d30 : { *(.text.w3d_get_802a3d30) }
  .text.w3d_address_802a3f74 0x802a3f74 : { *(.text.w3d_address_802a3f74) }
  .text.w3d_registry_unlink_802a3f80 0x802a3f80 : { *(.text.w3d_registry_unlink_802a3f80) }
  .text.w3d_registry_create_802a3fc4 0x802a3fc4 : { *(.text.w3d_registry_create_802a3fc4) }
  .text.w3d_registry_release_802a4024 0x802a4024 : { *(.text.w3d_registry_release_802a4024) }
  .text.w3d_registry_retain_802a4080 0x802a4080 : { *(.text.w3d_registry_retain_802a4080) }
  .text.w3d_get_802a7e44 0x802a7e44 : { *(.text.w3d_get_802a7e44) }
  .text.w3d_address_802a7e78 0x802a7e78 : { *(.text.w3d_address_802a7e78) }
  .text.w3d_registry_unlink_802a7e84 0x802a7e84 : { *(.text.w3d_registry_unlink_802a7e84) }
  .text.w3d_registry_create_802a7ec8 0x802a7ec8 : { *(.text.w3d_registry_create_802a7ec8) }
  .text.w3d_registry_release_802a7f28 0x802a7f28 : { *(.text.w3d_registry_release_802a7f28) }
  .text.w3d_registry_retain_802a7f84 0x802a7f84 : { *(.text.w3d_registry_retain_802a7f84) }
  .text.w3d_get_802ab7d0 0x802ab7d0 : { *(.text.w3d_get_802ab7d0) }
  .text.w3d_address_802af290 0x802af290 : { *(.text.w3d_address_802af290) }
  .text.w3d_registry_unlink_802af29c 0x802af29c : { *(.text.w3d_registry_unlink_802af29c) }
  .text.w3d_registry_create_802af2e0 0x802af2e0 : { *(.text.w3d_registry_create_802af2e0) }
  .text.w3d_registry_release_802af340 0x802af340 : { *(.text.w3d_registry_release_802af340) }
  .text.w3d_registry_retain_802af39c 0x802af39c : { *(.text.w3d_registry_retain_802af39c) }
  .text.w3d_constant_802af97c 0x802af97c : { *(.text.w3d_constant_802af97c) }
  .text.w3d_get_802afaec 0x802afaec : { *(.text.w3d_get_802afaec) }
  .text.w3d_set_802b1250 0x802b1250 : { *(.text.w3d_set_802b1250) }
  .text.w3d_empty_802b292c 0x802b292c : { *(.text.w3d_empty_802b292c) }
  .text.w3d_address_802b2a80 0x802b2a80 : { *(.text.w3d_address_802b2a80) }
  .text.w3d_registry_unlink_802b2a8c 0x802b2a8c : { *(.text.w3d_registry_unlink_802b2a8c) }
  .text.w3d_registry_create_802b2ad0 0x802b2ad0 : { *(.text.w3d_registry_create_802b2ad0) }
  .text.w3d_registry_release_802b2b30 0x802b2b30 : { *(.text.w3d_registry_release_802b2b30) }
  .text.w3d_registry_retain_802b2b8c 0x802b2b8c : { *(.text.w3d_registry_retain_802b2b8c) }
  .text.w3d_constant_802b2e28 0x802b2e28 : { *(.text.w3d_constant_802b2e28) }
  .text.w3d_address_802b3f0c 0x802b3f0c : { *(.text.w3d_address_802b3f0c) }
  .text.w3d_registry_unlink_802b3f18 0x802b3f18 : { *(.text.w3d_registry_unlink_802b3f18) }
  .text.w3d_registry_create_802b3f5c 0x802b3f5c : { *(.text.w3d_registry_create_802b3f5c) }
  .text.w3d_registry_release_802b3fbc 0x802b3fbc : { *(.text.w3d_registry_release_802b3fbc) }
  .text.w3d_registry_retain_802b4018 0x802b4018 : { *(.text.w3d_registry_retain_802b4018) }
  .text.w3d_get_802b53cc 0x802b53cc : { *(.text.w3d_get_802b53cc) }
  .text.w3d_address_802b5400 0x802b5400 : { *(.text.w3d_address_802b5400) }
  .text.w3d_registry_unlink_802b540c 0x802b540c : { *(.text.w3d_registry_unlink_802b540c) }
  .text.w3d_registry_create_802b5450 0x802b5450 : { *(.text.w3d_registry_create_802b5450) }
  .text.w3d_registry_release_802b54b0 0x802b54b0 : { *(.text.w3d_registry_release_802b54b0) }
  .text.w3d_registry_retain_802b550c 0x802b550c : { *(.text.w3d_registry_retain_802b550c) }
  .text.w3d_get_802ba2a4 0x802ba2a4 : { *(.text.w3d_get_802ba2a4) }
  .text.w3d_address_802ba2d8 0x802ba2d8 : { *(.text.w3d_address_802ba2d8) }
  .text.w3d_registry_unlink_802ba2e4 0x802ba2e4 : { *(.text.w3d_registry_unlink_802ba2e4) }
  .text.w3d_registry_create_802ba328 0x802ba328 : { *(.text.w3d_registry_create_802ba328) }
  .text.w3d_registry_release_802ba388 0x802ba388 : { *(.text.w3d_registry_release_802ba388) }
  .text.w3d_registry_retain_802ba3e4 0x802ba3e4 : { *(.text.w3d_registry_retain_802ba3e4) }
  .text.w3d_constant_802bad6c 0x802bad6c : { *(.text.w3d_constant_802bad6c) }
  .text.w3d_get_802badbc 0x802badbc : { *(.text.w3d_get_802badbc) }
  .text.w3d_address_802bbd00 0x802bbd00 : { *(.text.w3d_address_802bbd00) }
  .text.w3d_registry_unlink_802bbd0c 0x802bbd0c : { *(.text.w3d_registry_unlink_802bbd0c) }
  .text.w3d_registry_create_802bbd50 0x802bbd50 : { *(.text.w3d_registry_create_802bbd50) }
  .text.w3d_registry_release_802bbdb0 0x802bbdb0 : { *(.text.w3d_registry_release_802bbdb0) }
  .text.w3d_registry_retain_802bbe0c 0x802bbe0c : { *(.text.w3d_registry_retain_802bbe0c) }
  .text.w3d_empty_802bc1d0 0x802bc1d0 : { *(.text.w3d_empty_802bc1d0) }
  .text.w3d_set_802bcd10 0x802bcd10 : { *(.text.w3d_set_802bcd10) }
  .text.w3d_get_802bd2bc 0x802bd2bc : { *(.text.w3d_get_802bd2bc) }
  .text.w3d_set_802c0cac 0x802c0cac : { *(.text.w3d_set_802c0cac) }
  /DISCARD/ : { *(.text*) *(.rodata*) *(.data*) *(.bss*) *(.sdata*) *(.sbss*) *(.comment) }
}
