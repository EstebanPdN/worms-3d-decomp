/* Generated reference-only placements. All bodies are source-built. */
OUTPUT_FORMAT("elf32-powerpc")
OUTPUT_ARCH(powerpc)
ENTRY(w3d_d30g_wormpot_setup_8006e124)
_SDA_BASE_ = 0x804b2540;
_SDA2_BASE_ = 0x804c2540;
_._19Descriptor_80178474 = 0x80178474;
cast_80341584 = 0x80341584;
lookup_800fc1b0 = 0x800fc1b0;
native_80342a78 = 0x80342a78;
pot_80179598 = 0x80179598;
reel_80178d1c = 0x80178d1c;
s_8037c3d4 = 0x8037c3d4;
s_8037c3fc = 0x8037c3fc;
s_8037c410 = 0x8037c410;
s_8037c424 = 0x8037c424;
tags_801ea4c8 = 0x801ea4c8;
type_8020b680 = 0x8020b680;
type_8041b170 = 0x8041b170;
SECTIONS {
  .text.w3d_d30g_wormpot_setup_8006e124 0x8006e124 : { *(.text.w3d_d30g_wormpot_setup_8006e124) }
  /DISCARD/ : { *(.text*) *(.rodata*) *(.data*) *(.bss*) *(.sdata*) *(.sbss*) *(.comment) }
}
