/* Generated reference-only placements. All bodies are source-built. */
OUTPUT_FORMAT("elf32-powerpc")
OUTPUT_ARCH(powerpc)
ENTRY(d10c_pigeon_name_8003a6e8)
_SDA_BASE_ = 0x804b2540;
_SDA2_BASE_ = 0x804c2540;
d10c_handle_set_name_8015adf4 = 0x8015adf4;
d10c_lookup_handle_object_80164fc8 = 0x80164fc8;
d10c_pigeon_8037424c = 0x8037424c;
d10c_string_base_finish_8020c5c4 = 0x8020c5c4;
d10c_string_from_text_8020bb54 = 0x8020bb54;
d10c_string_release_80341588 = 0x80341588;
d10c_target_member_8003af58 = 0x8003af58;
SECTIONS {
  .text.d10c_pigeon_name_8003a6e8 0x8003a6e8 : { *(.text.d10c_pigeon_name_8003a6e8) }
  /DISCARD/ : { *(.text*) *(.rodata*) *(.data*) *(.bss*) *(.sdata*) *(.sbss*) *(.comment) }
}
