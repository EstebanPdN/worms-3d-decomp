/* Generated reference-only placements. All bodies are source-built. */
OUTPUT_FORMAT("elf32-powerpc")
OUTPUT_ARCH(powerpc)
ENTRY(w3d_d42n_item_list_remove_8017ae10)
_SDA_BASE_ = 0x804b2540;
_SDA2_BASE_ = 0x804c2540;
f4c_erase_80210dd8 = 0x80210dd8;
fn_801ef380 = 0x801ef380;
fn_802eee50 = 0x802eee50;
w3d_cx15b_interface_range_remove_801f2a30 = 0x801f2a30;
w3d_string_base_finish = 0x8020c5c4;
w3d_string_base_init = 0x8020c5c0;
w3d_string_header = 0x80341884;
w3d_string_release = 0x80341588;
SECTIONS {
  .text.w3d_d42n_item_list_remove_8017ae10 0x8017ae10 : { *(.text.w3d_d42n_item_list_remove_8017ae10) }
  /DISCARD/ : { *(.text*) *(.rodata*) *(.data*) *(.bss*) *(.sdata*) *(.sbss*) *(.comment) }
}
