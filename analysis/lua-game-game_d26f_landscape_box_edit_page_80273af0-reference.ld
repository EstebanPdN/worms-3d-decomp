/* Generated reference-only placements. All bodies are source-built. */
OUTPUT_FORMAT("elf32-powerpc")
OUTPUT_ARCH(powerpc)
ENTRY(d26f_landscape_box_edit_page_80273af0)
_SDA_BASE_ = 0x804b2540;
_SDA2_BASE_ = 0x804c2540;
__17D26fText_803426b8 = 0x803426b8;
lbl_803cc0d8 = 0x803cc0d8;
lbl_803cc8b4 = 0x803cc8b4;
lbl_803ccf1c = 0x803ccf1c;
lbl_803ccf30 = 0x803ccf30;
lbl_803ccf44 = 0x803ccf44;
lbl_803ccf64 = 0x803ccf64;
lbl_803ccf8c = 0x803ccf8c;
lbl_803ccfb4 = 0x803ccfb4;
lbl_803ccfd4 = 0x803ccfd4;
lbl_803ccff4 = 0x803ccff4;
lbl_803cd014 = 0x803cd014;
lbl_803cd034 = 0x803cd034;
lbl_803cd054 = 0x803cd054;
w3d_auto_802cbf2c = 0x802cbf2c;
w3d_auto_802cbfe0 = 0x802cbfe0;
w3d_auto_802cd128 = 0x802cd128;
w3d_cc32b_append_lines_v2_802cc0ac = 0x802cc0ac;
w3d_cx7b_script_flag_set_8027a934 = 0x8027a934;
w3d_dtor_node_8020d36c = 0x8020d36c;
w3d_registry_retain_8020d2b8 = 0x8020d2b8;
w3d_s21_append_position_802cd26c = 0x802cd26c;
w3d_s21_repeat_request_802cd220 = 0x802cd220;
w3d_s21_sink_write_indexed_802cbdf8 = 0x802cbdf8;
w3d_s21_vector_get_801e9db8 = 0x801e9db8;
w3d_string_base_finish = 0x8020c5c4;
w3d_string_release = 0x80341588;
w3d_tagged_construct_8020d318 = 0x8020d318;
SECTIONS {
  .text.d26f_landscape_box_edit_page_80273af0 0x80273af0 : { *(.text.d26f_landscape_box_edit_page_80273af0) }
  /DISCARD/ : { *(.text*) *(.rodata*) *(.data*) *(.bss*) *(.sdata*) *(.sbss*) *(.comment) }
}
