/* Generated reference-only placements. All bodies are source-built. */
OUTPUT_FORMAT("elf32-powerpc")
OUTPUT_ARCH(powerpc)
ENTRY(w3d_s10_read_tree_value_801d22ec)
_SDA_BASE_ = 0x804b2540;
_SDA2_BASE_ = 0x804c2540;
fn_80351ef8 = 0x80351ef8;
SECTIONS {
  .text.w3d_s10_read_tree_value_801d22ec 0x801d22ec : { *(.text.w3d_s10_read_tree_value_801d22ec) }
  /DISCARD/ : { *(.text*) *(.rodata*) *(.data*) *(.bss*) *(.sdata*) *(.sbss*) *(.comment) }
}
