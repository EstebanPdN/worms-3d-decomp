/* Generated reference-only placements. All bodies are source-built. */
OUTPUT_FORMAT("elf32-powerpc")
OUTPUT_ARCH(powerpc)
ENTRY(sol35f9_string_tree_hint_8035a6f8)
_SDA_BASE_ = 0x804b2540;
_SDA2_BASE_ = 0x804c2540;
sol35f9_strcmp_802ef234 = 0x802ef234;
sol35f9_string_hint_8035a6f8_insert_8035a464 = 0x8035a464;
sol35f9_string_hint_8035a6f8_next_80351ef8 = 0x80351ef8;
sol35f9_string_hint_8035a6f8_previous_803526a0 = 0x803526a0;
sol35f9_string_hint_8035a6f8_unique_8035a5e4 = 0x8035a5e4;
SECTIONS {
  .text.sol35f9_string_tree_hint_8035a6f8 0x8035a6f8 : { *(.text.sol35f9_string_tree_hint_8035a6f8) }
  /DISCARD/ : { *(.text*) *(.rodata*) *(.data*) *(.bss*) *(.sdata*) *(.sbss*) *(.comment) }
}
