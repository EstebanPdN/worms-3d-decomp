/* Generated reference-only placements. All bodies are source-built. */
OUTPUT_FORMAT("elf32-powerpc")
OUTPUT_ARCH(powerpc)
ENTRY(d25i_water_construct_8011f66c)
_SDA_BASE_ = 0x804b2540;
_SDA2_BASE_ = 0x804c2540;
as_float_80342a74 = 0x80342a74;
as_vector_80342fa4 = 0x80342fa4;
base_8015a0d4 = 0x8015a0d4;
f_8039b5ec = 0x8039b5ec;
member_float_8012629c = 0x8012629c;
member_init_80126184 = 0x80126184;
member_slot_801262e4 = 0x801262e4;
member_word_8012632c = 0x8012632c;
n_8039b5b0 = 0x8039b5b0;
n_8039b5bc = 0x8039b5bc;
n_8039b5c8 = 0x8039b5c8;
n_8039b5d4 = 0x8039b5d4;
read_setting_800fc1b0 = 0x800fc1b0;
vtable_80410ae0 = 0x80410ae0;
SECTIONS {
  .text.d25i_water_construct_8011f66c 0x8011f66c : { *(.text.d25i_water_construct_8011f66c) }
  /DISCARD/ : { *(.text*) *(.rodata*) *(.data*) *(.bss*) *(.sdata*) *(.sbss*) *(.comment) }
}
