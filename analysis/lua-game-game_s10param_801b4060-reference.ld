/* Generated reference-only placements. All bodies are source-built. */
OUTPUT_FORMAT("elf32-powerpc")
OUTPUT_ARCH(powerpc)
ENTRY(w3d_s10_find_string_801b4060)
_SDA_BASE_ = 0x804b2540;
_SDA2_BASE_ = 0x804c2540;
fn_802ef074 = 0x802ef074;
SECTIONS {
  .text.w3d_s10_find_string_801b4060 0x801b4060 : { *(.text.w3d_s10_find_string_801b4060) }
  .text.w3d_s10_find_string_801b40d0 0x801b40d0 : { *(.text.w3d_s10_find_string_801b40d0) }
  /DISCARD/ : { *(.text*) *(.rodata*) *(.data*) *(.bss*) *(.sdata*) *(.sbss*) *(.comment) }
}
