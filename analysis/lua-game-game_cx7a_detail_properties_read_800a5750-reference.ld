/* Generated reference-only placements. All bodies are source-built. */
OUTPUT_FORMAT("elf32-powerpc")
OUTPUT_ARCH(powerpc)
ENTRY(w3d_cx7a_detail_properties_read_800a5750)
_SDA_BASE_ = 0x804b2540;
_SDA2_BASE_ = 0x804c2540;
orientation_803811d8 = 0x803811d8;
position_803811c8 = 0x803811c8;
property_800fc1b0 = 0x800fc1b0;
refresh_800a57b0 = 0x800a57b0;
SECTIONS {
  .text.w3d_cx7a_detail_properties_read_800a5750 0x800a5750 : { *(.text.w3d_cx7a_detail_properties_read_800a5750) }
  /DISCARD/ : { *(.text*) *(.rodata*) *(.data*) *(.bss*) *(.sdata*) *(.sbss*) *(.comment) }
}
