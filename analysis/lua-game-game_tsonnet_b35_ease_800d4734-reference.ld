/* Generated reference-only placements. All bodies are source-built. */
OUTPUT_FORMAT("elf32-powerpc")
OUTPUT_ARCH(powerpc)
ENTRY(tsonnet_b35_ease_800d4734)
_SDA_BASE_ = 0x804b2540;
_SDA2_BASE_ = 0x804c2540;
fn_801797b4 = 0x801797b4;
fn_80341584 = 0x80341584;
lbl_80388d20 = 0x80388d20;
SECTIONS {
  .text.tsonnet_b35_ease_800d4734 0x800d4734 : { *(.text.tsonnet_b35_ease_800d4734) }
  /DISCARD/ : { *(.text*) *(.rodata*) *(.data*) *(.bss*) *(.sdata*) *(.sbss*) *(.comment) }
}
