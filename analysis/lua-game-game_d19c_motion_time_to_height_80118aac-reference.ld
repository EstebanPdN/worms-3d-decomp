/* Generated reference-only placements. All bodies are source-built. */
OUTPUT_FORMAT("elf32-powerpc")
OUTPUT_ARCH(powerpc)
ENTRY(d19c_motion_time_to_height_80118aac)
_SDA_BASE_ = 0x804b2540;
_SDA2_BASE_ = 0x804c2540;
d19c_sqrtf_802e82c0 = 0x802e82c0;
SECTIONS {
  .text.d19c_motion_time_to_height_80118aac 0x80118aac : { *(.text.d19c_motion_time_to_height_80118aac) }
  .rodata 0x8039a9d0 : { *(.rodata) }
  /DISCARD/ : { *(.text*) *(.rodata*) *(.data*) *(.bss*) *(.sdata*) *(.sbss*) *(.comment) }
}
