/* Generated reference-only placements. All bodies are source-built. */
OUTPUT_FORMAT("elf32-powerpc")
OUTPUT_ARCH(powerpc)
ENTRY(_._8F16bO180)
_SDA_BASE_ = 0x804b2540;
_SDA2_BASE_ = 0x804c2540;
__dl__8F16bO180Pv = 0x801fe1f8;
fn_80210990 = 0x80210990;
fn_802134fc = 0x802134fc;
vt_804181c0 = 0x804181c0;
vt_80419430 = 0x80419430;
SECTIONS {
  .text._._8F16bO180 0x8020ab2c : { *(.text._._8F16bO180) }
  /DISCARD/ : { *(.text*) *(.rodata*) *(.data*) *(.bss*) *(.sdata*) *(.sbss*) *(.comment) }
}
