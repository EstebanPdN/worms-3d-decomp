/* Generated reference-only placements. All bodies are source-built. */
OUTPUT_FORMAT("elf32-powerpc")
OUTPUT_ARCH(powerpc)
ENTRY(w3d_set_8024b054)
_SDA_BASE_ = 0x804b2540;
_SDA2_BASE_ = 0x804c2540;
w3d_global_80367dd8 = 0x80367dd8;
w3d_global_80367e28 = 0x80367e28;
w3d_global_80367e78 = 0x80367e78;
w3d_global_80367ec8 = 0x80367ec8;
w3d_owner_list_remove = 0x8020fd2c;
w3d_registry_list_80367dd8 = 0x80367dd8;
w3d_registry_list_80367e28 = 0x80367e28;
w3d_registry_list_80367e78 = 0x80367e78;
w3d_registry_list_80367ec8 = 0x80367ec8;
SECTIONS {
  .text.w3d_set_8024b054 0x8024b054 : { *(.text.w3d_set_8024b054) }
  .text.w3d_get_8024b05c 0x8024b05c : { *(.text.w3d_get_8024b05c) }
  .text.w3d_set_8024b064 0x8024b064 : { *(.text.w3d_set_8024b064) }
  .text.w3d_get_8024b06c 0x8024b06c : { *(.text.w3d_get_8024b06c) }
  .text.w3d_set_8024b074 0x8024b074 : { *(.text.w3d_set_8024b074) }
  .text.w3d_get_8024b07c 0x8024b07c : { *(.text.w3d_get_8024b07c) }
  .text.w3d_set_8024b084 0x8024b084 : { *(.text.w3d_set_8024b084) }
  .text.w3d_get_8024b08c 0x8024b08c : { *(.text.w3d_get_8024b08c) }
  .text.w3d_set_8024b094 0x8024b094 : { *(.text.w3d_set_8024b094) }
  .text.w3d_get_8024b09c 0x8024b09c : { *(.text.w3d_get_8024b09c) }
  .text.w3d_set_8024b0a4 0x8024b0a4 : { *(.text.w3d_set_8024b0a4) }
  .text.w3d_get_8024b0ac 0x8024b0ac : { *(.text.w3d_get_8024b0ac) }
  .text.w3d_set_8024b0b4 0x8024b0b4 : { *(.text.w3d_set_8024b0b4) }
  .text.w3d_get_8024b0bc 0x8024b0bc : { *(.text.w3d_get_8024b0bc) }
  .text.w3d_set_8024b0c4 0x8024b0c4 : { *(.text.w3d_set_8024b0c4) }
  .text.w3d_get_8024b0cc 0x8024b0cc : { *(.text.w3d_get_8024b0cc) }
  .text.w3d_set_8024b0d4 0x8024b0d4 : { *(.text.w3d_set_8024b0d4) }
  .text.w3d_get_8024b0dc 0x8024b0dc : { *(.text.w3d_get_8024b0dc) }
  .text.w3d_set_8024b0e4 0x8024b0e4 : { *(.text.w3d_set_8024b0e4) }
  .text.w3d_get_8024b0ec 0x8024b0ec : { *(.text.w3d_get_8024b0ec) }
  .text.w3d_set_8024b0f4 0x8024b0f4 : { *(.text.w3d_set_8024b0f4) }
  .text.w3d_get_8024b0fc 0x8024b0fc : { *(.text.w3d_get_8024b0fc) }
  .text.w3d_set_8024b104 0x8024b104 : { *(.text.w3d_set_8024b104) }
  .text.w3d_get_8024b10c 0x8024b10c : { *(.text.w3d_get_8024b10c) }
  .text.w3d_set_8024b114 0x8024b114 : { *(.text.w3d_set_8024b114) }
  .text.w3d_get_8024b11c 0x8024b11c : { *(.text.w3d_get_8024b11c) }
  .text.w3d_set_8024b124 0x8024b124 : { *(.text.w3d_set_8024b124) }
  .text.w3d_get_8024b12c 0x8024b12c : { *(.text.w3d_get_8024b12c) }
  .text.w3d_set_8024b134 0x8024b134 : { *(.text.w3d_set_8024b134) }
  .text.w3d_get_8024b13c 0x8024b13c : { *(.text.w3d_get_8024b13c) }
  .text.w3d_set_8024b144 0x8024b144 : { *(.text.w3d_set_8024b144) }
  .text.w3d_get_8024b14c 0x8024b14c : { *(.text.w3d_get_8024b14c) }
  .text.w3d_set_8024b154 0x8024b154 : { *(.text.w3d_set_8024b154) }
  .text.w3d_get_8024b15c 0x8024b15c : { *(.text.w3d_get_8024b15c) }
  .text.w3d_set_8024b5ec 0x8024b5ec : { *(.text.w3d_set_8024b5ec) }
  .text.w3d_get_8024b5f4 0x8024b5f4 : { *(.text.w3d_get_8024b5f4) }
  .text.w3d_set_8024b60c 0x8024b60c : { *(.text.w3d_set_8024b60c) }
  .text.w3d_get_8024b614 0x8024b614 : { *(.text.w3d_get_8024b614) }
  .text.w3d_set_8024b78c 0x8024b78c : { *(.text.w3d_set_8024b78c) }
  .text.w3d_get_8024b794 0x8024b794 : { *(.text.w3d_get_8024b794) }
  .text.w3d_set_8024b83c 0x8024b83c : { *(.text.w3d_set_8024b83c) }
  .text.w3d_get_8024b844 0x8024b844 : { *(.text.w3d_get_8024b844) }
  .text.w3d_set_8024b8bc 0x8024b8bc : { *(.text.w3d_set_8024b8bc) }
  .text.w3d_get_8024b8c4 0x8024b8c4 : { *(.text.w3d_get_8024b8c4) }
  .text.w3d_set_8024b8cc 0x8024b8cc : { *(.text.w3d_set_8024b8cc) }
  .text.w3d_get_8024b8d4 0x8024b8d4 : { *(.text.w3d_get_8024b8d4) }
  .text.w3d_set_8024ba54 0x8024ba54 : { *(.text.w3d_set_8024ba54) }
  .text.w3d_get_8024ba5c 0x8024ba5c : { *(.text.w3d_get_8024ba5c) }
  .text.w3d_set_8024ba64 0x8024ba64 : { *(.text.w3d_set_8024ba64) }
  .text.w3d_get_8024ba6c 0x8024ba6c : { *(.text.w3d_get_8024ba6c) }
  .text.w3d_set_8024ba74 0x8024ba74 : { *(.text.w3d_set_8024ba74) }
  .text.w3d_get_8024ba7c 0x8024ba7c : { *(.text.w3d_get_8024ba7c) }
  .text.w3d_set_8024ba84 0x8024ba84 : { *(.text.w3d_set_8024ba84) }
  .text.w3d_get_8024ba8c 0x8024ba8c : { *(.text.w3d_get_8024ba8c) }
  .text.w3d_set_8024ba94 0x8024ba94 : { *(.text.w3d_set_8024ba94) }
  .text.w3d_get_8024ba9c 0x8024ba9c : { *(.text.w3d_get_8024ba9c) }
  .text.w3d_set_8024baa4 0x8024baa4 : { *(.text.w3d_set_8024baa4) }
  .text.w3d_get_8024baac 0x8024baac : { *(.text.w3d_get_8024baac) }
  .text.w3d_set_8024bab4 0x8024bab4 : { *(.text.w3d_set_8024bab4) }
  .text.w3d_get_8024babc 0x8024babc : { *(.text.w3d_get_8024babc) }
  .text.w3d_set_8024bac4 0x8024bac4 : { *(.text.w3d_set_8024bac4) }
  .text.w3d_get_8024bacc 0x8024bacc : { *(.text.w3d_get_8024bacc) }
  .text.w3d_set_8024bad4 0x8024bad4 : { *(.text.w3d_set_8024bad4) }
  .text.w3d_get_8024badc 0x8024badc : { *(.text.w3d_get_8024badc) }
  .text.w3d_set_8024bae4 0x8024bae4 : { *(.text.w3d_set_8024bae4) }
  .text.w3d_get_8024baec 0x8024baec : { *(.text.w3d_get_8024baec) }
  .text.w3d_set_8024baf4 0x8024baf4 : { *(.text.w3d_set_8024baf4) }
  .text.w3d_get_8024bafc 0x8024bafc : { *(.text.w3d_get_8024bafc) }
  .text.w3d_set_8024bb04 0x8024bb04 : { *(.text.w3d_set_8024bb04) }
  .text.w3d_get_8024bb0c 0x8024bb0c : { *(.text.w3d_get_8024bb0c) }
  .text.w3d_set_8024bb14 0x8024bb14 : { *(.text.w3d_set_8024bb14) }
  .text.w3d_get_8024bb1c 0x8024bb1c : { *(.text.w3d_get_8024bb1c) }
  .text.w3d_address_8024bb50 0x8024bb50 : { *(.text.w3d_address_8024bb50) }
  .text.w3d_registry_unlink_8024bbc4 0x8024bbc4 : { *(.text.w3d_registry_unlink_8024bbc4) }
  .text.w3d_address_8024cc54 0x8024cc54 : { *(.text.w3d_address_8024cc54) }
  .text.w3d_registry_unlink_8024ccc8 0x8024ccc8 : { *(.text.w3d_registry_unlink_8024ccc8) }
  .text.w3d_address_8024ce08 0x8024ce08 : { *(.text.w3d_address_8024ce08) }
  .text.w3d_registry_unlink_8024ce7c 0x8024ce7c : { *(.text.w3d_registry_unlink_8024ce7c) }
  .text.w3d_address_8024d408 0x8024d408 : { *(.text.w3d_address_8024d408) }
  .text.w3d_registry_unlink_8024d47c 0x8024d47c : { *(.text.w3d_registry_unlink_8024d47c) }
  /DISCARD/ : { *(.text*) *(.rodata*) *(.data*) *(.bss*) *(.sdata*) *(.sbss*) *(.comment) }
}
