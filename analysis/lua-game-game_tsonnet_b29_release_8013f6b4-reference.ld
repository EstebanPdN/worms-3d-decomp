/* Generated reference-only placements. All bodies are source-built. */
OUTPUT_FORMAT("elf32-powerpc")
OUTPUT_ARCH(powerpc)
ENTRY(tsonnet_b29_release_8013f6b4)
_SDA_BASE_ = 0x804b2540;
_SDA2_BASE_ = 0x804c2540;
fn_80122af8 = 0x80122af8;
fn_80164fc8 = 0x80164fc8;
SECTIONS {
  .text.tsonnet_b29_release_8013f6b4 0x8013f6b4 : { *(.text.tsonnet_b29_release_8013f6b4) }
  /DISCARD/ : { *(.text*) *(.rodata*) *(.data*) *(.bss*) *(.sdata*) *(.sbss*) *(.comment) }
}
