/* Generated reference-only placements. All bodies are source-built. */
OUTPUT_FORMAT("elf32-powerpc")
OUTPUT_ARCH(powerpc)
ENTRY(w3d_cx7b_script_flag_set_8027a934)
_SDA_BASE_ = 0x804b2540;
_SDA2_BASE_ = 0x804c2540;
fn_802cd2e0 = 0x802cd2e0;
SECTIONS {
  .text.w3d_cx7b_script_flag_set_8027a934 0x8027a934 : { *(.text.w3d_cx7b_script_flag_set_8027a934) }
  /DISCARD/ : { *(.text*) *(.rodata*) *(.data*) *(.bss*) *(.sdata*) *(.sbss*) *(.comment) }
}
