/* Generated reference-only placements. All bodies are source-built. */
OUTPUT_FORMAT("elf32-powerpc")
OUTPUT_ARCH(powerpc)
ENTRY(d30i_unlock_list_fill_801167d4)
_SDA_BASE_ = 0x804b2540;
_SDA2_BASE_ = 0x804c2540;
_._19Descriptor_80178474 = 0x80178474;
__6String = 0x803426b8;
__6StringPCc = 0x8020bb54;
array_lock_801ef048 = 0x801ef048;
as_table_80341584 = 0x80341584;
class_80419e68 = 0x80419e68;
class_80419e88 = 0x80419e88;
create_8020b680 = 0x8020b680;
definition_801797b4 = 0x801797b4;
f_8039a460 = 0x8039a460;
f_8039a900 = 0x8039a900;
f_8039a914 = 0x8039a914;
f_8039a924 = 0x8039a924;
list_append_801ef174 = 0x801ef174;
list_begin_801ef380 = 0x801ef380;
n_8039a448 = 0x8039a448;
n_8039a454 = 0x8039a454;
n_8039a92c = 0x8039a92c;
next_setting_800fc69c = 0x800fc69c;
read_key2_800fc2b0 = 0x800fc2b0;
strcmp = 0x802ef234;
string_finish_8020c5c4 = 0x8020c5c4;
string_format_8020c510 = 0x8020c510;
string_release_8020bb2c = 0x8020bb2c;
string_release_80341588 = 0x80341588;
table_get_80179598 = 0x80179598;
type_80366208 = 0x80366208;
width_8039a93c = 0x8039a93c;
write_value_800fc550 = 0x800fc550;
SECTIONS {
  .text.d30i_unlock_list_fill_801167d4 0x801167d4 : { *(.text.d30i_unlock_list_fill_801167d4) }
  .rodata 0x8039a940 : { *(.rodata) }
  /DISCARD/ : { *(.text*) *(.rodata*) *(.data*) *(.bss*) *(.sdata*) *(.sbss*) *(.comment) }
}
