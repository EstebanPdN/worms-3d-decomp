/* Generated reference-only placements. All bodies are source-built. */
OUTPUT_FORMAT("elf32-powerpc")
OUTPUT_ARCH(powerpc)
ENTRY(cc42a_bind_typed_8017963c)
_SDA_BASE_ = 0x804b2540;
_SDA2_BASE_ = 0x804c2540;
cc42a_requiredType_80365788 = 0x80365788;
cc42a_resolve_8020b680 = 0x8020b680;
SECTIONS {
  .text.cc42a_bind_typed_8017963c 0x8017963c : { *(.text.cc42a_bind_typed_8017963c) }
  /DISCARD/ : { *(.text*) *(.rodata*) *(.data*) *(.bss*) *(.sdata*) *(.sbss*) *(.comment) }
}
