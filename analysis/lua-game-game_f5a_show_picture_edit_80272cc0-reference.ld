/* Generated reference-only placements. All bodies are source-built. */
OUTPUT_FORMAT("elf32-powerpc")
OUTPUT_ARCH(powerpc)
ENTRY(w3d_f5a_show_picture_edit_80272cc0)
_SDA_BASE_ = 0x804b2540;
_SDA2_BASE_ = 0x804c2540;
__13Text_803426b8 = 0x803426b8;
disabled_803ccad8 = 0x803ccad8;
edit_803cca90 = 0x803cca90;
empty_803cc0d8 = 0x803cc0d8;
fn_8020c5c4 = 0x8020c5c4;
fn_8027a934 = 0x8027a934;
fn_802cbdf8 = 0x802cbdf8;
fn_802cbf2c = 0x802cbf2c;
fn_802cc0ac = 0x802cc0ac;
fn_802cd128 = 0x802cd128;
fn_802cd220 = 0x802cd220;
fn_802cd26c = 0x802cd26c;
fn_80341588 = 0x80341588;
gfx_803ccab8 = 0x803ccab8;
help_803cc8b4 = 0x803cc8b4;
incoming_803ccaf8 = 0x803ccaf8;
line_803ccaa4 = 0x803ccaa4;
outgoing_803ccb18 = 0x803ccb18;
SECTIONS {
  .text.w3d_f5a_show_picture_edit_80272cc0 0x80272cc0 : { *(.text.w3d_f5a_show_picture_edit_80272cc0) }
  /DISCARD/ : { *(.text*) *(.rodata*) *(.data*) *(.bss*) *(.sdata*) *(.sbss*) *(.comment) }
}
