/* Generated reference-only placements. All bodies are source-built. */
OUTPUT_FORMAT("elf32-powerpc")
OUTPUT_ARCH(powerpc)
ENTRY(s19_dtor_80021468)
_SDA_BASE_ = 0x804b2540;
_SDA2_BASE_ = 0x804c2540;
lbl_8040dd88 = 0x8040dd88;
w3d_auto_80015264 = 0x80015264;
SECTIONS {
  .text.s19_dtor_80021468 0x80021468 : { *(.text.s19_dtor_80021468) }
  /DISCARD/ : { *(.text*) *(.rodata*) *(.data*) *(.bss*) *(.sdata*) *(.sbss*) *(.comment) }
}
