/* Generated reference-only placements. All bodies are source-built. */
OUTPUT_FORMAT("elf32-powerpc")
OUTPUT_ARCH(powerpc)
ENTRY(w3d_d18e_reset_flagged_transform_8024f6fc)
_SDA_BASE_ = 0x804b2540;
_SDA2_BASE_ = 0x804c2540;
fn_801e8d9c = 0x801e8d9c;
fn_801eb834 = 0x801eb834;
fn_801ebf38 = 0x801ebf38;
fn_801f0210 = 0x801f0210;
key_803c5628 = 0x803c5628;
key_803c5650 = 0x803c5650;
key_803c567c = 0x803c567c;
key_803c56a0 = 0x803c56a0;
key_803c56cc = 0x803c56cc;
key_803c56f0 = 0x803c56f0;
key_803c5714 = 0x803c5714;
key_803c5740 = 0x803c5740;
value_803c56c4 = 0x803c56c4;
value_803c5768 = 0x803c5768;
SECTIONS {
  .text.w3d_d18e_reset_flagged_transform_8024f6fc 0x8024f6fc : { *(.text.w3d_d18e_reset_flagged_transform_8024f6fc) }
  .text.w3d_d18e_reset_typed_transform_8024f990 0x8024f990 : { *(.text.w3d_d18e_reset_typed_transform_8024f990) }
  /DISCARD/ : { *(.text*) *(.rodata*) *(.data*) *(.bss*) *(.sdata*) *(.sbss*) *(.comment) }
}
