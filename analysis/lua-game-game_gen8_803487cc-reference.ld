/* Generated reference-only placements. All bodies are source-built. */
OUTPUT_FORMAT("elf32-powerpc")
OUTPUT_ARCH(powerpc)
ENTRY(w3d_ifaceset0_803487cc)
_SDA_BASE_ = 0x804b2540;
_SDA2_BASE_ = 0x804c2540;
SECTIONS {
  .text.w3d_ifaceset0_803487cc 0x803487cc : { *(.text.w3d_ifaceset0_803487cc) }
  .text.w3d_ifaceset0_80349ab0 0x80349ab0 : { *(.text.w3d_ifaceset0_80349ab0) }
  /DISCARD/ : { *(.text*) *(.rodata*) *(.data*) *(.bss*) *(.sdata*) *(.sbss*) *(.comment) }
}
