/* Generated reference-only placements. All bodies are source-built. */
OUTPUT_FORMAT("elf32-powerpc")
OUTPUT_ARCH(powerpc)
ENTRY(d29l_button_update_colours_802bfc64)
_SDA_BASE_ = 0x804b2540;
_SDA2_BASE_ = 0x804c2540;
fn_80173df0 = 0x80173df0;
fn_80173f88 = 0x80173f88;
fn_80178df0 = 0x80178df0;
fn_802bd354 = 0x802bd354;
fn_802bfc48 = 0x802bfc48;
SECTIONS {
  .text.d29l_button_update_colours_802bfc64 0x802bfc64 : { *(.text.d29l_button_update_colours_802bfc64) }
  /DISCARD/ : { *(.text*) *(.rodata*) *(.data*) *(.bss*) *(.sdata*) *(.sbss*) *(.comment) }
}
