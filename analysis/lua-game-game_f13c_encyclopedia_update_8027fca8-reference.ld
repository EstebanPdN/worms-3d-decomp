/* Generated reference-only placements. All bodies are source-built. */
OUTPUT_FORMAT("elf32-powerpc")
OUTPUT_ARCH(powerpc)
ENTRY(w3d_f13c_encyclopedia_update_8027fca8)
_SDA_BASE_ = 0x804b2540;
_SDA2_BASE_ = 0x804c2540;
fn_800fc1b0 = 0x800fc1b0;
fn_800fc230 = 0x800fc230;
fn_800fc2b0 = 0x800fc2b0;
fn_800fc43c = 0x800fc43c;
fn_800fc550 = 0x800fc550;
fn_801797b4 = 0x801797b4;
fn_8020bb2c = 0x8020bb2c;
fn_8020bd38 = 0x8020bd38;
fn_8020c5c0 = 0x8020c5c0;
fn_8020c5c4 = 0x8020c5c4;
fn_8027ffe0 = 0x8027ffe0;
fn_80341584 = 0x80341584;
fn_80341588 = 0x80341588;
fn_80341884 = 0x80341884;
pedcurrent_803cee10 = 0x803cee10;
peddata_803cee1c = 0x803cee1c;
peddesc_803cee54 = 0x803cee54;
pedfile_803cee78 = 0x803cee78;
pedimage_803cee60 = 0x803cee60;
pedmovie_803cee6c = 0x803cee6c;
pednext_803cee3c = 0x803cee3c;
pedprev_803cee30 = 0x803cee30;
pedtitle_803cee48 = 0x803cee48;
SECTIONS {
  .text.w3d_f13c_encyclopedia_update_8027fca8 0x8027fca8 : { *(.text.w3d_f13c_encyclopedia_update_8027fca8) }
  /DISCARD/ : { *(.text*) *(.rodata*) *(.data*) *(.bss*) *(.sdata*) *(.sbss*) *(.comment) }
}
