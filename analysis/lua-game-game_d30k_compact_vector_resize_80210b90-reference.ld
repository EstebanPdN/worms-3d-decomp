/* Generated reference-only placements. All bodies are source-built. */
OUTPUT_FORMAT("elf32-powerpc")
OUTPUT_ARCH(powerpc)
ENTRY(w3d_d30k_compact_vector_resize_80210b90)
_SDA_BASE_ = 0x804b2540;
_SDA2_BASE_ = 0x804c2540;
fn_801fe220 = 0x801fe220;
fn_801fe240 = 0x801fe240;
fn_802fb7ac = 0x802fb7ac;
lbl_803b35bc = 0x803b35bc;
SECTIONS {
  .text.w3d_d30k_compact_vector_resize_80210b90 0x80210b90 : { *(.text.w3d_d30k_compact_vector_resize_80210b90) }
  /DISCARD/ : { *(.text*) *(.rodata*) *(.data*) *(.bss*) *(.sdata*) *(.sbss*) *(.comment) }
}
