/* Generated reference-only placements. All bodies are source-built. */
OUTPUT_FORMAT("elf32-powerpc")
OUTPUT_ARCH(powerpc)
ENTRY(s8_index_query_800fca30)
_SDA_BASE_ = 0x804b2540;
_SDA2_BASE_ = 0x804c2540;
fn_801797b4 = 0x801797b4;
fn_80341584 = 0x80341584;
lbl_8044a584 = 0x8044a584;
SECTIONS {
  .text.s8_index_query_800fca30 0x800fca30 : { *(.text.s8_index_query_800fca30) }
  /DISCARD/ : { *(.text*) *(.rodata*) *(.data*) *(.bss*) *(.sdata*) *(.sbss*) *(.comment) }
}
