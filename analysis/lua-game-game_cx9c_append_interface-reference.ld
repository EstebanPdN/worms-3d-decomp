/* Generated reference-only placements. All bodies are source-built. */
OUTPUT_FORMAT("elf32-powerpc")
OUTPUT_ARCH(powerpc)
ENTRY(w3d_cx9c_append_interface_8034b9bc)
_SDA_BASE_ = 0x804b2540;
_SDA2_BASE_ = 0x804c2540;
cx9c_reserve_80210d54 = 0x80210d54;
SECTIONS {
  .text.w3d_cx9c_append_interface_8034b9bc 0x8034b9bc : { *(.text.w3d_cx9c_append_interface_8034b9bc) }
  /DISCARD/ : { *(.text*) *(.rodata*) *(.data*) *(.bss*) *(.sdata*) *(.sbss*) *(.comment) }
}
