/* Generated reference-only placements. All bodies are source-built. */
OUTPUT_FORMAT("elf32-powerpc")
OUTPUT_ARCH(powerpc)
ENTRY(w3d_hit_shrunken_8026ff6c)
_SDA_BASE_ = 0x804b2540;
_SDA2_BASE_ = 0x804c2540;
fn_802b15e0 = 0x802b15e0;
fn_802b22e4 = 0x802b22e4;
scale_803cbf44 = 0x803cbf44;
SECTIONS {
  .text.w3d_hit_shrunken_8026ff6c 0x8026ff6c : { *(.text.w3d_hit_shrunken_8026ff6c) }
  /DISCARD/ : { *(.text*) *(.rodata*) *(.data*) *(.bss*) *(.sdata*) *(.sbss*) *(.comment) }
}
