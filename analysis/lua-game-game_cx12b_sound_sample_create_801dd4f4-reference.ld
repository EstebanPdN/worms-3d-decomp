/* Generated reference-only placements. All bodies are source-built. */
OUTPUT_FORMAT("elf32-powerpc")
OUTPUT_ARCH(powerpc)
ENTRY(w3d_cx12b_sound_sample_create_801dd4f4)
_SDA_BASE_ = 0x804b2540;
_SDA2_BASE_ = 0x804c2540;
append_801ddf5c = 0x801ddf5c;
create_8020fcb4 = 0x8020fcb4;
descriptor_803656dc = 0x803656dc;
set_801e25cc = 0x801e25cc;
SECTIONS {
  .text.w3d_cx12b_sound_sample_create_801dd4f4 0x801dd4f4 : { *(.text.w3d_cx12b_sound_sample_create_801dd4f4) }
  /DISCARD/ : { *(.text*) *(.rodata*) *(.data*) *(.bss*) *(.sdata*) *(.sbss*) *(.comment) }
}
