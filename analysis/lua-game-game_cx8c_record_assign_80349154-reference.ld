/* Generated reference-only placements. All bodies are source-built. */
OUTPUT_FORMAT("elf32-powerpc")
OUTPUT_ARCH(powerpc)
ENTRY(w3d_cx8c_record_assign_80349154)
_SDA_BASE_ = 0x804b2540;
_SDA2_BASE_ = 0x804c2540;
cx8c_assign_member_80210eb4 = 0x80210eb4;
SECTIONS {
  .text.w3d_cx8c_record_assign_80349154 0x80349154 : { *(.text.w3d_cx8c_record_assign_80349154) }
  /DISCARD/ : { *(.text*) *(.rodata*) *(.data*) *(.bss*) *(.sdata*) *(.sbss*) *(.comment) }
}
