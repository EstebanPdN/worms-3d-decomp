/* Generated reference-only placements. All bodies are source-built. */
OUTPUT_FORMAT("elf32-powerpc")
OUTPUT_ARCH(powerpc)
ENTRY(tsonnet_c26_register_blob_801bc7ec)
_SDA_BASE_ = 0x804b2540;
_SDA2_BASE_ = 0x804c2540;
fn_801e8d9c = 0x801e8d9c;
fn_801ebf38 = 0x801ebf38;
fn_801f0e4c = 0x801f0e4c;
lbl_803ab88c = 0x803ab88c;
lbl_803ab8b0 = 0x803ab8b0;
lbl_8045e748 = 0x8045e748;
SECTIONS {
  .text.tsonnet_c26_register_blob_801bc7ec 0x801bc7ec : { *(.text.tsonnet_c26_register_blob_801bc7ec) }
  /DISCARD/ : { *(.text*) *(.rodata*) *(.data*) *(.bss*) *(.sdata*) *(.sbss*) *(.comment) }
}
