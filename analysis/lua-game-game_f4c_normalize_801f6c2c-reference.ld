/* Generated reference-only placements. All bodies are source-built. */
OUTPUT_FORMAT("elf32-powerpc")
OUTPUT_ARCH(powerpc)
ENTRY(f4c_normalize_801f6c2c)
_SDA_BASE_ = 0x804b2540;
_SDA2_BASE_ = 0x804c2540;
fn_801f6cb8 = 0x801f6cb8;
fn_801f70b0 = 0x801f70b0;
lbl_803b16dc = 0x803b16dc;
SECTIONS {
  .text.f4c_normalize_801f6c2c 0x801f6c2c : { *(.text.f4c_normalize_801f6c2c) }
  /DISCARD/ : { *(.text*) *(.rodata*) *(.data*) *(.bss*) *(.sdata*) *(.sbss*) *(.comment) }
}
