/* Generated reference-only placements. All bodies are source-built. */
OUTPUT_FORMAT("elf32-powerpc")
OUTPUT_ARCH(powerpc)
ENTRY(set_scalar__9D31sOwnerP10D31sTargeti)
_SDA_BASE_ = 0x804b2540;
_SDA2_BASE_ = 0x804c2540;
_._11D31sTagBase = 0x80210990;
_S_oom_malloc__Q24_STLt14__malloc_alloc1i0Ui = 0x803413d8;
__vt_11D31sCounted = 0x80411ac0;
__vt_8D31sItem = 0x80411a70;
malloc = 0x80212fd4;
SECTIONS {
  .text.set_scalar__9D31sOwnerP10D31sTargeti 0x80165b88 : { *(.text.set_scalar__9D31sOwnerP10D31sTargeti) }
  /DISCARD/ : { *(.text*) *(.rodata*) *(.data*) *(.bss*) *(.sdata*) *(.sbss*) *(.comment) }
}
