/* Generated reference-only placements. All bodies are source-built. */
OUTPUT_FORMAT("elf32-powerpc")
OUTPUT_ARCH(powerpc)
ENTRY(w3d_k8c_log_int_802cc264)
_SDA_BASE_ = 0x804b2540;
_SDA2_BASE_ = 0x804c2540;
fn_8020c510 = 0x8020c510;
fn_8020c5c4 = 0x8020c5c4;
fn_802cc0ac = 0x802cc0ac;
fn_80341588 = 0x80341588;
fn_803426b8 = 0x803426b8;
w3d_str_803d944c = 0x803d944c;
SECTIONS {
  .text.w3d_k8c_log_int_802cc264 0x802cc264 : { *(.text.w3d_k8c_log_int_802cc264) }
  /DISCARD/ : { *(.text*) *(.rodata*) *(.data*) *(.bss*) *(.sdata*) *(.sbss*) *(.comment) }
}
