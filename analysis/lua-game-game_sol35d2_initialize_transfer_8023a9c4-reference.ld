/* Generated reference-only placements. All bodies are source-built. */
OUTPUT_FORMAT("elf32-powerpc")
OUTPUT_ARCH(powerpc)
ENTRY(w3d_sol35d2_initialize_transfer_8023a9c4)
_SDA_BASE_ = 0x804b2540;
_SDA2_BASE_ = 0x804c2540;
fn_801e8d9c = 0x801e8d9c;
fn_801eb674 = 0x801eb674;
fn_801ebf38 = 0x801ebf38;
fn_801ecc6c = 0x801ecc6c;
fn_801ed24c = 0x801ed24c;
fn_8020bb2c = 0x8020bb2c;
fn_8020c5c0 = 0x8020c5c0;
fn_8020c5c4 = 0x8020c5c4;
fn_80341588 = 0x80341588;
fn_80341884 = 0x80341884;
lbl_803bb5c4 = 0x803bb5c4;
lbl_803bb5f8 = 0x803bb5f8;
lbl_803bb630 = 0x803bb630;
lbl_803bb658 = 0x803bb658;
lbl_803bb680 = 0x803bb680;
lbl_803bb6b0 = 0x803bb6b0;
lbl_803bb6d8 = 0x803bb6d8;
lbl_803bb70c = 0x803bb70c;
lbl_803bb740 = 0x803bb740;
lbl_803bb770 = 0x803bb770;
lbl_803bb7a4 = 0x803bb7a4;
lbl_803bb7d8 = 0x803bb7d8;
lbl_803bb810 = 0x803bb810;
lbl_803bb844 = 0x803bb844;
lbl_804b06a0 = 0x804b06a0;
SECTIONS {
  .text.w3d_sol35d2_initialize_transfer_8023a9c4 0x8023a9c4 : { *(.text.w3d_sol35d2_initialize_transfer_8023a9c4) }
  /DISCARD/ : { *(.text*) *(.rodata*) *(.data*) *(.bss*) *(.sdata*) *(.sbss*) *(.comment) }
}
