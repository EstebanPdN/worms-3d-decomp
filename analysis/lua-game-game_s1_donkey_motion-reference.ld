/* Generated reference-only placements. All bodies are source-built. */
OUTPUT_FORMAT("elf32-powerpc")
OUTPUT_ARCH(powerpc)
ENTRY(w3d_fn_800610fc)
_SDA_BASE_ = 0x804b2540;
_SDA2_BASE_ = 0x804c2540;
w3d_auto_801797b4 = 0x801797b4;
w3d_empty_80341584 = 0x80341584;
w3d_f32_80379298 = 0x80379298;
w3d_f32_8037929c = 0x8037929c;
w3d_f32_803792a0 = 0x803792a0;
w3d_handle_member_query_80126360 = 0x80126360;
SECTIONS {
  .text.w3d_fn_800610fc 0x800610fc : { *(.text.w3d_fn_800610fc) }
  .text.w3d_fn_8006119c 0x8006119c : { *(.text.w3d_fn_8006119c) }
  /DISCARD/ : { *(.text*) *(.rodata*) *(.data*) *(.bss*) *(.sdata*) *(.sbss*) *(.comment) }
}
