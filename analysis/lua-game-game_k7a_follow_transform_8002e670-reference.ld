/* Generated reference-only placements. All bodies are source-built. */
OUTPUT_FORMAT("elf32-powerpc")
OUTPUT_ARCH(powerpc)
ENTRY(w3d_k7a_follow_transform_8002e670)
_SDA_BASE_ = 0x804b2540;
_SDA2_BASE_ = 0x804c2540;
w3d_empty_80343740 = 0x80343740;
w3d_handle_member_query_801265ec = 0x801265ec;
w3d_s20_notify_global_800fdf24 = 0x800fdf24;
SECTIONS {
  .text.w3d_k7a_follow_transform_8002e670 0x8002e670 : { *(.text.w3d_k7a_follow_transform_8002e670) }
  /DISCARD/ : { *(.text*) *(.rodata*) *(.data*) *(.bss*) *(.sdata*) *(.sbss*) *(.comment) }
}
