/* Generated reference-only placements. All bodies are source-built. */
OUTPUT_FORMAT("elf32-powerpc")
OUTPUT_ARCH(powerpc)
ENTRY(w3d_auto_8003a5c8)
_SDA_BASE_ = 0x804b2540;
_SDA2_BASE_ = 0x804c2540;
fn_8003AF58 = 0x8003af58;
fn_8003AF60 = 0x8003af60;
fn_80164FC8 = 0x80164fc8;
fn_80181640 = 0x80181640;
fn_80181CCC = 0x80181ccc;
fn_80343584 = 0x80343584;
lbl_80374234 = 0x80374234;
lbl_80374238 = 0x80374238;
lbl_80374240 = 0x80374240;
lbl_80374244 = 0x80374244;
lbl_80374248 = 0x80374248;
SECTIONS {
  .text.w3d_auto_8003a5c8 0x8003a5c8 : { *(.text.w3d_auto_8003a5c8) }
  /DISCARD/ : { *(.text*) *(.rodata*) *(.data*) *(.bss*) *(.sdata*) *(.sbss*) *(.comment) }
}
