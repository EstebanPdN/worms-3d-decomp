/* Generated reference-only placements. All bodies are source-built. */
OUTPUT_FORMAT("elf32-powerpc")
OUTPUT_ARCH(powerpc)
ENTRY(w3d_d24h_find_movie_800c6100)
_SDA_BASE_ = 0x804b2540;
_SDA2_BASE_ = 0x804c2540;
fn_802ef074 = 0x802ef074;
fn_802ef9c0 = 0x802ef9c0;
fn_802fb82c = 0x802fb82c;
fn_80304de0 = 0x80304de0;
lbl_803876ac = 0x803876ac;
lbl_803876c4 = 0x803876c4;
lbl_803f5728 = 0x803f5728;
lbl_803f58b4 = 0x803f58b4;
SECTIONS {
  .text.w3d_d24h_find_movie_800c6100 0x800c6100 : { *(.text.w3d_d24h_find_movie_800c6100) }
  /DISCARD/ : { *(.text*) *(.rodata*) *(.data*) *(.bss*) *(.sdata*) *(.sbss*) *(.comment) }
}
