/* Generated reference-only placements. All bodies are source-built. */
OUTPUT_FORMAT("elf32-powerpc")
OUTPUT_ARCH(powerpc)
ENTRY(w3d_team_title_8027c24c)
_SDA_BASE_ = 0x804b2540;
_SDA2_BASE_ = 0x804c2540;
__21F1pDesc_8027c24c_Text = 0x803426b8;
__21F1pDesc_8027c24c_TextPCc = 0x8020bb54;
failed_803cea20 = 0x803cea20;
fn_800fc1b0 = 0x800fc1b0;
fn_800fc2b0 = 0x800fc2b0;
fn_801797b4 = 0x801797b4;
fn_8020bb2c = 0x8020bb2c;
fn_8020bd38 = 0x8020bd38;
fn_8020c510 = 0x8020c510;
fn_8020c5c0 = 0x8020c5c0;
fn_8020c5c4 = 0x8020c5c4;
fn_8027befc = 0x8027befc;
fn_80341584 = 0x80341584;
fn_80341588 = 0x80341588;
fn_80341884 = 0x80341884;
missing_803cea28 = 0x803cea28;
SECTIONS {
  .text.w3d_team_title_8027c24c 0x8027c24c : { *(.text.w3d_team_title_8027c24c) }
  /DISCARD/ : { *(.text*) *(.rodata*) *(.data*) *(.bss*) *(.sdata*) *(.sbss*) *(.comment) }
}
