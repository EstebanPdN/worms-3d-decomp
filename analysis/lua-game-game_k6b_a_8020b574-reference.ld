/* Generated reference-only placements. All bodies are source-built. */
OUTPUT_FORMAT("elf32-powerpc")
OUTPUT_ARCH(powerpc)
ENTRY(w3d_k6b_accessor_apply_8020b574)
_SDA_BASE_ = 0x804b2540;
_SDA2_BASE_ = 0x804c2540;
fn_8020b460 = 0x8020b460;
SECTIONS {
  .text.w3d_k6b_accessor_apply_8020b574 0x8020b574 : { *(.text.w3d_k6b_accessor_apply_8020b574) }
  /DISCARD/ : { *(.text*) *(.rodata*) *(.data*) *(.bss*) *(.sdata*) *(.sbss*) *(.comment) }
}
