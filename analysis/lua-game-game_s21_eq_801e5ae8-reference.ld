/* Generated reference-only placements. All bodies are source-built. */
OUTPUT_FORMAT("elf32-powerpc")
OUTPUT_ARCH(powerpc)
ENTRY(w3d_s21_destroy_801e5ae8)
_SDA_BASE_ = 0x804b2540;
_SDA2_BASE_ = 0x804c2540;
fn_801e5dfc = 0x801e5dfc;
fn_801fe1f8 = 0x801fe1f8;
fn_801fe2e0 = 0x801fe2e0;
lbl_80416f78 = 0x80416f78;
SECTIONS {
  .text.w3d_s21_destroy_801e5ae8 0x801e5ae8 : { *(.text.w3d_s21_destroy_801e5ae8) }
  /DISCARD/ : { *(.text*) *(.rodata*) *(.data*) *(.bss*) *(.sdata*) *(.sbss*) *(.comment) }
}
