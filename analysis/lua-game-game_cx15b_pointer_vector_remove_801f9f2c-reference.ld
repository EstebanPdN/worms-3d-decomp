/* Generated reference-only placements. All bodies are source-built. */
OUTPUT_FORMAT("elf32-powerpc")
OUTPUT_ARCH(powerpc)
ENTRY(w3d_cx15b_pointer_vector_remove_801f9f2c)
_SDA_BASE_ = 0x804b2540;
_SDA2_BASE_ = 0x804c2540;
move_802eeef4 = 0x802eeef4;
SECTIONS {
  .text.w3d_cx15b_pointer_vector_remove_801f9f2c 0x801f9f2c : { *(.text.w3d_cx15b_pointer_vector_remove_801f9f2c) }
  /DISCARD/ : { *(.text*) *(.rodata*) *(.data*) *(.bss*) *(.sdata*) *(.sbss*) *(.comment) }
}
