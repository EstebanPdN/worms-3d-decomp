/* Generated reference-only placements. All bodies are source-built. */
OUTPUT_FORMAT("elf32-powerpc")
OUTPUT_ARCH(powerpc)
ENTRY(w3d_s21_each_item_b_802bc5ac)
_SDA_BASE_ = 0x804b2540;
_SDA2_BASE_ = 0x804c2540;
fn_802bd348 = 0x802bd348;
SECTIONS {
  .text.w3d_s21_each_item_b_802bc5ac 0x802bc5ac : { *(.text.w3d_s21_each_item_b_802bc5ac) }
  /DISCARD/ : { *(.text*) *(.rodata*) *(.data*) *(.bss*) *(.sdata*) *(.sbss*) *(.comment) }
}
