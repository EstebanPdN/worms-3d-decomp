/* Generated reference-only placements. All bodies are source-built. */
OUTPUT_FORMAT("elf32-powerpc")
OUTPUT_ARCH(powerpc)
ENTRY(w3d_clear_named_string_8018e348)
_SDA_BASE_ = 0x804b2540;
_SDA2_BASE_ = 0x804c2540;
fn_801e8d9c = 0x801e8d9c;
fn_801eb674 = 0x801eb674;
fn_801ebf38 = 0x801ebf38;
fn_801ecc6c = 0x801ecc6c;
fn_801ece2c = 0x801ece2c;
fn_801ed24c = 0x801ed24c;
fn_8020bb2c = 0x8020bb2c;
fn_8020c5c0 = 0x8020c5c0;
fn_8020c5c4 = 0x8020c5c4;
fn_80341588 = 0x80341588;
fn_80341884 = 0x80341884;
lbl_803a7f78 = 0x803a7f78;
lbl_803a7fa4 = 0x803a7fa4;
lbl_803ac6fc = 0x803ac6fc;
lbl_803ac730 = 0x803ac730;
lbl_803b7c54 = 0x803b7c54;
lbl_803b7c84 = 0x803b7c84;
lbl_803c55a0 = 0x803c55a0;
lbl_803c55d0 = 0x803c55d0;
lbl_804b06a0 = 0x804b06a0;
SECTIONS {
  .text.w3d_clear_named_string_8018e348 0x8018e348 : { *(.text.w3d_clear_named_string_8018e348) }
  .text.w3d_clear_named_string_801c2260 0x801c2260 : { *(.text.w3d_clear_named_string_801c2260) }
  .text.w3d_clear_named_string_80225348 0x80225348 : { *(.text.w3d_clear_named_string_80225348) }
  .text.w3d_clear_named_string_8024f250 0x8024f250 : { *(.text.w3d_clear_named_string_8024f250) }
  /DISCARD/ : { *(.text*) *(.rodata*) *(.data*) *(.bss*) *(.sdata*) *(.sbss*) *(.comment) }
}
