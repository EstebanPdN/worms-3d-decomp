/* Generated reference-only placements. All bodies are source-built. */
OUTPUT_FORMAT("elf32-powerpc")
OUTPUT_ARCH(powerpc)
ENTRY(w3d_d24e_register_light_properties_801bf7f4)
_SDA_BASE_ = 0x804b2540;
_SDA2_BASE_ = 0x804c2540;
desc_803abf90 = 0x803abf90;
desc_803abfc0 = 0x803abfc0;
desc_803abff8 = 0x803abff8;
desc_803ac02c = 0x803ac02c;
desc_803ac060 = 0x803ac060;
desc_803ac098 = 0x803ac098;
fn_801e8d9c = 0x801e8d9c;
fn_801eb674 = 0x801eb674;
fn_801f0a50 = 0x801f0a50;
fn_801f0d2c = 0x801f0d2c;
k_803ac0bc = 0x803ac0bc;
k_803ac0c0 = 0x803ac0c0;
m_8045e708 = 0x8045e708;
SECTIONS {
  .text.w3d_d24e_register_light_properties_801bf7f4 0x801bf7f4 : { *(.text.w3d_d24e_register_light_properties_801bf7f4) }
  /DISCARD/ : { *(.text*) *(.rodata*) *(.data*) *(.bss*) *(.sdata*) *(.sbss*) *(.comment) }
}
