/* Generated reference-only placements. All bodies are source-built. */
OUTPUT_FORMAT("elf32-powerpc")
OUTPUT_ARCH(powerpc)
ENTRY(w3d_cx13a_trigger_defaults_8008c154)
_SDA_BASE_ = 0x804b2540;
_SDA2_BASE_ = 0x804c2540;
key_8037deb8 = 0x8037deb8;
key_8037ded8 = 0x8037ded8;
key_8037dee8 = 0x8037dee8;
key_8037def8 = 0x8037def8;
key_8037df0c = 0x8037df0c;
key_8037df20 = 0x8037df20;
key_8037df34 = 0x8037df34;
key_8037df48 = 0x8037df48;
key_8037df60 = 0x8037df60;
key_8037df78 = 0x8037df78;
key_8037df90 = 0x8037df90;
radius_8037dfa4 = 0x8037dfa4;
set_800fc3b0 = 0x800fc3b0;
set_800fc4c8 = 0x800fc4c8;
set_800fc550 = 0x800fc550;
value_8037dec8 = 0x8037dec8;
SECTIONS {
  .text.w3d_cx13a_trigger_defaults_8008c154 0x8008c154 : { *(.text.w3d_cx13a_trigger_defaults_8008c154) }
  /DISCARD/ : { *(.text*) *(.rodata*) *(.data*) *(.bss*) *(.sdata*) *(.sbss*) *(.comment) }
}
