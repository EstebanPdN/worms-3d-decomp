/* Generated reference-only placements. All bodies are source-built. */
OUTPUT_FORMAT("elf32-powerpc")
OUTPUT_ARCH(powerpc)
ENTRY(w3d_s10_cleanup_8019cc78)
_SDA_BASE_ = 0x804b2540;
_SDA2_BASE_ = 0x804c2540;
fn_801E828C = 0x801e828c;
fn_801F2758 = 0x801f2758;
fn_801FE1F8 = 0x801fe1f8;
fn_802134FC = 0x802134fc;
lbl_80413680 = 0x80413680;
lbl_804136C0 = 0x804136c0;
SECTIONS {
  .text.w3d_s10_cleanup_8019cc78 0x8019cc78 : { *(.text.w3d_s10_cleanup_8019cc78) }
  /DISCARD/ : { *(.text*) *(.rodata*) *(.data*) *(.bss*) *(.sdata*) *(.sbss*) *(.comment) }
}
