/* Generated reference-only placements. All bodies are source-built. */
OUTPUT_FORMAT("elf32-powerpc")
OUTPUT_ARCH(powerpc)
ENTRY(w3d_cx15a_step_four_800660d4)
_SDA_BASE_ = 0x804b2540;
_SDA2_BASE_ = 0x804c2540;
finish_800661c4 = 0x800661c4;
rate_80064548 = 0x80064548;
resolve_80164fc8 = 0x80164fc8;
step_80064950 = 0x80064950;
value_80178df0 = 0x80178df0;
zero_80379e8c = 0x80379e8c;
SECTIONS {
  .text.w3d_cx15a_step_four_800660d4 0x800660d4 : { *(.text.w3d_cx15a_step_four_800660d4) }
  /DISCARD/ : { *(.text*) *(.rodata*) *(.data*) *(.bss*) *(.sdata*) *(.sbss*) *(.comment) }
}
