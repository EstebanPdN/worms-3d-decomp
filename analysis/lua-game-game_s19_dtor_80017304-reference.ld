/* Generated reference-only placements. All bodies are source-built. */
OUTPUT_FORMAT("elf32-powerpc")
OUTPUT_ARCH(powerpc)
ENTRY(s19_path_owner_destroy_80017304)
_SDA_BASE_ = 0x804b2540;
_SDA2_BASE_ = 0x804c2540;
lbl_8040d990 = 0x8040d990;
w3d_auto_80015264 = 0x80015264;
w3d_path_cost_destroy = 0x80006388;
SECTIONS {
  .text.s19_path_owner_destroy_80017304 0x80017304 : { *(.text.s19_path_owner_destroy_80017304) }
  /DISCARD/ : { *(.text*) *(.rodata*) *(.data*) *(.bss*) *(.sdata*) *(.sbss*) *(.comment) }
}
