/* Generated reference-only placements. All bodies are source-built. */
OUTPUT_FORMAT("elf32-powerpc")
OUTPUT_ARCH(powerpc)
ENTRY(w3d_cx8c_remove_actor_8034bdb8)
_SDA_BASE_ = 0x804b2540;
_SDA2_BASE_ = 0x804c2540;
cx8c_erase_801f2a30 = 0x801f2a30;
SECTIONS {
  .text.w3d_cx8c_remove_actor_8034bdb8 0x8034bdb8 : { *(.text.w3d_cx8c_remove_actor_8034bdb8) }
  /DISCARD/ : { *(.text*) *(.rodata*) *(.data*) *(.bss*) *(.sdata*) *(.sbss*) *(.comment) }
}
