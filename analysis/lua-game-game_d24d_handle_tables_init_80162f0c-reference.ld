/* Generated reference-only placements. All bodies are source-built. */
OUTPUT_FORMAT("elf32-powerpc")
OUTPUT_ARCH(powerpc)
ENTRY(d24d_handle_tables_init_80162f0c)
_SDA_BASE_ = 0x804b2540;
_SDA2_BASE_ = 0x804c2540;
__16d24d_TableMember = 0x802109dc;
__builtin_new = 0x801fe1d8;
__builtin_vec_new = 0x801fe220;
d24d_limit_init_8016136c = 0x8016136c;
d24d_setting_803a4a7c = 0x803a4a7c;
d24d_setting_803a4a94 = 0x803a4a94;
d24d_setting_803a4aa4 = 0x803a4aa4;
d24d_setting_803a4ab8 = 0x803a4ab8;
d24d_setting_read_80206920 = 0x80206920;
d24d_table_list_8034ae84 = 0x8034ae84;
d24d_table_range_8034aa64 = 0x8034aa64;
SECTIONS {
  .text.d24d_handle_tables_init_80162f0c 0x80162f0c : { *(.text.d24d_handle_tables_init_80162f0c) }
  /DISCARD/ : { *(.text*) *(.rodata*) *(.data*) *(.bss*) *(.sdata*) *(.sbss*) *(.comment) }
}
