/* Generated reference-only placements. All bodies are source-built. */
OUTPUT_FORMAT("elf32-powerpc")
OUTPUT_ARCH(powerpc)
ENTRY(w3d_k6b_lua_container_attach_8019f93c)
_SDA_BASE_ = 0x804b2540;
_SDA2_BASE_ = 0x804c2540;
fn_8020b208 = 0x8020b208;
lbl_80414310 = 0x80414310;
w3d_r24a_check_container_userdata_8019e68c = 0x8019e68c;
w3d_s10_service_forward_8020b680 = 0x8020b680;
SECTIONS {
  .text.w3d_k6b_lua_container_attach_8019f93c 0x8019f93c : { *(.text.w3d_k6b_lua_container_attach_8019f93c) }
  /DISCARD/ : { *(.text*) *(.rodata*) *(.data*) *(.bss*) *(.sdata*) *(.sbss*) *(.comment) }
}
