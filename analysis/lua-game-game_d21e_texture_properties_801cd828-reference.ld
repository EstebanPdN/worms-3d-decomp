/* Generated reference-only placements. All bodies are source-built. */
OUTPUT_FORMAT("elf32-powerpc")
OUTPUT_ARCH(powerpc)
ENTRY(w3d_d21e_register_texture_properties_801cd828)
_SDA_BASE_ = 0x804b2540;
_SDA2_BASE_ = 0x804c2540;
d20e_empty_804b06a0 = 0x804b06a0;
d20e_release_header_8020bb2c = 0x8020bb2c;
d20e_string_finish_8020c5c4 = 0x8020c5c4;
d20e_string_header_80341884 = 0x80341884;
d20e_string_init_8020c5c0 = 0x8020c5c0;
d20e_string_release_80341588 = 0x80341588;
desc_803ae7c4 = 0x803ae7c4;
desc_803ae7f0 = 0x803ae7f0;
desc_803ae820 = 0x803ae820;
desc_803ae854 = 0x803ae854;
desc_803ae87c = 0x803ae87c;
desc_803ae8bc = 0x803ae8bc;
desc_803ae8f4 = 0x803ae8f4;
fn_801e8d9c = 0x801e8d9c;
fn_801ebbb8 = 0x801ebbb8;
fn_801ecc6c = 0x801ecc6c;
fn_801ece2c = 0x801ece2c;
fn_801ed24c = 0x801ed24c;
fn_801efd34 = 0x801efd34;
fn_801efdfc = 0x801efdfc;
lbl_803ae8a4 = 0x803ae8a4;
lbl_803ae8ac = 0x803ae8ac;
lbl_803ae8e4 = 0x803ae8e4;
lbl_8045ed1c = 0x8045ed1c;
lbl_8045ed4c = 0x8045ed4c;
memset = 0x802eefe0;
SECTIONS {
  .text.w3d_d21e_register_texture_properties_801cd828 0x801cd828 : { *(.text.w3d_d21e_register_texture_properties_801cd828) }
  .bss 0x8045d7b4 : { *(.bss) }
  .sbss 0x804b0528 : { *(.sbss) }
  /DISCARD/ : { *(.text*) *(.rodata*) *(.data*) *(.bss*) *(.sdata*) *(.sbss*) *(.comment) }
}
