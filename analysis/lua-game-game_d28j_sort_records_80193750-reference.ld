/* Generated reference-only placements. All bodies are source-built. */
OUTPUT_FORMAT("elf32-powerpc")
OUTPUT_ARCH(powerpc)
ENTRY(d28j_sort_records_80193750)
_SDA_BASE_ = 0x804b2540;
_SDA2_BASE_ = 0x804c2540;
_._4Body = 0x80197ce4;
__3Str = 0x803426b8;
__4Body = 0x80197c8c;
assign_8034e408 = 0x8034e408;
fn_801907d0 = 0x801907d0;
fn_8020bb2c = 0x8020bb2c;
fn_8020c5c4 = 0x8020c5c4;
fn_802134fc = 0x802134fc;
fn_80341588 = 0x80341588;
insert_80344380 = 0x80344380;
insert_8034db14 = 0x8034db14;
insert_8034e638 = 0x8034e638;
reserve_8034ee28 = 0x8034ee28;
reserve_8034efd0 = 0x8034efd0;
strcmp_802ef234 = 0x802ef234;
SECTIONS {
  .text.d28j_sort_records_80193750 0x80193750 : { *(.text.d28j_sort_records_80193750) }
  /DISCARD/ : { *(.text*) *(.rodata*) *(.data*) *(.bss*) *(.sdata*) *(.sbss*) *(.comment) }
}
