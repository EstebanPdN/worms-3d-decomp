/* Generated reference-only placements. All bodies are source-built. */
OUTPUT_FORMAT("elf32-powerpc")
OUTPUT_ARCH(powerpc)
ENTRY(w3d_s21_pack_pair_801fcb64)
_SDA_BASE_ = 0x804b2540;
_SDA2_BASE_ = 0x804c2540;
fn_801fcb90 = 0x801fcb90;
SECTIONS {
  .text.w3d_s21_pack_pair_801fcb64 0x801fcb64 : { *(.text.w3d_s21_pack_pair_801fcb64) }
  /DISCARD/ : { *(.text*) *(.rodata*) *(.data*) *(.bss*) *(.sdata*) *(.sbss*) *(.comment) }
}
