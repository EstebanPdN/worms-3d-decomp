/* Generated reference-only placements. All bodies are source-built. */
OUTPUT_FORMAT("elf32-powerpc")
OUTPUT_ARCH(powerpc)
ENTRY(g1p_card_read_tick_802abffc)
_SDA_BASE_ = 0x804b2540;
_SDA2_BASE_ = 0x804c2540;
fn_802ac1e4 = 0x802ac1e4;
fn_802ac224 = 0x802ac224;
fn_802ac2ec = 0x802ac2ec;
fn_802ac37c = 0x802ac37c;
fn_802ac438 = 0x802ac438;
fn_802ac4bc = 0x802ac4bc;
fn_802ac564 = 0x802ac564;
fn_802ac600 = 0x802ac600;
fn_802ac668 = 0x802ac668;
fn_802ac6ec = 0x802ac6ec;
fn_802ac74c = 0x802ac74c;
fn_802ac7b0 = 0x802ac7b0;
fn_802ac814 = 0x802ac814;
fn_802fb82c = 0x802fb82c;
message_803d6cdc = 0x803d6cdc;
path_803d6cc4 = 0x803d6cc4;
SECTIONS {
  .text.g1p_card_read_tick_802abffc 0x802abffc : { *(.text.g1p_card_read_tick_802abffc) }
  /DISCARD/ : { *(.text*) *(.rodata*) *(.data*) *(.bss*) *(.sdata*) *(.sbss*) *(.comment) }
}
