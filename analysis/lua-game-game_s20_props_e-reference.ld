/* Generated reference-only placements. All bodies are source-built. */
OUTPUT_FORMAT("elf32-powerpc")
OUTPUT_ARCH(powerpc)
ENTRY(w3d_s20_register_string_after_entry_801c919c)
_SDA_BASE_ = 0x804b2540;
_SDA2_BASE_ = 0x804c2540;
fn_801e8d9c = 0x801e8d9c;
fn_801eb674 = 0x801eb674;
fn_801ebf38 = 0x801ebf38;
fn_801ece2c = 0x801ece2c;
fn_801ed24c = 0x801ed24c;
fn_801f0b70 = 0x801f0b70;
fn_8020bb2c = 0x8020bb2c;
fn_8020c5c0 = 0x8020c5c0;
fn_8020c5c4 = 0x8020c5c4;
fn_80341588 = 0x80341588;
fn_80341884 = 0x80341884;
lbl_803ad7f0 = 0x803ad7f0;
lbl_803ad820 = 0x803ad820;
lbl_803ae4ac = 0x803ae4ac;
lbl_803ae4e0 = 0x803ae4e0;
lbl_803ae514 = 0x803ae514;
lbl_803ae548 = 0x803ae548;
lbl_803ae580 = 0x803ae580;
lbl_803ae5a4 = 0x803ae5a4;
lbl_803ae5a8 = 0x803ae5a8;
lbl_804b06a0 = 0x804b06a0;
SECTIONS {
  .text.w3d_s20_register_string_after_entry_801c919c 0x801c919c : { *(.text.w3d_s20_register_string_after_entry_801c919c) }
  .text.w3d_s20_register_entries_vec4_801ccf38 0x801ccf38 : { *(.text.w3d_s20_register_entries_vec4_801ccf38) }
  /DISCARD/ : { *(.text*) *(.rodata*) *(.data*) *(.bss*) *(.sdata*) *(.sbss*) *(.comment) }
}
