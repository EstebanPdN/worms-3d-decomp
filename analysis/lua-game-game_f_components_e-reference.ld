/* Generated reference-only placements. All bodies are source-built. */
OUTPUT_FORMAT("elf32-powerpc")
OUTPUT_ARCH(powerpc)
ENTRY(w3d_component_list_get_8009a7fc)
_SDA_BASE_ = 0x804b2540;
_SDA2_BASE_ = 0x804c2540;
w3d_base_construct_800ea180 = 0x800ea180;
w3d_base_construct_8015fef0 = 0x8015fef0;
w3d_base_construct_801628b0 = 0x801628b0;
w3d_base_destroy_800ea324 = 0x800ea324;
w3d_base_destroy_8015ff2c = 0x8015ff2c;
w3d_base_destroy_801628ec = 0x801628ec;
w3d_base_handle_message_800ea62c = 0x800ea62c;
w3d_base_handle_message_8015fb34 = 0x8015fb34;
w3d_base_handle_message_8016293c = 0x8016293c;
w3d_component_construct_8009b3d4 = 0x8009b3d4;
w3d_component_construct_800a50a8 = 0x800a50a8;
w3d_component_destroy_8009b4e0 = 0x8009b4e0;
w3d_component_destroy_800a50f4 = 0x800a50f4;
w3d_component_list_80360630 = 0x80360630;
w3d_component_list_80360660 = 0x80360660;
w3d_component_list_80360690 = 0x80360690;
w3d_component_list_803606c0 = 0x803606c0;
w3d_component_list_803606f0 = 0x803606f0;
w3d_component_list_80360720 = 0x80360720;
w3d_component_list_80360750 = 0x80360750;
w3d_component_list_80360780 = 0x80360780;
w3d_component_list_803607b0 = 0x803607b0;
w3d_component_start_8009f29c = 0x8009f29c;
w3d_component_start_800a4534 = 0x800a4534;
w3d_component_start_800a4bf4 = 0x800a4bf4;
w3d_component_start_800a51f8 = 0x800a51f8;
w3d_component_stop_8009f464 = 0x8009f464;
w3d_component_stop_800a4c50 = 0x800a4c50;
w3d_component_vtable_8040f350 = 0x8040f350;
w3d_component_vtable_8040f3f8 = 0x8040f3f8;
w3d_component_vtable_8040f468 = 0x8040f468;
w3d_component_vtable_8040f4a8 = 0x8040f4a8;
w3d_component_vtable_8040f4e8 = 0x8040f4e8;
w3d_component_vtable_8040f528 = 0x8040f528;
w3d_component_vtable_8040f568 = 0x8040f568;
w3d_heap_allocate_entry_a = 0x801fe1d8;
w3d_owner_list_remove = 0x8020fd2c;
w3d_state_register = 0x8020fd04;
SECTIONS {
  .text.w3d_component_list_get_8009a7fc 0x8009a7fc : { *(.text.w3d_component_list_get_8009a7fc) }
  .text.w3d_component_unlink_8009a808 0x8009a808 : { *(.text.w3d_component_unlink_8009a808) }
  .text.w3d_component_create_8009a84c 0x8009a84c : { *(.text.w3d_component_create_8009a84c) }
  .text.w3d_component_release_8009a8ac 0x8009a8ac : { *(.text.w3d_component_release_8009a8ac) }
  .text.w3d_component_retain_8009a908 0x8009a908 : { *(.text.w3d_component_retain_8009a908) }
  .text.w3d_component_construct_8009a920 0x8009a920 : { *(.text.w3d_component_construct_8009a920) }
  .text.w3d_component_destroy_8009a970 0x8009a970 : { *(.text.w3d_component_destroy_8009a970) }
  .text.w3d_component_list_get_8009b2b0 0x8009b2b0 : { *(.text.w3d_component_list_get_8009b2b0) }
  .text.w3d_component_unlink_8009b2bc 0x8009b2bc : { *(.text.w3d_component_unlink_8009b2bc) }
  .text.w3d_component_create_8009b300 0x8009b300 : { *(.text.w3d_component_create_8009b300) }
  .text.w3d_component_release_8009b360 0x8009b360 : { *(.text.w3d_component_release_8009b360) }
  .text.w3d_component_retain_8009b3bc 0x8009b3bc : { *(.text.w3d_component_retain_8009b3bc) }
  .text.w3d_component_list_get_8009eee8 0x8009eee8 : { *(.text.w3d_component_list_get_8009eee8) }
  .text.w3d_component_unlink_8009eef4 0x8009eef4 : { *(.text.w3d_component_unlink_8009eef4) }
  .text.w3d_component_create_8009ef38 0x8009ef38 : { *(.text.w3d_component_create_8009ef38) }
  .text.w3d_component_release_8009ef98 0x8009ef98 : { *(.text.w3d_component_release_8009ef98) }
  .text.w3d_component_retain_8009eff4 0x8009eff4 : { *(.text.w3d_component_retain_8009eff4) }
  .text.w3d_component_construct_8009f00c 0x8009f00c : { *(.text.w3d_component_construct_8009f00c) }
  .text.w3d_component_destroy_8009f050 0x8009f050 : { *(.text.w3d_component_destroy_8009f050) }
  .text.w3d_component_handle_message_8009f0b0 0x8009f0b0 : { *(.text.w3d_component_handle_message_8009f0b0) }
  .text.w3d_component_list_get_8009fe68 0x8009fe68 : { *(.text.w3d_component_list_get_8009fe68) }
  .text.w3d_component_unlink_8009fe74 0x8009fe74 : { *(.text.w3d_component_unlink_8009fe74) }
  .text.w3d_component_create_8009feb8 0x8009feb8 : { *(.text.w3d_component_create_8009feb8) }
  .text.w3d_component_release_8009ff18 0x8009ff18 : { *(.text.w3d_component_release_8009ff18) }
  .text.w3d_component_retain_8009ff74 0x8009ff74 : { *(.text.w3d_component_retain_8009ff74) }
  .text.w3d_component_construct_8009ff8c 0x8009ff8c : { *(.text.w3d_component_construct_8009ff8c) }
  .text.w3d_component_destroy_800a0014 0x800a0014 : { *(.text.w3d_component_destroy_800a0014) }
  .text.w3d_component_list_get_800a17b0 0x800a17b0 : { *(.text.w3d_component_list_get_800a17b0) }
  .text.w3d_component_unlink_800a17bc 0x800a17bc : { *(.text.w3d_component_unlink_800a17bc) }
  .text.w3d_component_create_800a1800 0x800a1800 : { *(.text.w3d_component_create_800a1800) }
  .text.w3d_component_release_800a1860 0x800a1860 : { *(.text.w3d_component_release_800a1860) }
  .text.w3d_component_retain_800a18bc 0x800a18bc : { *(.text.w3d_component_retain_800a18bc) }
  .text.w3d_component_construct_800a18d4 0x800a18d4 : { *(.text.w3d_component_construct_800a18d4) }
  .text.w3d_component_destroy_800a198c 0x800a198c : { *(.text.w3d_component_destroy_800a198c) }
  .text.w3d_component_list_get_800a3750 0x800a3750 : { *(.text.w3d_component_list_get_800a3750) }
  .text.w3d_component_unlink_800a375c 0x800a375c : { *(.text.w3d_component_unlink_800a375c) }
  .text.w3d_component_create_800a37a0 0x800a37a0 : { *(.text.w3d_component_create_800a37a0) }
  .text.w3d_component_release_800a3800 0x800a3800 : { *(.text.w3d_component_release_800a3800) }
  .text.w3d_component_retain_800a385c 0x800a385c : { *(.text.w3d_component_retain_800a385c) }
  .text.w3d_component_construct_800a3874 0x800a3874 : { *(.text.w3d_component_construct_800a3874) }
  .text.w3d_component_destroy_800a38f8 0x800a38f8 : { *(.text.w3d_component_destroy_800a38f8) }
  .text.w3d_component_list_get_800a4184 0x800a4184 : { *(.text.w3d_component_list_get_800a4184) }
  .text.w3d_component_unlink_800a4190 0x800a4190 : { *(.text.w3d_component_unlink_800a4190) }
  .text.w3d_component_create_800a41d4 0x800a41d4 : { *(.text.w3d_component_create_800a41d4) }
  .text.w3d_component_release_800a4234 0x800a4234 : { *(.text.w3d_component_release_800a4234) }
  .text.w3d_component_retain_800a4290 0x800a4290 : { *(.text.w3d_component_retain_800a4290) }
  .text.w3d_component_construct_800a42a8 0x800a42a8 : { *(.text.w3d_component_construct_800a42a8) }
  .text.w3d_component_destroy_800a42e4 0x800a42e4 : { *(.text.w3d_component_destroy_800a42e4) }
  .text.w3d_component_handle_message_800a4314 0x800a4314 : { *(.text.w3d_component_handle_message_800a4314) }
  .text.w3d_component_stop_800a47fc 0x800a47fc : { *(.text.w3d_component_stop_800a47fc) }
  .text.w3d_component_list_get_800a493c 0x800a493c : { *(.text.w3d_component_list_get_800a493c) }
  .text.w3d_component_unlink_800a4948 0x800a4948 : { *(.text.w3d_component_unlink_800a4948) }
  .text.w3d_component_create_800a498c 0x800a498c : { *(.text.w3d_component_create_800a498c) }
  .text.w3d_component_release_800a49ec 0x800a49ec : { *(.text.w3d_component_release_800a49ec) }
  .text.w3d_component_retain_800a4a48 0x800a4a48 : { *(.text.w3d_component_retain_800a4a48) }
  .text.w3d_component_construct_800a4a60 0x800a4a60 : { *(.text.w3d_component_construct_800a4a60) }
  .text.w3d_component_destroy_800a4aac 0x800a4aac : { *(.text.w3d_component_destroy_800a4aac) }
  .text.w3d_component_handle_message_800a4b0c 0x800a4b0c : { *(.text.w3d_component_handle_message_800a4b0c) }
  .text.w3d_component_list_get_800a4f84 0x800a4f84 : { *(.text.w3d_component_list_get_800a4f84) }
  .text.w3d_component_unlink_800a4f90 0x800a4f90 : { *(.text.w3d_component_unlink_800a4f90) }
  .text.w3d_component_create_800a4fd4 0x800a4fd4 : { *(.text.w3d_component_create_800a4fd4) }
  .text.w3d_component_release_800a5034 0x800a5034 : { *(.text.w3d_component_release_800a5034) }
  .text.w3d_component_retain_800a5090 0x800a5090 : { *(.text.w3d_component_retain_800a5090) }
  .text.w3d_component_handle_message_800a5168 0x800a5168 : { *(.text.w3d_component_handle_message_800a5168) }
  .text.w3d_component_stop_800a538c 0x800a538c : { *(.text.w3d_component_stop_800a538c) }
  /DISCARD/ : { *(.text*) *(.rodata*) *(.data*) *(.bss*) *(.sdata*) *(.sbss*) *(.comment) }
}
