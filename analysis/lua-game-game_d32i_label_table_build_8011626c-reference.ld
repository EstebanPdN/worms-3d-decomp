/* Generated reference-only placements. All bodies are source-built. */
OUTPUT_FORMAT("elf32-powerpc")
OUTPUT_ARCH(powerpc)
ENTRY(d32i_label_table_build_8011626c)
_SDA_BASE_ = 0x804b2540;
_SDA2_BASE_ = 0x804c2540;
_._19Descriptor_80178474 = 0x80178474;
__6String = 0x803426b8;
array_lock_801ef048 = 0x801ef048;
as_table_80341584 = 0x80341584;
class_80419e68 = 0x80419e68;
class_80419e88 = 0x80419e88;
create_8020b680 = 0x8020b680;
f_8039a4c8 = 0x8039a4c8;
list_append_801ef174 = 0x801ef174;
list_begin_801ef380 = 0x801ef380;
n_8039a7a0 = 0x8039a7a0;
n_8039a8f4 = 0x8039a8f4;
read_key_800fc2b0 = 0x800fc2b0;
string_assign_8020bd38 = 0x8020bd38;
string_finish_8020c5c4 = 0x8020c5c4;
string_format_8020c510 = 0x8020c510;
string_release_80341588 = 0x80341588;
table_8039a8bc = 0x8039a8bc;
table_get_80179598 = 0x80179598;
SECTIONS {
  .text.d32i_label_table_build_8011626c 0x8011626c : { *(.text.d32i_label_table_build_8011626c) }
  .rodata 0x8039a8f8 : { *(.rodata) }
  /DISCARD/ : { *(.text*) *(.rodata*) *(.data*) *(.bss*) *(.sdata*) *(.sbss*) *(.comment) }
}
