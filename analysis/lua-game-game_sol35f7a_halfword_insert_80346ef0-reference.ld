/* Generated reference-only placements. All bodies are source-built. */
OUTPUT_FORMAT("elf32-powerpc")
OUTPUT_ARCH(powerpc)
ENTRY(sol35f7a_halfword_insert_80346ef0)
_SDA_BASE_ = 0x804b2540;
_SDA2_BASE_ = 0x804c2540;
sol35f7a_allocate_80212fd4 = 0x80212fd4;
sol35f7a_fallback_803413d8 = 0x803413d8;
sol35f7a_free_802134fc = 0x802134fc;
sol35f7a_move_802eeef4 = 0x802eeef4;
SECTIONS {
  .text.sol35f7a_halfword_insert_80346ef0 0x80346ef0 : { *(.text.sol35f7a_halfword_insert_80346ef0) }
  /DISCARD/ : { *(.text*) *(.rodata*) *(.data*) *(.bss*) *(.sdata*) *(.sbss*) *(.comment) }
}
