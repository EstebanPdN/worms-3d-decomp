/* Generated reference-only placements. All bodies are source-built. */
OUTPUT_FORMAT("elf32-powerpc")
OUTPUT_ARCH(powerpc)
ENTRY(d30j_load_image_resource_801712c4)
_SDA_BASE_ = 0x804b2540;
_SDA2_BASE_ = 0x804c2540;
__3StrPCc = 0x8020bb54;
fn_802fa988 = 0x802fa988;
lbl_803a6648 = 0x803a6648;
lbl_80413db0 = 0x80413db0;
lbl_804143e0 = 0x804143e0;
w3d_auto_801d0858 = 0x801d0858;
w3d_auto_8020b648 = 0x8020b648;
w3d_s10_service_forward_8020b680 = 0x8020b680;
w3d_string_base_finish = 0x8020c5c4;
w3d_string_base_init = 0x8020c5c0;
w3d_string_header = 0x80341884;
w3d_string_release = 0x80341588;
w3d_string_release_header = 0x8020bb2c;
SECTIONS {
  .text.d30j_load_image_resource_801712c4 0x801712c4 : { *(.text.d30j_load_image_resource_801712c4) }
  /DISCARD/ : { *(.text*) *(.rodata*) *(.data*) *(.bss*) *(.sdata*) *(.sbss*) *(.comment) }
}
