/* Generated reference-only placements. All bodies are source-built. */
OUTPUT_FORMAT("elf32-powerpc")
OUTPUT_ARCH(powerpc)
ENTRY(w3d_cx12a_forward_positions_8002e59c)
_SDA_BASE_ = 0x804b2540;
_SDA2_BASE_ = 0x804c2540;
initialize_80343740 = 0x80343740;
SECTIONS {
  .text.w3d_cx12a_forward_positions_8002e59c 0x8002e59c : { *(.text.w3d_cx12a_forward_positions_8002e59c) }
  /DISCARD/ : { *(.text*) *(.rodata*) *(.data*) *(.bss*) *(.sdata*) *(.sbss*) *(.comment) }
}
