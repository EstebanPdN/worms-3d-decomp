/* Generated reference-only placements. All bodies are source-built. */
OUTPUT_FORMAT("elf32-powerpc")
OUTPUT_ARCH(powerpc)
ENTRY(d30c_emitter_update_800e3970)
_SDA_BASE_ = 0x804b2540;
_SDA2_BASE_ = 0x804c2540;
cast_801797b4 = 0x801797b4;
empty_80341584 = 0x80341584;
empty_80342a74 = 0x80342a74;
finish_8015fd1c = 0x8015fd1c;
forward_800e5d4c = 0x800e5d4c;
frac_800de5b4 = 0x800de5b4;
is_one_8006e71c = 0x8006e71c;
jitter_800dff7c = 0x800dff7c;
kill_800e422c = 0x800e422c;
mark_800dca14 = 0x800dca14;
rnd_801610a0 = 0x801610a0;
start_800ddcbc = 0x800ddcbc;
sweep_800df570 = 0x800df570;
tick_800e464c = 0x800e464c;
value_80178df0 = 0x80178df0;
SECTIONS {
  .text.d30c_emitter_update_800e3970 0x800e3970 : { *(.text.d30c_emitter_update_800e3970) }
  .rodata 0x8038a028 : { *(.rodata) }
  /DISCARD/ : { *(.text*) *(.rodata*) *(.data*) *(.bss*) *(.sdata*) *(.sbss*) *(.comment) }
}
