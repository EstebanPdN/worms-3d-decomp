/* Generated reference-only placements. All bodies are source-built. */
OUTPUT_FORMAT("elf32-powerpc")
OUTPUT_ARCH(powerpc)
ENTRY(w3d_cc18a_resource_sinit_8017e974)
_SDA_BASE_ = 0x804b2540;
_SDA2_BASE_ = 0x804c2540;
fn_8017b834 = 0x8017b834;
fn_8020fbd0 = 0x8020fbd0;
lbl_803e8a1c = 0x803e8a1c;
lbl_80411ad8 = 0x80411ad8;
lbl_80419598 = 0x80419598;
lbl_80456f14 = 0x80456f14;
lbl_80457014 = 0x80457014;
SECTIONS {
  .text.w3d_cc18a_resource_sinit_8017e974 0x8017e974 : { *(.text.w3d_cc18a_resource_sinit_8017e974) }
  /DISCARD/ : { *(.text*) *(.rodata*) *(.data*) *(.bss*) *(.sdata*) *(.sbss*) *(.comment) }
}
