/* Generated reference-only placements. All bodies are source-built. */
OUTPUT_FORMAT("elf32-powerpc")
OUTPUT_ARCH(powerpc)
ENTRY(w3d_s21_wrap_value_8026cc20)
_SDA_BASE_ = 0x804b2540;
_SDA2_BASE_ = 0x804c2540;
fn_8026cc60 = 0x8026cc60;
lbl_803cbcc2 = 0x803cbcc2;
SECTIONS {
  .text.w3d_s21_wrap_value_8026cc20 0x8026cc20 : { *(.text.w3d_s21_wrap_value_8026cc20) }
  /DISCARD/ : { *(.text*) *(.rodata*) *(.data*) *(.bss*) *(.sdata*) *(.sbss*) *(.comment) }
}
