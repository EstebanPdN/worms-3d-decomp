/* Generated reference-only placements. All bodies are source-built. */
OUTPUT_FORMAT("elf32-powerpc")
OUTPUT_ARCH(powerpc)
ENTRY(cc23a_planner_requeue_offset_8000b6bc)
_SDA_BASE_ = 0x804b2540;
_SDA2_BASE_ = 0x804c2540;
fn_8000753c = 0x8000753c;
lbl_80369c64 = 0x80369c64;
lbl_8041d3a0 = 0x8041d3a0;
lbl_8041e85c = 0x8041e85c;
SECTIONS {
  .text.cc23a_planner_requeue_offset_8000b6bc 0x8000b6bc : { *(.text.cc23a_planner_requeue_offset_8000b6bc) }
  /DISCARD/ : { *(.text*) *(.rodata*) *(.data*) *(.bss*) *(.sdata*) *(.sbss*) *(.comment) }
}
