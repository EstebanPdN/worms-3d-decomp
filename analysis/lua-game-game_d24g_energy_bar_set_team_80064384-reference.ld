/* Generated reference-only placements. All bodies are source-built. */
OUTPUT_FORMAT("elf32-powerpc")
OUTPUT_ARCH(powerpc)
ENTRY(w3d_d24g_energy_bar_set_team_80064384)
_SDA_BASE_ = 0x804b2540;
_SDA2_BASE_ = 0x804c2540;
__6StringPCc = 0x8020bb54;
as_text_80343580 = 0x80343580;
fill_text_8018d35c = 0x8018d35c;
fill_values_8018d434 = 0x8018d434;
layout_80064a80 = 0x80064a80;
load_8015adf4 = 0x8015adf4;
name_800fd3e4 = 0x800fd3e4;
s_80379d00 = 0x80379d00;
s_80379d40 = 0x80379d40;
s_80379d50 = 0x80379d50;
s_80379d60 = 0x80379d60;
s_80379d70 = 0x80379d70;
s_80379d80 = 0x80379d80;
string_finish_8020c5c4 = 0x8020c5c4;
string_release_80341588 = 0x80341588;
team_800fc7f8 = 0x800fc7f8;
update_80064198 = 0x80064198;
update_800642ac = 0x800642ac;
SECTIONS {
  .text.w3d_d24g_energy_bar_set_team_80064384 0x80064384 : { *(.text.w3d_d24g_energy_bar_set_team_80064384) }
  /DISCARD/ : { *(.text*) *(.rodata*) *(.data*) *(.bss*) *(.sdata*) *(.sbss*) *(.comment) }
}
