/* Generated reference-only placements. All bodies are source-built. */
OUTPUT_FORMAT("elf32-powerpc")
OUTPUT_ARCH(powerpc)
ENTRY(g2b_dispatch_held_801ad644)
_SDA_BASE_ = 0x804b2540;
_SDA2_BASE_ = 0x804c2540;
fn_801ace68 = 0x801ace68;
fn_801ad060 = 0x801ad060;
fn_801ad590 = 0x801ad590;
SECTIONS {
  .text.g2b_dispatch_held_801ad644 0x801ad644 : { *(.text.g2b_dispatch_held_801ad644) }
  /DISCARD/ : { *(.text*) *(.rodata*) *(.data*) *(.bss*) *(.sdata*) *(.sbss*) *(.comment) }
}
