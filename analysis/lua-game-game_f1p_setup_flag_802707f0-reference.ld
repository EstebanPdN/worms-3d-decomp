/* Generated reference-only placements. All bodies are source-built. */
OUTPUT_FORMAT("elf32-powerpc")
OUTPUT_ARCH(powerpc)
ENTRY(w3d_setup_flag_802707f0)
_SDA_BASE_ = 0x804b2540;
_SDA2_BASE_ = 0x804c2540;
__15String_8020bb54PCc = 0x8020bb54;
fn_8015adf4 = 0x8015adf4;
fn_80165254 = 0x80165254;
fn_8020c5c4 = 0x8020c5c4;
fn_802b0b84 = 0x802b0b84;
fn_80341588 = 0x80341588;
name_803cc024 = 0x803cc024;
zero_803cc02c = 0x803cc02c;
SECTIONS {
  .text.w3d_setup_flag_802707f0 0x802707f0 : { *(.text.w3d_setup_flag_802707f0) }
  /DISCARD/ : { *(.text*) *(.rodata*) *(.data*) *(.bss*) *(.sdata*) *(.sbss*) *(.comment) }
}
