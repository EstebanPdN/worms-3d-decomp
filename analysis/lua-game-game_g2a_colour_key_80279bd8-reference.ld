/* Generated reference-only placements. All bodies are source-built. */
OUTPUT_FORMAT("elf32-powerpc")
OUTPUT_ARCH(powerpc)
ENTRY(w3d_g2a_colour_key_80279bd8)
_SDA_BASE_ = 0x804b2540;
_SDA2_BASE_ = 0x804c2540;
__16G2aText_803426b8 = 0x803426b8;
alpha_803ce668 = 0x803ce668;
blue_803ce648 = 0x803ce648;
fn_801e9db8 = 0x801e9db8;
fn_8020c5c4 = 0x8020c5c4;
fn_8027a934 = 0x8027a934;
fn_8027ae00 = 0x8027ae00;
fn_802cbdf8 = 0x802cbdf8;
fn_802cc0ac = 0x802cc0ac;
fn_802cd26c = 0x802cd26c;
fn_80341588 = 0x80341588;
green_803ce628 = 0x803ce628;
red_803ce608 = 0x803ce608;
SECTIONS {
  .text.w3d_g2a_colour_key_80279bd8 0x80279bd8 : { *(.text.w3d_g2a_colour_key_80279bd8) }
  /DISCARD/ : { *(.text*) *(.rodata*) *(.data*) *(.bss*) *(.sdata*) *(.sbss*) *(.comment) }
}
