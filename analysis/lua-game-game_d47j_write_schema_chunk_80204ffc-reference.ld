/* Generated reference-only placements. All bodies are source-built. */
OUTPUT_FORMAT("elf32-powerpc")
OUTPUT_ARCH(powerpc)
ENTRY(d47j_write_schema_chunk_80204ffc)
_SDA_BASE_ = 0x804b2540;
_SDA2_BASE_ = 0x804c2540;
_M_increment__Q24_STLt10_Rb_global1ZbPQ24_STL18_Rb_tree_node_base = 0x80351ef8;
d30s_binary_index_80203598 = 0x80203598;
f5c_find_index_80205738 = 0x80205738;
w3d_auto_801fff3c = 0x801fff3c;
w3d_s21_forward_write_802047ac = 0x802047ac;
SECTIONS {
  .text.d47j_write_schema_chunk_80204ffc 0x80204ffc : { *(.text.d47j_write_schema_chunk_80204ffc) }
  /DISCARD/ : { *(.text*) *(.rodata*) *(.data*) *(.bss*) *(.sdata*) *(.sbss*) *(.comment) }
}
