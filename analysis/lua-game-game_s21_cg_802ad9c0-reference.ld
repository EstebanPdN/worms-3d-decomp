/* Generated reference-only placements. All bodies are source-built. */
OUTPUT_FORMAT("elf32-powerpc")
OUTPUT_ARCH(powerpc)
ENTRY(w3d_s21_verify_crc_802ad9c0)
_SDA_BASE_ = 0x804b2540;
_SDA2_BASE_ = 0x804c2540;
fn_802ad978 = 0x802ad978;
fn_802fb7ac = 0x802fb7ac;
lbl_803d7494 = 0x803d7494;
SECTIONS {
  .text.w3d_s21_verify_crc_802ad9c0 0x802ad9c0 : { *(.text.w3d_s21_verify_crc_802ad9c0) }
  /DISCARD/ : { *(.text*) *(.rodata*) *(.data*) *(.bss*) *(.sdata*) *(.sbss*) *(.comment) }
}
