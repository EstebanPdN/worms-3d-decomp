/* Generated reference-only placements. All bodies are source-built. */
OUTPUT_FORMAT("elf32-powerpc")
OUTPUT_ARCH(powerpc)
ENTRY(w3d_ifaceset_80234b84)
_SDA_BASE_ = 0x804b2540;
_SDA2_BASE_ = 0x804c2540;
w3d_address_802e2b84 = 0x802e2b84;
w3d_address_802e2f0c = 0x802e2f0c;
w3d_fn_801b4c6c = 0x801b4c6c;
w3d_fn_801b4ef0 = 0x801b4ef0;
w3d_fn_801b5454 = 0x801b5454;
w3d_fn_801ea138 = 0x801ea138;
w3d_fn_801ea740 = 0x801ea740;
w3d_fn_8020b460 = 0x8020b460;
w3d_fn_80238d88 = 0x80238d88;
w3d_fn_80239d60 = 0x80239d60;
w3d_fn_80239ddc = 0x80239ddc;
w3d_fn_8023b59c = 0x8023b59c;
w3d_fn_8023b7b4 = 0x8023b7b4;
w3d_fn_8023d6dc = 0x8023d6dc;
w3d_fn_8023d774 = 0x8023d774;
w3d_fn_802539c4 = 0x802539c4;
w3d_vtable_8041a6f8 = 0x8041a6f8;
w3d_vtable_8041a748 = 0x8041a748;
w3d_vtable_8041a798 = 0x8041a798;
w3d_vtable_8041a7e8 = 0x8041a7e8;
w3d_vtable_8041a838 = 0x8041a838;
w3d_vtable_8041a860 = 0x8041a860;
w3d_vtable_8041a888 = 0x8041a888;
w3d_vtable_8041a8b0 = 0x8041a8b0;
w3d_vtable_8041a900 = 0x8041a900;
w3d_vtable_8041aba8 = 0x8041aba8;
w3d_vtable_8041abf8 = 0x8041abf8;
w3d_vtable_8041ac70 = 0x8041ac70;
w3d_vtable_8041ac98 = 0x8041ac98;
w3d_vtable_8041ace8 = 0x8041ace8;
w3d_vtable_8041ad38 = 0x8041ad38;
w3d_vtable_8041ad60 = 0x8041ad60;
w3d_vtable_8041adb0 = 0x8041adb0;
w3d_vtable_8041add8 = 0x8041add8;
w3d_vtable_8041ae78 = 0x8041ae78;
w3d_vtable_8041aea0 = 0x8041aea0;
w3d_vtable_8041aec8 = 0x8041aec8;
w3d_vtable_8041aef0 = 0x8041aef0;
w3d_vtable_8041af18 = 0x8041af18;
w3d_vtable_8041af68 = 0x8041af68;
w3d_vtable_8041af90 = 0x8041af90;
w3d_vtable_8041afb8 = 0x8041afb8;
w3d_vtable_8041afe0 = 0x8041afe0;
w3d_vtable_8041b008 = 0x8041b008;
w3d_vtable_8041b030 = 0x8041b030;
w3d_vtable_8041b0a8 = 0x8041b0a8;
w3d_vtable_8041b668 = 0x8041b668;
w3d_vtable_8041b690 = 0x8041b690;
w3d_vtable_8041b6e0 = 0x8041b6e0;
w3d_vtable_8041b708 = 0x8041b708;
w3d_vtable_8041b730 = 0x8041b730;
w3d_vtable_8041b820 = 0x8041b820;
w3d_vtable_8041b898 = 0x8041b898;
w3d_vtable_8041b978 = 0x8041b978;
w3d_vtable_8041b9a0 = 0x8041b9a0;
w3d_vtable_8041ba40 = 0x8041ba40;
w3d_vtable_8041ba68 = 0x8041ba68;
SECTIONS {
  .text.w3d_ifaceset_80234b84 0x80234b84 : { *(.text.w3d_ifaceset_80234b84) }
  .text.w3d_ifaceset_80234bf0 0x80234bf0 : { *(.text.w3d_ifaceset_80234bf0) }
  .text.w3d_ifaceset_80234c5c 0x80234c5c : { *(.text.w3d_ifaceset_80234c5c) }
  .text.w3d_ifaceset_80234cc8 0x80234cc8 : { *(.text.w3d_ifaceset_80234cc8) }
  .text.w3d_ifaceset_80234d34 0x80234d34 : { *(.text.w3d_ifaceset_80234d34) }
  .text.w3d_ifaceset_80234da0 0x80234da0 : { *(.text.w3d_ifaceset_80234da0) }
  .text.w3d_ifaceset_80234e0c 0x80234e0c : { *(.text.w3d_ifaceset_80234e0c) }
  .text.w3d_ifaceset_80234e78 0x80234e78 : { *(.text.w3d_ifaceset_80234e78) }
  .text.w3d_dtor_held_802359d4 0x802359d4 : { *(.text.w3d_dtor_held_802359d4) }
  .text.w3d_dtor_held_80235f28 0x80235f28 : { *(.text.w3d_dtor_held_80235f28) }
  .text.w3d_dtor_held_8023616c 0x8023616c : { *(.text.w3d_dtor_held_8023616c) }
  .text.w3d_dtor_80236318 0x80236318 : { *(.text.w3d_dtor_80236318) }
  .text.w3d_dtor_held_802364bc 0x802364bc : { *(.text.w3d_dtor_held_802364bc) }
  .text.w3d_dtor_held_80236c5c 0x80236c5c : { *(.text.w3d_dtor_held_80236c5c) }
  .text.w3d_dtor_held_80237240 0x80237240 : { *(.text.w3d_dtor_held_80237240) }
  .text.w3d_dtor_held_802377a8 0x802377a8 : { *(.text.w3d_dtor_held_802377a8) }
  .text.w3d_dtor_held_80237d08 0x80237d08 : { *(.text.w3d_dtor_held_80237d08) }
  .text.w3d_ifaceset_802386d8 0x802386d8 : { *(.text.w3d_ifaceset_802386d8) }
  .text.w3d_dtor_80238dcc 0x80238dcc : { *(.text.w3d_dtor_80238dcc) }
  .text.w3d_dtor_80239490 0x80239490 : { *(.text.w3d_dtor_80239490) }
  .text.w3d_ctor_802395d8 0x802395d8 : { *(.text.w3d_ctor_802395d8) }
  .text.w3d_dtor_80239614 0x80239614 : { *(.text.w3d_dtor_80239614) }
  .text.w3d_dtor_80239784 0x80239784 : { *(.text.w3d_dtor_80239784) }
  .text.w3d_dtor_80239910 0x80239910 : { *(.text.w3d_dtor_80239910) }
  .text.w3d_dtor_80239aa0 0x80239aa0 : { *(.text.w3d_dtor_80239aa0) }
  .text.w3d_ctor_80239bf8 0x80239bf8 : { *(.text.w3d_ctor_80239bf8) }
  .text.w3d_dtor_80239c34 0x80239c34 : { *(.text.w3d_dtor_80239c34) }
  .text.w3d_ctor_80239fe8 0x80239fe8 : { *(.text.w3d_ctor_80239fe8) }
  .text.w3d_dtor_8023a024 0x8023a024 : { *(.text.w3d_dtor_8023a024) }
  .text.w3d_dtor_8023a194 0x8023a194 : { *(.text.w3d_dtor_8023a194) }
  .text.w3d_dtor_8023a320 0x8023a320 : { *(.text.w3d_dtor_8023a320) }
  .text.w3d_dtor_held_8023a4cc 0x8023a4cc : { *(.text.w3d_dtor_held_8023a4cc) }
  .text.w3d_dtor_8023a710 0x8023a710 : { *(.text.w3d_dtor_8023a710) }
  .text.w3d_dtor_held_8023b3a4 0x8023b3a4 : { *(.text.w3d_dtor_held_8023b3a4) }
  .text.w3d_dtor_8023b5f0 0x8023b5f0 : { *(.text.w3d_dtor_8023b5f0) }
  .text.w3d_dtor_held_8023bab8 0x8023bab8 : { *(.text.w3d_dtor_held_8023bab8) }
  .text.w3d_dtor_held_8023bd08 0x8023bd08 : { *(.text.w3d_dtor_held_8023bd08) }
  .text.w3d_dtor_held_8023c27c 0x8023c27c : { *(.text.w3d_dtor_held_8023c27c) }
  .text.w3d_ctor_8023c794 0x8023c794 : { *(.text.w3d_ctor_8023c794) }
  .text.w3d_dtor_8023c7d0 0x8023c7d0 : { *(.text.w3d_dtor_8023c7d0) }
  .text.w3d_dtor_held_8023c940 0x8023c940 : { *(.text.w3d_dtor_held_8023c940) }
  .text.w3d_ctor_8023d574 0x8023d574 : { *(.text.w3d_ctor_8023d574) }
  .text.w3d_dtor_8023d5b0 0x8023d5b0 : { *(.text.w3d_dtor_8023d5b0) }
  .text.w3d_ctor_8023d9e8 0x8023d9e8 : { *(.text.w3d_ctor_8023d9e8) }
  .text.w3d_dtor_8023da24 0x8023da24 : { *(.text.w3d_dtor_8023da24) }
  .text.w3d_dtor_8024cd58 0x8024cd58 : { *(.text.w3d_dtor_8024cd58) }
  .text.w3d_dtor_8024d980 0x8024d980 : { *(.text.w3d_dtor_8024d980) }
  .text.w3d_dtor_held_8024f430 0x8024f430 : { *(.text.w3d_dtor_held_8024f430) }
  .text.w3d_dtor_8024f6ac 0x8024f6ac : { *(.text.w3d_dtor_8024f6ac) }
  .text.w3d_dtor_8024f940 0x8024f940 : { *(.text.w3d_dtor_8024f940) }
  .text.w3d_dtor_held_802500ac 0x802500ac : { *(.text.w3d_dtor_held_802500ac) }
  .text.w3d_dtor_held_80250308 0x80250308 : { *(.text.w3d_dtor_held_80250308) }
  .text.w3d_ifaceset_80251234 0x80251234 : { *(.text.w3d_ifaceset_80251234) }
  .text.w3d_ifaceset_802512a0 0x802512a0 : { *(.text.w3d_ifaceset_802512a0) }
  .text.w3d_ifaceset_8025130c 0x8025130c : { *(.text.w3d_ifaceset_8025130c) }
  .text.w3d_ifaceset_802513e8 0x802513e8 : { *(.text.w3d_ifaceset_802513e8) }
  .text.w3d_ifaceset_80251454 0x80251454 : { *(.text.w3d_ifaceset_80251454) }
  .text.w3d_ifaceset_80251670 0x80251670 : { *(.text.w3d_ifaceset_80251670) }
  .text.w3d_ifaceset_80251d08 0x80251d08 : { *(.text.w3d_ifaceset_80251d08) }
  .text.w3d_dtor_8025518c 0x8025518c : { *(.text.w3d_dtor_8025518c) }
  .text.w3d_dtor_802553c8 0x802553c8 : { *(.text.w3d_dtor_802553c8) }
  .text.w3d_dtor_802570c0 0x802570c0 : { *(.text.w3d_dtor_802570c0) }
  .text.w3d_dtor_8025763c 0x8025763c : { *(.text.w3d_dtor_8025763c) }
  .text.w3d_forward_802e2c04 0x802e2c04 : { *(.text.w3d_forward_802e2c04) }
  .text.w3d_forward_802e2f8c 0x802e2f8c : { *(.text.w3d_forward_802e2f8c) }
  /DISCARD/ : { *(.text*) *(.rodata*) *(.data*) *(.bss*) *(.sdata*) *(.sbss*) *(.comment) }
}
