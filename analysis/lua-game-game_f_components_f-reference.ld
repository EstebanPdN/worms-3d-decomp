/* Generated reference-only placements. All bodies are source-built. */
OUTPUT_FORMAT("elf32-powerpc")
OUTPUT_ARCH(powerpc)
ENTRY(w3d_component_list_get_800a54d8)
_SDA_BASE_ = 0x804b2540;
_SDA2_BASE_ = 0x804c2540;
w3d_actor_base_destroy = 0x80161050;
w3d_actor_base_initialize = 0x80161014;
w3d_base_construct_8015fef0 = 0x8015fef0;
w3d_base_destroy_8015ff2c = 0x8015ff2c;
w3d_base_handle_message_8015fb34 = 0x8015fb34;
w3d_component_construct_800a5fdc = 0x800a5fdc;
w3d_component_construct_800a9ee0 = 0x800a9ee0;
w3d_component_construct_800ada58 = 0x800ada58;
w3d_component_construct_800b94b0 = 0x800b94b0;
w3d_component_construct_800ba884 = 0x800ba884;
w3d_component_construct_800bffb4 = 0x800bffb4;
w3d_component_destroy_800a60e8 = 0x800a60e8;
w3d_component_destroy_800b9598 = 0x800b9598;
w3d_component_destroy_800beeb0 = 0x800beeb0;
w3d_component_destroy_800c000c = 0x800c000c;
w3d_component_list_803607e0 = 0x803607e0;
w3d_component_list_80360810 = 0x80360810;
w3d_component_list_80360840 = 0x80360840;
w3d_component_list_80360870 = 0x80360870;
w3d_component_list_803608d0 = 0x803608d0;
w3d_component_list_80360900 = 0x80360900;
w3d_component_list_80360930 = 0x80360930;
w3d_component_list_80360960 = 0x80360960;
w3d_component_start_800a5750 = 0x800a5750;
w3d_component_start_800ade2c = 0x800ade2c;
w3d_component_stop_800ae200 = 0x800ae200;
w3d_component_vtable_8040f5e8 = 0x8040f5e8;
w3d_component_vtable_8040f690 = 0x8040f690;
w3d_component_vtable_8040f6f8 = 0x8040f6f8;
w3d_component_vtable_8040f828 = 0x8040f828;
w3d_component_vtable_8040f868 = 0x8040f868;
w3d_handle_storage_release = 0x802134fc;
w3d_heap_allocate_entry_a = 0x801fe1d8;
w3d_owner_list_remove = 0x8020fd2c;
w3d_state_register = 0x8020fd04;
SECTIONS {
  .text.w3d_component_list_get_800a54d8 0x800a54d8 : { *(.text.w3d_component_list_get_800a54d8) }
  .text.w3d_component_unlink_800a54e4 0x800a54e4 : { *(.text.w3d_component_unlink_800a54e4) }
  .text.w3d_component_create_800a5528 0x800a5528 : { *(.text.w3d_component_create_800a5528) }
  .text.w3d_component_release_800a5588 0x800a5588 : { *(.text.w3d_component_release_800a5588) }
  .text.w3d_component_retain_800a55e4 0x800a55e4 : { *(.text.w3d_component_retain_800a55e4) }
  .text.w3d_component_construct_800a55fc 0x800a55fc : { *(.text.w3d_component_construct_800a55fc) }
  .text.w3d_component_destroy_800a5644 0x800a5644 : { *(.text.w3d_component_destroy_800a5644) }
  .text.w3d_component_handle_message_800a56c0 0x800a56c0 : { *(.text.w3d_component_handle_message_800a56c0) }
  .text.w3d_component_stop_800a5ccc 0x800a5ccc : { *(.text.w3d_component_stop_800a5ccc) }
  .text.w3d_component_list_get_800a5eb8 0x800a5eb8 : { *(.text.w3d_component_list_get_800a5eb8) }
  .text.w3d_component_unlink_800a5ec4 0x800a5ec4 : { *(.text.w3d_component_unlink_800a5ec4) }
  .text.w3d_component_create_800a5f08 0x800a5f08 : { *(.text.w3d_component_create_800a5f08) }
  .text.w3d_component_release_800a5f68 0x800a5f68 : { *(.text.w3d_component_release_800a5f68) }
  .text.w3d_component_retain_800a5fc4 0x800a5fc4 : { *(.text.w3d_component_retain_800a5fc4) }
  .text.w3d_component_list_get_800a9dbc 0x800a9dbc : { *(.text.w3d_component_list_get_800a9dbc) }
  .text.w3d_component_unlink_800a9dc8 0x800a9dc8 : { *(.text.w3d_component_unlink_800a9dc8) }
  .text.w3d_component_create_800a9e0c 0x800a9e0c : { *(.text.w3d_component_create_800a9e0c) }
  .text.w3d_component_release_800a9e6c 0x800a9e6c : { *(.text.w3d_component_release_800a9e6c) }
  .text.w3d_component_retain_800a9ec8 0x800a9ec8 : { *(.text.w3d_component_retain_800a9ec8) }
  .text.w3d_component_destroy_800aa020 0x800aa020 : { *(.text.w3d_component_destroy_800aa020) }
  .text.w3d_component_list_get_800ad934 0x800ad934 : { *(.text.w3d_component_list_get_800ad934) }
  .text.w3d_component_unlink_800ad940 0x800ad940 : { *(.text.w3d_component_unlink_800ad940) }
  .text.w3d_component_create_800ad984 0x800ad984 : { *(.text.w3d_component_create_800ad984) }
  .text.w3d_component_release_800ad9e4 0x800ad9e4 : { *(.text.w3d_component_release_800ad9e4) }
  .text.w3d_component_retain_800ada40 0x800ada40 : { *(.text.w3d_component_retain_800ada40) }
  .text.w3d_component_destroy_800adad0 0x800adad0 : { *(.text.w3d_component_destroy_800adad0) }
  .text.w3d_component_handle_message_800adc2c 0x800adc2c : { *(.text.w3d_component_handle_message_800adc2c) }
  .text.w3d_component_list_get_800b938c 0x800b938c : { *(.text.w3d_component_list_get_800b938c) }
  .text.w3d_component_unlink_800b9398 0x800b9398 : { *(.text.w3d_component_unlink_800b9398) }
  .text.w3d_component_create_800b93dc 0x800b93dc : { *(.text.w3d_component_create_800b93dc) }
  .text.w3d_component_release_800b943c 0x800b943c : { *(.text.w3d_component_release_800b943c) }
  .text.w3d_component_retain_800b9498 0x800b9498 : { *(.text.w3d_component_retain_800b9498) }
  .text.w3d_component_list_get_800ba760 0x800ba760 : { *(.text.w3d_component_list_get_800ba760) }
  .text.w3d_component_unlink_800ba76c 0x800ba76c : { *(.text.w3d_component_unlink_800ba76c) }
  .text.w3d_component_create_800ba7b0 0x800ba7b0 : { *(.text.w3d_component_create_800ba7b0) }
  .text.w3d_component_release_800ba810 0x800ba810 : { *(.text.w3d_component_release_800ba810) }
  .text.w3d_component_retain_800ba86c 0x800ba86c : { *(.text.w3d_component_retain_800ba86c) }
  .text.w3d_component_destroy_800ba9a8 0x800ba9a8 : { *(.text.w3d_component_destroy_800ba9a8) }
  .text.w3d_component_list_get_800bed38 0x800bed38 : { *(.text.w3d_component_list_get_800bed38) }
  .text.w3d_component_unlink_800bed44 0x800bed44 : { *(.text.w3d_component_unlink_800bed44) }
  .text.w3d_component_create_800bed88 0x800bed88 : { *(.text.w3d_component_create_800bed88) }
  .text.w3d_component_release_800bede8 0x800bede8 : { *(.text.w3d_component_release_800bede8) }
  .text.w3d_component_retain_800bee44 0x800bee44 : { *(.text.w3d_component_retain_800bee44) }
  .text.w3d_component_construct_800bee5c 0x800bee5c : { *(.text.w3d_component_construct_800bee5c) }
  .text.w3d_component_list_get_800bfe90 0x800bfe90 : { *(.text.w3d_component_list_get_800bfe90) }
  .text.w3d_component_unlink_800bfe9c 0x800bfe9c : { *(.text.w3d_component_unlink_800bfe9c) }
  .text.w3d_component_create_800bfee0 0x800bfee0 : { *(.text.w3d_component_create_800bfee0) }
  .text.w3d_component_release_800bff40 0x800bff40 : { *(.text.w3d_component_release_800bff40) }
  .text.w3d_component_retain_800bff9c 0x800bff9c : { *(.text.w3d_component_retain_800bff9c) }
  /DISCARD/ : { *(.text*) *(.rodata*) *(.data*) *(.bss*) *(.sdata*) *(.sbss*) *(.comment) }
}
