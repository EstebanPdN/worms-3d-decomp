/* Generated reference-only placements. All bodies are source-built. */
OUTPUT_FORMAT("elf32-powerpc")
OUTPUT_ARCH(powerpc)
ENTRY(w3d_d24e_register_text_label_properties_802229a4)
_SDA_BASE_ = 0x804b2540;
_SDA2_BASE_ = 0x804c2540;
__15String_8020bb54PCc = 0x8020bb54;
d20e_empty_804b06a0 = 0x804b06a0;
d20e_release_header_8020bb2c = 0x8020bb2c;
d20e_string_finish_8020c5c4 = 0x8020c5c4;
d20e_string_header_80341884 = 0x80341884;
d20e_string_init_8020c5c0 = 0x8020c5c0;
d20e_string_release_80341588 = 0x80341588;
desc_803b6e88 = 0x803b6e88;
desc_803b6eac = 0x803b6eac;
desc_803b6ed8 = 0x803b6ed8;
desc_803b6f0c = 0x803b6f0c;
desc_803b6f40 = 0x803b6f40;
desc_803b6f74 = 0x803b6f74;
desc_803b6fac = 0x803b6fac;
desc_803b6fe0 = 0x803b6fe0;
fn_801e8d9c = 0x801e8d9c;
fn_801ebf38 = 0x801ebf38;
fn_801ec52c = 0x801ec52c;
fn_801ece2c = 0x801ece2c;
fn_801ed24c = 0x801ed24c;
lit_803b6408 = 0x803b6408;
SECTIONS {
  .text.w3d_d24e_register_text_label_properties_802229a4 0x802229a4 : { *(.text.w3d_d24e_register_text_label_properties_802229a4) }
  /DISCARD/ : { *(.text*) *(.rodata*) *(.data*) *(.bss*) *(.sdata*) *(.sbss*) *(.comment) }
}
