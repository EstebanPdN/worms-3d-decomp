/* Generated reference-only placements. All bodies are source-built. */
OUTPUT_FORMAT("elf32-powerpc")
OUTPUT_ARCH(powerpc)
ENTRY(w3d_cx7c_binary_tree_insert_unique_8035b478)
_SDA_BASE_ = 0x804b2540;
_SDA2_BASE_ = 0x804c2540;
cx7c_memcmp_802eedc0 = 0x802eedc0;
cx7c_tree_insert_8035b32c = 0x8035b32c;
cx7c_tree_predecessor_803526a0 = 0x803526a0;
SECTIONS {
  .text.w3d_cx7c_binary_tree_insert_unique_8035b478 0x8035b478 : { *(.text.w3d_cx7c_binary_tree_insert_unique_8035b478) }
  /DISCARD/ : { *(.text*) *(.rodata*) *(.data*) *(.bss*) *(.sdata*) *(.sbss*) *(.comment) }
}
