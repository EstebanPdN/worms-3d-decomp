/* Generated reference-only placements. All bodies are source-built. */
OUTPUT_FORMAT("elf32-powerpc")
OUTPUT_ARCH(powerpc)
ENTRY(s8_destroy_800e7ed8)
_SDA_BASE_ = 0x804b2540;
_SDA2_BASE_ = 0x804c2540;
fn_8015ff2c = 0x8015ff2c;
w3d_vtable_804101b0 = 0x804101b0;
SECTIONS {
  .text.s8_destroy_800e7ed8 0x800e7ed8 : { *(.text.s8_destroy_800e7ed8) }
  /DISCARD/ : { *(.text*) *(.rodata*) *(.data*) *(.bss*) *(.sdata*) *(.sbss*) *(.comment) }
}
