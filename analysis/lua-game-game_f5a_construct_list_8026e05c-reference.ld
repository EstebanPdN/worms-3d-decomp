/* Generated reference-only placements. All bodies are source-built. */
OUTPUT_FORMAT("elf32-powerpc")
OUTPUT_ARCH(powerpc)
ENTRY(w3d_f5a_construct_list_8026e05c)
_SDA_BASE_ = 0x804b2540;
_SDA2_BASE_ = 0x804c2540;
__15Member_802afb20 = 0x802afb20;
fn_8015fef0 = 0x8015fef0;
vt_8041bd60 = 0x8041bd60;
vt_8041bdb0 = 0x8041bdb0;
zero_803cbde4 = 0x803cbde4;
SECTIONS {
  .text.w3d_f5a_construct_list_8026e05c 0x8026e05c : { *(.text.w3d_f5a_construct_list_8026e05c) }
  /DISCARD/ : { *(.text*) *(.rodata*) *(.data*) *(.bss*) *(.sdata*) *(.sbss*) *(.comment) }
}
