/* Generated reference-only placements. All bodies are source-built. */
OUTPUT_FORMAT("elf32-powerpc")
OUTPUT_ARCH(powerpc)
ENTRY(w3d_cx11b_record_service_select_8020102c)
_SDA_BASE_ = 0x804b2540;
_SDA2_BASE_ = 0x804c2540;
index_802024f4 = 0x802024f4;
load_80202714 = 0x80202714;
SECTIONS {
  .text.w3d_cx11b_record_service_select_8020102c 0x8020102c : { *(.text.w3d_cx11b_record_service_select_8020102c) }
  /DISCARD/ : { *(.text*) *(.rodata*) *(.data*) *(.bss*) *(.sdata*) *(.sbss*) *(.comment) }
}
