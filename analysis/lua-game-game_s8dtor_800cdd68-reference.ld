/* Generated reference-only placements. All bodies are source-built. */
OUTPUT_FORMAT("elf32-powerpc")
OUTPUT_ARCH(powerpc)
ENTRY(s8_destroy_800cdd68)
_SDA_BASE_ = 0x804b2540;
_SDA2_BASE_ = 0x804c2540;
fn_80126230 = 0x80126230;
fn_80161050 = 0x80161050;
fn_802134fc = 0x802134fc;
w3d_vtable_8040fc08 = 0x8040fc08;
SECTIONS {
  .text.s8_destroy_800cdd68 0x800cdd68 : { *(.text.s8_destroy_800cdd68) }
  /DISCARD/ : { *(.text*) *(.rodata*) *(.data*) *(.bss*) *(.sdata*) *(.sbss*) *(.comment) }
}
