/* Generated reference-only placements. All bodies are source-built. */
OUTPUT_FORMAT("elf32-powerpc")
OUTPUT_ARCH(powerpc)
ENTRY(w3d_s20_register_float_pair_801bf55c)
_SDA_BASE_ = 0x804b2540;
_SDA2_BASE_ = 0x804c2540;
fn_801e8d9c = 0x801e8d9c;
fn_801ec52c = 0x801ec52c;
fn_801ece2c = 0x801ece2c;
fn_801f00f0 = 0x801f00f0;
fn_801f0b70 = 0x801f0b70;
lbl_803abec0 = 0x803abec0;
lbl_803abef4 = 0x803abef4;
lbl_803abf24 = 0x803abf24;
lbl_803abf58 = 0x803abf58;
lbl_803abf7c = 0x803abf7c;
lbl_803aecf8 = 0x803aecf8;
lbl_803aed28 = 0x803aed28;
lbl_803aed58 = 0x803aed58;
lbl_803aed80 = 0x803aed80;
lbl_803aed84 = 0x803aed84;
lbl_803aedf4 = 0x803aedf4;
lbl_803aee28 = 0x803aee28;
lbl_803aee4c = 0x803aee4c;
lbl_803aee50 = 0x803aee50;
SECTIONS {
  .text.w3d_s20_register_float_pair_801bf55c 0x801bf55c : { *(.text.w3d_s20_register_float_pair_801bf55c) }
  .text.w3d_s20_register_float_pairs_801ce708 0x801ce708 : { *(.text.w3d_s20_register_float_pairs_801ce708) }
  .text.w3d_s20_register_vec4_property_801cee80 0x801cee80 : { *(.text.w3d_s20_register_vec4_property_801cee80) }
  /DISCARD/ : { *(.text*) *(.rodata*) *(.data*) *(.bss*) *(.sdata*) *(.sbss*) *(.comment) }
}
