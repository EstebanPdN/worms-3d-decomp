/* Generated reference-only placements. All bodies are source-built. */
OUTPUT_FORMAT("elf32-powerpc")
OUTPUT_ARCH(powerpc)
ENTRY(w3d_cx10b_text_format_variadic_8020d6bc)
_SDA_BASE_ = 0x804b2540;
_SDA2_BASE_ = 0x804c2540;
format_list_8020d750 = 0x8020d750;
SECTIONS {
  .text.w3d_cx10b_text_format_variadic_8020d6bc 0x8020d6bc : { *(.text.w3d_cx10b_text_format_variadic_8020d6bc) }
  /DISCARD/ : { *(.text*) *(.rodata*) *(.data*) *(.bss*) *(.sdata*) *(.sbss*) *(.comment) }
}
