/* Generated reference-only placements. All bodies are source-built. */
OUTPUT_FORMAT("elf32-powerpc")
OUTPUT_ARCH(powerpc)
ENTRY(w3d_s21_acquire_801f7e98)
_SDA_BASE_ = 0x804b2540;
_SDA2_BASE_ = 0x804c2540;
fn_801f8754 = 0x801f8754;
fn_8020fcb4 = 0x8020fcb4;
lbl_80365808 = 0x80365808;
SECTIONS {
  .text.w3d_s21_acquire_801f7e98 0x801f7e98 : { *(.text.w3d_s21_acquire_801f7e98) }
  /DISCARD/ : { *(.text*) *(.rodata*) *(.data*) *(.bss*) *(.sdata*) *(.sbss*) *(.comment) }
}
