/* Generated reference-only placements. All bodies are source-built. */
OUTPUT_FORMAT("elf32-powerpc")
OUTPUT_ARCH(powerpc)
ENTRY(w3d_s21_u8_to_text_801fe7b4)
_SDA_BASE_ = 0x804b2540;
_SDA2_BASE_ = 0x804c2540;
fn_8020c510 = 0x8020c510;
lbl_803b29c8 = 0x803b29c8;
SECTIONS {
  .text.w3d_s21_u8_to_text_801fe7b4 0x801fe7b4 : { *(.text.w3d_s21_u8_to_text_801fe7b4) }
  /DISCARD/ : { *(.text*) *(.rodata*) *(.data*) *(.bss*) *(.sdata*) *(.sbss*) *(.comment) }
}
