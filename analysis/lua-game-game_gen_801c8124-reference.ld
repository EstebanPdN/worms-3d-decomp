/* Generated reference-only placements. All bodies are source-built. */
OUTPUT_FORMAT("elf32-powerpc")
OUTPUT_ARCH(powerpc)
ENTRY(w3d_get_801c8124)
_SDA_BASE_ = 0x804b2540;
_SDA2_BASE_ = 0x804c2540;
w3d_global_80364694 = 0x80364694;
w3d_global_803646e4 = 0x803646e4;
w3d_global_80364734 = 0x80364734;
w3d_global_80364784 = 0x80364784;
w3d_owner_list_remove = 0x8020fd2c;
w3d_registry_list_80364694 = 0x80364694;
w3d_registry_list_803646e4 = 0x803646e4;
w3d_registry_list_80364734 = 0x80364734;
w3d_registry_list_80364784 = 0x80364784;
SECTIONS {
  .text.w3d_get_801c8124 0x801c8124 : { *(.text.w3d_get_801c8124) }
  .text.w3d_get_801c8190 0x801c8190 : { *(.text.w3d_get_801c8190) }
  .text.w3d_set_801c81c8 0x801c81c8 : { *(.text.w3d_set_801c81c8) }
  .text.w3d_get_801c81d0 0x801c81d0 : { *(.text.w3d_get_801c81d0) }
  .text.w3d_set_801c81d8 0x801c81d8 : { *(.text.w3d_set_801c81d8) }
  .text.w3d_get_801c81e0 0x801c81e0 : { *(.text.w3d_get_801c81e0) }
  .text.w3d_set_801c8218 0x801c8218 : { *(.text.w3d_set_801c8218) }
  .text.w3d_get_801c8220 0x801c8220 : { *(.text.w3d_get_801c8220) }
  .text.w3d_set_801c8228 0x801c8228 : { *(.text.w3d_set_801c8228) }
  .text.w3d_get_801c8230 0x801c8230 : { *(.text.w3d_get_801c8230) }
  .text.w3d_get_801c829c 0x801c829c : { *(.text.w3d_get_801c829c) }
  .text.w3d_get_801c8308 0x801c8308 : { *(.text.w3d_get_801c8308) }
  .text.w3d_get_801c8374 0x801c8374 : { *(.text.w3d_get_801c8374) }
  .text.w3d_get_801c83e0 0x801c83e0 : { *(.text.w3d_get_801c83e0) }
  .text.w3d_set_801c8414 0x801c8414 : { *(.text.w3d_set_801c8414) }
  .text.w3d_get_801c841c 0x801c841c : { *(.text.w3d_get_801c841c) }
  .text.w3d_set_801c8478 0x801c8478 : { *(.text.w3d_set_801c8478) }
  .text.w3d_get_801c8480 0x801c8480 : { *(.text.w3d_get_801c8480) }
  .text.w3d_get_801c8580 0x801c8580 : { *(.text.w3d_get_801c8580) }
  .text.w3d_set_801c8668 0x801c8668 : { *(.text.w3d_set_801c8668) }
  .text.w3d_get_801c8670 0x801c8670 : { *(.text.w3d_get_801c8670) }
  .text.w3d_set_801c8688 0x801c8688 : { *(.text.w3d_set_801c8688) }
  .text.w3d_get_801c8690 0x801c8690 : { *(.text.w3d_get_801c8690) }
  .text.w3d_set_801c8734 0x801c8734 : { *(.text.w3d_set_801c8734) }
  .text.w3d_get_801c873c 0x801c873c : { *(.text.w3d_get_801c873c) }
  .text.w3d_set_801c8744 0x801c8744 : { *(.text.w3d_set_801c8744) }
  .text.w3d_get_801c874c 0x801c874c : { *(.text.w3d_get_801c874c) }
  .text.w3d_get_801c87b8 0x801c87b8 : { *(.text.w3d_get_801c87b8) }
  .text.w3d_get_801c8824 0x801c8824 : { *(.text.w3d_get_801c8824) }
  .text.w3d_set_801c8914 0x801c8914 : { *(.text.w3d_set_801c8914) }
  .text.w3d_get_801c891c 0x801c891c : { *(.text.w3d_get_801c891c) }
  .text.w3d_get_801c8988 0x801c8988 : { *(.text.w3d_get_801c8988) }
  .text.w3d_set_801c89dc 0x801c89dc : { *(.text.w3d_set_801c89dc) }
  .text.w3d_get_801c89e4 0x801c89e4 : { *(.text.w3d_get_801c89e4) }
  .text.w3d_set_801c89ec 0x801c89ec : { *(.text.w3d_set_801c89ec) }
  .text.w3d_get_801c89f4 0x801c89f4 : { *(.text.w3d_get_801c89f4) }
  .text.w3d_set_801c8c64 0x801c8c64 : { *(.text.w3d_set_801c8c64) }
  .text.w3d_get_801c8c6c 0x801c8c6c : { *(.text.w3d_get_801c8c6c) }
  .text.w3d_set_801c8c74 0x801c8c74 : { *(.text.w3d_set_801c8c74) }
  .text.w3d_get_801c8c7c 0x801c8c7c : { *(.text.w3d_get_801c8c7c) }
  .text.w3d_set_801c8c84 0x801c8c84 : { *(.text.w3d_set_801c8c84) }
  .text.w3d_get_801c8c8c 0x801c8c8c : { *(.text.w3d_get_801c8c8c) }
  .text.w3d_set_801c8c94 0x801c8c94 : { *(.text.w3d_set_801c8c94) }
  .text.w3d_get_801c8c9c 0x801c8c9c : { *(.text.w3d_get_801c8c9c) }
  .text.w3d_get_801c8d08 0x801c8d08 : { *(.text.w3d_get_801c8d08) }
  .text.w3d_set_801c8d10 0x801c8d10 : { *(.text.w3d_set_801c8d10) }
  .text.w3d_get_801c8d18 0x801c8d18 : { *(.text.w3d_get_801c8d18) }
  .text.w3d_set_801c8d20 0x801c8d20 : { *(.text.w3d_set_801c8d20) }
  .text.w3d_get_801c8d28 0x801c8d28 : { *(.text.w3d_get_801c8d28) }
  .text.w3d_set_801c8d30 0x801c8d30 : { *(.text.w3d_set_801c8d30) }
  .text.w3d_get_801c8d38 0x801c8d38 : { *(.text.w3d_get_801c8d38) }
  .text.w3d_set_801c8d40 0x801c8d40 : { *(.text.w3d_set_801c8d40) }
  .text.w3d_get_801c8d48 0x801c8d48 : { *(.text.w3d_get_801c8d48) }
  .text.w3d_set_801c8da0 0x801c8da0 : { *(.text.w3d_set_801c8da0) }
  .text.w3d_get_801c8da8 0x801c8da8 : { *(.text.w3d_get_801c8da8) }
  .text.w3d_set_801c8db0 0x801c8db0 : { *(.text.w3d_set_801c8db0) }
  .text.w3d_get_801c8db8 0x801c8db8 : { *(.text.w3d_get_801c8db8) }
  .text.w3d_get_801c8e94 0x801c8e94 : { *(.text.w3d_get_801c8e94) }
  .text.w3d_set_801c8f1c 0x801c8f1c : { *(.text.w3d_set_801c8f1c) }
  .text.w3d_get_801c8f24 0x801c8f24 : { *(.text.w3d_get_801c8f24) }
  .text.w3d_set_801c8f2c 0x801c8f2c : { *(.text.w3d_set_801c8f2c) }
  .text.w3d_get_801c8f34 0x801c8f34 : { *(.text.w3d_get_801c8f34) }
  .text.w3d_set_801c8f3c 0x801c8f3c : { *(.text.w3d_set_801c8f3c) }
  .text.w3d_get_801c8f44 0x801c8f44 : { *(.text.w3d_get_801c8f44) }
  .text.w3d_set_801c8f4c 0x801c8f4c : { *(.text.w3d_set_801c8f4c) }
  .text.w3d_get_801c8f54 0x801c8f54 : { *(.text.w3d_get_801c8f54) }
  .text.w3d_set_801c8fac 0x801c8fac : { *(.text.w3d_set_801c8fac) }
  .text.w3d_get_801c8fb4 0x801c8fb4 : { *(.text.w3d_get_801c8fb4) }
  .text.w3d_set_801c8fbc 0x801c8fbc : { *(.text.w3d_set_801c8fbc) }
  .text.w3d_get_801c8fc4 0x801c8fc4 : { *(.text.w3d_get_801c8fc4) }
  .text.w3d_set_801c8fcc 0x801c8fcc : { *(.text.w3d_set_801c8fcc) }
  .text.w3d_get_801c8fd4 0x801c8fd4 : { *(.text.w3d_get_801c8fd4) }
  .text.w3d_address_801c9008 0x801c9008 : { *(.text.w3d_address_801c9008) }
  .text.w3d_registry_unlink_801c907c 0x801c907c : { *(.text.w3d_registry_unlink_801c907c) }
  .text.w3d_address_801c9268 0x801c9268 : { *(.text.w3d_address_801c9268) }
  .text.w3d_registry_unlink_801c92dc 0x801c92dc : { *(.text.w3d_registry_unlink_801c92dc) }
  .text.w3d_address_801c95a4 0x801c95a4 : { *(.text.w3d_address_801c95a4) }
  .text.w3d_registry_unlink_801c9618 0x801c9618 : { *(.text.w3d_registry_unlink_801c9618) }
  .text.w3d_address_801c9800 0x801c9800 : { *(.text.w3d_address_801c9800) }
  .text.w3d_registry_unlink_801c9874 0x801c9874 : { *(.text.w3d_registry_unlink_801c9874) }
  /DISCARD/ : { *(.text*) *(.rodata*) *(.data*) *(.bss*) *(.sdata*) *(.sbss*) *(.comment) }
}
