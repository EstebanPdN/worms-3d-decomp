/* Generated reference-only placements. All bodies are source-built. */
OUTPUT_FORMAT("elf32-powerpc")
OUTPUT_ARCH(powerpc)
ENTRY(f10b_celebrate_8013faf0)
_SDA_BASE_ = 0x804b2540;
_SDA2_BASE_ = 0x804c2540;
allowed_8013fecc = 0x8013fecc;
amazing_8039fe00 = 0x8039fe00;
blend_8039fe24 = 0x8039fe24;
brilliant_8039fe08 = 0x8039fe08;
current_80139158 = 0x80139158;
excellent_8039fe14 = 0x8039fe14;
happy_8039ee9c = 0x8039ee9c;
mesh_80343584 = 0x80343584;
play_801359ec = 0x801359ec;
random_80162c20 = 0x80162c20;
rate_8039fe20 = 0x8039fe20;
speak_8013bd0c = 0x8013bd0c;
taunt_8039fdf8 = 0x8039fdf8;
zero_8039fe28 = 0x8039fe28;
SECTIONS {
  .text.f10b_celebrate_8013faf0 0x8013faf0 : { *(.text.f10b_celebrate_8013faf0) }
  .sdata 0x804ab2a4 (NOLOAD) : {
    . = 0x0; name_804ab2a4 = .;
    . = 0x4; name_804ab2a8 = .;
    . = 0x18; name_804ab2bc = .;
    . = 0x1c; name_804ab2c0 = .;
    . = 0x48; name_804ab2ec = .;
    . = 0x4c; name_804ab2f0 = .;
    . = 0x54; name_804ab2f8 = .;
    . = 0x5c; name_804ab300 = .;
    . = 0x68; name_804ab30c = .;
    . += 1; }
  /DISCARD/ : { *(.text*) *(.rodata*) *(.data*) *(.bss*) *(.sdata*) *(.sbss*) *(.comment) }
}
