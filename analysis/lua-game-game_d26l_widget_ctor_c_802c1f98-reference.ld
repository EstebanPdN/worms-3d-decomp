/* Generated reference-only placements. All bodies are source-built. */
OUTPUT_FORMAT("elf32-powerpc")
OUTPUT_ARCH(powerpc)
ENTRY(d26l_widget_ctor_c_802c1f98)
_SDA_BASE_ = 0x804b2540;
_SDA2_BASE_ = 0x804c2540;
__3Str = 0x803426b8;
fn_8015fef0 = 0x8015fef0;
ident_8045e788 = 0x8045e788;
vt_8041c8e0 = 0x8041c8e0;
SECTIONS {
  .text.d26l_widget_ctor_c_802c1f98 0x802c1f98 : { *(.text.d26l_widget_ctor_c_802c1f98) }
  .rodata 0x803d858c : { *(.rodata) }
  /DISCARD/ : { *(.text*) *(.rodata*) *(.data*) *(.bss*) *(.sdata*) *(.sbss*) *(.comment) }
}
