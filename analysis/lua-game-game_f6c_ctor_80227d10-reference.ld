/* Generated reference-only placements. All bodies are source-built. */
OUTPUT_FORMAT("elf32-powerpc")
OUTPUT_ARCH(powerpc)
ENTRY(f6c_ctor_80227d10)
_SDA_BASE_ = 0x804b2540;
_SDA2_BASE_ = 0x804c2540;
__15String_8020bb54PCc = 0x8020bb54;
fn_801ea0ec = 0x801ea0ec;
lbl_803b8198 = 0x803b8198;
lbl_803b819c = 0x803b819c;
lbl_803b8420 = 0x803b8420;
lbl_803b842c = 0x803b842c;
lbl_803b8438 = 0x803b8438;
lbl_803b8444 = 0x803b8444;
lbl_803b8450 = 0x803b8450;
lbl_803b845c = 0x803b845c;
lbl_803b8468 = 0x803b8468;
lbl_803b8474 = 0x803b8474;
lbl_803b847c = 0x803b847c;
lbl_803b8488 = 0x803b8488;
lbl_803b8494 = 0x803b8494;
lbl_803b84a0 = 0x803b84a0;
lbl_803b84ac = 0x803b84ac;
lbl_803b84b8 = 0x803b84b8;
lbl_803b84c4 = 0x803b84c4;
lbl_803b84d0 = 0x803b84d0;
lbl_803b84dc = 0x803b84dc;
lbl_803b84e8 = 0x803b84e8;
lbl_803b84f4 = 0x803b84f4;
lbl_803b8500 = 0x803b8500;
lbl_803b850c = 0x803b850c;
lbl_803b8518 = 0x803b8518;
lbl_803b8524 = 0x803b8524;
lbl_803b8530 = 0x803b8530;
lbl_803b853c = 0x803b853c;
lbl_803b8548 = 0x803b8548;
lbl_803b8554 = 0x803b8554;
lbl_803b8560 = 0x803b8560;
lbl_803b856c = 0x803b856c;
lbl_8041a118 = 0x8041a118;
SECTIONS {
  .text.f6c_ctor_80227d10 0x80227d10 : { *(.text.f6c_ctor_80227d10) }
  /DISCARD/ : { *(.text*) *(.rodata*) *(.data*) *(.bss*) *(.sdata*) *(.sbss*) *(.comment) }
}
