/* Generated reference-only placements. All bodies are source-built. */
OUTPUT_FORMAT("elf32-powerpc")
OUTPUT_ARCH(powerpc)
ENTRY(w3d_k5b_matrix3_rotate_rows01_801f63cc)
_SDA_BASE_ = 0x804b2540;
_SDA2_BASE_ = 0x804c2540;
fn_802e86d4 = 0x802e86d4;
fn_802e88ac = 0x802e88ac;
SECTIONS {
  .text.w3d_k5b_matrix3_rotate_rows01_801f63cc 0x801f63cc : { *(.text.w3d_k5b_matrix3_rotate_rows01_801f63cc) }
  /DISCARD/ : { *(.text*) *(.rodata*) *(.data*) *(.bss*) *(.sdata*) *(.sbss*) *(.comment) }
}
