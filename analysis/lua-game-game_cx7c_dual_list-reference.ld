/* Generated reference-only placements. All bodies are source-built. */
OUTPUT_FORMAT("elf32-powerpc")
OUTPUT_ARCH(powerpc)
ENTRY(w3d_cx7c_dual_list_construct_80357568)
_SDA_BASE_ = 0x804b2540;
_SDA2_BASE_ = 0x804c2540;
cx7c_allocate_80212fd4 = 0x80212fd4;
cx7c_allocation_fallback_803413d8 = 0x803413d8;
cx7c_vtable_80417220 = 0x80417220;
cx7c_vtable_80417240 = 0x80417240;
cx7c_vtable_80417260 = 0x80417260;
cx7c_vtable_80417280 = 0x80417280;
SECTIONS {
  .text.w3d_cx7c_dual_list_construct_80357568 0x80357568 : { *(.text.w3d_cx7c_dual_list_construct_80357568) }
  /DISCARD/ : { *(.text*) *(.rodata*) *(.data*) *(.bss*) *(.sdata*) *(.sbss*) *(.comment) }
}
