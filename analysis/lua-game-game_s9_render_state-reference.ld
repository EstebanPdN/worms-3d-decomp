/* Generated reference-only placements. All bodies are source-built. */
OUTPUT_FORMAT("elf32-powerpc")
OUTPUT_ARCH(powerpc)
ENTRY(s9_apply_render_state_80167dd4)
_SDA_BASE_ = 0x804b2540;
_SDA2_BASE_ = 0x804c2540;
fn_8016857C = 0x8016857c;
fn_8016A1E8 = 0x8016a1e8;
fn_803080A4 = 0x803080a4;
fn_8030990C = 0x8030990c;
fn_80309948 = 0x80309948;
fn_8030B058 = 0x8030b058;
fn_8030B4AC = 0x8030b4ac;
fn_8030B648 = 0x8030b648;
SECTIONS {
  .text.s9_apply_render_state_80167dd4 0x80167dd4 : { *(.text.s9_apply_render_state_80167dd4) }
  /DISCARD/ : { *(.text*) *(.rodata*) *(.data*) *(.bss*) *(.sdata*) *(.sbss*) *(.comment) }
}
