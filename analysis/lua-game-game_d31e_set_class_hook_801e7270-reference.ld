/* Generated reference-only placements. All bodies are source-built. */
OUTPUT_FORMAT("elf32-powerpc")
OUTPUT_ARCH(powerpc)
ENTRY(w3d_d31e_set_class_hook_801e7270)
_SDA_BASE_ = 0x804b2540;
_SDA2_BASE_ = 0x804c2540;
lbl_8045e080 = 0x8045e080;
w3d_actor_types_first = 0x8020ff3c;
w3d_auto_8020ff34 = 0x8020ff34;
SECTIONS {
  .text.w3d_d31e_set_class_hook_801e7270 0x801e7270 : { *(.text.w3d_d31e_set_class_hook_801e7270) }
  /DISCARD/ : { *(.text*) *(.rodata*) *(.data*) *(.bss*) *(.sdata*) *(.sbss*) *(.comment) }
}
