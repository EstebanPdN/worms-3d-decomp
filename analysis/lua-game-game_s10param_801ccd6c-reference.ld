/* Generated reference-only placements. All bodies are source-built. */
OUTPUT_FORMAT("elf32-powerpc")
OUTPUT_ARCH(powerpc)
ENTRY(w3d_s10_init_two_properties_801ccd6c)
_SDA_BASE_ = 0x804b2540;
_SDA2_BASE_ = 0x804c2540;
fn_801e8d9c = 0x801e8d9c;
fn_801ebbb8 = 0x801ebbb8;
lbl_803ae43c = 0x803ae43c;
lbl_803ae46c = 0x803ae46c;
SECTIONS {
  .text.w3d_s10_init_two_properties_801ccd6c 0x801ccd6c : { *(.text.w3d_s10_init_two_properties_801ccd6c) }
  /DISCARD/ : { *(.text*) *(.rodata*) *(.data*) *(.bss*) *(.sdata*) *(.sbss*) *(.comment) }
}
