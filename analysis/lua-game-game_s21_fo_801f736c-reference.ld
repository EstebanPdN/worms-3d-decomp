/* Generated reference-only placements. All bodies are source-built. */
OUTPUT_FORMAT("elf32-powerpc")
OUTPUT_ARCH(powerpc)
ENTRY(w3d_s21_static_identity4_801f736c)
_SDA_BASE_ = 0x804b2540;
_SDA2_BASE_ = 0x804c2540;
lbl_803b16f8 = 0x803b16f8;
lbl_803b16fc = 0x803b16fc;
lbl_8045e708 = 0x8045e708;
SECTIONS {
  .text.w3d_s21_static_identity4_801f736c 0x801f736c : { *(.text.w3d_s21_static_identity4_801f736c) }
  /DISCARD/ : { *(.text*) *(.rodata*) *(.data*) *(.bss*) *(.sdata*) *(.sbss*) *(.comment) }
}
