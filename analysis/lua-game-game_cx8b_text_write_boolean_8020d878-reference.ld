/* Generated reference-only placements. All bodies are source-built. */
OUTPUT_FORMAT("elf32-powerpc")
OUTPUT_ARCH(powerpc)
ENTRY(w3d_cx8b_text_write_boolean_8020d878)
_SDA_BASE_ = 0x804b2540;
_SDA2_BASE_ = 0x804c2540;
text_803b3230 = 0x803b3230;
text_803b3238 = 0x803b3238;
SECTIONS {
  .text.w3d_cx8b_text_write_boolean_8020d878 0x8020d878 : { *(.text.w3d_cx8b_text_write_boolean_8020d878) }
  /DISCARD/ : { *(.text*) *(.rodata*) *(.data*) *(.bss*) *(.sdata*) *(.sbss*) *(.comment) }
}
