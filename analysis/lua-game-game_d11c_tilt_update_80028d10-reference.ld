/* Generated reference-only placements. All bodies are source-built. */
OUTPUT_FORMAT("elf32-powerpc")
OUTPUT_ARCH(powerpc)
ENTRY(d11c_tilt_update_80028d10)
_SDA_BASE_ = 0x804b2540;
_SDA2_BASE_ = 0x804c2540;
d11c_f32_8036cea8 = 0x8036cea8;
d11c_f32_8036ceac = 0x8036ceac;
d11c_f32_8036ceb0 = 0x8036ceb0;
d11c_index_query_800fc6dc = 0x800fc6dc;
d11c_object_cast_803426b4 = 0x803426b4;
d11c_reference_index_80178c48 = 0x80178c48;
SECTIONS {
  .text.d11c_tilt_update_80028d10 0x80028d10 : { *(.text.d11c_tilt_update_80028d10) }
  /DISCARD/ : { *(.text*) *(.rodata*) *(.data*) *(.bss*) *(.sdata*) *(.sbss*) *(.comment) }
}
