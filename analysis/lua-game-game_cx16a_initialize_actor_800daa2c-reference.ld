/* Generated reference-only placements. All bodies are source-built. */
OUTPUT_FORMAT("elf32-powerpc")
OUTPUT_ARCH(powerpc)
ENTRY(w3d_cx16a_initialize_actor_800daa2c)
_SDA_BASE_ = 0x804b2540;
_SDA2_BASE_ = 0x804c2540;
base_80161014 = 0x80161014;
vtable_8040fe40 = 0x8040fe40;
zero_803897fc = 0x803897fc;
SECTIONS {
  .text.w3d_cx16a_initialize_actor_800daa2c 0x800daa2c : { *(.text.w3d_cx16a_initialize_actor_800daa2c) }
  /DISCARD/ : { *(.text*) *(.rodata*) *(.data*) *(.bss*) *(.sdata*) *(.sbss*) *(.comment) }
}
