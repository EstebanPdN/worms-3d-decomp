/* Generated reference-only placements. All bodies are source-built. */
OUTPUT_FORMAT("elf32-powerpc")
OUTPUT_ARCH(powerpc)
ENTRY(w3d_f5a_show_animation_edit_8027aa3c)
_SDA_BASE_ = 0x804b2540;
_SDA2_BASE_ = 0x804c2540;
__13Text_803426b8 = 0x803426b8;
empty_803cc0d8 = 0x803cc0d8;
fn_8020c5c4 = 0x8020c5c4;
fn_8027a934 = 0x8027a934;
fn_802cbdf8 = 0x802cbdf8;
fn_802cbf2c = 0x802cbf2c;
fn_802cbf68 = 0x802cbf68;
fn_802cc0ac = 0x802cc0ac;
fn_802cd128 = 0x802cd128;
fn_802cd220 = 0x802cd220;
fn_802cd26c = 0x802cd26c;
fn_80341588 = 0x80341588;
help_803ce850 = 0x803ce850;
label_803ce710 = 0x803ce710;
label_803ce730 = 0x803ce730;
label_803ce750 = 0x803ce750;
label_803ce770 = 0x803ce770;
label_803ce790 = 0x803ce790;
label_803ce7b0 = 0x803ce7b0;
label_803ce7d0 = 0x803ce7d0;
label_803ce7f0 = 0x803ce7f0;
label_803ce810 = 0x803ce810;
label_803ce830 = 0x803ce830;
line_803ce6f4 = 0x803ce6f4;
title_803ce6d8 = 0x803ce6d8;
SECTIONS {
  .text.w3d_f5a_show_animation_edit_8027aa3c 0x8027aa3c : { *(.text.w3d_f5a_show_animation_edit_8027aa3c) }
  /DISCARD/ : { *(.text*) *(.rodata*) *(.data*) *(.bss*) *(.sdata*) *(.sbss*) *(.comment) }
}
