/* Generated reference-only placements. All bodies are source-built. */
OUTPUT_FORMAT("elf32-powerpc")
OUTPUT_ARCH(powerpc)
ENTRY(w3d_cx9c_copy_transform_record_8034736c)
_SDA_BASE_ = 0x804b2540;
_SDA2_BASE_ = 0x804c2540;
cx9c_vtable_8040fd60 = 0x8040fd60;
cx9c_vtable_804108d8 = 0x804108d8;
SECTIONS {
  .text.w3d_cx9c_copy_transform_record_8034736c 0x8034736c : { *(.text.w3d_cx9c_copy_transform_record_8034736c) }
  /DISCARD/ : { *(.text*) *(.rodata*) *(.data*) *(.bss*) *(.sdata*) *(.sbss*) *(.comment) }
}
