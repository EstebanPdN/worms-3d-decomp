/* Generated reference-only placements. All bodies are source-built. */
OUTPUT_FORMAT("elf32-powerpc")
OUTPUT_ARCH(powerpc)
ENTRY(w3d_cx8b_transfer_begin_802e1a98)
_SDA_BASE_ = 0x804b2540;
_SDA2_BASE_ = 0x804c2540;
fn_8031ada0 = 0x8031ada0;
SECTIONS {
  .text.w3d_cx8b_transfer_begin_802e1a98 0x802e1a98 : { *(.text.w3d_cx8b_transfer_begin_802e1a98) }
  /DISCARD/ : { *(.text*) *(.rodata*) *(.data*) *(.bss*) *(.sdata*) *(.sbss*) *(.comment) }
}
