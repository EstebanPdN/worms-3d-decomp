/* Generated reference-only placements. All bodies are source-built. */
OUTPUT_FORMAT("elf32-powerpc")
OUTPUT_ARCH(powerpc)
ENTRY(w3d_cx7a_vector_set_refresh_8003e1f8)
_SDA_BASE_ = 0x804b2540;
_SDA2_BASE_ = 0x804c2540;
refresh_801262c0 = 0x801262c0;
SECTIONS {
  .text.w3d_cx7a_vector_set_refresh_8003e1f8 0x8003e1f8 : { *(.text.w3d_cx7a_vector_set_refresh_8003e1f8) }
  /DISCARD/ : { *(.text*) *(.rodata*) *(.data*) *(.bss*) *(.sdata*) *(.sbss*) *(.comment) }
}
