/* Generated reference-only placements. All bodies are source-built. */
OUTPUT_FORMAT("elf32-powerpc")
OUTPUT_ARCH(powerpc)
ENTRY(w3d_f12c_ensure_random_land_8026c54c)
_SDA_BASE_ = 0x804b2540;
_SDA2_BASE_ = 0x804c2540;
__23F12cRandomText_803426b8 = 0x803426b8;
fn_800fc1b0 = 0x800fc1b0;
fn_801790bc = 0x801790bc;
fn_80179170 = 0x80179170;
fn_8020bb2c = 0x8020bb2c;
fn_8020c5c4 = 0x8020c5c4;
fn_802ef234 = 0x802ef234;
fn_80341588 = 0x80341588;
fn_80343744 = 0x80343744;
random_803cba20 = 0x803cba20;
SECTIONS {
  .text.w3d_f12c_ensure_random_land_8026c54c 0x8026c54c : { *(.text.w3d_f12c_ensure_random_land_8026c54c) }
  /DISCARD/ : { *(.text*) *(.rodata*) *(.data*) *(.bss*) *(.sdata*) *(.sbss*) *(.comment) }
}
