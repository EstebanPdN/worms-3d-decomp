/* Generated reference-only placements. All bodies are source-built. */
OUTPUT_FORMAT("elf32-powerpc")
OUTPUT_ARCH(powerpc)
ENTRY(d29f_scheme_name_button_80292818)
_SDA_BASE_ = 0x804b2540;
_SDA2_BASE_ = 0x804c2540;
__15String_803426b8 = 0x803426b8;
__15String_803426b8PCc = 0x8020bb54;
lbl_803d0150 = 0x803d0150;
lbl_803d0164 = 0x803d0164;
lbl_803d02ac = 0x803d02ac;
lbl_803d04a4 = 0x803d04a4;
lbl_803d05ac = 0x803d05ac;
lbl_803d05b8 = 0x803d05b8;
lbl_803d05c4 = 0x803d05c4;
s8_property_read_800fc550 = 0x800fc550;
s9_update_value_80178c54 = 0x80178c54;
s9_update_value_80178d28 = 0x80178d28;
strcmp = 0x802ef234;
w3d_auto_800fc2b0 = 0x800fc2b0;
w3d_auto_801797b4 = 0x801797b4;
w3d_constructor_lookup_name = 0x800fc1b0;
w3d_constructor_native_cast = 0x80342a78;
w3d_empty_80341584 = 0x80341584;
w3d_empty_803426b4 = 0x803426b4;
w3d_string_assign = 0x8020bd38;
w3d_string_base_finish = 0x8020c5c4;
w3d_string_base_init = 0x8020c5c0;
w3d_string_format = 0x8020c510;
w3d_string_header = 0x80341884;
w3d_string_release = 0x80341588;
SECTIONS {
  .text.d29f_scheme_name_button_80292818 0x80292818 : { *(.text.d29f_scheme_name_button_80292818) }
  /DISCARD/ : { *(.text*) *(.rodata*) *(.data*) *(.bss*) *(.sdata*) *(.sbss*) *(.comment) }
}
