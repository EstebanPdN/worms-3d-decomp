/* Generated reference-only placements. All bodies are source-built. */
OUTPUT_FORMAT("elf32-powerpc")
OUTPUT_ARCH(powerpc)
ENTRY(w3d_d30e_load_tga_resource_801b44f8)
_SDA_BASE_ = 0x804b2540;
_SDA2_BASE_ = 0x804c2540;
__6StringPCc = 0x8020bb54;
lbl_80364fa4 = 0x80364fa4;
lbl_803aab64 = 0x803aab64;
lbl_804165e0 = 0x804165e0;
strrchr = 0x802efcc8;
w3d_auto_801b4938 = 0x801b4938;
w3d_d24z_strcasecmp_802ef074 = 0x802ef074;
w3d_r24b_invoke_ready_callback_8020fcb4 = 0x8020fcb4;
w3d_s10_create_entry_80208aac = 0x80208aac;
w3d_s10_service_forward_8020b680 = 0x8020b680;
w3d_string_base_finish = 0x8020c5c4;
w3d_string_release = 0x80341588;
w3d_string_release_header = 0x8020bb2c;
SECTIONS {
  .text.w3d_d30e_load_tga_resource_801b44f8 0x801b44f8 : { *(.text.w3d_d30e_load_tga_resource_801b44f8) }
  /DISCARD/ : { *(.text*) *(.rodata*) *(.data*) *(.bss*) *(.sdata*) *(.sbss*) *(.comment) }
}
