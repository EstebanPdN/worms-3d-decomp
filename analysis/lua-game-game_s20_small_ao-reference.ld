/* Generated reference-only placements. All bodies are source-built. */
OUTPUT_FORMAT("elf32-powerpc")
OUTPUT_ARCH(powerpc)
ENTRY(w3d_s20_find_value_801a688c)
_SDA_BASE_ = 0x804b2540;
_SDA2_BASE_ = 0x804c2540;
SECTIONS {
  .text.w3d_s20_find_value_801a688c 0x801a688c : { *(.text.w3d_s20_find_value_801a688c) }
  .text.w3d_s20_classify_item_bytes_801d5844 0x801d5844 : { *(.text.w3d_s20_classify_item_bytes_801d5844) }
  /DISCARD/ : { *(.text*) *(.rodata*) *(.data*) *(.bss*) *(.sdata*) *(.sbss*) *(.comment) }
}
