/* Generated reference-only placements. All bodies are source-built. */
OUTPUT_FORMAT("elf32-powerpc")
OUTPUT_ARCH(powerpc)
ENTRY(w3d_d20e_register_camera_properties_80247050)
_SDA_BASE_ = 0x804b2540;
_SDA2_BASE_ = 0x804c2540;
d20e_default_803c3c5c = 0x803c3c5c;
d20e_desc_803c3580 = 0x803c3580;
d20e_desc_803c35b4 = 0x803c35b4;
d20e_desc_803c35ec = 0x803c35ec;
d20e_desc_803c3624 = 0x803c3624;
d20e_desc_803c3658 = 0x803c3658;
d20e_desc_803c3690 = 0x803c3690;
d20e_desc_803c36c8 = 0x803c36c8;
d20e_desc_803c3700 = 0x803c3700;
d20e_desc_803c3738 = 0x803c3738;
d20e_desc_803c3770 = 0x803c3770;
d20e_desc_803c37a4 = 0x803c37a4;
d20e_desc_803c37dc = 0x803c37dc;
d20e_desc_803c3814 = 0x803c3814;
d20e_desc_803c3848 = 0x803c3848;
d20e_desc_803c387c = 0x803c387c;
d20e_desc_803c38a4 = 0x803c38a4;
d20e_desc_803c38d8 = 0x803c38d8;
d20e_desc_803c390c = 0x803c390c;
d20e_desc_803c3940 = 0x803c3940;
d20e_desc_803c3974 = 0x803c3974;
d20e_desc_803c39ac = 0x803c39ac;
d20e_desc_803c39e4 = 0x803c39e4;
d20e_desc_803c3a18 = 0x803c3a18;
d20e_desc_803c3a50 = 0x803c3a50;
d20e_desc_803c3a88 = 0x803c3a88;
d20e_desc_803c3ac4 = 0x803c3ac4;
d20e_desc_803c3afc = 0x803c3afc;
d20e_desc_803c3b30 = 0x803c3b30;
d20e_desc_803c3b68 = 0x803c3b68;
d20e_desc_803c3b9c = 0x803c3b9c;
d20e_desc_803c3bd4 = 0x803c3bd4;
d20e_desc_803c3c08 = 0x803c3c08;
d20e_desc_803c3c38 = 0x803c3c38;
d20e_finish_801e8d9c = 0x801e8d9c;
d20e_register_bits_801ebf38 = 0x801ebf38;
d20e_register_scalar_801ec52c = 0x801ec52c;
d20e_register_value_801ec0f8 = 0x801ec0f8;
d20e_register_vector_801f0210 = 0x801f0210;
SECTIONS {
  .text.w3d_d20e_register_camera_properties_80247050 0x80247050 : { *(.text.w3d_d20e_register_camera_properties_80247050) }
  /DISCARD/ : { *(.text*) *(.rodata*) *(.data*) *(.bss*) *(.sdata*) *(.sbss*) *(.comment) }
}
