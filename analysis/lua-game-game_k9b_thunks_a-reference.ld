/* Generated reference-only placements. All bodies are source-built. */
OUTPUT_FORMAT("elf32-powerpc")
OUTPUT_ARCH(powerpc)
ENTRY(__thunk_12_run_80160174__6K9bTC0PvT1)
_SDA_BASE_ = 0x804b2540;
_SDA2_BASE_ = 0x804c2540;
run_80160164__6K9bTC2 = 0x80160164;
run_8016016c__6K9bTC1 = 0x8016016c;
run_80160174__6K9bTC0PvT1 = 0x80160174;
run_80161288__6K9bTC8 = 0x80161288;
run_80161290__6K9bTC7 = 0x80161290;
run_80161298__6K9bTC6PvT1 = 0x80161298;
run_80162b24__7K9bTC11 = 0x80162b24;
run_80162b2c__7K9bTC10 = 0x80162b2c;
run_80162b34__6K9bTC9PvT1 = 0x80162b34;
run_801e882c__7K9bTC14 = 0x801e882c;
run_801e8834__7K9bTC13 = 0x801e8834;
run_801e883c__7K9bTC12PvT1 = 0x801e883c;
run_801e8960__7K9bTC17 = 0x801e8960;
run_801e8968__7K9bTC16 = 0x801e8968;
run_801e8970__7K9bTC15PvT1 = 0x801e8970;
run_801ea904__7K9bTC18 = 0x801ea904;
run_8020eec4__7K9bTC19Pv = 0x8020eec4;
run_8020f07c__7K9bTC20 = 0x8020f07c;
run_8020fb78__7K9bTC23 = 0x8020fb78;
run_8020fb80__7K9bTC22 = 0x8020fb80;
run_8020fb88__7K9bTC21PvT1 = 0x8020fb88;
run_8020fe30__6K9bTC5Pv = 0x8020fe30;
run_8020fe3c__6K9bTC3 = 0x8020fe3c;
run_8020fe48__6K9bTC4 = 0x8020fe48;
run_80211008__7K9bTC26 = 0x80211008;
run_80211064__7K9bTC25 = 0x80211064;
run_8021107c__7K9bTC24PvT1 = 0x8021107c;
run_80212aa4__7K9bTC27Pv = 0x80212aa4;
run_80212aec__7K9bTC28Pv = 0x80212aec;
run_8025fa64__7K9bTC30Pv = 0x8025fa64;
run_8025fa88__7K9bTC29Pv = 0x8025fa88;
run_8025fbb4__7K9bTC31Pv = 0x8025fbb4;
run_8025fbe8__7K9bTC32ff = 0x8025fbe8;
run_802600e8__7K9bTC34Pv = 0x802600e8;
run_80260784__7K9bTC33 = 0x80260784;
run_80266154__7K9bTC36Pv = 0x80266154;
run_80266178__7K9bTC37Pv = 0x80266178;
run_802661ac__7K9bTC35Pv = 0x802661ac;
run_80266234__7K9bTC38ff = 0x80266234;
run_802670d4__7K9bTC41Pv = 0x802670d4;
run_80267fe8__7K9bTC39Pv = 0x80267fe8;
run_802686b0__7K9bTC40 = 0x802686b0;
run_80269714__7K9bTC44Pv = 0x80269714;
run_80269860__7K9bTC43Pv = 0x80269860;
run_80269884__7K9bTC42Pv = 0x80269884;
run_8026992c__7K9bTC45ff = 0x8026992c;
run_8026b334__7K9bTC46Pv = 0x8026b334;
run_8026c6e0__7K9bTC47 = 0x8026c6e0;
run_8026eca8__7K9bTC50Pv = 0x8026eca8;
run_8026ecdc__7K9bTC49Pv = 0x8026ecdc;
run_8026f40c__7K9bTC48Pv = 0x8026f40c;
run_8026fa2c__7K9bTC52Pv = 0x8026fa2c;
run_8026ff6c__7K9bTC51ff = 0x8026ff6c;
run_802702c8__7K9bTC54Pv = 0x802702c8;
run_802704e8__7K9bTC53 = 0x802704e8;
run_802708dc__7K9bTC55Pv = 0x802708dc;
run_80270c04__7K9bTC56Pv = 0x80270c04;
run_80270c98__7K9bTC57 = 0x80270c98;
run_80285cf8__7K9bTC60Pv = 0x80285cf8;
run_80285d2c__7K9bTC59Pv = 0x80285d2c;
run_80285d50__7K9bTC61ff = 0x80285d50;
run_80286050__7K9bTC58Pv = 0x80286050;
run_80286e8c__7K9bTC62 = 0x80286e8c;
run_802870c4__7K9bTC64Pv = 0x802870c4;
run_80287254__7K9bTC63 = 0x80287254;
run_8028b7c0__7K9bTC66Pv = 0x8028b7c0;
run_8028b7e4__7K9bTC67Pv = 0x8028b7e4;
run_8028b818__7K9bTC68ff = 0x8028b818;
run_8028b990__7K9bTC65Pv = 0x8028b990;
run_8028cc88__7K9bTC69 = 0x8028cc88;
run_8028d2ac__7K9bTC71Pv = 0x8028d2ac;
run_8028d2d0__7K9bTC70Pv = 0x8028d2d0;
run_8028d2f4__7K9bTC72Pv = 0x8028d2f4;
run_8028d328__7K9bTC73ff = 0x8028d328;
run_8028dbf8__7K9bTC75Pv = 0x8028dbf8;
run_8028de08__7K9bTC74 = 0x8028de08;
run_8029eae0__7K9bTC77Pv = 0x8029eae0;
run_8029eb08__7K9bTC78Pv = 0x8029eb08;
run_8029fc08__7K9bTC76Pv = 0x8029fc08;
run_802a0cc0__7K9bTC80Pv = 0x802a0cc0;
run_802a0db4__7K9bTC79ff = 0x802a0db4;
run_802a0ebc__7K9bTC82Pv = 0x802a0ebc;
run_802a15d8__7K9bTC81 = 0x802a15d8;
run_802a1bc0__7K9bTC84Pv = 0x802a1bc0;
run_802a26b4__7K9bTC83Pv = 0x802a26b4;
run_802a2924__7K9bTC86Pv = 0x802a2924;
run_802a2cb0__7K9bTC85ff = 0x802a2cb0;
run_802a31c8__7K9bTC87Pv = 0x802a31c8;
run_802a3d28__7K9bTC88 = 0x802a3d28;
run_802a3d30__7K9bTC89 = 0x802a3d30;
run_802a50c4__7K9bTC92Pv = 0x802a50c4;
run_802a50f8__7K9bTC91Pv = 0x802a50f8;
run_802a511c__7K9bTC90Pv = 0x802a511c;
run_802a51cc__7K9bTC93ff = 0x802a51cc;
run_802a7c54__7K9bTC94 = 0x802a7c54;
run_802a7e44__7K9bTC95 = 0x802a7e44;
run_802aa11c__7K9bTC97Pv = 0x802aa11c;
run_802aa214__7K9bTC96Pv = 0x802aa214;
run_802aa2a4__7K9bTC98ff = 0x802aa2a4;
run_802ab3e8__7K9bTC99 = 0x802ab3e8;
run_802ab7d0__8K9bTC100 = 0x802ab7d0;
run_802af948__8K9bTC102Pv = 0x802af948;
run_802af97c__8K9bTC103 = 0x802af97c;
run_802af984__8K9bTC101 = 0x802af984;
run_802af9c4__8K9bTC104 = 0x802af9c4;
run_802afaec__8K9bTC105 = 0x802afaec;
run_802b4718__8K9bTC108Pv = 0x802b4718;
run_802b474c__8K9bTC107Pv = 0x802b474c;
run_802b4770__8K9bTC106Pv = 0x802b4770;
run_802b4820__8K9bTC109ff = 0x802b4820;
run_802b4d20__8K9bTC112Pv = 0x802b4d20;
run_802b509c__8K9bTC110 = 0x802b509c;
run_802b53cc__8K9bTC111 = 0x802b53cc;
run_802b6798__8K9bTC114Pv = 0x802b6798;
run_802b67bc__8K9bTC115Pv = 0x802b67bc;
run_802b67f0__8K9bTC113Pv = 0x802b67f0;
run_802b68f4__8K9bTC117Pv = 0x802b68f4;
run_802b6af0__8K9bTC116ff = 0x802b6af0;
run_802ba038__8K9bTC119Pv = 0x802ba038;
run_802ba2a4__8K9bTC118 = 0x802ba2a4;
run_802ba6dc__8K9bTC122Pv = 0x802ba6dc;
run_802bad6c__8K9bTC123 = 0x802bad6c;
run_802bad74__8K9bTC121Pv = 0x802bad74;
run_802bad98__8K9bTC120Pv = 0x802bad98;
run_802badbc__8K9bTC124 = 0x802badbc;
SECTIONS {
  .gnu.linkonce.t.__thunk_12_run_80160174__6K9bTC0PvT1 0x8034a3a0 : { *(.gnu.linkonce.t.__thunk_12_run_80160174__6K9bTC0PvT1) }
  .gnu.linkonce.t.__thunk_12_run_8016016c__6K9bTC1 0x8034a3a8 : { *(.gnu.linkonce.t.__thunk_12_run_8016016c__6K9bTC1) }
  .gnu.linkonce.t.__thunk_12_run_80160164__6K9bTC2 0x8034a3b0 : { *(.gnu.linkonce.t.__thunk_12_run_80160164__6K9bTC2) }
  .gnu.linkonce.t.__thunk_12_run_8020fe3c__6K9bTC3 0x8034a3b8 : { *(.gnu.linkonce.t.__thunk_12_run_8020fe3c__6K9bTC3) }
  .gnu.linkonce.t.__thunk_12_run_8020fe48__6K9bTC4 0x8034a3c0 : { *(.gnu.linkonce.t.__thunk_12_run_8020fe48__6K9bTC4) }
  .gnu.linkonce.t.__thunk_12_run_8020fe30__6K9bTC5Pv 0x8034a3c8 : { *(.gnu.linkonce.t.__thunk_12_run_8020fe30__6K9bTC5Pv) }
  .gnu.linkonce.t.__thunk_12_run_80161298__6K9bTC6PvT1 0x8034a3d0 : { *(.gnu.linkonce.t.__thunk_12_run_80161298__6K9bTC6PvT1) }
  .gnu.linkonce.t.__thunk_12_run_80161290__6K9bTC7 0x8034a3d8 : { *(.gnu.linkonce.t.__thunk_12_run_80161290__6K9bTC7) }
  .gnu.linkonce.t.__thunk_12_run_80161288__6K9bTC8 0x8034a3e0 : { *(.gnu.linkonce.t.__thunk_12_run_80161288__6K9bTC8) }
  .gnu.linkonce.t.__thunk_12_run_80162b34__6K9bTC9PvT1 0x8034a3e8 : { *(.gnu.linkonce.t.__thunk_12_run_80162b34__6K9bTC9PvT1) }
  .gnu.linkonce.t.__thunk_12_run_80162b2c__7K9bTC10 0x8034a3f0 : { *(.gnu.linkonce.t.__thunk_12_run_80162b2c__7K9bTC10) }
  .gnu.linkonce.t.__thunk_12_run_80162b24__7K9bTC11 0x8034a3f8 : { *(.gnu.linkonce.t.__thunk_12_run_80162b24__7K9bTC11) }
  .gnu.linkonce.t.__thunk_12_run_801e883c__7K9bTC12PvT1 0x80356524 : { *(.gnu.linkonce.t.__thunk_12_run_801e883c__7K9bTC12PvT1) }
  .gnu.linkonce.t.__thunk_12_run_801e8834__7K9bTC13 0x8035652c : { *(.gnu.linkonce.t.__thunk_12_run_801e8834__7K9bTC13) }
  .gnu.linkonce.t.__thunk_12_run_801e882c__7K9bTC14 0x80356534 : { *(.gnu.linkonce.t.__thunk_12_run_801e882c__7K9bTC14) }
  .gnu.linkonce.t.__thunk_12_run_801e8970__7K9bTC15PvT1 0x803569e4 : { *(.gnu.linkonce.t.__thunk_12_run_801e8970__7K9bTC15PvT1) }
  .gnu.linkonce.t.__thunk_12_run_801e8968__7K9bTC16 0x803569ec : { *(.gnu.linkonce.t.__thunk_12_run_801e8968__7K9bTC16) }
  .gnu.linkonce.t.__thunk_12_run_801e8960__7K9bTC17 0x803569f4 : { *(.gnu.linkonce.t.__thunk_12_run_801e8960__7K9bTC17) }
  .gnu.linkonce.t.__thunk_12_run_801ea904__7K9bTC18 0x803569fc : { *(.gnu.linkonce.t.__thunk_12_run_801ea904__7K9bTC18) }
  .gnu.linkonce.t.__thunk_16_run_8020eec4__7K9bTC19Pv 0x8035d13c : { *(.gnu.linkonce.t.__thunk_16_run_8020eec4__7K9bTC19Pv) }
  .gnu.linkonce.t.__thunk_16_run_8020f07c__7K9bTC20 0x8035d144 : { *(.gnu.linkonce.t.__thunk_16_run_8020f07c__7K9bTC20) }
  .gnu.linkonce.t.__thunk_12_run_8020fb88__7K9bTC21PvT1 0x8035d14c : { *(.gnu.linkonce.t.__thunk_12_run_8020fb88__7K9bTC21PvT1) }
  .gnu.linkonce.t.__thunk_12_run_8020fb80__7K9bTC22 0x8035d154 : { *(.gnu.linkonce.t.__thunk_12_run_8020fb80__7K9bTC22) }
  .gnu.linkonce.t.__thunk_12_run_8020fb78__7K9bTC23 0x8035d15c : { *(.gnu.linkonce.t.__thunk_12_run_8020fb78__7K9bTC23) }
  .gnu.linkonce.t.__thunk_20_run_8021107c__7K9bTC24PvT1 0x8035e048 : { *(.gnu.linkonce.t.__thunk_20_run_8021107c__7K9bTC24PvT1) }
  .gnu.linkonce.t.__thunk_20_run_80211064__7K9bTC25 0x8035e050 : { *(.gnu.linkonce.t.__thunk_20_run_80211064__7K9bTC25) }
  .gnu.linkonce.t.__thunk_20_run_80211008__7K9bTC26 0x8035e058 : { *(.gnu.linkonce.t.__thunk_20_run_80211008__7K9bTC26) }
  .gnu.linkonce.t.__thunk_20_run_80212aa4__7K9bTC27Pv 0x8035e060 : { *(.gnu.linkonce.t.__thunk_20_run_80212aa4__7K9bTC27Pv) }
  .gnu.linkonce.t.__thunk_20_run_80212aec__7K9bTC28Pv 0x8035e068 : { *(.gnu.linkonce.t.__thunk_20_run_80212aec__7K9bTC28Pv) }
  .gnu.linkonce.t.__thunk_28_run_8025fa88__7K9bTC29Pv 0x8035e9e4 : { *(.gnu.linkonce.t.__thunk_28_run_8025fa88__7K9bTC29Pv) }
  .gnu.linkonce.t.__thunk_28_run_8025fa64__7K9bTC30Pv 0x8035e9ec : { *(.gnu.linkonce.t.__thunk_28_run_8025fa64__7K9bTC30Pv) }
  .gnu.linkonce.t.__thunk_28_run_8025fbb4__7K9bTC31Pv 0x8035e9f4 : { *(.gnu.linkonce.t.__thunk_28_run_8025fbb4__7K9bTC31Pv) }
  .gnu.linkonce.t.__thunk_28_run_8025fbe8__7K9bTC32ff 0x8035e9fc : { *(.gnu.linkonce.t.__thunk_28_run_8025fbe8__7K9bTC32ff) }
  .gnu.linkonce.t.__thunk_28_run_80260784__7K9bTC33 0x8035ea04 : { *(.gnu.linkonce.t.__thunk_28_run_80260784__7K9bTC33) }
  .gnu.linkonce.t.__thunk_28_run_802600e8__7K9bTC34Pv 0x8035ea0c : { *(.gnu.linkonce.t.__thunk_28_run_802600e8__7K9bTC34Pv) }
  .gnu.linkonce.t.__thunk_28_run_802661ac__7K9bTC35Pv 0x8035ea14 : { *(.gnu.linkonce.t.__thunk_28_run_802661ac__7K9bTC35Pv) }
  .gnu.linkonce.t.__thunk_28_run_80266154__7K9bTC36Pv 0x8035ea1c : { *(.gnu.linkonce.t.__thunk_28_run_80266154__7K9bTC36Pv) }
  .gnu.linkonce.t.__thunk_28_run_80266178__7K9bTC37Pv 0x8035ea24 : { *(.gnu.linkonce.t.__thunk_28_run_80266178__7K9bTC37Pv) }
  .gnu.linkonce.t.__thunk_28_run_80266234__7K9bTC38ff 0x8035ea2c : { *(.gnu.linkonce.t.__thunk_28_run_80266234__7K9bTC38ff) }
  .gnu.linkonce.t.__thunk_28_run_80267fe8__7K9bTC39Pv 0x8035ea34 : { *(.gnu.linkonce.t.__thunk_28_run_80267fe8__7K9bTC39Pv) }
  .gnu.linkonce.t.__thunk_28_run_802686b0__7K9bTC40 0x8035ea3c : { *(.gnu.linkonce.t.__thunk_28_run_802686b0__7K9bTC40) }
  .gnu.linkonce.t.__thunk_28_run_802670d4__7K9bTC41Pv 0x8035ea44 : { *(.gnu.linkonce.t.__thunk_28_run_802670d4__7K9bTC41Pv) }
  .gnu.linkonce.t.__thunk_28_run_80269884__7K9bTC42Pv 0x8035ea4c : { *(.gnu.linkonce.t.__thunk_28_run_80269884__7K9bTC42Pv) }
  .gnu.linkonce.t.__thunk_28_run_80269860__7K9bTC43Pv 0x8035ea54 : { *(.gnu.linkonce.t.__thunk_28_run_80269860__7K9bTC43Pv) }
  .gnu.linkonce.t.__thunk_28_run_80269714__7K9bTC44Pv 0x8035ea5c : { *(.gnu.linkonce.t.__thunk_28_run_80269714__7K9bTC44Pv) }
  .gnu.linkonce.t.__thunk_28_run_8026992c__7K9bTC45ff 0x8035ea64 : { *(.gnu.linkonce.t.__thunk_28_run_8026992c__7K9bTC45ff) }
  .gnu.linkonce.t.__thunk_28_run_8026b334__7K9bTC46Pv 0x8035ea6c : { *(.gnu.linkonce.t.__thunk_28_run_8026b334__7K9bTC46Pv) }
  .gnu.linkonce.t.__thunk_28_run_8026c6e0__7K9bTC47 0x8035ea74 : { *(.gnu.linkonce.t.__thunk_28_run_8026c6e0__7K9bTC47) }
  .gnu.linkonce.t.__thunk_28_run_8026f40c__7K9bTC48Pv 0x8035ea7c : { *(.gnu.linkonce.t.__thunk_28_run_8026f40c__7K9bTC48Pv) }
  .gnu.linkonce.t.__thunk_28_run_8026ecdc__7K9bTC49Pv 0x8035ea84 : { *(.gnu.linkonce.t.__thunk_28_run_8026ecdc__7K9bTC49Pv) }
  .gnu.linkonce.t.__thunk_28_run_8026eca8__7K9bTC50Pv 0x8035ea8c : { *(.gnu.linkonce.t.__thunk_28_run_8026eca8__7K9bTC50Pv) }
  .gnu.linkonce.t.__thunk_28_run_8026ff6c__7K9bTC51ff 0x8035ea94 : { *(.gnu.linkonce.t.__thunk_28_run_8026ff6c__7K9bTC51ff) }
  .gnu.linkonce.t.__thunk_28_run_8026fa2c__7K9bTC52Pv 0x8035ea9c : { *(.gnu.linkonce.t.__thunk_28_run_8026fa2c__7K9bTC52Pv) }
  .gnu.linkonce.t.__thunk_28_run_802704e8__7K9bTC53 0x8035eaa4 : { *(.gnu.linkonce.t.__thunk_28_run_802704e8__7K9bTC53) }
  .gnu.linkonce.t.__thunk_28_run_802702c8__7K9bTC54Pv 0x8035eaac : { *(.gnu.linkonce.t.__thunk_28_run_802702c8__7K9bTC54Pv) }
  .gnu.linkonce.t.__thunk_28_run_802708dc__7K9bTC55Pv 0x8035eab4 : { *(.gnu.linkonce.t.__thunk_28_run_802708dc__7K9bTC55Pv) }
  .gnu.linkonce.t.__thunk_28_run_80270c04__7K9bTC56Pv 0x8035eac4 : { *(.gnu.linkonce.t.__thunk_28_run_80270c04__7K9bTC56Pv) }
  .gnu.linkonce.t.__thunk_28_run_80270c98__7K9bTC57 0x8035eacc : { *(.gnu.linkonce.t.__thunk_28_run_80270c98__7K9bTC57) }
  .gnu.linkonce.t.__thunk_28_run_80286050__7K9bTC58Pv 0x8035ead4 : { *(.gnu.linkonce.t.__thunk_28_run_80286050__7K9bTC58Pv) }
  .gnu.linkonce.t.__thunk_28_run_80285d2c__7K9bTC59Pv 0x8035eadc : { *(.gnu.linkonce.t.__thunk_28_run_80285d2c__7K9bTC59Pv) }
  .gnu.linkonce.t.__thunk_28_run_80285cf8__7K9bTC60Pv 0x8035eae4 : { *(.gnu.linkonce.t.__thunk_28_run_80285cf8__7K9bTC60Pv) }
  .gnu.linkonce.t.__thunk_28_run_80285d50__7K9bTC61ff 0x8035eaec : { *(.gnu.linkonce.t.__thunk_28_run_80285d50__7K9bTC61ff) }
  .gnu.linkonce.t.__thunk_28_run_80286e8c__7K9bTC62 0x8035eaf4 : { *(.gnu.linkonce.t.__thunk_28_run_80286e8c__7K9bTC62) }
  .gnu.linkonce.t.__thunk_28_run_80287254__7K9bTC63 0x8035eafc : { *(.gnu.linkonce.t.__thunk_28_run_80287254__7K9bTC63) }
  .gnu.linkonce.t.__thunk_28_run_802870c4__7K9bTC64Pv 0x8035eb04 : { *(.gnu.linkonce.t.__thunk_28_run_802870c4__7K9bTC64Pv) }
  .gnu.linkonce.t.__thunk_28_run_8028b990__7K9bTC65Pv 0x8035ebb4 : { *(.gnu.linkonce.t.__thunk_28_run_8028b990__7K9bTC65Pv) }
  .gnu.linkonce.t.__thunk_28_run_8028b7c0__7K9bTC66Pv 0x8035ebbc : { *(.gnu.linkonce.t.__thunk_28_run_8028b7c0__7K9bTC66Pv) }
  .gnu.linkonce.t.__thunk_28_run_8028b7e4__7K9bTC67Pv 0x8035ebc4 : { *(.gnu.linkonce.t.__thunk_28_run_8028b7e4__7K9bTC67Pv) }
  .gnu.linkonce.t.__thunk_28_run_8028b818__7K9bTC68ff 0x8035ebcc : { *(.gnu.linkonce.t.__thunk_28_run_8028b818__7K9bTC68ff) }
  .gnu.linkonce.t.__thunk_28_run_8028cc88__7K9bTC69 0x8035ebd4 : { *(.gnu.linkonce.t.__thunk_28_run_8028cc88__7K9bTC69) }
  .gnu.linkonce.t.__thunk_28_run_8028d2d0__7K9bTC70Pv 0x8035ebdc : { *(.gnu.linkonce.t.__thunk_28_run_8028d2d0__7K9bTC70Pv) }
  .gnu.linkonce.t.__thunk_28_run_8028d2ac__7K9bTC71Pv 0x8035ebe4 : { *(.gnu.linkonce.t.__thunk_28_run_8028d2ac__7K9bTC71Pv) }
  .gnu.linkonce.t.__thunk_28_run_8028d2f4__7K9bTC72Pv 0x8035ebec : { *(.gnu.linkonce.t.__thunk_28_run_8028d2f4__7K9bTC72Pv) }
  .gnu.linkonce.t.__thunk_28_run_8028d328__7K9bTC73ff 0x8035ebf4 : { *(.gnu.linkonce.t.__thunk_28_run_8028d328__7K9bTC73ff) }
  .gnu.linkonce.t.__thunk_28_run_8028de08__7K9bTC74 0x8035ebfc : { *(.gnu.linkonce.t.__thunk_28_run_8028de08__7K9bTC74) }
  .gnu.linkonce.t.__thunk_28_run_8028dbf8__7K9bTC75Pv 0x8035ec04 : { *(.gnu.linkonce.t.__thunk_28_run_8028dbf8__7K9bTC75Pv) }
  .gnu.linkonce.t.__thunk_28_run_8029fc08__7K9bTC76Pv 0x8035f21c : { *(.gnu.linkonce.t.__thunk_28_run_8029fc08__7K9bTC76Pv) }
  .gnu.linkonce.t.__thunk_28_run_8029eae0__7K9bTC77Pv 0x8035f224 : { *(.gnu.linkonce.t.__thunk_28_run_8029eae0__7K9bTC77Pv) }
  .gnu.linkonce.t.__thunk_28_run_8029eb08__7K9bTC78Pv 0x8035f22c : { *(.gnu.linkonce.t.__thunk_28_run_8029eb08__7K9bTC78Pv) }
  .gnu.linkonce.t.__thunk_28_run_802a0db4__7K9bTC79ff 0x8035f23c : { *(.gnu.linkonce.t.__thunk_28_run_802a0db4__7K9bTC79ff) }
  .gnu.linkonce.t.__thunk_28_run_802a0cc0__7K9bTC80Pv 0x8035f244 : { *(.gnu.linkonce.t.__thunk_28_run_802a0cc0__7K9bTC80Pv) }
  .gnu.linkonce.t.__thunk_28_run_802a15d8__7K9bTC81 0x8035f24c : { *(.gnu.linkonce.t.__thunk_28_run_802a15d8__7K9bTC81) }
  .gnu.linkonce.t.__thunk_28_run_802a0ebc__7K9bTC82Pv 0x8035f254 : { *(.gnu.linkonce.t.__thunk_28_run_802a0ebc__7K9bTC82Pv) }
  .gnu.linkonce.t.__thunk_28_run_802a26b4__7K9bTC83Pv 0x8035f25c : { *(.gnu.linkonce.t.__thunk_28_run_802a26b4__7K9bTC83Pv) }
  .gnu.linkonce.t.__thunk_28_run_802a1bc0__7K9bTC84Pv 0x8035f264 : { *(.gnu.linkonce.t.__thunk_28_run_802a1bc0__7K9bTC84Pv) }
  .gnu.linkonce.t.__thunk_28_run_802a2cb0__7K9bTC85ff 0x8035f26c : { *(.gnu.linkonce.t.__thunk_28_run_802a2cb0__7K9bTC85ff) }
  .gnu.linkonce.t.__thunk_28_run_802a2924__7K9bTC86Pv 0x8035f274 : { *(.gnu.linkonce.t.__thunk_28_run_802a2924__7K9bTC86Pv) }
  .gnu.linkonce.t.__thunk_28_run_802a31c8__7K9bTC87Pv 0x8035f27c : { *(.gnu.linkonce.t.__thunk_28_run_802a31c8__7K9bTC87Pv) }
  .gnu.linkonce.t.__thunk_28_run_802a3d28__7K9bTC88 0x8035f284 : { *(.gnu.linkonce.t.__thunk_28_run_802a3d28__7K9bTC88) }
  .gnu.linkonce.t.__thunk_28_run_802a3d30__7K9bTC89 0x8035f28c : { *(.gnu.linkonce.t.__thunk_28_run_802a3d30__7K9bTC89) }
  .gnu.linkonce.t.__thunk_28_run_802a511c__7K9bTC90Pv 0x8035f294 : { *(.gnu.linkonce.t.__thunk_28_run_802a511c__7K9bTC90Pv) }
  .gnu.linkonce.t.__thunk_28_run_802a50f8__7K9bTC91Pv 0x8035f29c : { *(.gnu.linkonce.t.__thunk_28_run_802a50f8__7K9bTC91Pv) }
  .gnu.linkonce.t.__thunk_28_run_802a50c4__7K9bTC92Pv 0x8035f2a4 : { *(.gnu.linkonce.t.__thunk_28_run_802a50c4__7K9bTC92Pv) }
  .gnu.linkonce.t.__thunk_28_run_802a51cc__7K9bTC93ff 0x8035f2ac : { *(.gnu.linkonce.t.__thunk_28_run_802a51cc__7K9bTC93ff) }
  .gnu.linkonce.t.__thunk_28_run_802a7c54__7K9bTC94 0x8035f2b4 : { *(.gnu.linkonce.t.__thunk_28_run_802a7c54__7K9bTC94) }
  .gnu.linkonce.t.__thunk_28_run_802a7e44__7K9bTC95 0x8035f2bc : { *(.gnu.linkonce.t.__thunk_28_run_802a7e44__7K9bTC95) }
  .gnu.linkonce.t.__thunk_28_run_802aa214__7K9bTC96Pv 0x8035f2c4 : { *(.gnu.linkonce.t.__thunk_28_run_802aa214__7K9bTC96Pv) }
  .gnu.linkonce.t.__thunk_28_run_802aa11c__7K9bTC97Pv 0x8035f2cc : { *(.gnu.linkonce.t.__thunk_28_run_802aa11c__7K9bTC97Pv) }
  .gnu.linkonce.t.__thunk_28_run_802aa2a4__7K9bTC98ff 0x8035f2d4 : { *(.gnu.linkonce.t.__thunk_28_run_802aa2a4__7K9bTC98ff) }
  .gnu.linkonce.t.__thunk_28_run_802ab3e8__7K9bTC99 0x8035f2dc : { *(.gnu.linkonce.t.__thunk_28_run_802ab3e8__7K9bTC99) }
  .gnu.linkonce.t.__thunk_28_run_802ab7d0__8K9bTC100 0x8035f2e4 : { *(.gnu.linkonce.t.__thunk_28_run_802ab7d0__8K9bTC100) }
  .gnu.linkonce.t.__thunk_28_run_802af984__8K9bTC101 0x8035f2ec : { *(.gnu.linkonce.t.__thunk_28_run_802af984__8K9bTC101) }
  .gnu.linkonce.t.__thunk_28_run_802af948__8K9bTC102Pv 0x8035f2f4 : { *(.gnu.linkonce.t.__thunk_28_run_802af948__8K9bTC102Pv) }
  .gnu.linkonce.t.__thunk_28_run_802af97c__8K9bTC103 0x8035f2fc : { *(.gnu.linkonce.t.__thunk_28_run_802af97c__8K9bTC103) }
  .gnu.linkonce.t.__thunk_28_run_802af9c4__8K9bTC104 0x8035f304 : { *(.gnu.linkonce.t.__thunk_28_run_802af9c4__8K9bTC104) }
  .gnu.linkonce.t.__thunk_28_run_802afaec__8K9bTC105 0x8035f30c : { *(.gnu.linkonce.t.__thunk_28_run_802afaec__8K9bTC105) }
  .gnu.linkonce.t.__thunk_28_run_802b4770__8K9bTC106Pv 0x8035f314 : { *(.gnu.linkonce.t.__thunk_28_run_802b4770__8K9bTC106Pv) }
  .gnu.linkonce.t.__thunk_28_run_802b474c__8K9bTC107Pv 0x8035f31c : { *(.gnu.linkonce.t.__thunk_28_run_802b474c__8K9bTC107Pv) }
  .gnu.linkonce.t.__thunk_28_run_802b4718__8K9bTC108Pv 0x8035f324 : { *(.gnu.linkonce.t.__thunk_28_run_802b4718__8K9bTC108Pv) }
  .gnu.linkonce.t.__thunk_28_run_802b4820__8K9bTC109ff 0x8035f32c : { *(.gnu.linkonce.t.__thunk_28_run_802b4820__8K9bTC109ff) }
  .gnu.linkonce.t.__thunk_28_run_802b509c__8K9bTC110 0x8035f334 : { *(.gnu.linkonce.t.__thunk_28_run_802b509c__8K9bTC110) }
  .gnu.linkonce.t.__thunk_28_run_802b53cc__8K9bTC111 0x8035f33c : { *(.gnu.linkonce.t.__thunk_28_run_802b53cc__8K9bTC111) }
  .gnu.linkonce.t.__thunk_28_run_802b4d20__8K9bTC112Pv 0x8035f344 : { *(.gnu.linkonce.t.__thunk_28_run_802b4d20__8K9bTC112Pv) }
  .gnu.linkonce.t.__thunk_28_run_802b67f0__8K9bTC113Pv 0x8035f34c : { *(.gnu.linkonce.t.__thunk_28_run_802b67f0__8K9bTC113Pv) }
  .gnu.linkonce.t.__thunk_28_run_802b6798__8K9bTC114Pv 0x8035f354 : { *(.gnu.linkonce.t.__thunk_28_run_802b6798__8K9bTC114Pv) }
  .gnu.linkonce.t.__thunk_28_run_802b67bc__8K9bTC115Pv 0x8035f35c : { *(.gnu.linkonce.t.__thunk_28_run_802b67bc__8K9bTC115Pv) }
  .gnu.linkonce.t.__thunk_28_run_802b6af0__8K9bTC116ff 0x8035f364 : { *(.gnu.linkonce.t.__thunk_28_run_802b6af0__8K9bTC116ff) }
  .gnu.linkonce.t.__thunk_28_run_802b68f4__8K9bTC117Pv 0x8035f36c : { *(.gnu.linkonce.t.__thunk_28_run_802b68f4__8K9bTC117Pv) }
  .gnu.linkonce.t.__thunk_28_run_802ba2a4__8K9bTC118 0x8035f374 : { *(.gnu.linkonce.t.__thunk_28_run_802ba2a4__8K9bTC118) }
  .gnu.linkonce.t.__thunk_28_run_802ba038__8K9bTC119Pv 0x8035f37c : { *(.gnu.linkonce.t.__thunk_28_run_802ba038__8K9bTC119Pv) }
  .gnu.linkonce.t.__thunk_28_run_802bad98__8K9bTC120Pv 0x8035f384 : { *(.gnu.linkonce.t.__thunk_28_run_802bad98__8K9bTC120Pv) }
  .gnu.linkonce.t.__thunk_28_run_802bad74__8K9bTC121Pv 0x8035f38c : { *(.gnu.linkonce.t.__thunk_28_run_802bad74__8K9bTC121Pv) }
  .gnu.linkonce.t.__thunk_28_run_802ba6dc__8K9bTC122Pv 0x8035f394 : { *(.gnu.linkonce.t.__thunk_28_run_802ba6dc__8K9bTC122Pv) }
  .gnu.linkonce.t.__thunk_28_run_802bad6c__8K9bTC123 0x8035f39c : { *(.gnu.linkonce.t.__thunk_28_run_802bad6c__8K9bTC123) }
  .gnu.linkonce.t.__thunk_28_run_802badbc__8K9bTC124 0x8035f3a4 : { *(.gnu.linkonce.t.__thunk_28_run_802badbc__8K9bTC124) }
  /DISCARD/ : { *(.text*) *(.rodata*) *(.data*) *(.bss*) *(.sdata*) *(.sbss*) *(.comment) }
}
