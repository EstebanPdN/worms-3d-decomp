/* Generated reference-only placements. All bodies are source-built. */
OUTPUT_FORMAT("elf32-powerpc")
OUTPUT_ARCH(powerpc)
ENTRY(w3d_d24e_skip_duplicate_b_801a7d40)
_SDA_BASE_ = 0x804b2540;
_SDA2_BASE_ = 0x804c2540;
fn_801a7680 = 0x801a7680;
SECTIONS {
  .text.w3d_d24e_skip_duplicate_b_801a7d40 0x801a7d40 : { *(.text.w3d_d24e_skip_duplicate_b_801a7d40) }
  /DISCARD/ : { *(.text*) *(.rodata*) *(.data*) *(.bss*) *(.sdata*) *(.sbss*) *(.comment) }
}
