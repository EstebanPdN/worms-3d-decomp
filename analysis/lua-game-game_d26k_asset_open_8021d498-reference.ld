/* Generated reference-only placements. All bodies are source-built. */
OUTPUT_FORMAT("elf32-powerpc")
OUTPUT_ARCH(powerpc)
ENTRY(w3d_d26k_asset_open_8021d498)
_SDA_BASE_ = 0x804b2540;
_SDA2_BASE_ = 0x804c2540;
__15String_8020bb54PCc = 0x8020bb54;
extent_8021d830 = 0x8021d830;
field_80240700 = 0x80240700;
probe_8021d8b4 = 0x8021d8b4;
read_8021d5c4 = 0x8021d5c4;
release_header_8020bb2c = 0x8020bb2c;
string_finish_8020c5c4 = 0x8020c5c4;
string_release_80341588 = 0x80341588;
SECTIONS {
  .text.w3d_d26k_asset_open_8021d498 0x8021d498 : { *(.text.w3d_d26k_asset_open_8021d498) }
  /DISCARD/ : { *(.text*) *(.rodata*) *(.data*) *(.bss*) *(.sdata*) *(.sbss*) *(.comment) }
}
