/* Generated reference-only placements. All bodies are source-built. */
OUTPUT_FORMAT("elf32-powerpc")
OUTPUT_ARCH(powerpc)
ENTRY(w3d_s10_registry_remove_80206d08)
_SDA_BASE_ = 0x804b2540;
_SDA2_BASE_ = 0x804c2540;
fn_80206e14 = 0x80206e14;
fn_8020fd2c = 0x8020fd2c;
lbl_8045ee24 = 0x8045ee24;
SECTIONS {
  .text.w3d_s10_registry_remove_80206d08 0x80206d08 : { *(.text.w3d_s10_registry_remove_80206d08) }
  /DISCARD/ : { *(.text*) *(.rodata*) *(.data*) *(.bss*) *(.sdata*) *(.sbss*) *(.comment) }
}
