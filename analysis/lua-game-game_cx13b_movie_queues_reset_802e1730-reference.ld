/* Generated reference-only placements. All bodies are source-built. */
OUTPUT_FORMAT("elf32-powerpc")
OUTPUT_ARCH(powerpc)
ENTRY(w3d_cx13b_movie_queues_reset_802e1730)
_SDA_BASE_ = 0x804b2540;
_SDA2_BASE_ = 0x804c2540;
cancel_802f7a68 = 0x802f7a68;
SECTIONS {
  .text.w3d_cx13b_movie_queues_reset_802e1730 0x802e1730 : { *(.text.w3d_cx13b_movie_queues_reset_802e1730) }
  /DISCARD/ : { *(.text*) *(.rodata*) *(.data*) *(.bss*) *(.sdata*) *(.sbss*) *(.comment) }
}
