/* Generated reference-only placements. All bodies are source-built. */
OUTPUT_FORMAT("elf32-powerpc")
OUTPUT_ARCH(powerpc)
ENTRY(d30s_string_index_ctor_80203204)
_SDA_BASE_ = 0x804b2540;
_SDA2_BASE_ = 0x804c2540;
_S_oom_malloc__Q24_STLt14__malloc_alloc1i0Ui = 0x803413d8;
d30s_empty_string_804b06a0 = 0x804b06a0;
insert_unique__Q24_STLt8_Rb_tree5Z7D30sStrZQ24_STLt4pair2ZC7D30sStrZiZQ24_STLt10_Select1st1ZQ24_STLt4pair2ZC7D30sStrZiZ13D30sStrLessFnZQ24_STLt9allocator1ZQ24_STLt4pair2ZC7D30sStrZiGQ24_STLt17_Rb_tree_iterator2ZQ24_STLt4pair2ZC7D30sStrZiZQ24_STLt16_Nonconst_traits1ZQ24_STLt4pair2ZC7D30sStrZiRCQ24_STLt4pair2ZC7D30sStrZi = 0x8035a6f8;
malloc = 0x80212fd4;
strcmp = 0x802ef234;
w3d_string_base_finish = 0x8020c5c4;
w3d_string_base_init = 0x8020c5c0;
w3d_string_header = 0x80341884;
w3d_string_release = 0x80341588;
SECTIONS {
  .text.d30s_string_index_ctor_80203204 0x80203204 : { *(.text.d30s_string_index_ctor_80203204) }
  /DISCARD/ : { *(.text*) *(.rodata*) *(.data*) *(.bss*) *(.sdata*) *(.sbss*) *(.comment) }
}
