/* Generated reference-only placements. All bodies are source-built. */
OUTPUT_FORMAT("elf32-powerpc")
OUTPUT_ARCH(powerpc)
ENTRY(w3d_cx14b_compressed_stream_attach_801f937c)
_SDA_BASE_ = 0x804b2540;
_SDA2_BASE_ = 0x804c2540;
initialize_802c8304 = 0x802c8304;
version_803b19d4 = 0x803b19d4;
SECTIONS {
  .text.w3d_cx14b_compressed_stream_attach_801f937c 0x801f937c : { *(.text.w3d_cx14b_compressed_stream_attach_801f937c) }
  /DISCARD/ : { *(.text*) *(.rodata*) *(.data*) *(.bss*) *(.sdata*) *(.sbss*) *(.comment) }
}
