/* Generated reference-only placements. All bodies are source-built. */
OUTPUT_FORMAT("elf32-powerpc")
OUTPUT_ARCH(powerpc)
ENTRY(w3d_f5a_show_title_edit_80272e28)
_SDA_BASE_ = 0x804b2540;
_SDA2_BASE_ = 0x804c2540;
__13Text_803426b8 = 0x803426b8;
empty_803cc0d8 = 0x803cc0d8;
false_803cc86c = 0x803cc86c;
fn_8020c510 = 0x8020c510;
fn_8020c5c4 = 0x8020c5c4;
fn_8027a934 = 0x8027a934;
fn_802cbdf8 = 0x802cbdf8;
fn_802cbf2c = 0x802cbf2c;
fn_802cbfa4 = 0x802cbfa4;
fn_802cc0ac = 0x802cc0ac;
fn_802cd128 = 0x802cd128;
fn_802cd220 = 0x802cd220;
fn_802cd26c = 0x802cd26c;
fn_80341588 = 0x80341588;
format_803ccbb8 = 0x803ccbb8;
help_803cc8b4 = 0x803cc8b4;
label_803ccb58 = 0x803ccb58;
label_803ccb78 = 0x803ccb78;
label_803ccb98 = 0x803ccb98;
label_803ccbc4 = 0x803ccbc4;
label_803ccbe4 = 0x803ccbe4;
label_803ccc04 = 0x803ccc04;
line_803ccb48 = 0x803ccb48;
title_803ccb38 = 0x803ccb38;
true_803cc864 = 0x803cc864;
SECTIONS {
  .text.w3d_f5a_show_title_edit_80272e28 0x80272e28 : { *(.text.w3d_f5a_show_title_edit_80272e28) }
  /DISCARD/ : { *(.text*) *(.rodata*) *(.data*) *(.bss*) *(.sdata*) *(.sbss*) *(.comment) }
}
