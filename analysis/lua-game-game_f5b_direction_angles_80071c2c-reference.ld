/* Generated reference-only placements. All bodies are source-built. */
OUTPUT_FORMAT("elf32-powerpc")
OUTPUT_ARCH(powerpc)
ENTRY(f5b_direction_angles_80071c2c)
_SDA_BASE_ = 0x804b2540;
_SDA2_BASE_ = 0x804c2540;
fn_801a3eb0 = 0x801a3eb0;
fn_802e7c30 = 0x802e7c30;
fn_802e82c0 = 0x802e82c0;
one_8037cacc = 0x8037cacc;
turn_8037cad0 = 0x8037cad0;
zero_8037cac8 = 0x8037cac8;
SECTIONS {
  .text.f5b_direction_angles_80071c2c 0x80071c2c : { *(.text.f5b_direction_angles_80071c2c) }
  /DISCARD/ : { *(.text*) *(.rodata*) *(.data*) *(.bss*) *(.sdata*) *(.sbss*) *(.comment) }
}
