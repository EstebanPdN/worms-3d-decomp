/* Generated reference-only placements. All bodies are source-built. */
OUTPUT_FORMAT("elf32-powerpc")
OUTPUT_ARCH(powerpc)
ENTRY(w3d_s21_destroy_global_801ea910)
_SDA_BASE_ = 0x804b2540;
_SDA2_BASE_ = 0x804c2540;
fn_80356ef8 = 0x80356ef8;
fn_80357230 = 0x80357230;
lbl_8045e0f8 = 0x8045e0f8;
SECTIONS {
  .text.w3d_s21_destroy_global_801ea910 0x801ea910 : { *(.text.w3d_s21_destroy_global_801ea910) }
  /DISCARD/ : { *(.text*) *(.rodata*) *(.data*) *(.bss*) *(.sdata*) *(.sbss*) *(.comment) }
}
