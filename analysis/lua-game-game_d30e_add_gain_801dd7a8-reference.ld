/* Generated reference-only placements. All bodies are source-built. */
OUTPUT_FORMAT("elf32-powerpc")
OUTPUT_ARCH(powerpc)
ENTRY(w3d_d30e_add_gain_801dd7a8)
_SDA_BASE_ = 0x804b2540;
_SDA2_BASE_ = 0x804c2540;
_._4Gain = 0x801daf5c;
_S_oom_malloc__Q24_STLt14__malloc_alloc1i0Ui = 0x803413d8;
__4Gain = 0x801daf38;
bind__4GainG4URefi = 0x801dafbc;
free = 0x802134fc;
malloc = 0x80212fd4;
SECTIONS {
  .text.w3d_d30e_add_gain_801dd7a8 0x801dd7a8 : { *(.text.w3d_d30e_add_gain_801dd7a8) }
  /DISCARD/ : { *(.text*) *(.rodata*) *(.data*) *(.bss*) *(.sdata*) *(.sbss*) *(.comment) }
}
