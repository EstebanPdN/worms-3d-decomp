/* Generated reference-only placements. All bodies are source-built. */
OUTPUT_FORMAT("elf32-powerpc")
OUTPUT_ARCH(powerpc)
ENTRY(w3d_k7b_settings_object_ctor_801ce3f4)
_SDA_BASE_ = 0x804b2540;
_SDA2_BASE_ = 0x804c2540;
lbl_80415e70 = 0x80415e70;
lbl_8045e708 = 0x8045e708;
w3d_ctor_801ce28c = 0x801ce28c;
SECTIONS {
  .text.w3d_k7b_settings_object_ctor_801ce3f4 0x801ce3f4 : { *(.text.w3d_k7b_settings_object_ctor_801ce3f4) }
  /DISCARD/ : { *(.text*) *(.rodata*) *(.data*) *(.bss*) *(.sdata*) *(.sbss*) *(.comment) }
}
