/* Generated reference-only placements. All bodies are source-built. */
OUTPUT_FORMAT("elf32-powerpc")
OUTPUT_ARCH(powerpc)
ENTRY(w3d_cc17b_name_hash_80177e28)
_SDA_BASE_ = 0x804b2540;
_SDA2_BASE_ = 0x804c2540;
fn_802ef9c0 = 0x802ef9c0;
SECTIONS {
  .text.w3d_cc17b_name_hash_80177e28 0x80177e28 : { *(.text.w3d_cc17b_name_hash_80177e28) }
  /DISCARD/ : { *(.text*) *(.rodata*) *(.data*) *(.bss*) *(.sdata*) *(.sbss*) *(.comment) }
}
