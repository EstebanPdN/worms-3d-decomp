/* Generated reference-only placements. All bodies are source-built. */
OUTPUT_FORMAT("elf32-powerpc")
OUTPUT_ARCH(powerpc)
ENTRY(w3d_cc25b_refresh_tags_801a7ed8)
_SDA_BASE_ = 0x804b2540;
_SDA2_BASE_ = 0x804c2540;
cc25b_global_80363c14 = 0x80363c14;
cc25b_global_80363c64 = 0x80363c64;
SECTIONS {
  .text.w3d_cc25b_refresh_tags_801a7ed8 0x801a7ed8 : { *(.text.w3d_cc25b_refresh_tags_801a7ed8) }
  /DISCARD/ : { *(.text*) *(.rodata*) *(.data*) *(.bss*) *(.sdata*) *(.sbss*) *(.comment) }
}
