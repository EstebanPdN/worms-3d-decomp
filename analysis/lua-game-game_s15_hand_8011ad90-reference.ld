/* Generated reference-only placements. All bodies are source-built. */
OUTPUT_FORMAT("elf32-powerpc")
OUTPUT_ARCH(powerpc)
ENTRY(s15_update_saved_effect_8011ad90)
_SDA_BASE_ = 0x804b2540;
_SDA2_BASE_ = 0x804c2540;
fn_8011bc28 = 0x8011bc28;
fn_8018c5b0 = 0x8018c5b0;
fn_8018d35c = 0x8018d35c;
fn_8018d434 = 0x8018d434;
fn_80343580 = 0x80343580;
SECTIONS {
  .text.s15_update_saved_effect_8011ad90 0x8011ad90 : { *(.text.s15_update_saved_effect_8011ad90) }
  /DISCARD/ : { *(.text*) *(.rodata*) *(.data*) *(.bss*) *(.sdata*) *(.sbss*) *(.comment) }
}
