/* Generated reference-only placements. All bodies are source-built. */
OUTPUT_FORMAT("elf32-powerpc")
OUTPUT_ARCH(powerpc)
ENTRY(w3d_k2b_apply_held_items_80176228)
_SDA_BASE_ = 0x804b2540;
_SDA2_BASE_ = 0x804c2540;
w3d_s20_forward_held_8019013c = 0x8019013c;
SECTIONS {
  .text.w3d_k2b_apply_held_items_80176228 0x80176228 : { *(.text.w3d_k2b_apply_held_items_80176228) }
  /DISCARD/ : { *(.text*) *(.rodata*) *(.data*) *(.bss*) *(.sdata*) *(.sbss*) *(.comment) }
}
