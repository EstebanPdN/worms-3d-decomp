/* Generated reference-only placements. All bodies are source-built. */
OUTPUT_FORMAT("elf32-powerpc")
OUTPUT_ARCH(powerpc)
ENTRY(w3d_cx13a_initialize_property_owner_8004db14)
_SDA_BASE_ = 0x804b2540;
_SDA2_BASE_ = 0x804c2540;
base_8015fef0 = 0x8015fef0;
cast_80342a78 = 0x80342a78;
key_80377770 = 0x80377770;
query_800fc1b0 = 0x800fc1b0;
string_803426b8 = 0x803426b8;
vtable_8040e9f8 = 0x8040e9f8;
SECTIONS {
  .text.w3d_cx13a_initialize_property_owner_8004db14 0x8004db14 : { *(.text.w3d_cx13a_initialize_property_owner_8004db14) }
  /DISCARD/ : { *(.text*) *(.rodata*) *(.data*) *(.bss*) *(.sdata*) *(.sbss*) *(.comment) }
}
