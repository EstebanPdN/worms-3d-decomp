/* Generated reference-only placements. All bodies are source-built. */
OUTPUT_FORMAT("elf32-powerpc")
OUTPUT_ARCH(powerpc)
ENTRY(cc38a_stats_append_8010a01c)
_SDA_BASE_ = 0x804b2540;
_SDA2_BASE_ = 0x804c2540;
__21cc38a_String_803426b8 = 0x803426b8;
cc38a_append_8020bf2c = 0x8020bf2c;
cc38a_assign_8020bd38 = 0x8020bd38;
cc38a_base_8020c5c0 = 0x8020c5c0;
cc38a_finish_8020c5c4 = 0x8020c5c4;
cc38a_header_80341884 = 0x80341884;
cc38a_key_80399cfc = 0x80399cfc;
cc38a_read_800fc2b0 = 0x800fc2b0;
cc38a_release_80341588 = 0x80341588;
cc38a_separator_80399d1c = 0x80399d1c;
cc38a_write_800fc550 = 0x800fc550;
SECTIONS {
  .text.cc38a_stats_append_8010a01c 0x8010a01c : { *(.text.cc38a_stats_append_8010a01c) }
  /DISCARD/ : { *(.text*) *(.rodata*) *(.data*) *(.bss*) *(.sdata*) *(.sbss*) *(.comment) }
}
