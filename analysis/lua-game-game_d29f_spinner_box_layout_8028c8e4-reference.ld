/* Generated reference-only placements. All bodies are source-built. */
OUTPUT_FORMAT("elf32-powerpc")
OUTPUT_ARCH(powerpc)
ENTRY(d29f_spinner_box_layout_8028c8e4)
_SDA_BASE_ = 0x804b2540;
_SDA2_BASE_ = 0x804c2540;
__6StringPCc = 0x8020bb54;
d25f_panel_visibility_8028c160 = 0x8028c160;
d26j_set_colour_80173df0 = 0x80173df0;
fn_8025e128 = 0x8025e128;
lbl_803cfd8c = 0x803cfd8c;
lbl_803cfd9c = 0x803cfd9c;
lbl_803cfdb0 = 0x803cfdb0;
lbl_803cfe14 = 0x803cfe14;
lbl_803cfe18 = 0x803cfe18;
lbl_8045e788 = 0x8045e788;
s11_named_handle_8025dffc = 0x8025dffc;
tsonnet_c31_text_size_802b1880 = 0x802b1880;
w3d_auto_80178f54 = 0x80178f54;
w3d_auto_80263c24 = 0x80263c24;
w3d_call_with_owner_8025ee94 = 0x8025ee94;
w3d_empty_8034357c = 0x8034357c;
w3d_forward_to_held_8025ee60 = 0x8025ee60;
w3d_handle_set_name = 0x8015adf4;
w3d_heap_allocate_entry_a = 0x801fe1d8;
w3d_s4_spinner_clear_texts = 0x8028c888;
w3d_string_base_finish = 0x8020c5c4;
w3d_string_release = 0x80341588;
SECTIONS {
  .text.d29f_spinner_box_layout_8028c8e4 0x8028c8e4 : { *(.text.d29f_spinner_box_layout_8028c8e4) }
  /DISCARD/ : { *(.text*) *(.rodata*) *(.data*) *(.bss*) *(.sdata*) *(.sbss*) *(.comment) }
}
