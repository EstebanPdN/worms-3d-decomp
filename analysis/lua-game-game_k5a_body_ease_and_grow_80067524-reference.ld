/* Generated reference-only placements. All bodies are source-built. */
OUTPUT_FORMAT("elf32-powerpc")
OUTPUT_ARCH(powerpc)
ENTRY(k5a_body_ease_and_grow_80067524)
_SDA_BASE_ = 0x804b2540;
_SDA2_BASE_ = 0x804c2540;
w3d_auto_8015fd1c = 0x8015fd1c;
w3d_f32_8037a0d0 = 0x8037a0d0;
w3d_f32_8037a0d4 = 0x8037a0d4;
w3d_f32_8037a0d8 = 0x8037a0d8;
w3d_f32_8037a0dc = 0x8037a0dc;
SECTIONS {
  .text.k5a_body_ease_and_grow_80067524 0x80067524 : { *(.text.k5a_body_ease_and_grow_80067524) }
  /DISCARD/ : { *(.text*) *(.rodata*) *(.data*) *(.bss*) *(.sdata*) *(.sbss*) *(.comment) }
}
