/* Generated reference-only placements. All bodies are source-built. */
OUTPUT_FORMAT("elf32-powerpc")
OUTPUT_ARCH(powerpc)
ENTRY(w3d_cc35b_movie_buffers_802e1134)
_SDA_BASE_ = 0x804b2540;
_SDA2_BASE_ = 0x804c2540;
fn_802fa95c = 0x802fa95c;
SECTIONS {
  .text.w3d_cc35b_movie_buffers_802e1134 0x802e1134 : { *(.text.w3d_cc35b_movie_buffers_802e1134) }
  /DISCARD/ : { *(.text*) *(.rodata*) *(.data*) *(.bss*) *(.sdata*) *(.sbss*) *(.comment) }
}
