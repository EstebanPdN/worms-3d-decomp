/* Generated reference-only placements. All bodies are source-built. */
OUTPUT_FORMAT("elf32-powerpc")
OUTPUT_ARCH(powerpc)
ENTRY(w3d_find_spawn_point_8003ad14)
_SDA_BASE_ = 0x804b2540;
_SDA2_BASE_ = 0x804c2540;
__18W3dString_8020bb54PCc = 0x8020bb54;
fn_8003af00 = 0x8003af00;
fn_8004a930 = 0x8004a930;
fn_8012568c = 0x8012568c;
fn_8020c5c4 = 0x8020c5c4;
fn_80212fd4 = 0x80212fd4;
fn_802134fc = 0x802134fc;
fn_802ef234 = 0x802ef234;
fn_80341588 = 0x80341588;
lbl_803742c8 = 0x803742c8;
lbl_80376f30 = 0x80376f30;
lbl_8039ba80 = 0x8039ba80;
lbl_8043bb64 = 0x8043bb64;
lbl_8045e788 = 0x8045e788;
memcpy = 0x802eee50;
SECTIONS {
  .text.w3d_find_spawn_point_8003ad14 0x8003ad14 : { *(.text.w3d_find_spawn_point_8003ad14) }
  .text.w3d_find_spawn_point_8004a608 0x8004a608 : { *(.text.w3d_find_spawn_point_8004a608) }
  .text.w3d_find_spawn_point_801254a0 0x801254a0 : { *(.text.w3d_find_spawn_point_801254a0) }
  /DISCARD/ : { *(.text*) *(.rodata*) *(.data*) *(.bss*) *(.sdata*) *(.sbss*) *(.comment) }
}
