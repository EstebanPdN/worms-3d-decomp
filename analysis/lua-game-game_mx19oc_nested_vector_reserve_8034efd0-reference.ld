/* Generated reference-only placements. All bodies are source-built. */
OUTPUT_FORMAT("elf32-powerpc")
OUTPUT_ARCH(powerpc)
ENTRY(mx19oc_nested_vector_reserve_8034efd0)
_SDA_BASE_ = 0x804b2540;
_SDA2_BASE_ = 0x804c2540;
native_array_allocate_801907a8 = 0x801907a8;
native_array_free_801907d0 = 0x801907d0;
SECTIONS {
  .text.mx19oc_nested_vector_reserve_8034efd0 0x8034efd0 : { *(.text.mx19oc_nested_vector_reserve_8034efd0) }
  /DISCARD/ : { *(.text*) *(.rodata*) *(.data*) *(.bss*) *(.sdata*) *(.sbss*) *(.comment) }
}
