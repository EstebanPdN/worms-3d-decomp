/* Generated reference-only placements. All bodies are source-built. */
OUTPUT_FORMAT("elf32-powerpc")
OUTPUT_ARCH(powerpc)
ENTRY(w3d_d28e_size_lists_801a9908)
_SDA_BASE_ = 0x804b2540;
_SDA2_BASE_ = 0x804c2540;
alloc_80212fd4 = 0x80212fd4;
free_802134fc = 0x802134fc;
memcpy_802eee50 = 0x802eee50;
sol35f4r_nested_buffer_insert_80354f08 = 0x80354f08;
SECTIONS {
  .text.w3d_d28e_size_lists_801a9908 0x801a9908 : { *(.text.w3d_d28e_size_lists_801a9908) }
  /DISCARD/ : { *(.text*) *(.rodata*) *(.data*) *(.bss*) *(.sdata*) *(.sbss*) *(.comment) }
}
