/* Generated reference-only placements. All bodies are source-built. */
OUTPUT_FORMAT("elf32-powerpc")
OUTPUT_ARCH(powerpc)
ENTRY(w3d_cx14b_stream_interface_attach_801f8754)
_SDA_BASE_ = 0x804b2540;
_SDA2_BASE_ = 0x804c2540;
validate_801f8838 = 0x801f8838;
SECTIONS {
  .text.w3d_cx14b_stream_interface_attach_801f8754 0x801f8754 : { *(.text.w3d_cx14b_stream_interface_attach_801f8754) }
  /DISCARD/ : { *(.text*) *(.rodata*) *(.data*) *(.bss*) *(.sdata*) *(.sbss*) *(.comment) }
}
