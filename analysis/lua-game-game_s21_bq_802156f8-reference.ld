/* Generated reference-only placements. All bodies are source-built. */
OUTPUT_FORMAT("elf32-powerpc")
OUTPUT_ARCH(powerpc)
ENTRY(w3d_s21_check_state_802156f8)
_SDA_BASE_ = 0x804b2540;
_SDA2_BASE_ = 0x804c2540;
fn_802e3244 = 0x802e3244;
fn_802ed798 = 0x802ed798;
SECTIONS {
  .text.w3d_s21_check_state_802156f8 0x802156f8 : { *(.text.w3d_s21_check_state_802156f8) }
  /DISCARD/ : { *(.text*) *(.rodata*) *(.data*) *(.bss*) *(.sdata*) *(.sbss*) *(.comment) }
}
