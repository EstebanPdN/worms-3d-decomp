/* Generated reference-only placements. All bodies are source-built. */
OUTPUT_FORMAT("elf32-powerpc")
OUTPUT_ARCH(powerpc)
ENTRY(k4a_owner_apply_property_8003d0a0)
_SDA_BASE_ = 0x804b2540;
_SDA2_BASE_ = 0x804c2540;
FUN_800fd388 = 0x800fd388;
FUN_80173df0 = 0x80173df0;
w3d_auto_80178c48 = 0x80178c48;
w3d_empty_8034357c = 0x8034357c;
SECTIONS {
  .text.k4a_owner_apply_property_8003d0a0 0x8003d0a0 : { *(.text.k4a_owner_apply_property_8003d0a0) }
  /DISCARD/ : { *(.text*) *(.rodata*) *(.data*) *(.bss*) *(.sdata*) *(.sbss*) *(.comment) }
}
