/* Generated reference-only placements. All bodies are source-built. */
OUTPUT_FORMAT("elf32-powerpc")
OUTPUT_ARCH(powerpc)
ENTRY(d24f_subscriber_destroy_8035d27c)
_SDA_BASE_ = 0x804b2540;
_SDA2_BASE_ = 0x804c2540;
lbl_80413a50 = 0x80413a50;
lbl_80419648 = 0x80419648;
w3d_actor_member_delete_backend = 0x801fe1f8;
w3d_auto_80351ea0 = 0x80351ea0;
w3d_auto_8035d214 = 0x8035d214;
w3d_handle_storage_release = 0x802134fc;
w3d_rb_increment_80351ef8 = 0x80351ef8;
w3d_rb_rebalance_for_erase_80352010 = 0x80352010;
SECTIONS {
  .text.d24f_subscriber_destroy_8035d27c 0x8035d27c : { *(.text.d24f_subscriber_destroy_8035d27c) }
  /DISCARD/ : { *(.text*) *(.rodata*) *(.data*) *(.bss*) *(.sdata*) *(.sbss*) *(.comment) }
}
