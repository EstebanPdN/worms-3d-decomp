/* Generated reference-only placements. All bodies are source-built. */
OUTPUT_FORMAT("elf32-powerpc")
OUTPUT_ARCH(powerpc)
ENTRY(w3d_sol35d4_initialize_strings_80222db8)
_SDA_BASE_ = 0x804b2540;
_SDA2_BASE_ = 0x804c2540;
fn_801e8d9c = 0x801e8d9c;
fn_801eb674 = 0x801eb674;
fn_801ec52c = 0x801ec52c;
fn_801ece2c = 0x801ece2c;
fn_801ed24c = 0x801ed24c;
fn_8020bb2c = 0x8020bb2c;
fn_8020c5c0 = 0x8020c5c0;
fn_8020c5c4 = 0x8020c5c4;
fn_80341588 = 0x80341588;
fn_80341884 = 0x80341884;
lbl_803b7020 = 0x803b7020;
lbl_803b7044 = 0x803b7044;
lbl_803b7068 = 0x803b7068;
lbl_803b708c = 0x803b708c;
lbl_803b70b0 = 0x803b70b0;
lbl_803b70e8 = 0x803b70e8;
lbl_803b7120 = 0x803b7120;
lbl_803b7158 = 0x803b7158;
lbl_803b718c = 0x803b718c;
lbl_803b71b4 = 0x803b71b4;
lbl_803b71ec = 0x803b71ec;
lbl_803b7214 = 0x803b7214;
lbl_804b06a0 = 0x804b06a0;
SECTIONS {
  .text.w3d_sol35d4_initialize_strings_80222db8 0x80222db8 : { *(.text.w3d_sol35d4_initialize_strings_80222db8) }
  /DISCARD/ : { *(.text*) *(.rodata*) *(.data*) *(.bss*) *(.sdata*) *(.sbss*) *(.comment) }
}
