/* Generated reference-only placements. All bodies are source-built. */
OUTPUT_FORMAT("elf32-powerpc")
OUTPUT_ARCH(powerpc)
ENTRY(w3d_k7b_item_list_join_names_801d38a8)
_SDA_BASE_ = 0x804b2540;
_SDA2_BASE_ = 0x804c2540;
lbl_803af028 = 0x803af028;
w3d_string_append = 0x8020bf2c;
SECTIONS {
  .text.w3d_k7b_item_list_join_names_801d38a8 0x801d38a8 : { *(.text.w3d_k7b_item_list_join_names_801d38a8) }
  /DISCARD/ : { *(.text*) *(.rodata*) *(.data*) *(.bss*) *(.sdata*) *(.sbss*) *(.comment) }
}
