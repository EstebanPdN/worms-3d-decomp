/* Generated reference-only placements. All bodies are source-built. */
OUTPUT_FORMAT("elf32-powerpc")
OUTPUT_ARCH(powerpc)
ENTRY(__as__Q24_STLt6vector2Z21D29sRecord12_8034e408Zt15ModuleAllocator1Z21D29sRecord12_8034e408RCQ24_STLt6vector2Z21D29sRecord12_8034e408Zt15ModuleAllocator1Z21D29sRecord12_8034e408)
_SDA_BASE_ = 0x804b2540;
_SDA2_BASE_ = 0x804c2540;
w3d_auto_801907a8 = 0x801907a8;
w3d_auto_801907d0 = 0x801907d0;
SECTIONS {
  .text.__as__Q24_STLt6vector2Z21D29sRecord12_8034e408Zt15ModuleAllocator1Z21D29sRecord12_8034e408RCQ24_STLt6vector2Z21D29sRecord12_8034e408Zt15ModuleAllocator1Z21D29sRecord12_8034e408 0x8034e408 : { *(.text.__as__Q24_STLt6vector2Z21D29sRecord12_8034e408Zt15ModuleAllocator1Z21D29sRecord12_8034e408RCQ24_STLt6vector2Z21D29sRecord12_8034e408Zt15ModuleAllocator1Z21D29sRecord12_8034e408) }
  /DISCARD/ : { *(.text*) *(.rodata*) *(.data*) *(.bss*) *(.sdata*) *(.sbss*) *(.comment) }
}
