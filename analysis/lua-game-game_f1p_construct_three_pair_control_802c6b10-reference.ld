/* Generated reference-only placements. All bodies are source-built. */
OUTPUT_FORMAT("elf32-powerpc")
OUTPUT_ARCH(powerpc)
ENTRY(w3d_construct_three_pair_control_802c6b10)
_SDA_BASE_ = 0x804b2540;
_SDA2_BASE_ = 0x804c2540;
fn_8015fef0 = 0x8015fef0;
fn_803426b8 = 0x803426b8;
one_803d8dcc = 0x803d8dcc;
vector_8045e788 = 0x8045e788;
vt_8041c960 = 0x8041c960;
zero_803d8dc8 = 0x803d8dc8;
SECTIONS {
  .text.w3d_construct_three_pair_control_802c6b10 0x802c6b10 : { *(.text.w3d_construct_three_pair_control_802c6b10) }
  /DISCARD/ : { *(.text*) *(.rodata*) *(.data*) *(.bss*) *(.sdata*) *(.sbss*) *(.comment) }
}
