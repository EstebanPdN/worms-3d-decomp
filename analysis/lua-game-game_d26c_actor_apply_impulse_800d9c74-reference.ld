/* Generated reference-only placements. All bodies are source-built. */
OUTPUT_FORMAT("elf32-powerpc")
OUTPUT_ARCH(powerpc)
ENTRY(d26c_actor_apply_impulse_800d9c74)
_SDA_BASE_ = 0x804b2540;
_SDA2_BASE_ = 0x804c2540;
ctx_80165254 = 0x80165254;
desc_801797b4 = 0x801797b4;
empty_80341584 = 0x80341584;
land_800d8b4c = 0x800d8b4c;
leave_800eb6e4 = 0x800eb6e4;
sqrt_802e82c0 = 0x802e82c0;
SECTIONS {
  .text.d26c_actor_apply_impulse_800d9c74 0x800d9c74 : { *(.text.d26c_actor_apply_impulse_800d9c74) }
  .rodata 0x80389584 : { *(.rodata) }
  /DISCARD/ : { *(.text*) *(.rodata*) *(.data*) *(.bss*) *(.sdata*) *(.sbss*) *(.comment) }
}
