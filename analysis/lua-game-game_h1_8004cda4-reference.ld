/* Generated reference-only placements. All bodies are source-built. */
OUTPUT_FORMAT("elf32-powerpc")
OUTPUT_ARCH(powerpc)
ENTRY(w3d_h1_apply_team_handle_8004cda4)
_SDA_BASE_ = 0x804b2540;
_SDA2_BASE_ = 0x804c2540;
fn_8025cbe0 = 0x8025cbe0;
fn_8025d020 = 0x8025d020;
s8_handle_800fcdb8 = 0x800fcdb8;
s8_index_query_800fc7f8 = 0x800fc7f8;
w3d_s20_destroy_owned_80178474 = 0x80178474;
SECTIONS {
  .text.w3d_h1_apply_team_handle_8004cda4 0x8004cda4 : { *(.text.w3d_h1_apply_team_handle_8004cda4) }
  /DISCARD/ : { *(.text*) *(.rodata*) *(.data*) *(.bss*) *(.sdata*) *(.sbss*) *(.comment) }
}
