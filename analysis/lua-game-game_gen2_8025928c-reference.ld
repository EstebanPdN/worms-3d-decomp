/* Generated reference-only placements. All bodies are source-built. */
OUTPUT_FORMAT("elf32-powerpc")
OUTPUT_ARCH(powerpc)
ENTRY(w3d_strassign_8025928c)
_SDA_BASE_ = 0x804b2540;
_SDA2_BASE_ = 0x804c2540;
w3d_fn_802579ec = 0x802579ec;
w3d_fn_8025d518 = 0x8025d518;
w3d_fn_8025d680 = 0x8025d680;
w3d_fn_8025def0 = 0x8025def0;
w3d_fn_802606f4 = 0x802606f4;
w3d_fn_80264860 = 0x80264860;
w3d_fn_802685f0 = 0x802685f0;
w3d_fn_8026c660 = 0x8026c660;
w3d_fn_8026de9c = 0x8026de9c;
w3d_fn_802703f8 = 0x802703f8;
w3d_fn_80270c38 = 0x80270c38;
w3d_fn_8027b358 = 0x8027b358;
w3d_fn_80284b24 = 0x80284b24;
w3d_fn_802853f0 = 0x802853f0;
w3d_fn_802871b4 = 0x802871b4;
w3d_fn_80287834 = 0x80287834;
w3d_fn_80287db4 = 0x80287db4;
w3d_fn_8028ab1c = 0x8028ab1c;
w3d_fn_8028cb88 = 0x8028cb88;
w3d_fn_8028dda8 = 0x8028dda8;
w3d_fn_8028ecb0 = 0x8028ecb0;
w3d_fn_80293314 = 0x80293314;
w3d_fn_802967fc = 0x802967fc;
w3d_fn_8029da1c = 0x8029da1c;
w3d_fn_802a1558 = 0x802a1558;
w3d_fn_802a2bd0 = 0x802a2bd0;
w3d_fn_802a3cc8 = 0x802a3cc8;
w3d_fn_802a3dc8 = 0x802a3dc8;
w3d_fn_802a3e3c = 0x802a3e3c;
w3d_fn_802a7da4 = 0x802a7da4;
w3d_fn_802ab6f0 = 0x802ab6f0;
w3d_fn_802af9ec = 0x802af9ec;
w3d_fn_802b2930 = 0x802b2930;
w3d_fn_802b3e80 = 0x802b3e80;
w3d_fn_802b532c = 0x802b532c;
w3d_fn_802ba1a4 = 0x802ba1a4;
w3d_fn_802bad0c = 0x802bad0c;
w3d_fn_802bcd84 = 0x802bcd84;
w3d_fn_802c1dd8 = 0x802c1dd8;
w3d_fn_802c4f30 = 0x802c4f30;
w3d_fn_802c6960 = 0x802c6960;
w3d_fn_802c817c = 0x802c817c;
w3d_fn_802cd308 = 0x802cd308;
w3d_fn_802e2dd4 = 0x802e2dd4;
w3d_string_release_header = 0x8020bb2c;
SECTIONS {
  .text.w3d_strassign_8025928c 0x8025928c : { *(.text.w3d_strassign_8025928c) }
  .text.w3d_strassign_802592fc 0x802592fc : { *(.text.w3d_strassign_802592fc) }
  .text.w3d_strassign_8025936c 0x8025936c : { *(.text.w3d_strassign_8025936c) }
  .text.w3d_strassign_802593dc 0x802593dc : { *(.text.w3d_strassign_802593dc) }
  .text.w3d_strassign_8025945c 0x8025945c : { *(.text.w3d_strassign_8025945c) }
  .text.w3d_strassign_802594cc 0x802594cc : { *(.text.w3d_strassign_802594cc) }
  .text.w3d_strassign_8025953c 0x8025953c : { *(.text.w3d_strassign_8025953c) }
  .text.w3d_strassign_802595ac 0x802595ac : { *(.text.w3d_strassign_802595ac) }
  .text.w3d_strassign_8025961c 0x8025961c : { *(.text.w3d_strassign_8025961c) }
  .text.w3d_strassign_8025968c 0x8025968c : { *(.text.w3d_strassign_8025968c) }
  .text.w3d_strassign_802596fc 0x802596fc : { *(.text.w3d_strassign_802596fc) }
  .text.w3d_strassign_8025976c 0x8025976c : { *(.text.w3d_strassign_8025976c) }
  .text.w3d_strassign_802597dc 0x802597dc : { *(.text.w3d_strassign_802597dc) }
  .text.w3d_strassign_8025984c 0x8025984c : { *(.text.w3d_strassign_8025984c) }
  .text.w3d_strassign_802598bc 0x802598bc : { *(.text.w3d_strassign_802598bc) }
  .text.w3d_strassign_8025993c 0x8025993c : { *(.text.w3d_strassign_8025993c) }
  .text.w3d_strassign_80259c6c 0x80259c6c : { *(.text.w3d_strassign_80259c6c) }
  .text.w3d_strassign_80259cdc 0x80259cdc : { *(.text.w3d_strassign_80259cdc) }
  .text.w3d_strassign_80259d4c 0x80259d4c : { *(.text.w3d_strassign_80259d4c) }
  .text.w3d_strassign_80259dbc 0x80259dbc : { *(.text.w3d_strassign_80259dbc) }
  .text.w3d_strassign_80259e2c 0x80259e2c : { *(.text.w3d_strassign_80259e2c) }
  .text.w3d_strassign_80259e9c 0x80259e9c : { *(.text.w3d_strassign_80259e9c) }
  .text.w3d_strassign_80259f0c 0x80259f0c : { *(.text.w3d_strassign_80259f0c) }
  .text.w3d_strassign_8025a10c 0x8025a10c : { *(.text.w3d_strassign_8025a10c) }
  .text.w3d_strassign_8025a17c 0x8025a17c : { *(.text.w3d_strassign_8025a17c) }
  .text.w3d_strassign_8025a1ec 0x8025a1ec : { *(.text.w3d_strassign_8025a1ec) }
  .text.w3d_strassign_8025a25c 0x8025a25c : { *(.text.w3d_strassign_8025a25c) }
  .text.w3d_strassign_8025a2cc 0x8025a2cc : { *(.text.w3d_strassign_8025a2cc) }
  .text.w3d_strassign_8025a33c 0x8025a33c : { *(.text.w3d_strassign_8025a33c) }
  .text.w3d_strassign_8025a3ac 0x8025a3ac : { *(.text.w3d_strassign_8025a3ac) }
  .text.w3d_strassign_8025a41c 0x8025a41c : { *(.text.w3d_strassign_8025a41c) }
  .text.w3d_strassign_8025a48c 0x8025a48c : { *(.text.w3d_strassign_8025a48c) }
  .text.w3d_strassign_8025a5ec 0x8025a5ec : { *(.text.w3d_strassign_8025a5ec) }
  .text.w3d_strassign_8025a65c 0x8025a65c : { *(.text.w3d_strassign_8025a65c) }
  .text.w3d_strassign_8025a6cc 0x8025a6cc : { *(.text.w3d_strassign_8025a6cc) }
  .text.w3d_strassign_8025a73c 0x8025a73c : { *(.text.w3d_strassign_8025a73c) }
  .text.w3d_static_init_8025af98 0x8025af98 : { *(.text.w3d_static_init_8025af98) }
  .text.w3d_static_init_8025d55c 0x8025d55c : { *(.text.w3d_static_init_8025d55c) }
  .text.w3d_static_init_8025d6c8 0x8025d6c8 : { *(.text.w3d_static_init_8025d6c8) }
  .text.w3d_static_init_8025dfd0 0x8025dfd0 : { *(.text.w3d_static_init_8025dfd0) }
  .text.w3d_static_init_8026078c 0x8026078c : { *(.text.w3d_static_init_8026078c) }
  .text.w3d_static_init_80264b00 0x80264b00 : { *(.text.w3d_static_init_80264b00) }
  .text.w3d_static_init_802686b8 0x802686b8 : { *(.text.w3d_static_init_802686b8) }
  .text.w3d_static_init_8026c6e8 0x8026c6e8 : { *(.text.w3d_static_init_8026c6e8) }
  .text.w3d_static_init_8026df0c 0x8026df0c : { *(.text.w3d_static_init_8026df0c) }
  .text.w3d_static_init_802704f0 0x802704f0 : { *(.text.w3d_static_init_802704f0) }
  .text.w3d_static_init_80270ca0 0x80270ca0 : { *(.text.w3d_static_init_80270ca0) }
  .text.w3d_static_init_8027b3d8 0x8027b3d8 : { *(.text.w3d_static_init_8027b3d8) }
  .text.w3d_static_init_80284c24 0x80284c24 : { *(.text.w3d_static_init_80284c24) }
  .text.w3d_static_init_802854c0 0x802854c0 : { *(.text.w3d_static_init_802854c0) }
  .text.w3d_static_init_8028725c 0x8028725c : { *(.text.w3d_static_init_8028725c) }
  .text.w3d_static_init_80287934 0x80287934 : { *(.text.w3d_static_init_80287934) }
  .text.w3d_static_init_80287e14 0x80287e14 : { *(.text.w3d_static_init_80287e14) }
  .text.w3d_static_init_8028abfc 0x8028abfc : { *(.text.w3d_static_init_8028abfc) }
  .text.w3d_static_init_8028cc90 0x8028cc90 : { *(.text.w3d_static_init_8028cc90) }
  .text.w3d_static_init_8028de10 0x8028de10 : { *(.text.w3d_static_init_8028de10) }
  .text.w3d_static_init_8028edc0 0x8028edc0 : { *(.text.w3d_static_init_8028edc0) }
  .text.w3d_static_init_80293434 0x80293434 : { *(.text.w3d_static_init_80293434) }
  .text.w3d_static_init_802968dc 0x802968dc : { *(.text.w3d_static_init_802968dc) }
  .text.w3d_static_init_8029dbfc 0x8029dbfc : { *(.text.w3d_static_init_8029dbfc) }
  .text.w3d_static_init_802a15e0 0x802a15e0 : { *(.text.w3d_static_init_802a15e0) }
  .text.w3d_static_init_802a2cd4 0x802a2cd4 : { *(.text.w3d_static_init_802a2cd4) }
  .text.w3d_static_init_802a3d38 0x802a3d38 : { *(.text.w3d_static_init_802a3d38) }
  .text.w3d_static_init_802a3e10 0x802a3e10 : { *(.text.w3d_static_init_802a3e10) }
  .text.w3d_static_init_802a3f48 0x802a3f48 : { *(.text.w3d_static_init_802a3f48) }
  .text.w3d_static_init_802a7e4c 0x802a7e4c : { *(.text.w3d_static_init_802a7e4c) }
  .text.w3d_static_init_802ab7d8 0x802ab7d8 : { *(.text.w3d_static_init_802ab7d8) }
  .text.w3d_static_init_802afaf4 0x802afaf4 : { *(.text.w3d_static_init_802afaf4) }
  .text.w3d_static_init_802b2a54 0x802b2a54 : { *(.text.w3d_static_init_802b2a54) }
  .text.w3d_static_init_802b3ee0 0x802b3ee0 : { *(.text.w3d_static_init_802b3ee0) }
  .text.w3d_static_init_802b53d4 0x802b53d4 : { *(.text.w3d_static_init_802b53d4) }
  .text.w3d_static_init_802ba2ac 0x802ba2ac : { *(.text.w3d_static_init_802ba2ac) }
  .text.w3d_static_init_802badc4 0x802badc4 : { *(.text.w3d_static_init_802badc4) }
  .text.w3d_static_init_802bcde4 0x802bcde4 : { *(.text.w3d_static_init_802bcde4) }
  .text.w3d_static_init_802c1e48 0x802c1e48 : { *(.text.w3d_static_init_802c1e48) }
  .text.w3d_static_init_802c4ff0 0x802c4ff0 : { *(.text.w3d_static_init_802c4ff0) }
  .text.w3d_static_init_802c69c0 0x802c69c0 : { *(.text.w3d_static_init_802c69c0) }
  .text.w3d_static_init_802c81dc 0x802c81dc : { *(.text.w3d_static_init_802c81dc) }
  .text.w3d_static_init_802cd3dc 0x802cd3dc : { *(.text.w3d_static_init_802cd3dc) }
  .text.w3d_static_init_802e2e30 0x802e2e30 : { *(.text.w3d_static_init_802e2e30) }
  /DISCARD/ : { *(.text*) *(.rodata*) *(.data*) *(.bss*) *(.sdata*) *(.sbss*) *(.comment) }
}
