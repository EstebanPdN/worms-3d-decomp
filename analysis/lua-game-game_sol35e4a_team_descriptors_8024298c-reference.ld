/* Generated reference-only placements. All bodies are source-built. */
OUTPUT_FORMAT("elf32-powerpc")
OUTPUT_ARCH(powerpc)
ENTRY(sol35e4a_team_descriptors_8024298c)
_SDA_BASE_ = 0x804b2540;
_SDA2_BASE_ = 0x804c2540;
sol35e4a_desc_803be7d0 = 0x803be7d0;
sol35e4a_desc_803be7f4 = 0x803be7f4;
sol35e4a_desc_803be82c = 0x803be82c;
sol35e4a_desc_803be860 = 0x803be860;
sol35e4a_desc_803be898 = 0x803be898;
sol35e4a_desc_803be8cc = 0x803be8cc;
sol35e4a_desc_803be908 = 0x803be908;
sol35e4a_desc_803be940 = 0x803be940;
sol35e4a_desc_803be974 = 0x803be974;
sol35e4a_desc_803be9a8 = 0x803be9a8;
sol35e4a_desc_803be9e0 = 0x803be9e0;
sol35e4a_desc_803bea14 = 0x803bea14;
sol35e4a_desc_803bea48 = 0x803bea48;
sol35e4a_desc_803bea7c = 0x803bea7c;
sol35e4a_desc_803beab4 = 0x803beab4;
sol35e4a_desc_803beae4 = 0x803beae4;
sol35e4a_desc_803beb14 = 0x803beb14;
sol35e4a_empty_804b06a0 = 0x804b06a0;
sol35e4a_finish_801e8d9c = 0x801e8d9c;
sol35e4a_register_bool_801eb674 = 0x801eb674;
sol35e4a_register_string_801ed24c = 0x801ed24c;
sol35e4a_register_u32_801ebf38 = 0x801ebf38;
sol35e4a_register_u8_801eb834 = 0x801eb834;
sol35e4a_release_header_8020bb2c = 0x8020bb2c;
sol35e4a_string_finish_8020c5c4 = 0x8020c5c4;
sol35e4a_string_header_80341884 = 0x80341884;
sol35e4a_string_init_8020c5c0 = 0x8020c5c0;
sol35e4a_string_release_80341588 = 0x80341588;
SECTIONS {
  .text.sol35e4a_team_descriptors_8024298c 0x8024298c : { *(.text.sol35e4a_team_descriptors_8024298c) }
  /DISCARD/ : { *(.text*) *(.rodata*) *(.data*) *(.bss*) *(.sdata*) *(.sbss*) *(.comment) }
}
