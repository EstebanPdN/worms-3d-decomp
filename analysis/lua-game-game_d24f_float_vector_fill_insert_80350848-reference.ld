/* Generated reference-only placements. All bodies are source-built. */
OUTPUT_FORMAT("elf32-powerpc")
OUTPUT_ARCH(powerpc)
ENTRY(d24f_float_vector_fill_insert_80350848)
_SDA_BASE_ = 0x804b2540;
_SDA2_BASE_ = 0x804c2540;
memmove = 0x802eeef4;
w3d_auto_801907a8 = 0x801907a8;
w3d_auto_801907d0 = 0x801907d0;
SECTIONS {
  .text.d24f_float_vector_fill_insert_80350848 0x80350848 : { *(.text.d24f_float_vector_fill_insert_80350848) }
  /DISCARD/ : { *(.text*) *(.rodata*) *(.data*) *(.bss*) *(.sdata*) *(.sbss*) *(.comment) }
}
