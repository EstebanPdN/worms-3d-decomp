/* Generated reference-only placements. All bodies are source-built. */
OUTPUT_FORMAT("elf32-powerpc")
OUTPUT_ARCH(powerpc)
ENTRY(w3d_cx13b_focus_vertical_1_802c3c80)
_SDA_BASE_ = 0x804b2540;
_SDA2_BASE_ = 0x804c2540;
dispatch_802c3ff0 = 0x802c3ff0;
map_803d86e8 = 0x803d86e8;
map_803d8710 = 0x803d8710;
SECTIONS {
  .text.w3d_cx13b_focus_vertical_1_802c3c80 0x802c3c80 : { *(.text.w3d_cx13b_focus_vertical_1_802c3c80) }
  /DISCARD/ : { *(.text*) *(.rodata*) *(.data*) *(.bss*) *(.sdata*) *(.sbss*) *(.comment) }
}
