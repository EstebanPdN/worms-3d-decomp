/* Generated reference-only placements. All bodies are source-built. */
OUTPUT_FORMAT("elf32-powerpc")
OUTPUT_ARCH(powerpc)
ENTRY(w3d_k8a_held_array_destroy_8004f118)
_SDA_BASE_ = 0x804b2540;
_SDA2_BASE_ = 0x804c2540;
w3d_service_destroy_801628ec = 0x801628ec;
w3d_vtable_8040eaa0 = 0x8040eaa0;
SECTIONS {
  .text.w3d_k8a_held_array_destroy_8004f118 0x8004f118 : { *(.text.w3d_k8a_held_array_destroy_8004f118) }
  /DISCARD/ : { *(.text*) *(.rodata*) *(.data*) *(.bss*) *(.sdata*) *(.sbss*) *(.comment) }
}
