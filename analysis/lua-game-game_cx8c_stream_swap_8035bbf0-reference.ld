/* Generated reference-only placements. All bodies are source-built. */
OUTPUT_FORMAT("elf32-powerpc")
OUTPUT_ARCH(powerpc)
ENTRY(w3d_cx8c_stream_swap_8035bbf0)
_SDA_BASE_ = 0x804b2540;
_SDA2_BASE_ = 0x804c2540;
cx8c_stream_transfer_802047e0 = 0x802047e0;
SECTIONS {
  .text.w3d_cx8c_stream_swap_8035bbf0 0x8035bbf0 : { *(.text.w3d_cx8c_stream_swap_8035bbf0) }
  /DISCARD/ : { *(.text*) *(.rodata*) *(.data*) *(.bss*) *(.sdata*) *(.sbss*) *(.comment) }
}
