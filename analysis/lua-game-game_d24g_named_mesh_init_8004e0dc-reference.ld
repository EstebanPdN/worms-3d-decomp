/* Generated reference-only placements. All bodies are source-built. */
OUTPUT_FORMAT("elf32-powerpc")
OUTPUT_ARCH(powerpc)
ENTRY(w3d_d24g_named_mesh_init_8004e0dc)
_SDA_BASE_ = 0x804b2540;
_SDA2_BASE_ = 0x804c2540;
__6StringPCc = 0x8020bb54;
as_8034357c = 0x8034357c;
as_80343584 = 0x80343584;
load_8015adf4 = 0x8015adf4;
position_8045e788 = 0x8045e788;
string_assign_8020bd38 = 0x8020bd38;
string_finish_8020c5c4 = 0x8020c5c4;
string_release_80341588 = 0x80341588;
value_8004e544 = 0x8004e544;
SECTIONS {
  .text.w3d_d24g_named_mesh_init_8004e0dc 0x8004e0dc : { *(.text.w3d_d24g_named_mesh_init_8004e0dc) }
  /DISCARD/ : { *(.text*) *(.rodata*) *(.data*) *(.bss*) *(.sdata*) *(.sbss*) *(.comment) }
}
