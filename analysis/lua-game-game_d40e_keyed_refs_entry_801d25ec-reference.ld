/* Generated reference-only placements. All bodies are source-built. */
OUTPUT_FORMAT("elf32-powerpc")
OUTPUT_ARCH(powerpc)
ENTRY(w3d_d40e_keyed_refs_entry_801d25ec)
_SDA_BASE_ = 0x804b2540;
_SDA2_BASE_ = 0x804c2540;
_._4Refs = 0x801f2758;
__4Refs = 0x801f2678;
__as__4RefsRC4Refs = 0x801f2b04;
insert_unique__Q24_STLt8_Rb_tree5Z3KeyZQ24_STLt4pair2ZC3KeyZ5ValueZQ24_STLt10_Select1st1ZQ24_STLt4pair2ZC3KeyZ5ValueZQ24_STLt4less1Z3KeyZQ24_STLt9allocator1ZQ24_STLt4pair2ZC3KeyZ5ValueGQ24_STLt17_Rb_tree_iterator2ZQ24_STLt4pair2ZC3KeyZ5ValueZQ24_STLt16_Nonconst_traits1ZQ24_STLt4pair2ZC3KeyZ5ValueRCQ24_STLt4pair2ZC3KeyZ5Value = 0x80355fa0;
resize__4RefsUi = 0x801f282c;
w3d_copy_refs_801f2698 = 0x801f2698;
SECTIONS {
  .text.w3d_d40e_keyed_refs_entry_801d25ec 0x801d25ec : { *(.text.w3d_d40e_keyed_refs_entry_801d25ec) }
  /DISCARD/ : { *(.text*) *(.rodata*) *(.data*) *(.bss*) *(.sdata*) *(.sbss*) *(.comment) }
}
