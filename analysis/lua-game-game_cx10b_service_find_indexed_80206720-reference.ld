/* Generated reference-only placements. All bodies are source-built. */
OUTPUT_FORMAT("elf32-powerpc")
OUTPUT_ARCH(powerpc)
ENTRY(w3d_cx10b_service_find_indexed_80206720)
_SDA_BASE_ = 0x804b2540;
_SDA2_BASE_ = 0x804c2540;
find_8035c220 = 0x8035c220;
SECTIONS {
  .text.w3d_cx10b_service_find_indexed_80206720 0x80206720 : { *(.text.w3d_cx10b_service_find_indexed_80206720) }
  /DISCARD/ : { *(.text*) *(.rodata*) *(.data*) *(.bss*) *(.sdata*) *(.sbss*) *(.comment) }
}
