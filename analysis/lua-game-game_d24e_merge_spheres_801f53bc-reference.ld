/* Generated reference-only placements. All bodies are source-built. */
OUTPUT_FORMAT("elf32-powerpc")
OUTPUT_ARCH(powerpc)
ENTRY(w3d_d24e_merge_spheres_801f53bc)
_SDA_BASE_ = 0x804b2540;
_SDA2_BASE_ = 0x804c2540;
constant_803b15a0 = 0x803b15a0;
constant_803b15a4 = 0x803b15a4;
constant_803b15a8 = 0x803b15a8;
fn_802e82c0 = 0x802e82c0;
SECTIONS {
  .text.w3d_d24e_merge_spheres_801f53bc 0x801f53bc : { *(.text.w3d_d24e_merge_spheres_801f53bc) }
  /DISCARD/ : { *(.text*) *(.rodata*) *(.data*) *(.bss*) *(.sdata*) *(.sbss*) *(.comment) }
}
