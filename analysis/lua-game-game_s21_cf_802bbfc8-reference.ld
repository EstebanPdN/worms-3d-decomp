/* Generated reference-only placements. All bodies are source-built. */
OUTPUT_FORMAT("elf32-powerpc")
OUTPUT_ARCH(powerpc)
ENTRY(w3d_s21_each_item_802bbfc8)
_SDA_BASE_ = 0x804b2540;
_SDA2_BASE_ = 0x804c2540;
fn_802c0064 = 0x802c0064;
SECTIONS {
  .text.w3d_s21_each_item_802bbfc8 0x802bbfc8 : { *(.text.w3d_s21_each_item_802bbfc8) }
  /DISCARD/ : { *(.text*) *(.rodata*) *(.data*) *(.bss*) *(.sdata*) *(.sbss*) *(.comment) }
}
