/* Generated reference-only placements. All bodies are source-built. */
OUTPUT_FORMAT("elf32-powerpc")
OUTPUT_ARCH(powerpc)
ENTRY(w3d_s21_equal_801eb4e4)
_SDA_BASE_ = 0x804b2540;
_SDA2_BASE_ = 0x804c2540;
fn_80200050 = 0x80200050;
fn_802eedc0 = 0x802eedc0;
SECTIONS {
  .text.w3d_s21_equal_801eb4e4 0x801eb4e4 : { *(.text.w3d_s21_equal_801eb4e4) }
  /DISCARD/ : { *(.text*) *(.rodata*) *(.data*) *(.bss*) *(.sdata*) *(.sbss*) *(.comment) }
}
