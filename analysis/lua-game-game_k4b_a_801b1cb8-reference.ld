/* Generated reference-only placements. All bodies are source-built. */
OUTPUT_FORMAT("elf32-powerpc")
OUTPUT_ARCH(powerpc)
ENTRY(w3d_k4b_group_add_child_801b1cb8)
_SDA_BASE_ = 0x804b2540;
_SDA2_BASE_ = 0x804c2540;
fn_801f29d0 = 0x801f29d0;
w3d_s10_has_ancestor_801b1de0 = 0x801b1de0;
SECTIONS {
  .text.w3d_k4b_group_add_child_801b1cb8 0x801b1cb8 : { *(.text.w3d_k4b_group_add_child_801b1cb8) }
  /DISCARD/ : { *(.text*) *(.rodata*) *(.data*) *(.bss*) *(.sdata*) *(.sbss*) *(.comment) }
}
