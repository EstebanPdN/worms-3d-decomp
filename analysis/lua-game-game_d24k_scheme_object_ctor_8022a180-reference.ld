/* Generated reference-only placements. All bodies are source-built. */
OUTPUT_FORMAT("elf32-powerpc")
OUTPUT_ARCH(powerpc)
ENTRY(w3d_d24k_scheme_object_ctor_8022a180)
_SDA_BASE_ = 0x804b2540;
_SDA2_BASE_ = 0x804c2540;
d20e_empty_804b06a0 = 0x804b06a0;
d20e_string_header_80341884 = 0x80341884;
d20e_string_init_8020c5c0 = 0x8020c5c0;
fn_801ea0ec = 0x801ea0ec;
fn_8020b680 = 0x8020b680;
fn_802336ec = 0x802336ec;
fn_802336fc = 0x802336fc;
key_80419f08 = 0x80419f08;
vtable_8041a078 = 0x8041a078;
SECTIONS {
  .text.w3d_d24k_scheme_object_ctor_8022a180 0x8022a180 : { *(.text.w3d_d24k_scheme_object_ctor_8022a180) }
  /DISCARD/ : { *(.text*) *(.rodata*) *(.data*) *(.bss*) *(.sdata*) *(.sbss*) *(.comment) }
}
