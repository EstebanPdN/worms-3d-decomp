/* Generated reference-only placements. All bodies are source-built. */
OUTPUT_FORMAT("elf32-powerpc")
OUTPUT_ARCH(powerpc)
ENTRY(d29f_border_setup_80295268)
_SDA_BASE_ = 0x804b2540;
_SDA2_BASE_ = 0x804c2540;
__6StringPCc = 0x8020bb54;
fn_80295cec = 0x80295cec;
lbl_803d0798 = 0x803d0798;
lbl_803d07a0 = 0x803d07a0;
lbl_803d07b4 = 0x803d07b4;
lbl_803d07b8 = 0x803d07b8;
lbl_803d07bc = 0x803d07bc;
w3d_auto_80178df0 = 0x80178df0;
w3d_constructor_lookup_name = 0x800fc1b0;
w3d_empty_80342a74 = 0x80342a74;
w3d_handle_set_name = 0x8015adf4;
w3d_string_base_finish = 0x8020c5c4;
w3d_string_release = 0x80341588;
SECTIONS {
  .text.d29f_border_setup_80295268 0x80295268 : { *(.text.d29f_border_setup_80295268) }
  /DISCARD/ : { *(.text*) *(.rodata*) *(.data*) *(.bss*) *(.sdata*) *(.sbss*) *(.comment) }
}
