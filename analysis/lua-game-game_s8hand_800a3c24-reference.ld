/* Generated reference-only placements. All bodies are source-built. */
OUTPUT_FORMAT("elf32-powerpc")
OUTPUT_ARCH(powerpc)
ENTRY(s8_visibility_800a3c24)
_SDA_BASE_ = 0x804b2540;
_SDA2_BASE_ = 0x804c2540;
fn_800243a8 = 0x800243a8;
fn_8002900c = 0x8002900c;
fn_80065c94 = 0x80065c94;
fn_800a14c4 = 0x800a14c4;
fn_800a3010 = 0x800a3010;
fn_800f0c20 = 0x800f0c20;
fn_800ff634 = 0x800ff634;
fn_801315a0 = 0x801315a0;
fn_80164fc8 = 0x80164fc8;
SECTIONS {
  .text.s8_visibility_800a3c24 0x800a3c24 : { *(.text.s8_visibility_800a3c24) }
  /DISCARD/ : { *(.text*) *(.rodata*) *(.data*) *(.bss*) *(.sdata*) *(.sbss*) *(.comment) }
}
