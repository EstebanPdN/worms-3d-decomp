/* Generated reference-only placements. All bodies are source-built. */
OUTPUT_FORMAT("elf32-powerpc")
OUTPUT_ARCH(powerpc)
ENTRY(f4b_signed_direction_800af580)
_SDA_BASE_ = 0x804b2540;
_SDA2_BASE_ = 0x804c2540;
config_801797b4 = 0x801797b4;
identity_80341584 = 0x80341584;
one_803822cc = 0x803822cc;
sqrt_802e82c0 = 0x802e82c0;
zero_803822c8 = 0x803822c8;
SECTIONS {
  .text.f4b_signed_direction_800af580 0x800af580 : { *(.text.f4b_signed_direction_800af580) }
  /DISCARD/ : { *(.text*) *(.rodata*) *(.data*) *(.bss*) *(.sdata*) *(.sbss*) *(.comment) }
}
