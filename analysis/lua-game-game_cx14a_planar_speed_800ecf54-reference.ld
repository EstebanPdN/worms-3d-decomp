/* Generated reference-only placements. All bodies are source-built. */
OUTPUT_FORMAT("elf32-powerpc")
OUTPUT_ARCH(powerpc)
ENTRY(w3d_cx14a_planar_speed_800ecf54)
_SDA_BASE_ = 0x804b2540;
_SDA2_BASE_ = 0x804c2540;
lookup_80341584 = 0x80341584;
parameters_801797b4 = 0x801797b4;
sqrt_802e82c0 = 0x802e82c0;
zero_8038b5c8 = 0x8038b5c8;
SECTIONS {
  .text.w3d_cx14a_planar_speed_800ecf54 0x800ecf54 : { *(.text.w3d_cx14a_planar_speed_800ecf54) }
  /DISCARD/ : { *(.text*) *(.rodata*) *(.data*) *(.bss*) *(.sdata*) *(.sbss*) *(.comment) }
}
