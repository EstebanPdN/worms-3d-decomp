/* Generated reference-only placements. All bodies are source-built. */
OUTPUT_FORMAT("elf32-powerpc")
OUTPUT_ARCH(powerpc)
ENTRY(w3d_k2b_extend_bounds_8015ab54)
_SDA_BASE_ = 0x804b2540;
_SDA2_BASE_ = 0x804c2540;
w3d_query_extent_80178df0 = 0x80178df0;
SECTIONS {
  .text.w3d_k2b_extend_bounds_8015ab54 0x8015ab54 : { *(.text.w3d_k2b_extend_bounds_8015ab54) }
  /DISCARD/ : { *(.text*) *(.rodata*) *(.data*) *(.bss*) *(.sdata*) *(.sbss*) *(.comment) }
}
