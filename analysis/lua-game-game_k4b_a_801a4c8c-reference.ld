/* Generated reference-only placements. All bodies are source-built. */
OUTPUT_FORMAT("elf32-powerpc")
OUTPUT_ARCH(powerpc)
ENTRY(w3d_k4b_visit_prepared_item_801a4c8c)
_SDA_BASE_ = 0x804b2540;
_SDA2_BASE_ = 0x804c2540;
fn_801a4278 = 0x801a4278;
lbl_80363938 = 0x80363938;
SECTIONS {
  .text.w3d_k4b_visit_prepared_item_801a4c8c 0x801a4c8c : { *(.text.w3d_k4b_visit_prepared_item_801a4c8c) }
  /DISCARD/ : { *(.text*) *(.rodata*) *(.data*) *(.bss*) *(.sdata*) *(.sbss*) *(.comment) }
}
