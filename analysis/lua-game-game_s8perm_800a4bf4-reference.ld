/* Generated reference-only placements. All bodies are source-built. */
OUTPUT_FORMAT("elf32-powerpc")
OUTPUT_ARCH(powerpc)
ENTRY(s8_permuted_800a4bf4)
_SDA_BASE_ = 0x804b2540;
_SDA2_BASE_ = 0x804c2540;
fn_8015ADF4 = 0x8015adf4;
fn_8020BB54 = 0x8020bb54;
fn_8020C5C4 = 0x8020c5c4;
fn_80341588 = 0x80341588;
lbl_80380F9C = 0x80380f9c;
SECTIONS {
  .text.s8_permuted_800a4bf4 0x800a4bf4 : { *(.text.s8_permuted_800a4bf4) }
  /DISCARD/ : { *(.text*) *(.rodata*) *(.data*) *(.bss*) *(.sdata*) *(.sbss*) *(.comment) }
}
