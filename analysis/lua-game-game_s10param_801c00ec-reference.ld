/* Generated reference-only placements. All bodies are source-built. */
OUTPUT_FORMAT("elf32-powerpc")
OUTPUT_ARCH(powerpc)
ENTRY(w3d_s10_init_two_properties_801c00ec)
_SDA_BASE_ = 0x804b2540;
_SDA2_BASE_ = 0x804c2540;
fn_801e8d9c = 0x801e8d9c;
fn_801ec52c = 0x801ec52c;
lbl_803ac294 = 0x803ac294;
lbl_803ac2c8 = 0x803ac2c8;
SECTIONS {
  .text.w3d_s10_init_two_properties_801c00ec 0x801c00ec : { *(.text.w3d_s10_init_two_properties_801c00ec) }
  /DISCARD/ : { *(.text*) *(.rodata*) *(.data*) *(.bss*) *(.sdata*) *(.sbss*) *(.comment) }
}
