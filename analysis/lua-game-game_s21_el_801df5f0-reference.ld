/* Generated reference-only placements. All bodies are source-built. */
OUTPUT_FORMAT("elf32-powerpc")
OUTPUT_ARCH(powerpc)
ENTRY(w3d_s21_rebuild_801df5f0)
_SDA_BASE_ = 0x804b2540;
_SDA2_BASE_ = 0x804c2540;
fn_801e39bc = 0x801e39bc;
fn_801fe240 = 0x801fe240;
SECTIONS {
  .text.w3d_s21_rebuild_801df5f0 0x801df5f0 : { *(.text.w3d_s21_rebuild_801df5f0) }
  /DISCARD/ : { *(.text*) *(.rodata*) *(.data*) *(.bss*) *(.sdata*) *(.sbss*) *(.comment) }
}
