/* Generated reference-only placements. All bodies are source-built. */
OUTPUT_FORMAT("elf32-powerpc")
OUTPUT_ARCH(powerpc)
ENTRY(__23s8_Constructed_800e7a98)
_SDA_BASE_ = 0x804b2540;
_SDA2_BASE_ = 0x804c2540;
fn_801628b0 = 0x801628b0;
w3d_vtable_80410170 = 0x80410170;
SECTIONS {
  .text.__23s8_Constructed_800e7a98 0x800e7a98 : { *(.text.__23s8_Constructed_800e7a98) }
  /DISCARD/ : { *(.text*) *(.rodata*) *(.data*) *(.bss*) *(.sdata*) *(.sbss*) *(.comment) }
}
