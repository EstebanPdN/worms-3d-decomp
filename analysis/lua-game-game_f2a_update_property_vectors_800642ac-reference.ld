/* Generated reference-only placements. All bodies are source-built. */
OUTPUT_FORMAT("elf32-powerpc")
OUTPUT_ARCH(powerpc)
ENTRY(w3d_f2a_update_property_vectors_800642ac)
_SDA_BASE_ = 0x804b2540;
_SDA2_BASE_ = 0x804c2540;
fn_80178df0 = 0x80178df0;
fn_80189518 = 0x80189518;
fn_8018963c = 0x8018963c;
fn_8034380c = 0x8034380c;
lbl_80379d30 = 0x80379d30;
lbl_80379d34 = 0x80379d34;
lbl_80379d38 = 0x80379d38;
lbl_80379d3c = 0x80379d3c;
SECTIONS {
  .text.w3d_f2a_update_property_vectors_800642ac 0x800642ac : { *(.text.w3d_f2a_update_property_vectors_800642ac) }
  /DISCARD/ : { *(.text*) *(.rodata*) *(.data*) *(.bss*) *(.sdata*) *(.sbss*) *(.comment) }
}
