/* Generated reference-only placements. All bodies are source-built. */
OUTPUT_FORMAT("elf32-powerpc")
OUTPUT_ARCH(powerpc)
ENTRY(w3d_registry_release_8002dcf4)
_SDA_BASE_ = 0x804b2540;
_SDA2_BASE_ = 0x804c2540;
w3d_fn_8002dc50 = 0x8002dc50;
w3d_fn_8002ddc4 = 0x8002ddc4;
w3d_fn_8002e8ec = 0x8002e8ec;
w3d_fn_8002e93c = 0x8002e93c;
w3d_fn_8002f9d8 = 0x8002f9d8;
w3d_fn_8002fa40 = 0x8002fa40;
w3d_fn_800308e4 = 0x800308e4;
w3d_fn_800310b0 = 0x800310b0;
w3d_fn_80036e08 = 0x80036e08;
w3d_fn_80036e68 = 0x80036e68;
w3d_fn_80037988 = 0x80037988;
w3d_fn_800379fc = 0x800379fc;
w3d_fn_80038894 = 0x80038894;
w3d_fn_80038910 = 0x80038910;
w3d_fn_8003a490 = 0x8003a490;
w3d_fn_8003a4e0 = 0x8003a4e0;
w3d_fn_8003a924 = 0x8003a924;
w3d_fn_8003a970 = 0x8003a970;
w3d_fn_8003ba00 = 0x8003ba00;
w3d_fn_8003ba8c = 0x8003ba8c;
w3d_fn_8003d37c = 0x8003d37c;
w3d_fn_8003d3cc = 0x8003d3cc;
w3d_fn_8003dde0 = 0x8003dde0;
w3d_fn_8003de80 = 0x8003de80;
w3d_fn_8003f254 = 0x8003f254;
w3d_fn_8003f2a4 = 0x8003f2a4;
w3d_fn_80041ef8 = 0x80041ef8;
w3d_fn_80042004 = 0x80042004;
w3d_global_8035fe20 = 0x8035fe20;
w3d_global_8035fe50 = 0x8035fe50;
w3d_global_8035fe80 = 0x8035fe80;
w3d_global_8035feb0 = 0x8035feb0;
w3d_global_8035fee0 = 0x8035fee0;
w3d_global_8035ff10 = 0x8035ff10;
w3d_global_8035ff40 = 0x8035ff40;
w3d_global_8035ff70 = 0x8035ff70;
w3d_global_8035ffa0 = 0x8035ffa0;
w3d_global_8035ffd0 = 0x8035ffd0;
w3d_global_80360000 = 0x80360000;
w3d_global_80360030 = 0x80360030;
w3d_global_80360060 = 0x80360060;
w3d_heap_allocate_entry_a = 0x801fe1d8;
w3d_owner_list_remove = 0x8020fd2c;
w3d_registry_list_8035fe20 = 0x8035fe20;
w3d_registry_list_8035fe50 = 0x8035fe50;
w3d_registry_list_8035fe80 = 0x8035fe80;
w3d_registry_list_8035feb0 = 0x8035feb0;
w3d_registry_list_8035fee0 = 0x8035fee0;
w3d_registry_list_8035ff10 = 0x8035ff10;
w3d_registry_list_8035ff40 = 0x8035ff40;
w3d_registry_list_8035ff70 = 0x8035ff70;
w3d_registry_list_8035ffa0 = 0x8035ffa0;
w3d_registry_list_8035ffd0 = 0x8035ffd0;
w3d_registry_list_80360000 = 0x80360000;
w3d_registry_list_80360030 = 0x80360030;
w3d_registry_list_80360060 = 0x80360060;
w3d_state_register = 0x8020fd04;
SECTIONS {
  .text.w3d_registry_release_8002dcf4 0x8002dcf4 : { *(.text.w3d_registry_release_8002dcf4) }
  .text.w3d_registry_retain_8002dd50 0x8002dd50 : { *(.text.w3d_registry_retain_8002dd50) }
  .text.w3d_address_8002e7c8 0x8002e7c8 : { *(.text.w3d_address_8002e7c8) }
  .text.w3d_registry_unlink_8002e7d4 0x8002e7d4 : { *(.text.w3d_registry_unlink_8002e7d4) }
  .text.w3d_registry_create_8002e818 0x8002e818 : { *(.text.w3d_registry_create_8002e818) }
  .text.w3d_registry_release_8002e878 0x8002e878 : { *(.text.w3d_registry_release_8002e878) }
  .text.w3d_registry_retain_8002e8d4 0x8002e8d4 : { *(.text.w3d_registry_retain_8002e8d4) }
  .text.w3d_constant_8002ead0 0x8002ead0 : { *(.text.w3d_constant_8002ead0) }
  .text.w3d_address_8002f8b4 0x8002f8b4 : { *(.text.w3d_address_8002f8b4) }
  .text.w3d_registry_unlink_8002f8c0 0x8002f8c0 : { *(.text.w3d_registry_unlink_8002f8c0) }
  .text.w3d_registry_create_8002f904 0x8002f904 : { *(.text.w3d_registry_create_8002f904) }
  .text.w3d_registry_release_8002f964 0x8002f964 : { *(.text.w3d_registry_release_8002f964) }
  .text.w3d_registry_retain_8002f9c0 0x8002f9c0 : { *(.text.w3d_registry_retain_8002f9c0) }
  .text.w3d_empty_8003013c 0x8003013c : { *(.text.w3d_empty_8003013c) }
  .text.w3d_address_800307c0 0x800307c0 : { *(.text.w3d_address_800307c0) }
  .text.w3d_registry_unlink_800307cc 0x800307cc : { *(.text.w3d_registry_unlink_800307cc) }
  .text.w3d_registry_create_80030810 0x80030810 : { *(.text.w3d_registry_create_80030810) }
  .text.w3d_registry_release_80030870 0x80030870 : { *(.text.w3d_registry_release_80030870) }
  .text.w3d_registry_retain_800308cc 0x800308cc : { *(.text.w3d_registry_retain_800308cc) }
  .text.w3d_constant_80033200 0x80033200 : { *(.text.w3d_constant_80033200) }
  .text.w3d_empty_80036a90 0x80036a90 : { *(.text.w3d_empty_80036a90) }
  .text.w3d_address_80036ce4 0x80036ce4 : { *(.text.w3d_address_80036ce4) }
  .text.w3d_registry_unlink_80036cf0 0x80036cf0 : { *(.text.w3d_registry_unlink_80036cf0) }
  .text.w3d_registry_create_80036d34 0x80036d34 : { *(.text.w3d_registry_create_80036d34) }
  .text.w3d_registry_release_80036d94 0x80036d94 : { *(.text.w3d_registry_release_80036d94) }
  .text.w3d_registry_retain_80036df0 0x80036df0 : { *(.text.w3d_registry_retain_80036df0) }
  .text.w3d_address_80037864 0x80037864 : { *(.text.w3d_address_80037864) }
  .text.w3d_registry_unlink_80037870 0x80037870 : { *(.text.w3d_registry_unlink_80037870) }
  .text.w3d_registry_create_800378b4 0x800378b4 : { *(.text.w3d_registry_create_800378b4) }
  .text.w3d_registry_release_80037914 0x80037914 : { *(.text.w3d_registry_release_80037914) }
  .text.w3d_registry_retain_80037970 0x80037970 : { *(.text.w3d_registry_retain_80037970) }
  .text.w3d_address_80038768 0x80038768 : { *(.text.w3d_address_80038768) }
  .text.w3d_registry_unlink_80038774 0x80038774 : { *(.text.w3d_registry_unlink_80038774) }
  .text.w3d_registry_create_800387b8 0x800387b8 : { *(.text.w3d_registry_create_800387b8) }
  .text.w3d_registry_release_80038818 0x80038818 : { *(.text.w3d_registry_release_80038818) }
  .text.w3d_registry_retain_80038874 0x80038874 : { *(.text.w3d_registry_retain_80038874) }
  .text.w3d_constant_80038c6c 0x80038c6c : { *(.text.w3d_constant_80038c6c) }
  .text.w3d_empty_80038d18 0x80038d18 : { *(.text.w3d_empty_80038d18) }
  .text.w3d_address_8003a36c 0x8003a36c : { *(.text.w3d_address_8003a36c) }
  .text.w3d_registry_unlink_8003a378 0x8003a378 : { *(.text.w3d_registry_unlink_8003a378) }
  .text.w3d_registry_create_8003a3bc 0x8003a3bc : { *(.text.w3d_registry_create_8003a3bc) }
  .text.w3d_registry_release_8003a41c 0x8003a41c : { *(.text.w3d_registry_release_8003a41c) }
  .text.w3d_registry_retain_8003a478 0x8003a478 : { *(.text.w3d_registry_retain_8003a478) }
  .text.w3d_empty_8003a770 0x8003a770 : { *(.text.w3d_empty_8003a770) }
  .text.w3d_address_8003a800 0x8003a800 : { *(.text.w3d_address_8003a800) }
  .text.w3d_registry_unlink_8003a80c 0x8003a80c : { *(.text.w3d_registry_unlink_8003a80c) }
  .text.w3d_registry_create_8003a850 0x8003a850 : { *(.text.w3d_registry_create_8003a850) }
  .text.w3d_registry_release_8003a8b0 0x8003a8b0 : { *(.text.w3d_registry_release_8003a8b0) }
  .text.w3d_registry_retain_8003a90c 0x8003a90c : { *(.text.w3d_registry_retain_8003a90c) }
  .text.w3d_empty_8003ad10 0x8003ad10 : { *(.text.w3d_empty_8003ad10) }
  .text.w3d_address_8003b8dc 0x8003b8dc : { *(.text.w3d_address_8003b8dc) }
  .text.w3d_registry_unlink_8003b8e8 0x8003b8e8 : { *(.text.w3d_registry_unlink_8003b8e8) }
  .text.w3d_registry_create_8003b92c 0x8003b92c : { *(.text.w3d_registry_create_8003b92c) }
  .text.w3d_registry_release_8003b98c 0x8003b98c : { *(.text.w3d_registry_release_8003b98c) }
  .text.w3d_registry_retain_8003b9e8 0x8003b9e8 : { *(.text.w3d_registry_retain_8003b9e8) }
  .text.w3d_address_8003d258 0x8003d258 : { *(.text.w3d_address_8003d258) }
  .text.w3d_registry_unlink_8003d264 0x8003d264 : { *(.text.w3d_registry_unlink_8003d264) }
  .text.w3d_registry_create_8003d2a8 0x8003d2a8 : { *(.text.w3d_registry_create_8003d2a8) }
  .text.w3d_registry_release_8003d308 0x8003d308 : { *(.text.w3d_registry_release_8003d308) }
  .text.w3d_registry_retain_8003d364 0x8003d364 : { *(.text.w3d_registry_retain_8003d364) }
  .text.w3d_empty_8003dc00 0x8003dc00 : { *(.text.w3d_empty_8003dc00) }
  .text.w3d_address_8003dcbc 0x8003dcbc : { *(.text.w3d_address_8003dcbc) }
  .text.w3d_registry_unlink_8003dcc8 0x8003dcc8 : { *(.text.w3d_registry_unlink_8003dcc8) }
  .text.w3d_registry_create_8003dd0c 0x8003dd0c : { *(.text.w3d_registry_create_8003dd0c) }
  .text.w3d_registry_release_8003dd6c 0x8003dd6c : { *(.text.w3d_registry_release_8003dd6c) }
  .text.w3d_registry_retain_8003ddc8 0x8003ddc8 : { *(.text.w3d_registry_retain_8003ddc8) }
  .text.w3d_empty_8003e1f4 0x8003e1f4 : { *(.text.w3d_empty_8003e1f4) }
  .text.w3d_empty_8003ebd8 0x8003ebd8 : { *(.text.w3d_empty_8003ebd8) }
  .text.w3d_address_8003f11c 0x8003f11c : { *(.text.w3d_address_8003f11c) }
  .text.w3d_registry_unlink_8003f128 0x8003f128 : { *(.text.w3d_registry_unlink_8003f128) }
  .text.w3d_registry_create_8003f16c 0x8003f16c : { *(.text.w3d_registry_create_8003f16c) }
  .text.w3d_registry_release_8003f1cc 0x8003f1cc : { *(.text.w3d_registry_release_8003f1cc) }
  .text.w3d_registry_retain_8003f228 0x8003f228 : { *(.text.w3d_registry_retain_8003f228) }
  .text.w3d_constant_8003f3f4 0x8003f3f4 : { *(.text.w3d_constant_8003f3f4) }
  .text.w3d_empty_8003f3fc 0x8003f3fc : { *(.text.w3d_empty_8003f3fc) }
  .text.w3d_empty_800419c8 0x800419c8 : { *(.text.w3d_empty_800419c8) }
  .text.w3d_address_80041c04 0x80041c04 : { *(.text.w3d_address_80041c04) }
  .text.w3d_registry_unlink_80041c10 0x80041c10 : { *(.text.w3d_registry_unlink_80041c10) }
  .text.w3d_registry_create_80041c54 0x80041c54 : { *(.text.w3d_registry_create_80041c54) }
  .text.w3d_registry_release_80041cb4 0x80041cb4 : { *(.text.w3d_registry_release_80041cb4) }
  /DISCARD/ : { *(.text*) *(.rodata*) *(.data*) *(.bss*) *(.sdata*) *(.sbss*) *(.comment) }
}
