/* Generated reference-only placements. All bodies are source-built. */
OUTPUT_FORMAT("elf32-powerpc")
OUTPUT_ARCH(powerpc)
ENTRY(d27j_sort_entries_80193204)
_SDA_BASE_ = 0x804b2540;
_SDA2_BASE_ = 0x804c2540;
fn_801907d0 = 0x801907d0;
fn_8020bb2c = 0x8020bb2c;
fn_8020c5c4 = 0x8020c5c4;
fn_802134fc = 0x802134fc;
fn_80341588 = 0x80341588;
fn_803426b8 = 0x803426b8;
fn_8034f190 = 0x8034f190;
insert_80344380 = 0x80344380;
insert_8034d1c8 = 0x8034d1c8;
insert_8034d568 = 0x8034d568;
strcmp_802ef234 = 0x802ef234;
SECTIONS {
  .text.d27j_sort_entries_80193204 0x80193204 : { *(.text.d27j_sort_entries_80193204) }
  /DISCARD/ : { *(.text*) *(.rodata*) *(.data*) *(.bss*) *(.sdata*) *(.sbss*) *(.comment) }
}
