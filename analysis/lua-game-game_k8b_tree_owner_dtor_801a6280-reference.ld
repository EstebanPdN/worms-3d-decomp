/* Generated reference-only placements. All bodies are source-built. */
OUTPUT_FORMAT("elf32-powerpc")
OUTPUT_ARCH(powerpc)
ENTRY(w3d_k8b_tree_owner_dtor_801a6280)
_SDA_BASE_ = 0x804b2540;
_SDA2_BASE_ = 0x804c2540;
lbl_80413b38 = 0x80413b38;
lbl_80413b90 = 0x80413b90;
w3d_actor_member_delete_backend = 0x801fe1f8;
w3d_auto_80352f34 = 0x80352f34;
w3d_destroy_801e828c = 0x801e828c;
w3d_handle_storage_release = 0x802134fc;
SECTIONS {
  .text.w3d_k8b_tree_owner_dtor_801a6280 0x801a6280 : { *(.text.w3d_k8b_tree_owner_dtor_801a6280) }
  /DISCARD/ : { *(.text*) *(.rodata*) *(.data*) *(.bss*) *(.sdata*) *(.sbss*) *(.comment) }
}
