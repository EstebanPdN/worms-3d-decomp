/* Generated reference-only placements. All bodies are source-built. */
OUTPUT_FORMAT("elf32-powerpc")
OUTPUT_ARCH(powerpc)
ENTRY(w3d_get_80348834)
_SDA_BASE_ = 0x804b2540;
_SDA2_BASE_ = 0x804c2540;
SECTIONS {
  .text.w3d_get_80348834 0x80348834 : { *(.text.w3d_get_80348834) }
  .text.w3d_get_80348870 0x80348870 : { *(.text.w3d_get_80348870) }
  .text.w3d_get_80348f1c 0x80348f1c : { *(.text.w3d_get_80348f1c) }
  .text.w3d_constant_80348f24 0x80348f24 : { *(.text.w3d_constant_80348f24) }
  .text.w3d_get_80349b18 0x80349b18 : { *(.text.w3d_get_80349b18) }
  .text.w3d_get_80349b54 0x80349b54 : { *(.text.w3d_get_80349b54) }
  .text.w3d_get_8034a210 0x8034a210 : { *(.text.w3d_get_8034a210) }
  .text.w3d_constant_8034a398 0x8034a398 : { *(.text.w3d_constant_8034a398) }
  .text.w3d_get_8034bb3c 0x8034bb3c : { *(.text.w3d_get_8034bb3c) }
  .text.w3d_get_8034bbcc 0x8034bbcc : { *(.text.w3d_get_8034bbcc) }
  .text.w3d_empty_8034bf48 0x8034bf48 : { *(.text.w3d_empty_8034bf48) }
  .text.w3d_empty_8034bf4c 0x8034bf4c : { *(.text.w3d_empty_8034bf4c) }
  .text.w3d_constant_8034cb34 0x8034cb34 : { *(.text.w3d_constant_8034cb34) }
  .text.w3d_constant_8034cb3c 0x8034cb3c : { *(.text.w3d_constant_8034cb3c) }
  .text.w3d_constant_8034cb44 0x8034cb44 : { *(.text.w3d_constant_8034cb44) }
  .text.w3d_constant_8034cb4c 0x8034cb4c : { *(.text.w3d_constant_8034cb4c) }
  .text.w3d_constant_8034cb54 0x8034cb54 : { *(.text.w3d_constant_8034cb54) }
  .text.w3d_constant_8034cb5c 0x8034cb5c : { *(.text.w3d_constant_8034cb5c) }
  .text.w3d_empty_8034cc30 0x8034cc30 : { *(.text.w3d_empty_8034cc30) }
  .text.w3d_empty_8034cc34 0x8034cc34 : { *(.text.w3d_empty_8034cc34) }
  .text.w3d_empty_8034cc38 0x8034cc38 : { *(.text.w3d_empty_8034cc38) }
  .text.w3d_get_803528b0 0x803528b0 : { *(.text.w3d_get_803528b0) }
  .text.w3d_get_803529c8 0x803529c8 : { *(.text.w3d_get_803529c8) }
  .text.w3d_empty_80352ae0 0x80352ae0 : { *(.text.w3d_empty_80352ae0) }
  .text.w3d_empty_80352ae4 0x80352ae4 : { *(.text.w3d_empty_80352ae4) }
  .text.w3d_get_803556e8 0x803556e8 : { *(.text.w3d_get_803556e8) }
  .text.w3d_get_80356464 0x80356464 : { *(.text.w3d_get_80356464) }
  .text.w3d_get_8035676c 0x8035676c : { *(.text.w3d_get_8035676c) }
  .text.w3d_get_80356d10 0x80356d10 : { *(.text.w3d_get_80356d10) }
  .text.w3d_get_8035a1f0 0x8035a1f0 : { *(.text.w3d_get_8035a1f0) }
  .text.w3d_get_8035e100 0x8035e100 : { *(.text.w3d_get_8035e100) }
  .text.w3d_get_8035e108 0x8035e108 : { *(.text.w3d_get_8035e108) }
  .text.w3d_get_8035e110 0x8035e110 : { *(.text.w3d_get_8035e110) }
  .text.w3d_constant_8035e1d8 0x8035e1d8 : { *(.text.w3d_constant_8035e1d8) }
  .text.w3d_get_8035e2a8 0x8035e2a8 : { *(.text.w3d_get_8035e2a8) }
  .text.w3d_get_8035e2b0 0x8035e2b0 : { *(.text.w3d_get_8035e2b0) }
  .text.w3d_get_8035e2b8 0x8035e2b8 : { *(.text.w3d_get_8035e2b8) }
  .text.w3d_constant_8035e3c8 0x8035e3c8 : { *(.text.w3d_constant_8035e3c8) }
  .text.w3d_get_8035e4ec 0x8035e4ec : { *(.text.w3d_get_8035e4ec) }
  .text.w3d_get_8035e4f4 0x8035e4f4 : { *(.text.w3d_get_8035e4f4) }
  .text.w3d_get_8035e4fc 0x8035e4fc : { *(.text.w3d_get_8035e4fc) }
  .text.w3d_constant_8035e5c4 0x8035e5c4 : { *(.text.w3d_constant_8035e5c4) }
  .text.w3d_get_8035e694 0x8035e694 : { *(.text.w3d_get_8035e694) }
  .text.w3d_get_8035e69c 0x8035e69c : { *(.text.w3d_get_8035e69c) }
  .text.w3d_get_8035e6a4 0x8035e6a4 : { *(.text.w3d_get_8035e6a4) }
  .text.w3d_constant_8035e76c 0x8035e76c : { *(.text.w3d_constant_8035e76c) }
  .text.w3d_get_8035e83c 0x8035e83c : { *(.text.w3d_get_8035e83c) }
  .text.w3d_get_8035e844 0x8035e844 : { *(.text.w3d_get_8035e844) }
  .text.w3d_get_8035e84c 0x8035e84c : { *(.text.w3d_get_8035e84c) }
  .text.w3d_constant_8035e914 0x8035e914 : { *(.text.w3d_constant_8035e914) }
  /DISCARD/ : { *(.text*) *(.rodata*) *(.data*) *(.bss*) *(.sdata*) *(.sbss*) *(.comment) }
}
