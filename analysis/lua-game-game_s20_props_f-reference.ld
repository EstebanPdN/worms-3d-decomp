/* Generated reference-only placements. All bodies are source-built. */
OUTPUT_FORMAT("elf32-powerpc")
OUTPUT_ARCH(powerpc)
ENTRY(w3d_s20_register_entries_vec4_801cd188)
_SDA_BASE_ = 0x804b2540;
_SDA2_BASE_ = 0x804c2540;
fn_801e8d9c = 0x801e8d9c;
fn_801eb674 = 0x801eb674;
fn_801ec52c = 0x801ec52c;
fn_801ece2c = 0x801ece2c;
fn_801f0b70 = 0x801f0b70;
lbl_803ae5bc = 0x803ae5bc;
lbl_803ae5ec = 0x803ae5ec;
lbl_803ae61c = 0x803ae61c;
lbl_803ae648 = 0x803ae648;
lbl_803ae674 = 0x803ae674;
lbl_803ae6a4 = 0x803ae6a4;
lbl_803ae6cc = 0x803ae6cc;
SECTIONS {
  .text.w3d_s20_register_entries_vec4_801cd188 0x801cd188 : { *(.text.w3d_s20_register_entries_vec4_801cd188) }
  /DISCARD/ : { *(.text*) *(.rodata*) *(.data*) *(.bss*) *(.sdata*) *(.sbss*) *(.comment) }
}
