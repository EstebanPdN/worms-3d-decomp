/* Generated reference-only placements. All bodies are source-built. */
OUTPUT_FORMAT("elf32-powerpc")
OUTPUT_ARCH(powerpc)
ENTRY(w3d_s21_construct_801f7538)
_SDA_BASE_ = 0x804b2540;
_SDA2_BASE_ = 0x804c2540;
fn_801f6480 = 0x801f6480;
lbl_803b1708 = 0x803b1708;
SECTIONS {
  .text.w3d_s21_construct_801f7538 0x801f7538 : { *(.text.w3d_s21_construct_801f7538) }
  /DISCARD/ : { *(.text*) *(.rodata*) *(.data*) *(.bss*) *(.sdata*) *(.sbss*) *(.comment) }
}
