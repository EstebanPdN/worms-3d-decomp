/* Generated reference-only placements. All bodies are source-built. */
OUTPUT_FORMAT("elf32-powerpc")
OUTPUT_ARCH(powerpc)
ENTRY(f5b_blend_positions_80067c4c)
_SDA_BASE_ = 0x804b2540;
_SDA2_BASE_ = 0x804c2540;
fn_8015ab54 = 0x8015ab54;
fn_80164fc8 = 0x80164fc8;
fn_80165254 = 0x80165254;
one_8037a1a0 = 0x8037a1a0;
SECTIONS {
  .text.f5b_blend_positions_80067c4c 0x80067c4c : { *(.text.f5b_blend_positions_80067c4c) }
  /DISCARD/ : { *(.text*) *(.rodata*) *(.data*) *(.bss*) *(.sdata*) *(.sbss*) *(.comment) }
}
