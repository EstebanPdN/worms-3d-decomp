/* Generated reference-only placements. All bodies are source-built. */
OUTPUT_FORMAT("elf32-powerpc")
OUTPUT_ARCH(powerpc)
ENTRY(w3d_cc17c_props_reset_80221c84)
_SDA_BASE_ = 0x804b2540;
_SDA2_BASE_ = 0x804c2540;
fn_801e8d9c = 0x801e8d9c;
fn_801ece2c = 0x801ece2c;
fn_801ed24c = 0x801ed24c;
fn_8020bb2c = 0x8020bb2c;
fn_8020c5c0 = 0x8020c5c0;
fn_8020c5c4 = 0x8020c5c4;
fn_80341588 = 0x80341588;
fn_80341884 = 0x80341884;
lbl_803b6a78 = 0x803b6a78;
lbl_803b6ab0 = 0x803b6ab0;
lbl_803b6ad4 = 0x803b6ad4;
lbl_804b06a0 = 0x804b06a0;
SECTIONS {
  .text.w3d_cc17c_props_reset_80221c84 0x80221c84 : { *(.text.w3d_cc17c_props_reset_80221c84) }
  /DISCARD/ : { *(.text*) *(.rodata*) *(.data*) *(.bss*) *(.sdata*) *(.sbss*) *(.comment) }
}
