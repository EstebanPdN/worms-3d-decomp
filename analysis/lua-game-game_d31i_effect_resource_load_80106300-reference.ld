/* Generated reference-only placements. All bodies are source-built. */
OUTPUT_FORMAT("elf32-powerpc")
OUTPUT_ARCH(powerpc)
ENTRY(d31i_effect_resource_load_80106300)
_SDA_BASE_ = 0x804b2540;
_SDA2_BASE_ = 0x804c2540;
__6String = 0x803426b8;
class_804164c0 = 0x804164c0;
create_8020b680 = 0x8020b680;
link_8010682c = 0x8010682c;
record_8040e078 = 0x8040e078;
reg_a_80106530 = 0x80106530;
reg_b_80106734 = 0x80106734;
reg_c_8010663c = 0x8010663c;
s_803998bc = 0x803998bc;
s_803998c4 = 0x803998c4;
s_803998d0 = 0x803998d0;
string_finish_8020c5c4 = 0x8020c5c4;
string_format_8020c510 = 0x8020c510;
string_release_80341588 = 0x80341588;
SECTIONS {
  .text.d31i_effect_resource_load_80106300 0x80106300 : { *(.text.d31i_effect_resource_load_80106300) }
  /DISCARD/ : { *(.text*) *(.rodata*) *(.data*) *(.bss*) *(.sdata*) *(.sbss*) *(.comment) }
}
