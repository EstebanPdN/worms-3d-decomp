/* Generated reference-only placements. All bodies are source-built. */
OUTPUT_FORMAT("elf32-powerpc")
OUTPUT_ARCH(powerpc)
ENTRY(w3d_k8c_widget_set_state_8026c4dc)
_SDA_BASE_ = 0x804b2540;
_SDA2_BASE_ = 0x804c2540;
fn_80178d28 = 0x80178d28;
fn_802b1258 = 0x802b1258;
fn_80342a78 = 0x80342a78;
SECTIONS {
  .text.w3d_k8c_widget_set_state_8026c4dc 0x8026c4dc : { *(.text.w3d_k8c_widget_set_state_8026c4dc) }
  /DISCARD/ : { *(.text*) *(.rodata*) *(.data*) *(.bss*) *(.sdata*) *(.sbss*) *(.comment) }
}
