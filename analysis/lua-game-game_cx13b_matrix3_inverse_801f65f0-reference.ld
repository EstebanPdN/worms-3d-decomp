/* Generated reference-only placements. All bodies are source-built. */
OUTPUT_FORMAT("elf32-powerpc")
OUTPUT_ARCH(powerpc)
ENTRY(w3d_cx13b_matrix3_inverse_801f65f0)
_SDA_BASE_ = 0x804b2540;
_SDA2_BASE_ = 0x804c2540;
one_803b1624 = 0x803b1624;
SECTIONS {
  .text.w3d_cx13b_matrix3_inverse_801f65f0 0x801f65f0 : { *(.text.w3d_cx13b_matrix3_inverse_801f65f0) }
  /DISCARD/ : { *(.text*) *(.rodata*) *(.data*) *(.bss*) *(.sdata*) *(.sbss*) *(.comment) }
}
