/* Generated reference-only placements. All bodies are source-built. */
OUTPUT_FORMAT("elf32-powerpc")
OUTPUT_ARCH(powerpc)
ENTRY(h1b_attach_mode_801dd62c)
_SDA_BASE_ = 0x804b2540;
_SDA2_BASE_ = 0x804c2540;
fn_80210d54 = 0x80210d54;
SECTIONS {
  .text.h1b_attach_mode_801dd62c 0x801dd62c : { *(.text.h1b_attach_mode_801dd62c) }
  /DISCARD/ : { *(.text*) *(.rodata*) *(.data*) *(.bss*) *(.sdata*) *(.sbss*) *(.comment) }
}
