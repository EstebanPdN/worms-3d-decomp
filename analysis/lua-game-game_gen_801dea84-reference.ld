/* Generated reference-only placements. All bodies are source-built. */
OUTPUT_FORMAT("elf32-powerpc")
OUTPUT_ARCH(powerpc)
ENTRY(w3d_empty_801dea84)
_SDA_BASE_ = 0x804b2540;
_SDA2_BASE_ = 0x804c2540;
w3d_fn_801dec90 = 0x801dec90;
w3d_fn_801ded9c = 0x801ded9c;
w3d_fn_801df490 = 0x801df490;
w3d_fn_801df4ec = 0x801df4ec;
w3d_fn_801dfbd4 = 0x801dfbd4;
w3d_fn_801dfcb4 = 0x801dfcb4;
w3d_fn_801e84d0 = 0x801e84d0;
w3d_fn_801ea138 = 0x801ea138;
w3d_fn_801f2d24 = 0x801f2d24;
w3d_fn_801f2db4 = 0x801f2db4;
w3d_global_8036564c = 0x8036564c;
w3d_global_8036567c = 0x8036567c;
w3d_global_803656ac = 0x803656ac;
w3d_global_8036573c = 0x8036573c;
w3d_global_80365788 = 0x80365788;
w3d_global_803657d8 = 0x803657d8;
w3d_global_803b034c = 0x803b034c;
w3d_global_803b0394 = 0x803b0394;
w3d_global_803b03d4 = 0x803b03d4;
w3d_global_803b03ec = 0x803b03ec;
w3d_global_803b09a0 = 0x803b09a0;
w3d_global_803b09f8 = 0x803b09f8;
w3d_global_803b0d98 = 0x803b0d98;
w3d_global_803ffe4c = 0x803ffe4c;
w3d_global_8045e0b0 = 0x8045e0b0;
w3d_global_8045e7b8 = 0x8045e7b8;
w3d_heap_allocate_entry_a = 0x801fe1d8;
w3d_owner_list_remove = 0x8020fd2c;
w3d_registry_list_8036564c = 0x8036564c;
w3d_registry_list_8036567c = 0x8036567c;
w3d_registry_list_803656ac = 0x803656ac;
w3d_registry_list_8036573c = 0x8036573c;
w3d_registry_list_80365788 = 0x80365788;
w3d_registry_list_803657d8 = 0x803657d8;
w3d_state_register = 0x8020fd04;
SECTIONS {
  .text.w3d_empty_801dea84 0x801dea84 : { *(.text.w3d_empty_801dea84) }
  .text.w3d_constant_801dea88 0x801dea88 : { *(.text.w3d_constant_801dea88) }
  .text.w3d_address_801deb18 0x801deb18 : { *(.text.w3d_address_801deb18) }
  .text.w3d_registry_unlink_801deb24 0x801deb24 : { *(.text.w3d_registry_unlink_801deb24) }
  .text.w3d_registry_create_801deb68 0x801deb68 : { *(.text.w3d_registry_create_801deb68) }
  .text.w3d_address_801debc8 0x801debc8 : { *(.text.w3d_address_801debc8) }
  .text.w3d_registry_release_801debd4 0x801debd4 : { *(.text.w3d_registry_release_801debd4) }
  .text.w3d_registry_retain_801dec30 0x801dec30 : { *(.text.w3d_registry_retain_801dec30) }
  .text.w3d_constant_801dee64 0x801dee64 : { *(.text.w3d_constant_801dee64) }
  .text.w3d_get_801dee78 0x801dee78 : { *(.text.w3d_get_801dee78) }
  .text.w3d_get_801dee8c 0x801dee8c : { *(.text.w3d_get_801dee8c) }
  .text.w3d_get_801deebc 0x801deebc : { *(.text.w3d_get_801deebc) }
  .text.w3d_get_801deed0 0x801deed0 : { *(.text.w3d_get_801deed0) }
  .text.w3d_get_801df104 0x801df104 : { *(.text.w3d_get_801df104) }
  .text.w3d_constant_801df10c 0x801df10c : { *(.text.w3d_constant_801df10c) }
  .text.w3d_constant_801df114 0x801df114 : { *(.text.w3d_constant_801df114) }
  .text.w3d_get_801df1ac 0x801df1ac : { *(.text.w3d_get_801df1ac) }
  .text.w3d_set_801df1dc 0x801df1dc : { *(.text.w3d_set_801df1dc) }
  .text.w3d_set_801df234 0x801df234 : { *(.text.w3d_set_801df234) }
  .text.w3d_set_801df280 0x801df280 : { *(.text.w3d_set_801df280) }
  .text.w3d_get_801df288 0x801df288 : { *(.text.w3d_get_801df288) }
  .text.w3d_address_801df318 0x801df318 : { *(.text.w3d_address_801df318) }
  .text.w3d_registry_unlink_801df324 0x801df324 : { *(.text.w3d_registry_unlink_801df324) }
  .text.w3d_registry_create_801df368 0x801df368 : { *(.text.w3d_registry_create_801df368) }
  .text.w3d_address_801df3c8 0x801df3c8 : { *(.text.w3d_address_801df3c8) }
  .text.w3d_registry_release_801df3d4 0x801df3d4 : { *(.text.w3d_registry_release_801df3d4) }
  .text.w3d_registry_retain_801df430 0x801df430 : { *(.text.w3d_registry_retain_801df430) }
  .text.w3d_get_801df56c 0x801df56c : { *(.text.w3d_get_801df56c) }
  .text.w3d_get_801df574 0x801df574 : { *(.text.w3d_get_801df574) }
  .text.w3d_address_801df994 0x801df994 : { *(.text.w3d_address_801df994) }
  .text.w3d_registry_unlink_801df9a0 0x801df9a0 : { *(.text.w3d_registry_unlink_801df9a0) }
  .text.w3d_registry_create_801df9e4 0x801df9e4 : { *(.text.w3d_registry_create_801df9e4) }
  .text.w3d_address_801dfa44 0x801dfa44 : { *(.text.w3d_address_801dfa44) }
  .text.w3d_address_801dfb0c 0x801dfb0c : { *(.text.w3d_address_801dfb0c) }
  .text.w3d_registry_release_801dfb18 0x801dfb18 : { *(.text.w3d_registry_release_801dfb18) }
  .text.w3d_registry_retain_801dfb74 0x801dfb74 : { *(.text.w3d_registry_retain_801dfb74) }
  .text.w3d_constant_801e50b0 0x801e50b0 : { *(.text.w3d_constant_801e50b0) }
  .text.w3d_empty_801e50b8 0x801e50b8 : { *(.text.w3d_empty_801e50b8) }
  .text.w3d_empty_801e5604 0x801e5604 : { *(.text.w3d_empty_801e5604) }
  .text.w3d_empty_801e5608 0x801e5608 : { *(.text.w3d_empty_801e5608) }
  .text.w3d_constant_801e59a4 0x801e59a4 : { *(.text.w3d_constant_801e59a4) }
  .text.w3d_constant_801e59ac 0x801e59ac : { *(.text.w3d_constant_801e59ac) }
  .text.w3d_empty_801e5b7c 0x801e5b7c : { *(.text.w3d_empty_801e5b7c) }
  .text.w3d_constant_801e6dc4 0x801e6dc4 : { *(.text.w3d_constant_801e6dc4) }
  .text.w3d_constant_801e6f04 0x801e6f04 : { *(.text.w3d_constant_801e6f04) }
  .text.w3d_constant_801e6f4c 0x801e6f4c : { *(.text.w3d_constant_801e6f4c) }
  .text.w3d_address_801e6f54 0x801e6f54 : { *(.text.w3d_address_801e6f54) }
  .text.w3d_constant_801e716c 0x801e716c : { *(.text.w3d_constant_801e716c) }
  .text.w3d_address_801e82e0 0x801e82e0 : { *(.text.w3d_address_801e82e0) }
  .text.w3d_registry_unlink_801e82ec 0x801e82ec : { *(.text.w3d_registry_unlink_801e82ec) }
  .text.w3d_registry_create_801e8330 0x801e8330 : { *(.text.w3d_registry_create_801e8330) }
  .text.w3d_get_801e83e8 0x801e83e8 : { *(.text.w3d_get_801e83e8) }
  .text.w3d_address_801e83f0 0x801e83f0 : { *(.text.w3d_address_801e83f0) }
  .text.w3d_registry_retain_801e8470 0x801e8470 : { *(.text.w3d_registry_retain_801e8470) }
  .text.w3d_constant_801e85e4 0x801e85e4 : { *(.text.w3d_constant_801e85e4) }
  .text.w3d_constant_801e85ec 0x801e85ec : { *(.text.w3d_constant_801e85ec) }
  .text.w3d_constant_801e882c 0x801e882c : { *(.text.w3d_constant_801e882c) }
  .text.w3d_constant_801e8834 0x801e8834 : { *(.text.w3d_constant_801e8834) }
  .text.w3d_constant_801e8960 0x801e8960 : { *(.text.w3d_constant_801e8960) }
  .text.w3d_constant_801e8968 0x801e8968 : { *(.text.w3d_constant_801e8968) }
  .text.w3d_constant_801e89b8 0x801e89b8 : { *(.text.w3d_constant_801e89b8) }
  .text.w3d_address_801e9c20 0x801e9c20 : { *(.text.w3d_address_801e9c20) }
  .text.w3d_address_801e9f6c 0x801e9f6c : { *(.text.w3d_address_801e9f6c) }
  .text.w3d_registry_unlink_801e9fe0 0x801e9fe0 : { *(.text.w3d_registry_unlink_801e9fe0) }
  .text.w3d_address_801ea024 0x801ea024 : { *(.text.w3d_address_801ea024) }
  .text.w3d_registry_release_801ea030 0x801ea030 : { *(.text.w3d_registry_release_801ea030) }
  .text.w3d_registry_retain_801ea08c 0x801ea08c : { *(.text.w3d_registry_retain_801ea08c) }
  .text.w3d_constant_801ea6c8 0x801ea6c8 : { *(.text.w3d_constant_801ea6c8) }
  .text.w3d_set_801eb0a8 0x801eb0a8 : { *(.text.w3d_set_801eb0a8) }
  .text.w3d_registry_retain_801ee250 0x801ee250 : { *(.text.w3d_registry_retain_801ee250) }
  .text.w3d_set_801ee408 0x801ee408 : { *(.text.w3d_set_801ee408) }
  .text.w3d_empty_801ef5cc 0x801ef5cc : { *(.text.w3d_empty_801ef5cc) }
  .text.w3d_address_801f2bac 0x801f2bac : { *(.text.w3d_address_801f2bac) }
  .text.w3d_registry_unlink_801f2bb8 0x801f2bb8 : { *(.text.w3d_registry_unlink_801f2bb8) }
  .text.w3d_registry_create_801f2bfc 0x801f2bfc : { *(.text.w3d_registry_create_801f2bfc) }
  .text.w3d_address_801f2c5c 0x801f2c5c : { *(.text.w3d_address_801f2c5c) }
  .text.w3d_registry_release_801f2c68 0x801f2c68 : { *(.text.w3d_registry_release_801f2c68) }
  .text.w3d_registry_retain_801f2cc4 0x801f2cc4 : { *(.text.w3d_registry_retain_801f2cc4) }
  .text.w3d_get_801f30b8 0x801f30b8 : { *(.text.w3d_get_801f30b8) }
  .text.w3d_address_801f7b00 0x801f7b00 : { *(.text.w3d_address_801f7b00) }
  /DISCARD/ : { *(.text*) *(.rodata*) *(.data*) *(.bss*) *(.sdata*) *(.sbss*) *(.comment) }
}
