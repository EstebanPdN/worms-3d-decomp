/* Generated reference-only placements. All bodies are source-built. */
OUTPUT_FORMAT("elf32-powerpc")
OUTPUT_ARCH(powerpc)
ENTRY(w3d_s21_text_to_u64_801feea4)
_SDA_BASE_ = 0x804b2540;
_SDA2_BASE_ = 0x804c2540;
fn_802ed89c = 0x802ed89c;
SECTIONS {
  .text.w3d_s21_text_to_u64_801feea4 0x801feea4 : { *(.text.w3d_s21_text_to_u64_801feea4) }
  /DISCARD/ : { *(.text*) *(.rodata*) *(.data*) *(.bss*) *(.sdata*) *(.sbss*) *(.comment) }
}
