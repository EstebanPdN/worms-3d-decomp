/* Generated reference-only placements. All bodies are source-built. */
OUTPUT_FORMAT("elf32-powerpc")
OUTPUT_ARCH(powerpc)
ENTRY(w3d_k4b_indexed_component_construct_801a61c0)
_SDA_BASE_ = 0x804b2540;
_SDA2_BASE_ = 0x804c2540;
fn_801e81c8 = 0x801e81c8;
lbl_80413b38 = 0x80413b38;
lbl_80413b90 = 0x80413b90;
w3d_handle_storage_allocate = 0x80212fd4;
w3d_handle_storage_fallback = 0x803413d8;
SECTIONS {
  .text.w3d_k4b_indexed_component_construct_801a61c0 0x801a61c0 : { *(.text.w3d_k4b_indexed_component_construct_801a61c0) }
  /DISCARD/ : { *(.text*) *(.rodata*) *(.data*) *(.bss*) *(.sdata*) *(.sbss*) *(.comment) }
}
