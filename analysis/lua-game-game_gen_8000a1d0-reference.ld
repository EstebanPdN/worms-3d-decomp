/* Generated reference-only placements. All bodies are source-built. */
OUTPUT_FORMAT("elf32-powerpc")
OUTPUT_ARCH(powerpc)
ENTRY(w3d_constant_8000a1d0)
_SDA_BASE_ = 0x804b2540;
_SDA2_BASE_ = 0x804c2540;
w3d_global_8035fb50 = 0x8035fb50;
w3d_owner_list_remove = 0x8020fd2c;
w3d_registry_list_8035fb50 = 0x8035fb50;
SECTIONS {
  .text.w3d_constant_8000a1d0 0x8000a1d0 : { *(.text.w3d_constant_8000a1d0) }
  .text.w3d_constant_8000a61c 0x8000a61c : { *(.text.w3d_constant_8000a61c) }
  .text.w3d_constant_8000a624 0x8000a624 : { *(.text.w3d_constant_8000a624) }
  .text.w3d_constant_8000cfd4 0x8000cfd4 : { *(.text.w3d_constant_8000cfd4) }
  .text.w3d_constant_8000cfdc 0x8000cfdc : { *(.text.w3d_constant_8000cfdc) }
  .text.w3d_empty_8000d064 0x8000d064 : { *(.text.w3d_empty_8000d064) }
  .text.w3d_empty_8000d0b0 0x8000d0b0 : { *(.text.w3d_empty_8000d0b0) }
  .text.w3d_empty_8000d11c 0x8000d11c : { *(.text.w3d_empty_8000d11c) }
  .text.w3d_empty_8000d150 0x8000d150 : { *(.text.w3d_empty_8000d150) }
  .text.w3d_empty_8000d194 0x8000d194 : { *(.text.w3d_empty_8000d194) }
  .text.w3d_empty_8000d1d8 0x8000d1d8 : { *(.text.w3d_empty_8000d1d8) }
  .text.w3d_empty_8000d230 0x8000d230 : { *(.text.w3d_empty_8000d230) }
  .text.w3d_empty_8000d274 0x8000d274 : { *(.text.w3d_empty_8000d274) }
  .text.w3d_empty_8000d2c4 0x8000d2c4 : { *(.text.w3d_empty_8000d2c4) }
  .text.w3d_empty_8000d324 0x8000d324 : { *(.text.w3d_empty_8000d324) }
  .text.w3d_empty_8000d370 0x8000d370 : { *(.text.w3d_empty_8000d370) }
  .text.w3d_constant_8000db94 0x8000db94 : { *(.text.w3d_constant_8000db94) }
  .text.w3d_empty_8000dcac 0x8000dcac : { *(.text.w3d_empty_8000dcac) }
  .text.w3d_empty_8000dcb8 0x8000dcb8 : { *(.text.w3d_empty_8000dcb8) }
  .text.w3d_empty_8000dcf0 0x8000dcf0 : { *(.text.w3d_empty_8000dcf0) }
  .text.w3d_constant_8000dcf4 0x8000dcf4 : { *(.text.w3d_constant_8000dcf4) }
  .text.w3d_constant_8000e1fc 0x8000e1fc : { *(.text.w3d_constant_8000e1fc) }
  .text.w3d_empty_8000eaf4 0x8000eaf4 : { *(.text.w3d_empty_8000eaf4) }
  .text.w3d_empty_8000eb00 0x8000eb00 : { *(.text.w3d_empty_8000eb00) }
  .text.w3d_empty_8000eb0c 0x8000eb0c : { *(.text.w3d_empty_8000eb0c) }
  .text.w3d_empty_8000eb18 0x8000eb18 : { *(.text.w3d_empty_8000eb18) }
  .text.w3d_constant_800103cc 0x800103cc : { *(.text.w3d_constant_800103cc) }
  .text.w3d_empty_80010448 0x80010448 : { *(.text.w3d_empty_80010448) }
  .text.w3d_empty_80010454 0x80010454 : { *(.text.w3d_empty_80010454) }
  .text.w3d_empty_80010460 0x80010460 : { *(.text.w3d_empty_80010460) }
  .text.w3d_empty_80010580 0x80010580 : { *(.text.w3d_empty_80010580) }
  .text.w3d_constant_800106d8 0x800106d8 : { *(.text.w3d_constant_800106d8) }
  .text.w3d_empty_80010880 0x80010880 : { *(.text.w3d_empty_80010880) }
  .text.w3d_empty_8001088c 0x8001088c : { *(.text.w3d_empty_8001088c) }
  .text.w3d_empty_800108f0 0x800108f0 : { *(.text.w3d_empty_800108f0) }
  .text.w3d_empty_800108fc 0x800108fc : { *(.text.w3d_empty_800108fc) }
  .text.w3d_empty_80010908 0x80010908 : { *(.text.w3d_empty_80010908) }
  .text.w3d_empty_80010914 0x80010914 : { *(.text.w3d_empty_80010914) }
  .text.w3d_constant_80010f24 0x80010f24 : { *(.text.w3d_constant_80010f24) }
  .text.w3d_constant_80010f2c 0x80010f2c : { *(.text.w3d_constant_80010f2c) }
  .text.w3d_empty_80010ff4 0x80010ff4 : { *(.text.w3d_empty_80010ff4) }
  .text.w3d_empty_80011054 0x80011054 : { *(.text.w3d_empty_80011054) }
  .text.w3d_empty_800110a8 0x800110a8 : { *(.text.w3d_empty_800110a8) }
  .text.w3d_empty_800110fc 0x800110fc : { *(.text.w3d_empty_800110fc) }
  .text.w3d_constant_80012000 0x80012000 : { *(.text.w3d_constant_80012000) }
  .text.w3d_constant_80012008 0x80012008 : { *(.text.w3d_constant_80012008) }
  .text.w3d_constant_800120f4 0x800120f4 : { *(.text.w3d_constant_800120f4) }
  .text.w3d_constant_800120fc 0x800120fc : { *(.text.w3d_constant_800120fc) }
  .text.w3d_constant_800122a4 0x800122a4 : { *(.text.w3d_constant_800122a4) }
  .text.w3d_constant_800122ac 0x800122ac : { *(.text.w3d_constant_800122ac) }
  .text.w3d_constant_80012310 0x80012310 : { *(.text.w3d_constant_80012310) }
  .text.w3d_constant_8001245c 0x8001245c : { *(.text.w3d_constant_8001245c) }
  .text.w3d_constant_80012464 0x80012464 : { *(.text.w3d_constant_80012464) }
  .text.w3d_constant_8001246c 0x8001246c : { *(.text.w3d_constant_8001246c) }
  .text.w3d_constant_80012474 0x80012474 : { *(.text.w3d_constant_80012474) }
  .text.w3d_constant_8001247c 0x8001247c : { *(.text.w3d_constant_8001247c) }
  .text.w3d_constant_80012484 0x80012484 : { *(.text.w3d_constant_80012484) }
  .text.w3d_constant_8001307c 0x8001307c : { *(.text.w3d_constant_8001307c) }
  .text.w3d_constant_8001332c 0x8001332c : { *(.text.w3d_constant_8001332c) }
  .text.w3d_constant_80013730 0x80013730 : { *(.text.w3d_constant_80013730) }
  .text.w3d_constant_80013c88 0x80013c88 : { *(.text.w3d_constant_80013c88) }
  .text.w3d_constant_800141e0 0x800141e0 : { *(.text.w3d_constant_800141e0) }
  .text.w3d_constant_800149e0 0x800149e0 : { *(.text.w3d_constant_800149e0) }
  .text.w3d_constant_80014f4c 0x80014f4c : { *(.text.w3d_constant_80014f4c) }
  .text.w3d_empty_80015230 0x80015230 : { *(.text.w3d_empty_80015230) }
  .text.w3d_constant_80015234 0x80015234 : { *(.text.w3d_constant_80015234) }
  .text.w3d_empty_80016bec 0x80016bec : { *(.text.w3d_empty_80016bec) }
  .text.w3d_empty_80017040 0x80017040 : { *(.text.w3d_empty_80017040) }
  .text.w3d_empty_800171b0 0x800171b0 : { *(.text.w3d_empty_800171b0) }
  .text.w3d_constant_80017444 0x80017444 : { *(.text.w3d_constant_80017444) }
  .text.w3d_constant_800174f8 0x800174f8 : { *(.text.w3d_constant_800174f8) }
  .text.w3d_empty_80017508 0x80017508 : { *(.text.w3d_empty_80017508) }
  .text.w3d_constant_8001765c 0x8001765c : { *(.text.w3d_constant_8001765c) }
  .text.w3d_empty_80017844 0x80017844 : { *(.text.w3d_empty_80017844) }
  .text.w3d_empty_800178b0 0x800178b0 : { *(.text.w3d_empty_800178b0) }
  .text.w3d_constant_80017c30 0x80017c30 : { *(.text.w3d_constant_80017c30) }
  .text.w3d_constant_80017de8 0x80017de8 : { *(.text.w3d_constant_80017de8) }
  .text.w3d_empty_800243a4 0x800243a4 : { *(.text.w3d_empty_800243a4) }
  .text.w3d_address_80024be4 0x80024be4 : { *(.text.w3d_address_80024be4) }
  .text.w3d_registry_unlink_80024bf0 0x80024bf0 : { *(.text.w3d_registry_unlink_80024bf0) }
  /DISCARD/ : { *(.text*) *(.rodata*) *(.data*) *(.bss*) *(.sdata*) *(.sbss*) *(.comment) }
}
