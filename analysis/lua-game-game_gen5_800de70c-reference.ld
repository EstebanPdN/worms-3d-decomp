/* Generated reference-only placements. All bodies are source-built. */
OUTPUT_FORMAT("elf32-powerpc")
OUTPUT_ARCH(powerpc)
ENTRY(w3d_dtor_800de70c)
_SDA_BASE_ = 0x804b2540;
_SDA2_BASE_ = 0x804c2540;
w3d_actor_base_initialize = 0x80161014;
w3d_actor_reference_initialize = 0x8015fa40;
w3d_address_8015b448 = 0x8015b448;
w3d_address_8015bdd8 = 0x8015bdd8;
w3d_address_8015c47c = 0x8015c47c;
w3d_address_8015da78 = 0x8015da78;
w3d_address_8015ec04 = 0x8015ec04;
w3d_address_8015f978 = 0x8015f978;
w3d_address_80162d48 = 0x80162d48;
w3d_address_801656c8 = 0x801656c8;
w3d_address_8016585c = 0x8016585c;
w3d_address_8016662c = 0x8016662c;
w3d_address_80166cc4 = 0x80166cc4;
w3d_address_80169b48 = 0x80169b48;
w3d_fn_800dc604 = 0x800dc604;
w3d_fn_800dc674 = 0x800dc674;
w3d_fn_8011a918 = 0x8011a918;
w3d_fn_8016eabc = 0x8016eabc;
w3d_fn_8016ec44 = 0x8016ec44;
w3d_fn_8016f0d8 = 0x8016f0d8;
w3d_fn_8016f2d8 = 0x8016f2d8;
w3d_fn_8016f338 = 0x8016f338;
w3d_fn_8016f4ec = 0x8016f4ec;
w3d_fn_8016f5dc = 0x8016f5dc;
w3d_fn_8016f7cc = 0x8016f7cc;
w3d_fn_8016f818 = 0x8016f818;
w3d_fn_8016f8b4 = 0x8016f8b4;
w3d_fn_8016fc7c = 0x8016fc7c;
w3d_fn_8017077c = 0x8017077c;
w3d_fn_80172a0c = 0x80172a0c;
w3d_fn_80174230 = 0x80174230;
w3d_fn_80174354 = 0x80174354;
w3d_fn_8020b460 = 0x8020b460;
w3d_fn_8020fac8 = 0x8020fac8;
w3d_global_80361a78 = 0x80361a78;
w3d_global_80361aa8 = 0x80361aa8;
w3d_global_80361ad8 = 0x80361ad8;
w3d_global_80361b08 = 0x80361b08;
w3d_global_80361b38 = 0x80361b38;
w3d_global_803a63d8 = 0x803a63d8;
w3d_global_803a6488 = 0x803a6488;
w3d_global_803a64c4 = 0x803a64c4;
w3d_global_803a655c = 0x803a655c;
w3d_global_803a6584 = 0x803a6584;
w3d_global_803a66e4 = 0x803a66e4;
w3d_global_803a674c = 0x803a674c;
w3d_heap_allocate_entry_a = 0x801fe1d8;
w3d_owner_list_remove = 0x8020fd2c;
w3d_registry_list_80361a78 = 0x80361a78;
w3d_registry_list_80361aa8 = 0x80361aa8;
w3d_registry_list_80361ad8 = 0x80361ad8;
w3d_registry_list_80361b08 = 0x80361b08;
w3d_registry_list_80361b38 = 0x80361b38;
w3d_state_register = 0x8020fd04;
w3d_vtable_8040feb8 = 0x8040feb8;
w3d_vtable_804100e8 = 0x804100e8;
w3d_vtable_804109d0 = 0x804109d0;
w3d_vtable_80410fc0 = 0x80410fc0;
w3d_vtable_804115c8 = 0x804115c8;
w3d_vtable_80411828 = 0x80411828;
SECTIONS {
  .text.w3d_dtor_800de70c 0x800de70c : { *(.text.w3d_dtor_800de70c) }
  .text.w3d_dtor_800e6780 0x800e6780 : { *(.text.w3d_dtor_800e6780) }
  .text.w3d_ctor_8011a0cc 0x8011a0cc : { *(.text.w3d_ctor_8011a0cc) }
  .text.w3d_ctor_80159ef8 0x80159ef8 : { *(.text.w3d_ctor_80159ef8) }
  .text.w3d_forward_8015b464 0x8015b464 : { *(.text.w3d_forward_8015b464) }
  .text.w3d_forward_8015bdf4 0x8015bdf4 : { *(.text.w3d_forward_8015bdf4) }
  .text.w3d_forward_8015c498 0x8015c498 : { *(.text.w3d_forward_8015c498) }
  .text.w3d_forward_8015daf8 0x8015daf8 : { *(.text.w3d_forward_8015daf8) }
  .text.w3d_forward_8015ec84 0x8015ec84 : { *(.text.w3d_forward_8015ec84) }
  .text.w3d_forward_8015f9f8 0x8015f9f8 : { *(.text.w3d_forward_8015f9f8) }
  .text.w3d_ctor_8015fef0 0x8015fef0 : { *(.text.w3d_ctor_8015fef0) }
  .text.w3d_forward_80160174 0x80160174 : { *(.text.w3d_forward_80160174) }
  .text.w3d_forward_80161298 0x80161298 : { *(.text.w3d_forward_80161298) }
  .text.w3d_ctor_801628b0 0x801628b0 : { *(.text.w3d_ctor_801628b0) }
  .text.w3d_forward_80162b34 0x80162b34 : { *(.text.w3d_forward_80162b34) }
  .text.w3d_forward_80162dc8 0x80162dc8 : { *(.text.w3d_forward_80162dc8) }
  .text.w3d_forward_80165814 0x80165814 : { *(.text.w3d_forward_80165814) }
  .text.w3d_forward_801658dc 0x801658dc : { *(.text.w3d_forward_801658dc) }
  .text.w3d_forward_801666ac 0x801666ac : { *(.text.w3d_forward_801666ac) }
  .text.w3d_forward_80166d44 0x80166d44 : { *(.text.w3d_forward_80166d44) }
  .text.w3d_forward_80169bc8 0x80169bc8 : { *(.text.w3d_forward_80169bc8) }
  .text.w3d_constant_8016a5c4 0x8016a5c4 : { *(.text.w3d_constant_8016a5c4) }
  .text.w3d_constant_8016a5cc 0x8016a5cc : { *(.text.w3d_constant_8016a5cc) }
  .text.w3d_constant_8016a5d4 0x8016a5d4 : { *(.text.w3d_constant_8016a5d4) }
  .text.w3d_address_8016e944 0x8016e944 : { *(.text.w3d_address_8016e944) }
  .text.w3d_registry_unlink_8016e950 0x8016e950 : { *(.text.w3d_registry_unlink_8016e950) }
  .text.w3d_registry_create_8016e994 0x8016e994 : { *(.text.w3d_registry_create_8016e994) }
  .text.w3d_address_8016e9f4 0x8016e9f4 : { *(.text.w3d_address_8016e9f4) }
  .text.w3d_registry_release_8016ea00 0x8016ea00 : { *(.text.w3d_registry_release_8016ea00) }
  .text.w3d_registry_retain_8016ea5c 0x8016ea5c : { *(.text.w3d_registry_retain_8016ea5c) }
  .text.w3d_forward_8016ea74 0x8016ea74 : { *(.text.w3d_forward_8016ea74) }
  .text.w3d_constant_8016ed10 0x8016ed10 : { *(.text.w3d_constant_8016ed10) }
  .text.w3d_get_8016ede0 0x8016ede0 : { *(.text.w3d_get_8016ede0) }
  .text.w3d_constant_8016edf4 0x8016edf4 : { *(.text.w3d_constant_8016edf4) }
  .text.w3d_constant_8016edfc 0x8016edfc : { *(.text.w3d_constant_8016edfc) }
  .text.w3d_empty_8016ee44 0x8016ee44 : { *(.text.w3d_empty_8016ee44) }
  .text.w3d_empty_8016ee48 0x8016ee48 : { *(.text.w3d_empty_8016ee48) }
  .text.w3d_static_init_8016f134 0x8016f134 : { *(.text.w3d_static_init_8016f134) }
  .text.w3d_address_8016f160 0x8016f160 : { *(.text.w3d_address_8016f160) }
  .text.w3d_registry_unlink_8016f16c 0x8016f16c : { *(.text.w3d_registry_unlink_8016f16c) }
  .text.w3d_registry_create_8016f1b0 0x8016f1b0 : { *(.text.w3d_registry_create_8016f1b0) }
  .text.w3d_address_8016f210 0x8016f210 : { *(.text.w3d_address_8016f210) }
  .text.w3d_registry_release_8016f21c 0x8016f21c : { *(.text.w3d_registry_release_8016f21c) }
  .text.w3d_registry_retain_8016f278 0x8016f278 : { *(.text.w3d_registry_retain_8016f278) }
  .text.w3d_forward_8016f290 0x8016f290 : { *(.text.w3d_forward_8016f290) }
  .text.w3d_get_8016f4a8 0x8016f4a8 : { *(.text.w3d_get_8016f4a8) }
  .text.w3d_constant_8016f4b0 0x8016f4b0 : { *(.text.w3d_constant_8016f4b0) }
  .text.w3d_static_init_8016f548 0x8016f548 : { *(.text.w3d_static_init_8016f548) }
  .text.w3d_static_init_8016f624 0x8016f624 : { *(.text.w3d_static_init_8016f624) }
  .text.w3d_empty_8016f650 0x8016f650 : { *(.text.w3d_empty_8016f650) }
  .text.w3d_address_8016f654 0x8016f654 : { *(.text.w3d_address_8016f654) }
  .text.w3d_registry_unlink_8016f660 0x8016f660 : { *(.text.w3d_registry_unlink_8016f660) }
  .text.w3d_registry_create_8016f6a4 0x8016f6a4 : { *(.text.w3d_registry_create_8016f6a4) }
  .text.w3d_address_8016f704 0x8016f704 : { *(.text.w3d_address_8016f704) }
  .text.w3d_registry_release_8016f710 0x8016f710 : { *(.text.w3d_registry_release_8016f710) }
  .text.w3d_registry_retain_8016f76c 0x8016f76c : { *(.text.w3d_registry_retain_8016f76c) }
  .text.w3d_forward_8016f784 0x8016f784 : { *(.text.w3d_forward_8016f784) }
  .text.w3d_get_8016f888 0x8016f888 : { *(.text.w3d_get_8016f888) }
  .text.w3d_get_8016f890 0x8016f890 : { *(.text.w3d_get_8016f890) }
  .text.w3d_constant_8016f898 0x8016f898 : { *(.text.w3d_constant_8016f898) }
  .text.w3d_static_init_8016f910 0x8016f910 : { *(.text.w3d_static_init_8016f910) }
  .text.w3d_address_8016fb04 0x8016fb04 : { *(.text.w3d_address_8016fb04) }
  .text.w3d_registry_unlink_8016fb10 0x8016fb10 : { *(.text.w3d_registry_unlink_8016fb10) }
  .text.w3d_registry_create_8016fb54 0x8016fb54 : { *(.text.w3d_registry_create_8016fb54) }
  .text.w3d_address_8016fbb4 0x8016fbb4 : { *(.text.w3d_address_8016fbb4) }
  .text.w3d_registry_release_8016fbc0 0x8016fbc0 : { *(.text.w3d_registry_release_8016fbc0) }
  .text.w3d_registry_retain_8016fc1c 0x8016fc1c : { *(.text.w3d_registry_retain_8016fc1c) }
  .text.w3d_forward_8016fc34 0x8016fc34 : { *(.text.w3d_forward_8016fc34) }
  .text.w3d_constant_80172ad4 0x80172ad4 : { *(.text.w3d_constant_80172ad4) }
  .text.w3d_address_80172adc 0x80172adc : { *(.text.w3d_address_80172adc) }
  .text.w3d_static_init_80172ae8 0x80172ae8 : { *(.text.w3d_static_init_80172ae8) }
  .text.w3d_constant_80172bd0 0x80172bd0 : { *(.text.w3d_constant_80172bd0) }
  .text.w3d_address_80172bd8 0x80172bd8 : { *(.text.w3d_address_80172bd8) }
  .text.w3d_constant_801734c8 0x801734c8 : { *(.text.w3d_constant_801734c8) }
  .text.w3d_address_801740b8 0x801740b8 : { *(.text.w3d_address_801740b8) }
  .text.w3d_registry_unlink_801740c4 0x801740c4 : { *(.text.w3d_registry_unlink_801740c4) }
  .text.w3d_registry_create_80174108 0x80174108 : { *(.text.w3d_registry_create_80174108) }
  .text.w3d_address_80174168 0x80174168 : { *(.text.w3d_address_80174168) }
  .text.w3d_registry_release_80174174 0x80174174 : { *(.text.w3d_registry_release_80174174) }
  .text.w3d_registry_retain_801741d0 0x801741d0 : { *(.text.w3d_registry_retain_801741d0) }
  /DISCARD/ : { *(.text*) *(.rodata*) *(.data*) *(.bss*) *(.sdata*) *(.sbss*) *(.comment) }
}
