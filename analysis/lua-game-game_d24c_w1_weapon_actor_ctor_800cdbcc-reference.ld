/* Generated reference-only placements. All bodies are source-built. */
OUTPUT_FORMAT("elf32-powerpc")
OUTPUT_ARCH(powerpc)
ENTRY(d24c_w1_weapon_actor_ctor_800cdbcc)
_SDA_BASE_ = 0x804b2540;
_SDA2_BASE_ = 0x804c2540;
base_80161014 = 0x80161014;
member_80126184 = 0x80126184;
one_80387ef0 = 0x80387ef0;
origin_8045e788 = 0x8045e788;
vtable_8040fc08 = 0x8040fc08;
SECTIONS {
  .text.d24c_w1_weapon_actor_ctor_800cdbcc 0x800cdbcc : { *(.text.d24c_w1_weapon_actor_ctor_800cdbcc) }
  /DISCARD/ : { *(.text*) *(.rodata*) *(.data*) *(.bss*) *(.sdata*) *(.sbss*) *(.comment) }
}
