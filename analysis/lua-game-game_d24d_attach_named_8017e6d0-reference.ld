/* Generated reference-only placements. All bodies are source-built. */
OUTPUT_FORMAT("elf32-powerpc")
OUTPUT_ARCH(powerpc)
ENTRY(d24d_attach_named_8017e6d0)
_SDA_BASE_ = 0x804b2540;
_SDA2_BASE_ = 0x804c2540;
__20d24d_String_8020bb54PCc = 0x8020bb54;
d24d_list_append_801ef174 = 0x801ef174;
d24d_string_finish_8020c5c4 = 0x8020c5c4;
d24d_string_release_80341588 = 0x80341588;
d24d_string_release_header_8020bb2c = 0x8020bb2c;
SECTIONS {
  .text.d24d_attach_named_8017e6d0 0x8017e6d0 : { *(.text.d24d_attach_named_8017e6d0) }
  /DISCARD/ : { *(.text*) *(.rodata*) *(.data*) *(.bss*) *(.sdata*) *(.sbss*) *(.comment) }
}
