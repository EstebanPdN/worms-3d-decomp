/* Generated reference-only placements. All bodies are source-built. */
OUTPUT_FORMAT("elf32-powerpc")
OUTPUT_ARCH(powerpc)
ENTRY(d25f_team_barracks_reset_80281d0c)
_SDA_BASE_ = 0x804b2540;
_SDA2_BASE_ = 0x804c2540;
_._19Descriptor_80178474 = 0x80178474;
w3d_as_team_80179598 = 0x80179598;
w3d_identity_80341584 = 0x80341584;
w3d_resource_property_800fc1b0 = 0x800fc1b0;
w3d_string_803ceaa0 = 0x803ceaa0;
SECTIONS {
  .text.d25f_team_barracks_reset_80281d0c 0x80281d0c : { *(.text.d25f_team_barracks_reset_80281d0c) }
  /DISCARD/ : { *(.text*) *(.rodata*) *(.data*) *(.bss*) *(.sdata*) *(.sbss*) *(.comment) }
}
