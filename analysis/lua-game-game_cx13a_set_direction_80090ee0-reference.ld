/* Generated reference-only placements. All bodies are source-built. */
OUTPUT_FORMAT("elf32-powerpc")
OUTPUT_ARCH(powerpc)
ENTRY(w3d_cx13a_set_direction_80090ee0)
_SDA_BASE_ = 0x804b2540;
_SDA2_BASE_ = 0x804c2540;
one_8037e864 = 0x8037e864;
refresh_80090dac = 0x80090dac;
sqrt_802e82c0 = 0x802e82c0;
SECTIONS {
  .text.w3d_cx13a_set_direction_80090ee0 0x80090ee0 : { *(.text.w3d_cx13a_set_direction_80090ee0) }
  /DISCARD/ : { *(.text*) *(.rodata*) *(.data*) *(.bss*) *(.sdata*) *(.sbss*) *(.comment) }
}
