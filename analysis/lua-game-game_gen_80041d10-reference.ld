/* Generated reference-only placements. All bodies are source-built. */
OUTPUT_FORMAT("elf32-powerpc")
OUTPUT_ARCH(powerpc)
ENTRY(w3d_registry_retain_80041d10)
_SDA_BASE_ = 0x804b2540;
_SDA2_BASE_ = 0x804c2540;
w3d_fn_800485b0 = 0x800485b0;
w3d_fn_8004862c = 0x8004862c;
w3d_fn_8004971c = 0x8004971c;
w3d_fn_80049804 = 0x80049804;
w3d_fn_8004db14 = 0x8004db14;
w3d_fn_8004dc38 = 0x8004dc38;
w3d_fn_8004e8e8 = 0x8004e8e8;
w3d_fn_8004e934 = 0x8004e934;
w3d_fn_8004f0b8 = 0x8004f0b8;
w3d_fn_8004f118 = 0x8004f118;
w3d_fn_8004f9f4 = 0x8004f9f4;
w3d_fn_8004fba8 = 0x8004fba8;
w3d_fn_8005150c = 0x8005150c;
w3d_fn_80051564 = 0x80051564;
w3d_fn_80051c9c = 0x80051c9c;
w3d_fn_80051d18 = 0x80051d18;
w3d_fn_800d2488 = 0x800d2488;
w3d_fn_800d24e0 = 0x800d24e0;
w3d_global_80360090 = 0x80360090;
w3d_global_803600c0 = 0x803600c0;
w3d_global_803600f0 = 0x803600f0;
w3d_global_80360120 = 0x80360120;
w3d_global_80360150 = 0x80360150;
w3d_global_80360180 = 0x80360180;
w3d_global_803601b0 = 0x803601b0;
w3d_global_803601e0 = 0x803601e0;
w3d_global_80360bd0 = 0x80360bd0;
w3d_heap_allocate_entry_a = 0x801fe1d8;
w3d_owner_list_remove = 0x8020fd2c;
w3d_registry_list_80360090 = 0x80360090;
w3d_registry_list_803600c0 = 0x803600c0;
w3d_registry_list_803600f0 = 0x803600f0;
w3d_registry_list_80360120 = 0x80360120;
w3d_registry_list_80360150 = 0x80360150;
w3d_registry_list_80360180 = 0x80360180;
w3d_registry_list_803601b0 = 0x803601b0;
w3d_registry_list_803601e0 = 0x803601e0;
w3d_registry_list_80360bd0 = 0x80360bd0;
w3d_state_register = 0x8020fd04;
SECTIONS {
  .text.w3d_registry_retain_80041d10 0x80041d10 : { *(.text.w3d_registry_retain_80041d10) }
  .text.w3d_address_8004848c 0x8004848c : { *(.text.w3d_address_8004848c) }
  .text.w3d_registry_unlink_80048498 0x80048498 : { *(.text.w3d_registry_unlink_80048498) }
  .text.w3d_registry_create_800484dc 0x800484dc : { *(.text.w3d_registry_create_800484dc) }
  .text.w3d_registry_release_8004853c 0x8004853c : { *(.text.w3d_registry_release_8004853c) }
  .text.w3d_registry_retain_80048598 0x80048598 : { *(.text.w3d_registry_retain_80048598) }
  .text.w3d_constant_80048838 0x80048838 : { *(.text.w3d_constant_80048838) }
  .text.w3d_address_800495f8 0x800495f8 : { *(.text.w3d_address_800495f8) }
  .text.w3d_registry_unlink_80049604 0x80049604 : { *(.text.w3d_registry_unlink_80049604) }
  .text.w3d_registry_create_80049648 0x80049648 : { *(.text.w3d_registry_create_80049648) }
  .text.w3d_registry_release_800496a8 0x800496a8 : { *(.text.w3d_registry_release_800496a8) }
  .text.w3d_registry_retain_80049704 0x80049704 : { *(.text.w3d_registry_retain_80049704) }
  .text.w3d_get_8004d978 0x8004d978 : { *(.text.w3d_get_8004d978) }
  .text.w3d_address_8004d9f0 0x8004d9f0 : { *(.text.w3d_address_8004d9f0) }
  .text.w3d_registry_unlink_8004d9fc 0x8004d9fc : { *(.text.w3d_registry_unlink_8004d9fc) }
  .text.w3d_registry_create_8004da40 0x8004da40 : { *(.text.w3d_registry_create_8004da40) }
  .text.w3d_registry_release_8004daa0 0x8004daa0 : { *(.text.w3d_registry_release_8004daa0) }
  .text.w3d_registry_retain_8004dafc 0x8004dafc : { *(.text.w3d_registry_retain_8004dafc) }
  .text.w3d_empty_8004e0d4 0x8004e0d4 : { *(.text.w3d_empty_8004e0d4) }
  .text.w3d_empty_8004e0d8 0x8004e0d8 : { *(.text.w3d_empty_8004e0d8) }
  .text.w3d_address_8004e7c4 0x8004e7c4 : { *(.text.w3d_address_8004e7c4) }
  .text.w3d_registry_unlink_8004e7d0 0x8004e7d0 : { *(.text.w3d_registry_unlink_8004e7d0) }
  .text.w3d_registry_create_8004e814 0x8004e814 : { *(.text.w3d_registry_create_8004e814) }
  .text.w3d_registry_release_8004e874 0x8004e874 : { *(.text.w3d_registry_release_8004e874) }
  .text.w3d_registry_retain_8004e8d0 0x8004e8d0 : { *(.text.w3d_registry_retain_8004e8d0) }
  .text.w3d_address_8004ef94 0x8004ef94 : { *(.text.w3d_address_8004ef94) }
  .text.w3d_registry_unlink_8004efa0 0x8004efa0 : { *(.text.w3d_registry_unlink_8004efa0) }
  .text.w3d_registry_create_8004efe4 0x8004efe4 : { *(.text.w3d_registry_create_8004efe4) }
  .text.w3d_registry_release_8004f044 0x8004f044 : { *(.text.w3d_registry_release_8004f044) }
  .text.w3d_registry_retain_8004f0a0 0x8004f0a0 : { *(.text.w3d_registry_retain_8004f0a0) }
  .text.w3d_empty_8004f840 0x8004f840 : { *(.text.w3d_empty_8004f840) }
  .text.w3d_address_8004f8d0 0x8004f8d0 : { *(.text.w3d_address_8004f8d0) }
  .text.w3d_registry_unlink_8004f8dc 0x8004f8dc : { *(.text.w3d_registry_unlink_8004f8dc) }
  .text.w3d_registry_create_8004f920 0x8004f920 : { *(.text.w3d_registry_create_8004f920) }
  .text.w3d_registry_release_8004f980 0x8004f980 : { *(.text.w3d_registry_release_8004f980) }
  .text.w3d_registry_retain_8004f9dc 0x8004f9dc : { *(.text.w3d_registry_retain_8004f9dc) }
  .text.w3d_empty_80050978 0x80050978 : { *(.text.w3d_empty_80050978) }
  .text.w3d_address_800513e8 0x800513e8 : { *(.text.w3d_address_800513e8) }
  .text.w3d_registry_unlink_800513f4 0x800513f4 : { *(.text.w3d_registry_unlink_800513f4) }
  .text.w3d_registry_create_80051438 0x80051438 : { *(.text.w3d_registry_create_80051438) }
  .text.w3d_registry_release_80051498 0x80051498 : { *(.text.w3d_registry_release_80051498) }
  .text.w3d_registry_retain_800514f4 0x800514f4 : { *(.text.w3d_registry_retain_800514f4) }
  .text.w3d_empty_80051744 0x80051744 : { *(.text.w3d_empty_80051744) }
  .text.w3d_address_80051b78 0x80051b78 : { *(.text.w3d_address_80051b78) }
  .text.w3d_registry_unlink_80051b84 0x80051b84 : { *(.text.w3d_registry_unlink_80051b84) }
  .text.w3d_registry_create_80051bc8 0x80051bc8 : { *(.text.w3d_registry_create_80051bc8) }
  .text.w3d_registry_release_80051c28 0x80051c28 : { *(.text.w3d_registry_release_80051c28) }
  .text.w3d_registry_retain_80051c84 0x80051c84 : { *(.text.w3d_registry_retain_80051c84) }
  .text.w3d_constant_80051f8c 0x80051f8c : { *(.text.w3d_constant_80051f8c) }
  .text.w3d_empty_80052004 0x80052004 : { *(.text.w3d_empty_80052004) }
  .text.w3d_empty_80052008 0x80052008 : { *(.text.w3d_empty_80052008) }
  .text.w3d_empty_80052044 0x80052044 : { *(.text.w3d_empty_80052044) }
  .text.w3d_constant_80096c28 0x80096c28 : { *(.text.w3d_constant_80096c28) }
  .text.w3d_get_80098370 0x80098370 : { *(.text.w3d_get_80098370) }
  .text.w3d_empty_80099dbc 0x80099dbc : { *(.text.w3d_empty_80099dbc) }
  .text.w3d_empty_800a08ac 0x800a08ac : { *(.text.w3d_empty_800a08ac) }
  .text.w3d_constant_800a3abc 0x800a3abc : { *(.text.w3d_constant_800a3abc) }
  .text.w3d_set_800a4f44 0x800a4f44 : { *(.text.w3d_set_800a4f44) }
  .text.w3d_get_800a4f4c 0x800a4f4c : { *(.text.w3d_get_800a4f4c) }
  .text.w3d_set_800a4f54 0x800a4f54 : { *(.text.w3d_set_800a4f54) }
  .text.w3d_get_800a4f5c 0x800a4f5c : { *(.text.w3d_get_800a4f5c) }
  .text.w3d_set_800a4f64 0x800a4f64 : { *(.text.w3d_set_800a4f64) }
  .text.w3d_get_800a4f6c 0x800a4f6c : { *(.text.w3d_get_800a4f6c) }
  .text.w3d_set_800a4f74 0x800a4f74 : { *(.text.w3d_set_800a4f74) }
  .text.w3d_get_800a4f7c 0x800a4f7c : { *(.text.w3d_get_800a4f7c) }
  .text.w3d_constant_800a51f0 0x800a51f0 : { *(.text.w3d_constant_800a51f0) }
  .text.w3d_empty_800a5390 0x800a5390 : { *(.text.w3d_empty_800a5390) }
  .text.w3d_constant_800a5748 0x800a5748 : { *(.text.w3d_constant_800a5748) }
  .text.w3d_empty_800a8148 0x800a8148 : { *(.text.w3d_empty_800a8148) }
  .text.w3d_get_800a830c 0x800a830c : { *(.text.w3d_get_800a830c) }
  .text.w3d_empty_800afccc 0x800afccc : { *(.text.w3d_empty_800afccc) }
  .text.w3d_get_800b4d98 0x800b4d98 : { *(.text.w3d_get_800b4d98) }
  .text.w3d_set_800b7ebc 0x800b7ebc : { *(.text.w3d_set_800b7ebc) }
  .text.w3d_empty_800b923c 0x800b923c : { *(.text.w3d_empty_800b923c) }
  .text.w3d_constant_800bae4c 0x800bae4c : { *(.text.w3d_constant_800bae4c) }
  .text.w3d_get_800d1c14 0x800d1c14 : { *(.text.w3d_get_800d1c14) }
  .text.w3d_address_800d2364 0x800d2364 : { *(.text.w3d_address_800d2364) }
  .text.w3d_registry_unlink_800d2370 0x800d2370 : { *(.text.w3d_registry_unlink_800d2370) }
  .text.w3d_registry_create_800d23b4 0x800d23b4 : { *(.text.w3d_registry_create_800d23b4) }
  .text.w3d_registry_release_800d2414 0x800d2414 : { *(.text.w3d_registry_release_800d2414) }
  /DISCARD/ : { *(.text*) *(.rodata*) *(.data*) *(.bss*) *(.sdata*) *(.sbss*) *(.comment) }
}
