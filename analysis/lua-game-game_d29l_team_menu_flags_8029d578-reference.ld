/* Generated reference-only placements. All bodies are source-built. */
OUTPUT_FORMAT("elf32-powerpc")
OUTPUT_ARCH(powerpc)
ENTRY(d29l_team_menu_flags_8029d578)
_SDA_BASE_ = 0x804b2540;
_SDA2_BASE_ = 0x804c2540;
__3Str = 0x803426b8;
__3StrPCc = 0x8020bb54;
fn_800fc230 = 0x800fc230;
fn_800fc2b0 = 0x800fc2b0;
fn_8020bd38 = 0x8020bd38;
fn_8020c510 = 0x8020c510;
fn_8020c5c4 = 0x8020c5c4;
fn_802997fc = 0x802997fc;
fn_80299a94 = 0x80299a94;
fn_80299b48 = 0x80299b48;
fn_8029d7b4 = 0x8029d7b4;
fn_8029d89c = 0x8029d89c;
fn_80341588 = 0x80341588;
menuAccept_803d0d9c = 0x803d0d9c;
menuAdd_803d0d88 = 0x803d0d88;
menuDelete_803d0d90 = 0x803d0d90;
menuFlag_803d0db0 = 0x803d0db0;
menuSkill_803d0d7c = 0x803d0d7c;
menuTeam_803d0da8 = 0x803d0da8;
skill_803d0a54 = 0x803d0a54;
worm_803d0a0c = 0x803d0a0c;
SECTIONS {
  .text.d29l_team_menu_flags_8029d578 0x8029d578 : { *(.text.d29l_team_menu_flags_8029d578) }
  /DISCARD/ : { *(.text*) *(.rodata*) *(.data*) *(.bss*) *(.sdata*) *(.sbss*) *(.comment) }
}
