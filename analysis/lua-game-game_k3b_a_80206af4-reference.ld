/* Generated reference-only placements. All bodies are source-built. */
OUTPUT_FORMAT("elf32-powerpc")
OUTPUT_ARCH(powerpc)
ENTRY(w3d_k3b_tagged_construct_80206af4)
_SDA_BASE_ = 0x804b2540;
_SDA2_BASE_ = 0x804c2540;
w3d_vtable_804181c0 = 0x804181c0;
w3d_vtable_80419180 = 0x80419180;
SECTIONS {
  .text.w3d_k3b_tagged_construct_80206af4 0x80206af4 : { *(.text.w3d_k3b_tagged_construct_80206af4) }
  /DISCARD/ : { *(.text*) *(.rodata*) *(.data*) *(.bss*) *(.sdata*) *(.sbss*) *(.comment) }
}
