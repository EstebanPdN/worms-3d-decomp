/* Generated reference-only placements. All bodies are source-built. */
OUTPUT_FORMAT("elf32-powerpc")
OUTPUT_ARCH(powerpc)
ENTRY(__23s8_Constructed_800f1730)
_SDA_BASE_ = 0x804b2540;
_SDA2_BASE_ = 0x804c2540;
fn_8015fef0 = 0x8015fef0;
w3d_vtable_80410368 = 0x80410368;
SECTIONS {
  .text.__23s8_Constructed_800f1730 0x800f1730 : { *(.text.__23s8_Constructed_800f1730) }
  /DISCARD/ : { *(.text*) *(.rodata*) *(.data*) *(.bss*) *(.sdata*) *(.sbss*) *(.comment) }
}
