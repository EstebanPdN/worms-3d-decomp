/* Generated reference-only placements. All bodies are source-built. */
OUTPUT_FORMAT("elf32-powerpc")
OUTPUT_ARCH(powerpc)
ENTRY(w3d_k8b_key_levels_8019980c)
_SDA_BASE_ = 0x804b2540;
_SDA2_BASE_ = 0x804c2540;
lbl_803a86e0 = 0x803a86e0;
lbl_803a86e4 = 0x803a86e4;
SECTIONS {
  .text.w3d_k8b_key_levels_8019980c 0x8019980c : { *(.text.w3d_k8b_key_levels_8019980c) }
  /DISCARD/ : { *(.text*) *(.rodata*) *(.data*) *(.bss*) *(.sdata*) *(.sbss*) *(.comment) }
}
