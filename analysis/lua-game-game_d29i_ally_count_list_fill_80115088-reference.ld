/* Generated reference-only placements. All bodies are source-built. */
OUTPUT_FORMAT("elf32-powerpc")
OUTPUT_ARCH(powerpc)
ENTRY(d29i_ally_count_list_fill_80115088)
_SDA_BASE_ = 0x804b2540;
_SDA2_BASE_ = 0x804c2540;
_._19Descriptor_80178474 = 0x80178474;
__6String = 0x803426b8;
__6StringPCc = 0x8020bb54;
array_lock_801ef048 = 0x801ef048;
as_table_80341584 = 0x80341584;
class_80419e68 = 0x80419e68;
class_80419e88 = 0x80419e88;
create_8020b680 = 0x8020b680;
definition_801797b4 = 0x801797b4;
f_8039a4c8 = 0x8039a4c8;
f_8039a768 = 0x8039a768;
list_append_801ef174 = 0x801ef174;
list_begin_801ef380 = 0x801ef380;
n_8039a478 = 0x8039a478;
n_8039a488 = 0x8039a488;
n_8039a49c = 0x8039a49c;
n_8039a750 = 0x8039a750;
n_8039a760 = 0x8039a760;
read_key2_800fc2b0 = 0x800fc2b0;
read_setting_800fc1b0 = 0x800fc1b0;
strcmp_802ef234 = 0x802ef234;
string_assign_8020bd38 = 0x8020bd38;
string_finish_8020c5c4 = 0x8020c5c4;
string_format_8020c510 = 0x8020c510;
string_release_8020bb2c = 0x8020bb2c;
string_release_80341588 = 0x80341588;
table_get_80179598 = 0x80179598;
SECTIONS {
  .text.d29i_ally_count_list_fill_80115088 0x80115088 : { *(.text.d29i_ally_count_list_fill_80115088) }
  .rodata 0x8039a770 : { *(.rodata) }
  /DISCARD/ : { *(.text*) *(.rodata*) *(.data*) *(.bss*) *(.sdata*) *(.sbss*) *(.comment) }
}
