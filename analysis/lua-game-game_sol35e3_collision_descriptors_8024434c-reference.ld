/* Generated reference-only placements. All bodies are source-built. */
OUTPUT_FORMAT("elf32-powerpc")
OUTPUT_ARCH(powerpc)
ENTRY(sol35e3_collision_descriptors_8024434c)
_SDA_BASE_ = 0x804b2540;
_SDA2_BASE_ = 0x804c2540;
sol35e3_default_803c054c = 0x803c054c;
sol35e3_desc_803c0254 = 0x803c0254;
sol35e3_desc_803c0298 = 0x803c0298;
sol35e3_desc_803c02d8 = 0x803c02d8;
sol35e3_desc_803c0300 = 0x803c0300;
sol35e3_desc_803c0328 = 0x803c0328;
sol35e3_desc_803c036c = 0x803c036c;
sol35e3_desc_803c03b0 = 0x803c03b0;
sol35e3_desc_803c03fc = 0x803c03fc;
sol35e3_desc_803c0448 = 0x803c0448;
sol35e3_desc_803c0498 = 0x803c0498;
sol35e3_desc_803c04e4 = 0x803c04e4;
sol35e3_desc_803c0524 = 0x803c0524;
sol35e3_finish_descriptors_801e8d9c = 0x801e8d9c;
sol35e3_register_bool_801eb674 = 0x801eb674;
sol35e3_register_int_801eb834 = 0x801eb834;
sol35e3_register_kind_801ece2c = 0x801ece2c;
sol35e3_register_scalar_801ec52c = 0x801ec52c;
sol35e3_register_u16_801ebbb8 = 0x801ebbb8;
sol35e3_register_vector_801f0210 = 0x801f0210;
SECTIONS {
  .text.sol35e3_collision_descriptors_8024434c 0x8024434c : { *(.text.sol35e3_collision_descriptors_8024434c) }
  /DISCARD/ : { *(.text*) *(.rodata*) *(.data*) *(.bss*) *(.sdata*) *(.sbss*) *(.comment) }
}
