/* Generated reference-only placements. All bodies are source-built. */
OUTPUT_FORMAT("elf32-powerpc")
OUTPUT_ARCH(powerpc)
ENTRY(s9_finish_actor_transition_8013e65c)
_SDA_BASE_ = 0x804b2540;
_SDA2_BASE_ = 0x804c2540;
fn_801385A4 = 0x801385a4;
fn_80138DAC = 0x80138dac;
fn_80139084 = 0x80139084;
fn_80139454 = 0x80139454;
fn_801394AC = 0x801394ac;
fn_8013E3D4 = 0x8013e3d4;
fn_8013E458 = 0x8013e458;
SECTIONS {
  .text.s9_finish_actor_transition_8013e65c 0x8013e65c : { *(.text.s9_finish_actor_transition_8013e65c) }
  /DISCARD/ : { *(.text*) *(.rodata*) *(.data*) *(.bss*) *(.sdata*) *(.sbss*) *(.comment) }
}
