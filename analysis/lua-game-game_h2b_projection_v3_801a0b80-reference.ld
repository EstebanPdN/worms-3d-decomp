/* Generated reference-only placements. All bodies are source-built. */
OUTPUT_FORMAT("elf32-powerpc")
OUTPUT_ARCH(powerpc)
ENTRY(h2b_projection_v3_801a0b80)
_SDA_BASE_ = 0x804b2540;
_SDA2_BASE_ = 0x804c2540;
scalar_803a9b24 = 0x803a9b24;
scalar_803a9b28 = 0x803a9b28;
scalar_803a9b2c = 0x803a9b2c;
scalar_803a9b30 = 0x803a9b30;
scalar_803a9b34 = 0x803a9b34;
SECTIONS {
  .text.h2b_projection_v3_801a0b80 0x801a0b80 : { *(.text.h2b_projection_v3_801a0b80) }
  /DISCARD/ : { *(.text*) *(.rodata*) *(.data*) *(.bss*) *(.sdata*) *(.sbss*) *(.comment) }
}
