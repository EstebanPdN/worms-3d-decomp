/* Generated reference-only placements. All bodies are source-built. */
OUTPUT_FORMAT("elf32-powerpc")
OUTPUT_ARCH(powerpc)
ENTRY(d30f_create_team_from_properties_8029c4d0)
_SDA_BASE_ = 0x804b2540;
_SDA2_BASE_ = 0x804c2540;
_._19Descriptor_80178474 = 0x80178474;
__15String_803426b8 = 0x803426b8;
lbl_803d097c = 0x803d097c;
lbl_803d09ec = 0x803d09ec;
lbl_803d0a0c = 0x803d0a0c;
lbl_803d0a20 = 0x803d0a20;
lbl_803d0a2c = 0x803d0a2c;
lbl_803d0a3c = 0x803d0a3c;
lbl_803d0a48 = 0x803d0a48;
lbl_803d0a54 = 0x803d0a54;
lbl_80419eb8 = 0x80419eb8;
strcmp = 0x802ef234;
w3d_auto_80178d1c = 0x80178d1c;
w3d_auto_80179170 = 0x80179170;
w3d_auto_80179598 = 0x80179598;
w3d_constructor_lookup_name = 0x800fc1b0;
w3d_constructor_native_c_80342a78 = 0x80342a78;
w3d_empty_80341584 = 0x80341584;
w3d_empty_80343744 = 0x80343744;
w3d_k5b_array_ref_lock_801ef048 = 0x801ef048;
w3d_k5b_iface_array_field_append_801ef174 = 0x801ef174;
w3d_s10_service_forward_8020b680 = 0x8020b680;
w3d_string_base_finish = 0x8020c5c4;
w3d_string_format = 0x8020c510;
w3d_string_release = 0x80341588;
w3d_string_release_header = 0x8020bb2c;
SECTIONS {
  .text.d30f_create_team_from_properties_8029c4d0 0x8029c4d0 : { *(.text.d30f_create_team_from_properties_8029c4d0) }
  /DISCARD/ : { *(.text*) *(.rodata*) *(.data*) *(.bss*) *(.sdata*) *(.sbss*) *(.comment) }
}
