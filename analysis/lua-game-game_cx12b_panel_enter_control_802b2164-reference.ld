/* Generated reference-only placements. All bodies are source-built. */
OUTPUT_FORMAT("elf32-powerpc")
OUTPUT_ARCH(powerpc)
ENTRY(w3d_cx12b_panel_enter_control_802b2164)
_SDA_BASE_ = 0x804b2540;
_SDA2_BASE_ = 0x804c2540;
cast_80343584 = 0x80343584;
check_8018179c = 0x8018179c;
time_803d7af4 = 0x803d7af4;
SECTIONS {
  .text.w3d_cx12b_panel_enter_control_802b2164 0x802b2164 : { *(.text.w3d_cx12b_panel_enter_control_802b2164) }
  /DISCARD/ : { *(.text*) *(.rodata*) *(.data*) *(.bss*) *(.sdata*) *(.sbss*) *(.comment) }
}
