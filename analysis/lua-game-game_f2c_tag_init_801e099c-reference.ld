/* Generated reference-only placements. All bodies are source-built. */
OUTPUT_FORMAT("elf32-powerpc")
OUTPUT_ARCH(powerpc)
ENTRY(f2c_tag_init_801e099c)
_SDA_BASE_ = 0x804b2540;
_SDA2_BASE_ = 0x804c2540;
lbl_803b048c = 0x803b048c;
lbl_803b0490 = 0x803b0490;
lbl_803b0494 = 0x803b0494;
lbl_80416a90 = 0x80416a90;
lbl_80416d20 = 0x80416d20;
SECTIONS {
  .text.f2c_tag_init_801e099c 0x801e099c : { *(.text.f2c_tag_init_801e099c) }
  /DISCARD/ : { *(.text*) *(.rodata*) *(.data*) *(.bss*) *(.sdata*) *(.sbss*) *(.comment) }
}
