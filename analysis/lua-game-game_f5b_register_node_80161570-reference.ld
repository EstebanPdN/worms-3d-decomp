/* Generated reference-only placements. All bodies are source-built. */
OUTPUT_FORMAT("elf32-powerpc")
OUTPUT_ARCH(powerpc)
ENTRY(f5b_register_node_80161570)
_SDA_BASE_ = 0x804b2540;
_SDA2_BASE_ = 0x804c2540;
allocate_80212fd4 = 0x80212fd4;
copy_802eee50 = 0x802eee50;
fn_80162310 = 0x80162310;
registry_80455244 = 0x80455244;
release_802134fc = 0x802134fc;
SECTIONS {
  .text.f5b_register_node_80161570 0x80161570 : { *(.text.f5b_register_node_80161570) }
  /DISCARD/ : { *(.text*) *(.rodata*) *(.data*) *(.bss*) *(.sdata*) *(.sbss*) *(.comment) }
}
