/* Generated reference-only placements. All bodies are source-built. */
OUTPUT_FORMAT("elf32-powerpc")
OUTPUT_ARCH(powerpc)
ENTRY(d41l_list_scroll_rows_802bc1d4)
_SDA_BASE_ = 0x804b2540;
_SDA2_BASE_ = 0x804c2540;
__4Elem = 0x802bce10;
__builtin_new = 0x801fe1d8;
active_802bd318 = 0x802bd318;
apply_802c0cb4 = 0x802c0cb4;
count_802bc71c = 0x802bc71c;
each_802bc5ac = 0x802bc5ac;
fade_802bd360 = 0x802bd360;
find_802bc6a8 = 0x802bc6a8;
free_802134fc = 0x802134fc;
height_802bfb68 = 0x802bfb68;
interface_802bdc88 = 0x802bdc88;
interface_802c0c24 = 0x802c0c24;
layer_802c0cac = 0x802c0cac;
length_802bd3cc = 0x802bd3cc;
malloc = 0x80212fd4;
memcpy_802eee50 = 0x802eee50;
position_802bd430 = 0x802bd430;
property_802bfba4 = 0x802bfba4;
prune_802bc600 = 0x802bc600;
select_802bd2c4 = 0x802bd2c4;
setup_802bd158 = 0x802bd158;
value_802bfb2c = 0x802bfb2c;
SECTIONS {
  .text.d41l_list_scroll_rows_802bc1d4 0x802bc1d4 : { *(.text.d41l_list_scroll_rows_802bc1d4) }
  .rodata 0x803d82c8 : { *(.rodata) }
  /DISCARD/ : { *(.text*) *(.rodata*) *(.data*) *(.bss*) *(.sdata*) *(.sbss*) *(.comment) }
}
