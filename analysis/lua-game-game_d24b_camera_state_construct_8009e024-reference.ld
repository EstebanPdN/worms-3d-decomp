/* Generated reference-only placements. All bodies are source-built. */
OUTPUT_FORMAT("elf32-powerpc")
OUTPUT_ARCH(powerpc)
ENTRY(w3d_d24b_camera_state_construct_8009e024)
_SDA_BASE_ = 0x804b2540;
_SDA2_BASE_ = 0x804c2540;
w3d_base_construct_8015a0d4 = 0x8015a0d4;
w3d_identity_80342a74 = 0x80342a74;
w3d_resource_property_800fc1b0 = 0x800fc1b0;
w3d_string_80380564 = 0x80380564;
w3d_string_80380578 = 0x80380578;
w3d_string_80380594 = 0x80380594;
w3d_vtable_8040f3c0 = 0x8040f3c0;
SECTIONS {
  .text.w3d_d24b_camera_state_construct_8009e024 0x8009e024 : { *(.text.w3d_d24b_camera_state_construct_8009e024) }
  /DISCARD/ : { *(.text*) *(.rodata*) *(.data*) *(.bss*) *(.sdata*) *(.sbss*) *(.comment) }
}
