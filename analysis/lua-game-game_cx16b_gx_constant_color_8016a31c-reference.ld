/* Generated reference-only placements. All bodies are source-built. */
OUTPUT_FORMAT("elf32-powerpc")
OUTPUT_ARCH(powerpc)
ENTRY(w3d_cx16b_gx_constant_color_8016a31c)
_SDA_BASE_ = 0x804b2540;
_SDA2_BASE_ = 0x804c2540;
fn_8030981c = 0x8030981c;
lbl_803a54e0 = 0x803a54e0;
SECTIONS {
  .text.w3d_cx16b_gx_constant_color_8016a31c 0x8016a31c : { *(.text.w3d_cx16b_gx_constant_color_8016a31c) }
  /DISCARD/ : { *(.text*) *(.rodata*) *(.data*) *(.bss*) *(.sdata*) *(.sbss*) *(.comment) }
}
