/* Generated reference-only placements. All bodies are source-built. */
OUTPUT_FORMAT("elf32-powerpc")
OUTPUT_ARCH(powerpc)
ENTRY(w3d_cc17b_earthquake_names_8014e4c8)
_SDA_BASE_ = 0x804b2540;
_SDA2_BASE_ = 0x804c2540;
fn_800fc1b0 = 0x800fc1b0;
fn_800fc270 = 0x800fc270;
name_803a16c0 = 0x803a16c0;
name_803a16e0 = 0x803a16e0;
name_803a1700 = 0x803a1700;
name_803a1714 = 0x803a1714;
SECTIONS {
  .text.w3d_cc17b_earthquake_names_8014e4c8 0x8014e4c8 : { *(.text.w3d_cc17b_earthquake_names_8014e4c8) }
  /DISCARD/ : { *(.text*) *(.rodata*) *(.data*) *(.bss*) *(.sdata*) *(.sbss*) *(.comment) }
}
