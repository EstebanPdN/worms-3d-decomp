/* Generated reference-only placements. All bodies are source-built. */
OUTPUT_FORMAT("elf32-powerpc")
OUTPUT_ARCH(powerpc)
ENTRY(sol11b_filter_select_801d7750)
_SDA_BASE_ = 0x804b2540;
_SDA2_BASE_ = 0x804c2540;
kernel_801d6998 = 0x801d6998;
kernel_801d69dc = 0x801d69dc;
kernel_801d6a18 = 0x801d6a18;
kernel_801d6a4c = 0x801d6a4c;
kernel_801d6aac = 0x801d6aac;
kernel_801d6b7c = 0x801d6b7c;
kernel_801d6bf0 = 0x801d6bf0;
resample_801d6ca8 = 0x801d6ca8;
support_803af6c4 = 0x803af6c4;
support_803af6c8 = 0x803af6c8;
support_803af6cc = 0x803af6cc;
support_803af6d0 = 0x803af6d0;
support_803af6d4 = 0x803af6d4;
SECTIONS {
  .text.sol11b_filter_select_801d7750 0x801d7750 : { *(.text.sol11b_filter_select_801d7750) }
  /DISCARD/ : { *(.text*) *(.rodata*) *(.data*) *(.bss*) *(.sdata*) *(.sbss*) *(.comment) }
}
