/* Generated reference-only placements. All bodies are source-built. */
OUTPUT_FORMAT("elf32-powerpc")
OUTPUT_ARCH(powerpc)
ENTRY(w3d_s21_register_descriptor_8025d61c)
_SDA_BASE_ = 0x804b2540;
_SDA2_BASE_ = 0x804c2540;
fn_80200a70 = 0x80200a70;
lbl_803ca980 = 0x803ca980;
lbl_8040cb00 = 0x8040cb00;
lbl_80465068 = 0x80465068;
lbl_8046506c = 0x8046506c;
SECTIONS {
  .text.w3d_s21_register_descriptor_8025d61c 0x8025d61c : { *(.text.w3d_s21_register_descriptor_8025d61c) }
  /DISCARD/ : { *(.text*) *(.rodata*) *(.data*) *(.bss*) *(.sdata*) *(.sbss*) *(.comment) }
}
