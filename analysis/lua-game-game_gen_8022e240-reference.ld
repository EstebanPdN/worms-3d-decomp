/* Generated reference-only placements. All bodies are source-built. */
OUTPUT_FORMAT("elf32-powerpc")
OUTPUT_ARCH(powerpc)
ENTRY(w3d_registry_release_8022e240)
_SDA_BASE_ = 0x804b2540;
_SDA2_BASE_ = 0x804c2540;
w3d_fn_802223c8 = 0x802223c8;
w3d_fn_802224f8 = 0x802224f8;
w3d_fn_8022283c = 0x8022283c;
w3d_fn_80222928 = 0x80222928;
w3d_fn_80222ba4 = 0x80222ba4;
w3d_fn_80222d14 = 0x80222d14;
w3d_fn_802230f4 = 0x802230f4;
w3d_fn_802232cc = 0x802232cc;
w3d_fn_80223868 = 0x80223868;
w3d_fn_802239d4 = 0x802239d4;
w3d_fn_80223ddc = 0x80223ddc;
w3d_fn_80223fd8 = 0x80223fd8;
w3d_fn_8022462c = 0x8022462c;
w3d_fn_802247c4 = 0x802247c4;
w3d_fn_80224c90 = 0x80224c90;
w3d_fn_80224e00 = 0x80224e00;
w3d_fn_80225228 = 0x80225228;
w3d_fn_802252e0 = 0x802252e0;
w3d_fn_80225488 = 0x80225488;
w3d_fn_80225510 = 0x80225510;
w3d_fn_80225614 = 0x80225614;
w3d_fn_802256c4 = 0x802256c4;
w3d_fn_8022585c = 0x8022585c;
w3d_fn_802259e4 = 0x802259e4;
w3d_fn_80225eac = 0x80225eac;
w3d_fn_80225f54 = 0x80225f54;
w3d_fn_8022610c = 0x8022610c;
w3d_fn_80226224 = 0x80226224;
w3d_fn_80226560 = 0x80226560;
w3d_fn_8022661c = 0x8022661c;
w3d_fn_802267d4 = 0x802267d4;
w3d_fn_80226874 = 0x80226874;
w3d_fn_80226a24 = 0x80226a24;
w3d_fn_80226ac4 = 0x80226ac4;
w3d_fn_80226c74 = 0x80226c74;
w3d_fn_80226cf4 = 0x80226cf4;
w3d_fn_80226ddc = 0x80226ddc;
w3d_fn_80226eb8 = 0x80226eb8;
w3d_fn_802271b4 = 0x802271b4;
w3d_fn_80227240 = 0x80227240;
w3d_fn_80227354 = 0x80227354;
w3d_fn_80227560 = 0x80227560;
w3d_fn_80227a3c = 0x80227a3c;
w3d_fn_80227bb8 = 0x80227bb8;
w3d_fn_80227ccc = 0x80227ccc;
w3d_fn_80228038 = 0x80228038;
w3d_fn_8022982c = 0x8022982c;
w3d_fn_80229944 = 0x80229944;
w3d_fn_80229c3c = 0x80229c3c;
w3d_fn_80229cfc = 0x80229cfc;
w3d_fn_80229f70 = 0x80229f70;
w3d_fn_8022a008 = 0x8022a008;
w3d_fn_8022a13c = 0x8022a13c;
w3d_fn_8022b11c = 0x8022b11c;
w3d_fn_8022be04 = 0x8022be04;
w3d_fn_8022bea4 = 0x8022bea4;
w3d_fn_8022c058 = 0x8022c058;
w3d_fn_8022c0f8 = 0x8022c0f8;
w3d_fn_8022c2ac = 0x8022c2ac;
w3d_fn_8022c414 = 0x8022c414;
w3d_fn_8022c81c = 0x8022c81c;
w3d_fn_8022c92c = 0x8022c92c;
w3d_fn_8022cc04 = 0x8022cc04;
w3d_fn_8022cca4 = 0x8022cca4;
w3d_fn_8022ce58 = 0x8022ce58;
w3d_fn_8022d0c0 = 0x8022d0c0;
SECTIONS {
  .text.w3d_registry_release_8022e240 0x8022e240 : { *(.text.w3d_registry_release_8022e240) }
  .text.w3d_registry_release_8022e29c 0x8022e29c : { *(.text.w3d_registry_release_8022e29c) }
  .text.w3d_registry_release_8022e2f8 0x8022e2f8 : { *(.text.w3d_registry_release_8022e2f8) }
  .text.w3d_registry_release_8022e354 0x8022e354 : { *(.text.w3d_registry_release_8022e354) }
  .text.w3d_registry_release_8022e3b0 0x8022e3b0 : { *(.text.w3d_registry_release_8022e3b0) }
  .text.w3d_registry_release_8022e40c 0x8022e40c : { *(.text.w3d_registry_release_8022e40c) }
  .text.w3d_registry_release_8022e468 0x8022e468 : { *(.text.w3d_registry_release_8022e468) }
  .text.w3d_registry_release_8022e4c4 0x8022e4c4 : { *(.text.w3d_registry_release_8022e4c4) }
  .text.w3d_registry_release_8022e520 0x8022e520 : { *(.text.w3d_registry_release_8022e520) }
  .text.w3d_registry_release_8022e57c 0x8022e57c : { *(.text.w3d_registry_release_8022e57c) }
  .text.w3d_registry_release_8022e5d8 0x8022e5d8 : { *(.text.w3d_registry_release_8022e5d8) }
  .text.w3d_registry_release_8022e634 0x8022e634 : { *(.text.w3d_registry_release_8022e634) }
  .text.w3d_registry_release_8022e690 0x8022e690 : { *(.text.w3d_registry_release_8022e690) }
  .text.w3d_registry_release_8022e6ec 0x8022e6ec : { *(.text.w3d_registry_release_8022e6ec) }
  .text.w3d_registry_release_8022e748 0x8022e748 : { *(.text.w3d_registry_release_8022e748) }
  .text.w3d_registry_release_8022e7a4 0x8022e7a4 : { *(.text.w3d_registry_release_8022e7a4) }
  .text.w3d_registry_release_8022e800 0x8022e800 : { *(.text.w3d_registry_release_8022e800) }
  .text.w3d_registry_release_8022e85c 0x8022e85c : { *(.text.w3d_registry_release_8022e85c) }
  .text.w3d_registry_release_8022e8b8 0x8022e8b8 : { *(.text.w3d_registry_release_8022e8b8) }
  .text.w3d_registry_release_8022e914 0x8022e914 : { *(.text.w3d_registry_release_8022e914) }
  .text.w3d_registry_release_8022e970 0x8022e970 : { *(.text.w3d_registry_release_8022e970) }
  .text.w3d_registry_release_8022e9cc 0x8022e9cc : { *(.text.w3d_registry_release_8022e9cc) }
  .text.w3d_registry_release_8022ea28 0x8022ea28 : { *(.text.w3d_registry_release_8022ea28) }
  .text.w3d_registry_release_8022ea84 0x8022ea84 : { *(.text.w3d_registry_release_8022ea84) }
  .text.w3d_registry_release_8022eae0 0x8022eae0 : { *(.text.w3d_registry_release_8022eae0) }
  .text.w3d_registry_release_8022eb3c 0x8022eb3c : { *(.text.w3d_registry_release_8022eb3c) }
  .text.w3d_registry_release_8022eb98 0x8022eb98 : { *(.text.w3d_registry_release_8022eb98) }
  .text.w3d_registry_release_8022ebf4 0x8022ebf4 : { *(.text.w3d_registry_release_8022ebf4) }
  .text.w3d_registry_release_8022ec50 0x8022ec50 : { *(.text.w3d_registry_release_8022ec50) }
  .text.w3d_registry_release_8022ecac 0x8022ecac : { *(.text.w3d_registry_release_8022ecac) }
  .text.w3d_registry_release_8022ed08 0x8022ed08 : { *(.text.w3d_registry_release_8022ed08) }
  .text.w3d_registry_release_8022ed64 0x8022ed64 : { *(.text.w3d_registry_release_8022ed64) }
  .text.w3d_registry_release_8022edc0 0x8022edc0 : { *(.text.w3d_registry_release_8022edc0) }
  .text.w3d_set_8022ee1c 0x8022ee1c : { *(.text.w3d_set_8022ee1c) }
  .text.w3d_get_8022ee24 0x8022ee24 : { *(.text.w3d_get_8022ee24) }
  .text.w3d_set_8022ee2c 0x8022ee2c : { *(.text.w3d_set_8022ee2c) }
  .text.w3d_get_8022ee34 0x8022ee34 : { *(.text.w3d_get_8022ee34) }
  .text.w3d_set_8022f6ec 0x8022f6ec : { *(.text.w3d_set_8022f6ec) }
  .text.w3d_get_8022f6f4 0x8022f6f4 : { *(.text.w3d_get_8022f6f4) }
  .text.w3d_set_8022f6fc 0x8022f6fc : { *(.text.w3d_set_8022f6fc) }
  .text.w3d_get_8022f704 0x8022f704 : { *(.text.w3d_get_8022f704) }
  .text.w3d_set_8022f70c 0x8022f70c : { *(.text.w3d_set_8022f70c) }
  .text.w3d_get_8022f714 0x8022f714 : { *(.text.w3d_get_8022f714) }
  .text.w3d_set_8022f72c 0x8022f72c : { *(.text.w3d_set_8022f72c) }
  .text.w3d_get_8022f734 0x8022f734 : { *(.text.w3d_get_8022f734) }
  .text.w3d_set_8022f81c 0x8022f81c : { *(.text.w3d_set_8022f81c) }
  .text.w3d_get_8022f824 0x8022f824 : { *(.text.w3d_get_8022f824) }
  .text.w3d_set_8022fbd0 0x8022fbd0 : { *(.text.w3d_set_8022fbd0) }
  .text.w3d_get_8022fbd8 0x8022fbd8 : { *(.text.w3d_get_8022fbd8) }
  .text.w3d_set_8022fbe0 0x8022fbe0 : { *(.text.w3d_set_8022fbe0) }
  .text.w3d_get_8022fbe8 0x8022fbe8 : { *(.text.w3d_get_8022fbe8) }
  .text.w3d_set_80230290 0x80230290 : { *(.text.w3d_set_80230290) }
  .text.w3d_get_80230298 0x80230298 : { *(.text.w3d_get_80230298) }
  .text.w3d_set_802304d0 0x802304d0 : { *(.text.w3d_set_802304d0) }
  .text.w3d_get_802304d8 0x802304d8 : { *(.text.w3d_get_802304d8) }
  .text.w3d_set_802304e0 0x802304e0 : { *(.text.w3d_set_802304e0) }
  .text.w3d_get_802304e8 0x802304e8 : { *(.text.w3d_get_802304e8) }
  .text.w3d_set_802304f0 0x802304f0 : { *(.text.w3d_set_802304f0) }
  .text.w3d_get_802304f8 0x802304f8 : { *(.text.w3d_get_802304f8) }
  .text.w3d_set_80230500 0x80230500 : { *(.text.w3d_set_80230500) }
  .text.w3d_get_80230508 0x80230508 : { *(.text.w3d_get_80230508) }
  .text.w3d_set_80230660 0x80230660 : { *(.text.w3d_set_80230660) }
  .text.w3d_get_80230668 0x80230668 : { *(.text.w3d_get_80230668) }
  .text.w3d_set_80230670 0x80230670 : { *(.text.w3d_set_80230670) }
  .text.w3d_get_80230678 0x80230678 : { *(.text.w3d_get_80230678) }
  .text.w3d_set_80230690 0x80230690 : { *(.text.w3d_set_80230690) }
  .text.w3d_get_80230698 0x80230698 : { *(.text.w3d_get_80230698) }
  .text.w3d_set_802306a0 0x802306a0 : { *(.text.w3d_set_802306a0) }
  .text.w3d_get_802306a8 0x802306a8 : { *(.text.w3d_get_802306a8) }
  .text.w3d_set_802306c4 0x802306c4 : { *(.text.w3d_set_802306c4) }
  .text.w3d_get_802306cc 0x802306cc : { *(.text.w3d_get_802306cc) }
  .text.w3d_set_802307b4 0x802307b4 : { *(.text.w3d_set_802307b4) }
  .text.w3d_get_802307bc 0x802307bc : { *(.text.w3d_get_802307bc) }
  .text.w3d_set_802307c4 0x802307c4 : { *(.text.w3d_set_802307c4) }
  .text.w3d_get_802307cc 0x802307cc : { *(.text.w3d_get_802307cc) }
  .text.w3d_set_802307d4 0x802307d4 : { *(.text.w3d_set_802307d4) }
  .text.w3d_get_802307dc 0x802307dc : { *(.text.w3d_get_802307dc) }
  .text.w3d_set_802307f4 0x802307f4 : { *(.text.w3d_set_802307f4) }
  .text.w3d_get_802307fc 0x802307fc : { *(.text.w3d_get_802307fc) }
  .text.w3d_set_80230804 0x80230804 : { *(.text.w3d_set_80230804) }
  /DISCARD/ : { *(.text*) *(.rodata*) *(.data*) *(.bss*) *(.sdata*) *(.sbss*) *(.comment) }
}
