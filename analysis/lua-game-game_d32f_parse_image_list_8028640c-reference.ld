/* Generated reference-only placements. All bodies are source-built. */
OUTPUT_FORMAT("elf32-powerpc")
OUTPUT_ARCH(powerpc)
ENTRY(d32f_parse_image_list_8028640c)
_SDA_BASE_ = 0x804b2540;
_SDA2_BASE_ = 0x804c2540;
_S_oom_malloc__Q24_STLt14__malloc_alloc1i0Ui = 0x803413d8;
__15String_803426b8 = 0x803426b8;
atol = 0x802ed8c4;
fn_80285ee0 = 0x80285ee0;
fn_802b1510 = 0x802b1510;
free = 0x802134fc;
lbl_803cf418 = 0x803cf418;
lbl_803cf460 = 0x803cf460;
lbl_803cf494 = 0x803cf494;
lbl_803cf498 = 0x803cf498;
malloc = 0x80212fd4;
sol35d12_assign_8020c0fc = 0x8020c0fc;
strcspn = 0x802ef380;
w3d_cx11b_string_truncate_8020c3a0 = 0x8020c3a0;
w3d_string_assign = 0x8020bd38;
w3d_string_base_finish = 0x8020c5c4;
w3d_string_base_init = 0x8020c5c0;
w3d_string_format = 0x8020c510;
w3d_string_header = 0x80341884;
w3d_string_release = 0x80341588;
w3d_string_release_header = 0x8020bb2c;
SECTIONS {
  .text.d32f_parse_image_list_8028640c 0x8028640c : { *(.text.d32f_parse_image_list_8028640c) }
  /DISCARD/ : { *(.text*) *(.rodata*) *(.data*) *(.bss*) *(.sdata*) *(.sbss*) *(.comment) }
}
