/* Generated reference-only placements. All bodies are source-built. */
OUTPUT_FORMAT("elf32-powerpc")
OUTPUT_ARCH(powerpc)
ENTRY(w3d_strassign_80249bac)
_SDA_BASE_ = 0x804b2540;
_SDA2_BASE_ = 0x804c2540;
w3d_fn_801ea70c = 0x801ea70c;
w3d_fn_8024838c = 0x8024838c;
w3d_fn_8024bc08 = 0x8024bc08;
w3d_fn_8024cd0c = 0x8024cd0c;
w3d_fn_8024cec0 = 0x8024cec0;
w3d_fn_8024d4c0 = 0x8024d4c0;
w3d_fn_8024d93c = 0x8024d93c;
w3d_fn_8024dac8 = 0x8024dac8;
w3d_fn_8024df2c = 0x8024df2c;
w3d_fn_8024e980 = 0x8024e980;
w3d_fn_8024ee58 = 0x8024ee58;
w3d_fn_8024f174 = 0x8024f174;
w3d_fn_8024f3d4 = 0x8024f3d4;
w3d_fn_8024f630 = 0x8024f630;
w3d_fn_8024f8c4 = 0x8024f8c4;
w3d_fn_8024fb58 = 0x8024fb58;
w3d_fn_80250050 = 0x80250050;
w3d_fn_802502ac = 0x802502ac;
w3d_fn_80250444 = 0x80250444;
w3d_fn_80251f40 = 0x80251f40;
w3d_fn_80253330 = 0x80253330;
w3d_fn_80255120 = 0x80255120;
w3d_fn_80255354 = 0x80255354;
w3d_fn_802555b0 = 0x802555b0;
w3d_fn_80255ddc = 0x80255ddc;
w3d_fn_8025693c = 0x8025693c;
w3d_fn_80256fac = 0x80256fac;
w3d_fn_80257528 = 0x80257528;
w3d_registry_list_80367dd8 = 0x80367dd8;
w3d_registry_list_80367e28 = 0x80367e28;
w3d_registry_list_80367e78 = 0x80367e78;
w3d_registry_list_80367ec8 = 0x80367ec8;
w3d_registry_list_80367f18 = 0x80367f18;
w3d_registry_list_80367f68 = 0x80367f68;
w3d_registry_list_80367fb8 = 0x80367fb8;
w3d_registry_list_80368008 = 0x80368008;
w3d_registry_list_80368058 = 0x80368058;
w3d_registry_list_803680a8 = 0x803680a8;
w3d_registry_list_803680f8 = 0x803680f8;
w3d_registry_list_80368148 = 0x80368148;
w3d_registry_list_80368198 = 0x80368198;
w3d_registry_list_803681e8 = 0x803681e8;
w3d_registry_list_80368238 = 0x80368238;
w3d_registry_list_80368288 = 0x80368288;
w3d_registry_list_803682d8 = 0x803682d8;
w3d_registry_list_80368328 = 0x80368328;
w3d_registry_list_80368378 = 0x80368378;
w3d_registry_list_803683c8 = 0x803683c8;
w3d_registry_list_80368418 = 0x80368418;
w3d_registry_list_80368468 = 0x80368468;
w3d_registry_list_803684b8 = 0x803684b8;
w3d_registry_list_80368508 = 0x80368508;
w3d_registry_list_80368558 = 0x80368558;
w3d_state_register = 0x8020fd04;
w3d_string_release_header = 0x8020bb2c;
SECTIONS {
  .text.w3d_strassign_80249bac 0x80249bac : { *(.text.w3d_strassign_80249bac) }
  .text.w3d_strassign_80249c2c 0x80249c2c : { *(.text.w3d_strassign_80249c2c) }
  .text.w3d_strassign_80249c9c 0x80249c9c : { *(.text.w3d_strassign_80249c9c) }
  .text.w3d_strassign_80249e3c 0x80249e3c : { *(.text.w3d_strassign_80249e3c) }
  .text.w3d_strassign_80249eac 0x80249eac : { *(.text.w3d_strassign_80249eac) }
  .text.w3d_strassign_80249f2c 0x80249f2c : { *(.text.w3d_strassign_80249f2c) }
  .text.w3d_strassign_8024a910 0x8024a910 : { *(.text.w3d_strassign_8024a910) }
  .text.w3d_strassign_8024aa40 0x8024aa40 : { *(.text.w3d_strassign_8024aa40) }
  .text.w3d_strassign_8024aab0 0x8024aab0 : { *(.text.w3d_strassign_8024aab0) }
  .text.w3d_strassign_8024b358 0x8024b358 : { *(.text.w3d_strassign_8024b358) }
  .text.w3d_strassign_8024b3c8 0x8024b3c8 : { *(.text.w3d_strassign_8024b3c8) }
  .text.w3d_strassign_8024b438 0x8024b438 : { *(.text.w3d_strassign_8024b438) }
  .text.w3d_strassign_8024b4a8 0x8024b4a8 : { *(.text.w3d_strassign_8024b4a8) }
  .text.w3d_static_init_8024bb24 0x8024bb24 : { *(.text.w3d_static_init_8024bb24) }
  .text.w3d_registry_create_typed_8024bb5c 0x8024bb5c : { *(.text.w3d_registry_create_typed_8024bb5c) }
  .text.w3d_registry_create_typed_8024cc60 0x8024cc60 : { *(.text.w3d_registry_create_typed_8024cc60) }
  .text.w3d_registry_create_typed_8024ce14 0x8024ce14 : { *(.text.w3d_registry_create_typed_8024ce14) }
  .text.w3d_registry_create_typed_8024d414 0x8024d414 : { *(.text.w3d_registry_create_typed_8024d414) }
  .text.w3d_registry_create_typed_8024d890 0x8024d890 : { *(.text.w3d_registry_create_typed_8024d890) }
  .text.w3d_registry_create_typed_8024da1c 0x8024da1c : { *(.text.w3d_registry_create_typed_8024da1c) }
  .text.w3d_registry_create_typed_8024de80 0x8024de80 : { *(.text.w3d_registry_create_typed_8024de80) }
  .text.w3d_registry_create_typed_8024e8d4 0x8024e8d4 : { *(.text.w3d_registry_create_typed_8024e8d4) }
  .text.w3d_registry_create_typed_8024edac 0x8024edac : { *(.text.w3d_registry_create_typed_8024edac) }
  .text.w3d_registry_create_typed_8024f0c8 0x8024f0c8 : { *(.text.w3d_registry_create_typed_8024f0c8) }
  .text.w3d_registry_create_typed_8024f328 0x8024f328 : { *(.text.w3d_registry_create_typed_8024f328) }
  .text.w3d_registry_create_typed_8024f584 0x8024f584 : { *(.text.w3d_registry_create_typed_8024f584) }
  .text.w3d_registry_create_typed_8024f818 0x8024f818 : { *(.text.w3d_registry_create_typed_8024f818) }
  .text.w3d_registry_create_typed_8024faac 0x8024faac : { *(.text.w3d_registry_create_typed_8024faac) }
  .text.w3d_registry_create_typed_8024ffa4 0x8024ffa4 : { *(.text.w3d_registry_create_typed_8024ffa4) }
  .text.w3d_registry_create_typed_80250200 0x80250200 : { *(.text.w3d_registry_create_typed_80250200) }
  .text.w3d_strassign_8025170c 0x8025170c : { *(.text.w3d_strassign_8025170c) }
  .text.w3d_strassign_8025177c 0x8025177c : { *(.text.w3d_strassign_8025177c) }
  .text.w3d_strassign_8025188c 0x8025188c : { *(.text.w3d_strassign_8025188c) }
  .text.w3d_strassign_80251b08 0x80251b08 : { *(.text.w3d_strassign_80251b08) }
  .text.w3d_strassign_80251b78 0x80251b78 : { *(.text.w3d_strassign_80251b78) }
  .text.w3d_static_init_80251e5c 0x80251e5c : { *(.text.w3d_static_init_80251e5c) }
  .text.w3d_registry_create_typed_80251e94 0x80251e94 : { *(.text.w3d_registry_create_typed_80251e94) }
  .text.w3d_registry_create_typed_80253284 0x80253284 : { *(.text.w3d_registry_create_typed_80253284) }
  .text.w3d_registry_create_typed_80255074 0x80255074 : { *(.text.w3d_registry_create_typed_80255074) }
  .text.w3d_registry_create_typed_802552a8 0x802552a8 : { *(.text.w3d_registry_create_typed_802552a8) }
  .text.w3d_registry_create_typed_80255504 0x80255504 : { *(.text.w3d_registry_create_typed_80255504) }
  .text.w3d_registry_create_typed_80255d30 0x80255d30 : { *(.text.w3d_registry_create_typed_80255d30) }
  .text.w3d_registry_create_typed_80256890 0x80256890 : { *(.text.w3d_registry_create_typed_80256890) }
  .text.w3d_registry_create_typed_80256f00 0x80256f00 : { *(.text.w3d_registry_create_typed_80256f00) }
  .text.w3d_registry_create_typed_8025747c 0x8025747c : { *(.text.w3d_registry_create_typed_8025747c) }
  .text.w3d_strassign_80257ef4 0x80257ef4 : { *(.text.w3d_strassign_80257ef4) }
  .text.w3d_strassign_80257f64 0x80257f64 : { *(.text.w3d_strassign_80257f64) }
  .text.w3d_strassign_80257fd4 0x80257fd4 : { *(.text.w3d_strassign_80257fd4) }
  .text.w3d_strassign_80258044 0x80258044 : { *(.text.w3d_strassign_80258044) }
  .text.w3d_strassign_802580b4 0x802580b4 : { *(.text.w3d_strassign_802580b4) }
  .text.w3d_strassign_80258124 0x80258124 : { *(.text.w3d_strassign_80258124) }
  .text.w3d_strassign_80258194 0x80258194 : { *(.text.w3d_strassign_80258194) }
  .text.w3d_strassign_802582a4 0x802582a4 : { *(.text.w3d_strassign_802582a4) }
  .text.w3d_strassign_80258314 0x80258314 : { *(.text.w3d_strassign_80258314) }
  .text.w3d_strassign_80258384 0x80258384 : { *(.text.w3d_strassign_80258384) }
  .text.w3d_strassign_802583f4 0x802583f4 : { *(.text.w3d_strassign_802583f4) }
  .text.w3d_strassign_80258464 0x80258464 : { *(.text.w3d_strassign_80258464) }
  .text.w3d_strassign_802584d4 0x802584d4 : { *(.text.w3d_strassign_802584d4) }
  .text.w3d_strassign_80258544 0x80258544 : { *(.text.w3d_strassign_80258544) }
  .text.w3d_strassign_802585b4 0x802585b4 : { *(.text.w3d_strassign_802585b4) }
  .text.w3d_strassign_80258624 0x80258624 : { *(.text.w3d_strassign_80258624) }
  .text.w3d_strassign_80258694 0x80258694 : { *(.text.w3d_strassign_80258694) }
  .text.w3d_strassign_80258704 0x80258704 : { *(.text.w3d_strassign_80258704) }
  .text.w3d_strassign_80258774 0x80258774 : { *(.text.w3d_strassign_80258774) }
  .text.w3d_strassign_802587e4 0x802587e4 : { *(.text.w3d_strassign_802587e4) }
  .text.w3d_strassign_80258854 0x80258854 : { *(.text.w3d_strassign_80258854) }
  .text.w3d_strassign_802588c4 0x802588c4 : { *(.text.w3d_strassign_802588c4) }
  .text.w3d_strassign_80258a54 0x80258a54 : { *(.text.w3d_strassign_80258a54) }
  .text.w3d_strassign_80258ae4 0x80258ae4 : { *(.text.w3d_strassign_80258ae4) }
  .text.w3d_strassign_80258b54 0x80258b54 : { *(.text.w3d_strassign_80258b54) }
  .text.w3d_strassign_80258bc4 0x80258bc4 : { *(.text.w3d_strassign_80258bc4) }
  .text.w3d_strassign_80258c34 0x80258c34 : { *(.text.w3d_strassign_80258c34) }
  .text.w3d_strassign_80258ca4 0x80258ca4 : { *(.text.w3d_strassign_80258ca4) }
  .text.w3d_strassign_80258d14 0x80258d14 : { *(.text.w3d_strassign_80258d14) }
  .text.w3d_strassign_80258fec 0x80258fec : { *(.text.w3d_strassign_80258fec) }
  .text.w3d_strassign_8025905c 0x8025905c : { *(.text.w3d_strassign_8025905c) }
  .text.w3d_strassign_802590cc 0x802590cc : { *(.text.w3d_strassign_802590cc) }
  .text.w3d_strassign_8025913c 0x8025913c : { *(.text.w3d_strassign_8025913c) }
  .text.w3d_strassign_802591ac 0x802591ac : { *(.text.w3d_strassign_802591ac) }
  .text.w3d_strassign_8025921c 0x8025921c : { *(.text.w3d_strassign_8025921c) }
  /DISCARD/ : { *(.text*) *(.rodata*) *(.data*) *(.bss*) *(.sdata*) *(.sbss*) *(.comment) }
}
