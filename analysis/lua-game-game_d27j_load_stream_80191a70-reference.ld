/* Generated reference-only placements. All bodies are source-built. */
OUTPUT_FORMAT("elf32-powerpc")
OUTPUT_ARCH(powerpc)
ENTRY(d27j_load_stream_80191a70)
_SDA_BASE_ = 0x804b2540;
_SDA2_BASE_ = 0x804c2540;
fn_80197c8c = 0x80197c8c;
fn_80197ce4 = 0x80197ce4;
fn_80197d78 = 0x80197d78;
fn_80197dd4 = 0x80197dd4;
fn_80197e08 = 0x80197e08;
fn_80197f0c = 0x80197f0c;
fn_8020c5c4 = 0x8020c5c4;
fn_80341588 = 0x80341588;
fn_803426b8 = 0x803426b8;
fn_8034f190 = 0x8034f190;
SECTIONS {
  .text.d27j_load_stream_80191a70 0x80191a70 : { *(.text.d27j_load_stream_80191a70) }
  /DISCARD/ : { *(.text*) *(.rodata*) *(.data*) *(.bss*) *(.sdata*) *(.sbss*) *(.comment) }
}
