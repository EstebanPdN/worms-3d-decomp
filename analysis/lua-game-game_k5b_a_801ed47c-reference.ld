/* Generated reference-only placements. All bodies are source-built. */
OUTPUT_FORMAT("elf32-powerpc")
OUTPUT_ARCH(powerpc)
ENTRY(w3d_k5b_binding_write_object_801ed47c)
_SDA_BASE_ = 0x804b2540;
_SDA2_BASE_ = 0x804c2540;
lbl_8040c970 = 0x8040c970;
SECTIONS {
  .text.w3d_k5b_binding_write_object_801ed47c 0x801ed47c : { *(.text.w3d_k5b_binding_write_object_801ed47c) }
  /DISCARD/ : { *(.text*) *(.rodata*) *(.data*) *(.bss*) *(.sdata*) *(.sbss*) *(.comment) }
}
