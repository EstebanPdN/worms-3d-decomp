/* Generated reference-only placements. All bodies are source-built. */
OUTPUT_FORMAT("elf32-powerpc")
OUTPUT_ARCH(powerpc)
ENTRY(s9_release_video_buffer_8016e698)
_SDA_BASE_ = 0x804b2540;
_SDA2_BASE_ = 0x804c2540;
fn_801fe2e0 = 0x801fe2e0;
fn_802fb7ac = 0x802fb7ac;
lbl_803a6398 = 0x803a6398;
SECTIONS {
  .text.s9_release_video_buffer_8016e698 0x8016e698 : { *(.text.s9_release_video_buffer_8016e698) }
  /DISCARD/ : { *(.text*) *(.rodata*) *(.data*) *(.bss*) *(.sdata*) *(.sbss*) *(.comment) }
}
